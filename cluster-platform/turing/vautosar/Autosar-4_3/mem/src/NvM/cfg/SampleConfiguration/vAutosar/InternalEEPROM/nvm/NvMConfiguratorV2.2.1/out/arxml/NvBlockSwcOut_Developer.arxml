AUTOSAR XML (schema 4-2-1)
package /ComponentTypes
  nv block sw component type NvBlockSwComponentType
    50 x provide/require port:
      Sample_Element_1: nv-provide-com-spec{ram-block-init-value=15 x 1, rom-block-init-value=15 x 1, variable=Sample_Element_1/Value}, nv-require-com-spec=init-value=15 x 1, provided-required-interface=Sample_Element_1
      Sample_Element_10: nv-provide-com-spec{ram-block-init-value=999, rom-block-init-value=999, variable=Sample_Element_10/Value}, nv-require-com-spec=init-value=999, provided-required-interface=Sample_Element_10
      Sample_Element_11: nv-provide-com-spec{ram-block-init-value=5 x 3, rom-block-init-value=5 x 3, variable=Sample_Element_11/Value}, nv-require-com-spec=init-value=5 x 3, provided-required-interface=Sample_Element_11
      Sample_Element_12: nv-provide-com-spec{ram-block-init-value=5 x 0, rom-block-init-value=5 x 0, variable=Sample_Element_12/Value}, nv-require-com-spec=init-value=5 x 0, provided-required-interface=Sample_Element_12
      Sample_Element_13: nv-provide-com-spec{ram-block-init-value=18 x 5 x 0, rom-block-init-value=18 x 5 x 0, variable=Sample_Element_13/Value}, nv-require-com-spec=init-value=18 x 5 x 0, provided-required-interface=Sample_Element_13
      Sample_Element_14:
        nv-provide-com-spec{ram-block-init-value=[[0, 3, 6, 10, 17, 366], [3, 5, 10, 15, 23, 366], [5, 9, 14, 21, 31, 366], [10, 14, 21, 30, 42, 366], [15, 21, 30, 41, 56, 366], [23, 31, 42, 56, 74, 366], [34, 45, 58, 75, 97, 366], [49, 63, 80, 101, 127, 366], [71, 88, 109, 134, 166, 366], [101, 122, 148, 179, 216, 366], [143, 169, 201, 237, 281, 366], [201, 234, 271, 315, 366, 366], [366, 391, 418, 446, 477, 510], [418, 447, 479, 512, 548, 586], [446, 485, 527, 572, 621, 674], [477, 526, 580, 639, 704, 775], [490, 555, 630, 714, 809, 917], [510, 586, 674, 775, 891, 1024]], rom-block-init-value=[[0, 3, 6, 10, 17, 366], [3, 5, 10, 15, 23, 366], [5, 9, 14, 21, 31, 366], [10, 14, 21, 30, 42, 366], [15, 21, 30, 41, 56, 366], [23, 31, 42, 56, 74, 366], [34, 45, 58, 75, 97, 366], [49, 63, 80, 101, 127, 366], [71, 88, 109, 134, 166, 366], [101, 122, 148, 179, 216, 366], [143, 169, 201, 237, 281, 366], [201, 234, 271, 315, 366, 366], [366, 391, 418, 446, 477, 510], [418, 447, 479, 512, 548, 586], [446, 485, 527, 572, 621, 674], [477, 526, 580, 639, 704, 775], [490, 555, 630, 714, 809, 917], [510, 586, 674, 775, 891, 1024]], variable=Sample_Element_14/Value}
        nv-require-com-spec=init-value=[[0, 3, 6, 10, 17, 366], [3, 5, 10, 15, 23, 366], [5, 9, 14, 21, 31, 366], [10, 14, 21, 30, 42, 366], [15, 21, 30, 41, 56, 366], [23, 31, 42, 56, 74, 366], [34, 45, 58, 75, 97, 366], [49, 63, 80, 101, 127, 366], [71, 88, 109, 134, 166, 366], [101, 122, 148, 179, 216, 366], [143, 169, 201, 237, 281, 366], [201, 234, 271, 315, 366, 366], [366, 391, 418, 446, 477, 510], [418, 447, 479, 512, 548, 586], [446, 485, 527, 572, 621, 674], [477, 526, 580, 639, 704, 775], [490, 555, 630, 714, 809, 917], [510, 586, 674, 775, 891, 1024]]
        provided-required-interface=Sample_Element_14
      Sample_Element_15: nv-provide-com-spec{ram-block-init-value=[0, 0, 0, 0], rom-block-init-value=[0, 0, 0, 0], variable=Sample_Element_15/Value}, nv-require-com-spec=init-value=[0, 0, 0, 0], provided-required-interface=Sample_Element_15
      Sample_Element_16: nv-provide-com-spec{ram-block-init-value=[10 x 0, 10 x 0, 10 x 0], rom-block-init-value=[10 x 0, 10 x 0, 10 x 0], variable=Sample_Element_16/Value}, nv-require-com-spec=init-value=[10 x 0, 10 x 0, 10 x 0], provided-required-interface=Sample_Element_16
      Sample_Element_17: nv-provide-com-spec{ram-block-init-value=fields=[a1_u8:0, a2_u8:0, a3_u8_4:[0, 0, 0, 0], a4_u32:0], rom-block-init-value=fields=[a1_u8:0, a2_u8:0, a3_u8_4:[0, 0, 0, 0], a4_u32:0], variable=Sample_Element_17/Value}, nv-require-com-spec=init-value=fields=[a1_u8:0, a2_u8:0, a3_u8_4:[0, 0, 0, 0], a4_u32:0], provided-required-interface=Sample_Element_17
      Sample_Element_18: nv-provide-com-spec{ram-block-init-value=395, rom-block-init-value=395, variable=Sample_Element_18/Value}, nv-require-com-spec=init-value=395, provided-required-interface=Sample_Element_18
      Sample_Element_19: nv-provide-com-spec{ram-block-init-value=155, rom-block-init-value=155, variable=Sample_Element_19/Value}, nv-require-com-spec=init-value=155, provided-required-interface=Sample_Element_19
      Sample_Element_2:
        nv-provide-com-spec{ram-block-init-value=[0, 64, 128, 192, 0, 64, 128, 192, 0, 64, 128, 192, 0, 64, 128, 192, 255, 0, 85, 170, 255, 3, 0, 0, 0, 0, 0, 0, 64, 128, 192, 0, 64, 128, 192, 0, 64, 128, 192, 0, 64, 128, 192, 255, 0, 85, 170, 255, 3, 0, 0, 0, 0, 0, 0, 64, 128, 192, 0, 64, 128, 192, 0, 64, 128, 192, 0, 64, 128, 192, 255, 0, 85, 170, 255, 3, 0, 0, 0, 0, 0, 96, 140, 178, 210, 238, 56, 102, 146, 202, 2, 52, 122, 168, 220, 46, 72, 111, 144, 208, 0, 84, 169, 250, 63, 96, 140, 178, 210, 238, 56, 102, 146, 202, 2, 52, 122, 168, 220, 46, 72, 111, 144, 208, 0, 84, 169, 250, 63, 96, 140, 178, 210, 238, 56, 102, 146, 202, 2, 52, 122, 168, 220, 46, 72, 111, 144, 208, 0, 84, 169, 250, 63, 96, 140, 178, 210, 238, 56, 102, 146, 202, 2, 52, 122, 168, 220, 46, 72, 111, 144, 208, 0, 84, 169, 250, 63, 96, 140, 178, 210, 238, 56, 102, 146, 202, 2, 52, 122, 168, 220, 46, 72, 111, 144, 208, 0, 84, 169, 250, 63, 96, 140, 178, 210, 238, 56, 102, 146, 202, 2, 52, 122, 168, 220, 46, 72, 111, 144, 208, 0, 84, 169, 250, 63, 255, 255, 255, 255, 255, 255, 255, 255, 255, 255, 255, 255, 255, 255, 255, 255, 255, 175, 216], rom-block-init-value=[0, 64, 128, 192, 0, 64, 128, 192, 0, 64, 128, 192, 0, 64, 128, 192, 255, 0, 85, 170, 255, 3, 0, 0, 0, 0, 0, 0, 64, 128, 192, 0, 64, 128, 192, 0, 64, 128, 192, 0, 64, 128, 192, 255, 0, 85, 170, 255, 3, 0, 0, 0, 0, 0, 0, 64, 128, 192, 0, 64, 128, 192, 0, 64, 128, 192, 0, 64, 128, 192, 255, 0, 85, 170, 255, 3, 0, 0, 0, 0, 0, 96, 140, 178, 210, 238, 56, 102, 146, 202, 2, 52, 122, 168, 220, 46, 72, 111, 144, 208, 0, 84, 169, 250, 63, 96, 140, 178, 210, 238, 56, 102, 146, 202, 2, 52, 122, 168, 220, 46, 72, 111, 144, 208, 0, 84, 169, 250, 63, 96, 140, 178, 210, 238, 56, 102, 146, 202, 2, 52, 122, 168, 220, 46, 72, 111, 144, 208, 0, 84, 169, 250, 63, 96, 140, 178, 210, 238, 56, 102, 146, 202, 2, 52, 122, 168, 220, 46, 72, 111, 144, 208, 0, 84, 169, 250, 63, 96, 140, 178, 210, 238, 56, 102, 146, 202, 2, 52, 122, 168, 220, 46, 72, 111, 144, 208, 0, 84, 169, 250, 63, 96, 140, 178, 210, 238, 56, 102, 146, 202, 2, 52, 122, 168, 220, 46, 72, 111, 144, 208, 0, 84, 169, 250, 63, 255, 255, 255, 255, 255, 255, 255, 255, 255, 255, 255, 255, 255, 255, 255, 255, 255, 175, 216], variable=Sample_Element_2/Value}
        nv-require-com-spec=init-value=[0, 64, 128, 192, 0, 64, 128, 192, 0, 64, 128, 192, 0, 64, 128, 192, 255, 0, 85, 170, 255, 3, 0, 0, 0, 0, 0, 0, 64, 128, 192, 0, 64, 128, 192, 0, 64, 128, 192, 0, 64, 128, 192, 255, 0, 85, 170, 255, 3, 0, 0, 0, 0, 0, 0, 64, 128, 192, 0, 64, 128, 192, 0, 64, 128, 192, 0, 64, 128, 192, 255, 0, 85, 170, 255, 3, 0, 0, 0, 0, 0, 96, 140, 178, 210, 238, 56, 102, 146, 202, 2, 52, 122, 168, 220, 46, 72, 111, 144, 208, 0, 84, 169, 250, 63, 96, 140, 178, 210, 238, 56, 102, 146, 202, 2, 52, 122, 168, 220, 46, 72, 111, 144, 208, 0, 84, 169, 250, 63, 96, 140, 178, 210, 238, 56, 102, 146, 202, 2, 52, 122, 168, 220, 46, 72, 111, 144, 208, 0, 84, 169, 250, 63, 96, 140, 178, 210, 238, 56, 102, 146, 202, 2, 52, 122, 168, 220, 46, 72, 111, 144, 208, 0, 84, 169, 250, 63, 96, 140, 178, 210, 238, 56, 102, 146, 202, 2, 52, 122, 168, 220, 46, 72, 111, 144, 208, 0, 84, 169, 250, 63, 96, 140, 178, 210, 238, 56, 102, 146, 202, 2, 52, 122, 168, 220, 46, 72, 111, 144, 208, 0, 84, 169, 250, 63, 255, 255, 255, 255, 255, 255, 255, 255, 255, 255, 255, 255, 255, 255, 255, 255, 255, 175, 216]
        provided-required-interface=Sample_Element_2
      Sample_Element_20: nv-provide-com-spec{ram-block-init-value=0, rom-block-init-value=0, variable=Sample_Element_20/Value}, nv-require-com-spec=init-value=0, provided-required-interface=Sample_Element_20
      Sample_Element_21: nv-provide-com-spec{ram-block-init-value=1, rom-block-init-value=1, variable=Sample_Element_21/Value}, nv-require-com-spec=init-value=1, provided-required-interface=Sample_Element_21
      Sample_Element_22: nv-provide-com-spec{ram-block-init-value=1, rom-block-init-value=1, variable=Sample_Element_22/Value}, nv-require-com-spec=init-value=1, provided-required-interface=Sample_Element_22
      Sample_Element_23: nv-provide-com-spec{ram-block-init-value=5 x 0, rom-block-init-value=5 x 0, variable=Sample_Element_23/Value}, nv-require-com-spec=init-value=5 x 0, provided-required-interface=Sample_Element_23
      Sample_Element_24:
        nv-provide-com-spec{ram-block-init-value=[768, 768, 896, 896, 1280, 2739, 3993, 6720, 9433, 12160, 12544, 12544, 12544, 12544, 12544, 0, 0, 0, 0, 0, 0, 0, 0, 0], rom-block-init-value=[768, 768, 896, 896, 1280, 2739, 3993, 6720, 9433, 12160, 12544, 12544, 12544, 12544, 12544, 0, 0, 0, 0, 0, 0, 0, 0, 0], variable=Sample_Element_24/Value}
        nv-require-com-spec=init-value=[768, 768, 896, 896, 1280, 2739, 3993, 6720, 9433, 12160, 12544, 12544, 12544, 12544, 12544, 0, 0, 0, 0, 0, 0, 0, 0, 0]
        provided-required-interface=Sample_Element_24
      Sample_Element_25:
        nv-provide-com-spec{ram-block-init-value=[[0, 19, 43, 75, 119, 335], [7, 27, 53, 87, 132, 335], [16, 37, 64, 100, 147, 335], [25, 48, 77, 114, 162, 335], [36, 60, 90, 129, 178, 335], [48, 74, 105, 145, 196, 335], [61, 89, 122, 164, 215, 335], [77, 106, 140, 183, 235, 335], [94, 124, 161, 204, 257, 335], [114, 146, 183, 228, 281, 335], [136, 169, 208, 254, 307, 335], [162, 196, 236, 281, 335, 335], [335, 361, 389, 419, 451, 486], [389, 420, 453, 488, 525, 566], [419, 459, 503, 551, 602, 658], [451, 502, 558, 620, 688, 763], [464, 533, 611, 699, 799, 911], [486, 566, 658, 763, 885, 1024]], rom-block-init-value=[[0, 19, 43, 75, 119, 335], [7, 27, 53, 87, 132, 335], [16, 37, 64, 100, 147, 335], [25, 48, 77, 114, 162, 335], [36, 60, 90, 129, 178, 335], [48, 74, 105, 145, 196, 335], [61, 89, 122, 164, 215, 335], [77, 106, 140, 183, 235, 335], [94, 124, 161, 204, 257, 335], [114, 146, 183, 228, 281, 335], [136, 169, 208, 254, 307, 335], [162, 196, 236, 281, 335, 335], [335, 361, 389, 419, 451, 486], [389, 420, 453, 488, 525, 566], [419, 459, 503, 551, 602, 658], [451, 502, 558, 620, 688, 763], [464, 533, 611, 699, 799, 911], [486, 566, 658, 763, 885, 1024]], variable=Sample_Element_25/Value}
        nv-require-com-spec=init-value=[[0, 19, 43, 75, 119, 335], [7, 27, 53, 87, 132, 335], [16, 37, 64, 100, 147, 335], [25, 48, 77, 114, 162, 335], [36, 60, 90, 129, 178, 335], [48, 74, 105, 145, 196, 335], [61, 89, 122, 164, 215, 335], [77, 106, 140, 183, 235, 335], [94, 124, 161, 204, 257, 335], [114, 146, 183, 228, 281, 335], [136, 169, 208, 254, 307, 335], [162, 196, 236, 281, 335, 335], [335, 361, 389, 419, 451, 486], [389, 420, 453, 488, 525, 566], [419, 459, 503, 551, 602, 658], [451, 502, 558, 620, 688, 763], [464, 533, 611, 699, 799, 911], [486, 566, 658, 763, 885, 1024]]
        provided-required-interface=Sample_Element_25
      Sample_Element_26: nv-provide-com-spec{ram-block-init-value=[0, 0, 0, 0], rom-block-init-value=[0, 0, 0, 0], variable=Sample_Element_26/Value}, nv-require-com-spec=init-value=[0, 0, 0, 0], provided-required-interface=Sample_Element_26
      Sample_Element_27: nv-provide-com-spec{ram-block-init-value=10 x [fields=[c1_u32:0, c2_u32:0, c3_u32:0, c4_u8:0]], rom-block-init-value=10 x [fields=[c1_u32:0, c2_u32:0, c3_u32:0, c4_u8:0]], variable=Sample_Element_27/Value}, nv-require-com-spec=init-value=10 x [fields=[c1_u32:0, c2_u32:0, c3_u32:0, c4_u8:0]], provided-required-interface=Sample_Element_27
      Sample_Element_28: nv-provide-com-spec{ram-block-init-value=0, rom-block-init-value=0, variable=Sample_Element_28/Value}, nv-require-com-spec=init-value=0, provided-required-interface=Sample_Element_28
      Sample_Element_29: nv-provide-com-spec{ram-block-init-value=2147483647, rom-block-init-value=2147483647, variable=Sample_Element_29/Value}, nv-require-com-spec=init-value=2147483647, provided-required-interface=Sample_Element_29
      Sample_Element_3: nv-provide-com-spec{ram-block-init-value=29 x 0, rom-block-init-value=29 x 0, variable=Sample_Element_3/Value}, nv-require-com-spec=init-value=29 x 0, provided-required-interface=Sample_Element_3
      Sample_Element_30: nv-provide-com-spec{ram-block-init-value=5 x 6, rom-block-init-value=5 x 6, variable=Sample_Element_30/Value}, nv-require-com-spec=init-value=5 x 6, provided-required-interface=Sample_Element_30
      Sample_Element_31: nv-provide-com-spec{ram-block-init-value=[1000, 1000], rom-block-init-value=[1000, 1000], variable=Sample_Element_31/Value}, nv-require-com-spec=init-value=[1000, 1000], provided-required-interface=Sample_Element_31
      Sample_Element_32: nv-provide-com-spec{ram-block-init-value=0, rom-block-init-value=0, variable=Sample_Element_32/Value}, nv-require-com-spec=init-value=0, provided-required-interface=Sample_Element_32
      Sample_Element_33: nv-provide-com-spec{ram-block-init-value=2147483647, rom-block-init-value=2147483647, variable=Sample_Element_33/Value}, nv-require-com-spec=init-value=2147483647, provided-required-interface=Sample_Element_33
      Sample_Element_34: nv-provide-com-spec{ram-block-init-value=0, rom-block-init-value=0, variable=Sample_Element_34/Value}, nv-require-com-spec=init-value=0, provided-required-interface=Sample_Element_34
      Sample_Element_35: nv-provide-com-spec{ram-block-init-value=10 x [fields=[c1_u32:0, c2_u32:0, c3_u32:0, c4_u8:0]], rom-block-init-value=10 x [fields=[c1_u32:0, c2_u32:0, c3_u32:0, c4_u8:0]], variable=Sample_Element_35/Value}, nv-require-com-spec=init-value=10 x [fields=[c1_u32:0, c2_u32:0, c3_u32:0, c4_u8:0]], provided-required-interface=Sample_Element_35
      Sample_Element_36:
        nv-provide-com-spec{ram-block-init-value=fields=[b1_u8:0, b2_u16:0, b3_u16:0, b4_u16:0, b5_u8:0, b6_u8:0, b7_u8:0, b8_u8:0, b9_u8:0, b10_u8:0, b11_u32_2:[0, 0], b12_u16_2:[0, 0], b13_u8_4:[0, 0, 0, 0]], rom-block-init-value=fields=[b1_u8:0, b2_u16:0, b3_u16:0, b4_u16:0, b5_u8:0, b6_u8:0, b7_u8:0, b8_u8:0, b9_u8:0, b10_u8:0, b11_u32_2:[0, 0], b12_u16_2:[0, 0], b13_u8_4:[0, 0, 0, 0]], variable=Sample_Element_36/Value}
        nv-require-com-spec=init-value=fields=[b1_u8:0, b2_u16:0, b3_u16:0, b4_u16:0, b5_u8:0, b6_u8:0, b7_u8:0, b8_u8:0, b9_u8:0, b10_u8:0, b11_u32_2:[0, 0], b12_u16_2:[0, 0], b13_u8_4:[0, 0, 0, 0]]
        provided-required-interface=Sample_Element_36
      Sample_Element_37: nv-provide-com-spec{ram-block-init-value=5 x 0, rom-block-init-value=5 x 0, variable=Sample_Element_37/Value}, nv-require-com-spec=init-value=5 x 0, provided-required-interface=Sample_Element_37
      Sample_Element_38:
        nv-provide-com-spec{ram-block-init-value=[[0, 19, 43, 75, 119, 335], [7, 27, 53, 87, 132, 335], [16, 37, 64, 100, 147, 335], [25, 48, 77, 114, 162, 335], [36, 60, 90, 129, 178, 335], [48, 74, 105, 145, 196, 335], [61, 89, 122, 164, 215, 335], [77, 106, 140, 183, 235, 335], [94, 124, 161, 204, 257, 335], [114, 146, 183, 228, 281, 335], [136, 169, 208, 254, 307, 335], [162, 196, 236, 281, 335, 335], [335, 361, 389, 419, 451, 486], [389, 420, 453, 488, 525, 566], [419, 459, 503, 551, 602, 658], [451, 502, 558, 620, 688, 763], [464, 533, 611, 699, 799, 911], [486, 566, 658, 763, 885, 1024]], rom-block-init-value=[[0, 19, 43, 75, 119, 335], [7, 27, 53, 87, 132, 335], [16, 37, 64, 100, 147, 335], [25, 48, 77, 114, 162, 335], [36, 60, 90, 129, 178, 335], [48, 74, 105, 145, 196, 335], [61, 89, 122, 164, 215, 335], [77, 106, 140, 183, 235, 335], [94, 124, 161, 204, 257, 335], [114, 146, 183, 228, 281, 335], [136, 169, 208, 254, 307, 335], [162, 196, 236, 281, 335, 335], [335, 361, 389, 419, 451, 486], [389, 420, 453, 488, 525, 566], [419, 459, 503, 551, 602, 658], [451, 502, 558, 620, 688, 763], [464, 533, 611, 699, 799, 911], [486, 566, 658, 763, 885, 1024]], variable=Sample_Element_38/Value}
        nv-require-com-spec=init-value=[[0, 19, 43, 75, 119, 335], [7, 27, 53, 87, 132, 335], [16, 37, 64, 100, 147, 335], [25, 48, 77, 114, 162, 335], [36, 60, 90, 129, 178, 335], [48, 74, 105, 145, 196, 335], [61, 89, 122, 164, 215, 335], [77, 106, 140, 183, 235, 335], [94, 124, 161, 204, 257, 335], [114, 146, 183, 228, 281, 335], [136, 169, 208, 254, 307, 335], [162, 196, 236, 281, 335, 335], [335, 361, 389, 419, 451, 486], [389, 420, 453, 488, 525, 566], [419, 459, 503, 551, 602, 658], [451, 502, 558, 620, 688, 763], [464, 533, 611, 699, 799, 911], [486, 566, 658, 763, 885, 1024]]
        provided-required-interface=Sample_Element_38
      Sample_Element_39: nv-provide-com-spec{ram-block-init-value=[0, 0, 0, 0], rom-block-init-value=[0, 0, 0, 0], variable=Sample_Element_39/Value}, nv-require-com-spec=init-value=[0, 0, 0, 0], provided-required-interface=Sample_Element_39
      Sample_Element_4: nv-provide-com-spec{ram-block-init-value=5 x 1, rom-block-init-value=5 x 1, variable=Sample_Element_4/Value}, nv-require-com-spec=init-value=5 x 1, provided-required-interface=Sample_Element_4
      Sample_Element_40: nv-provide-com-spec{ram-block-init-value=[10 x 0, 10 x 0, 10 x 0], rom-block-init-value=[10 x 0, 10 x 0, 10 x 0], variable=Sample_Element_40/Value}, nv-require-com-spec=init-value=[10 x 0, 10 x 0, 10 x 0], provided-required-interface=Sample_Element_40
      Sample_Element_41: nv-provide-com-spec{ram-block-init-value=65535, rom-block-init-value=65535, variable=Sample_Element_41/Value}, nv-require-com-spec=init-value=65535, provided-required-interface=Sample_Element_41
      Sample_Element_42: nv-provide-com-spec{ram-block-init-value=1, rom-block-init-value=1, variable=Sample_Element_42/Value}, nv-require-com-spec=init-value=1, provided-required-interface=Sample_Element_42
      Sample_Element_43: nv-provide-com-spec{ram-block-init-value=5 x 1, rom-block-init-value=5 x 1, variable=Sample_Element_43/Value}, nv-require-com-spec=init-value=5 x 1, provided-required-interface=Sample_Element_43
      Sample_Element_44:
        nv-provide-com-spec{ram-block-init-value=[[0, 3, 6, 10, 17, 366], [3, 5, 10, 15, 23, 366], [5, 9, 14, 21, 31, 366], [10, 14, 21, 30, 42, 366], [15, 21, 30, 41, 56, 366], [23, 31, 42, 56, 74, 366], [34, 45, 58, 75, 97, 366], [49, 63, 80, 101, 127, 366], [71, 88, 109, 134, 166, 366], [101, 122, 148, 179, 216, 366], [143, 169, 201, 237, 281, 366], [201, 234, 271, 315, 366, 366], [366, 391, 418, 446, 477, 510], [418, 447, 479, 512, 548, 586], [446, 485, 527, 572, 621, 674], [477, 526, 580, 639, 704, 775], [490, 555, 630, 714, 809, 917], [510, 586, 674, 775, 891, 1024]], rom-block-init-value=[[0, 3, 6, 10, 17, 366], [3, 5, 10, 15, 23, 366], [5, 9, 14, 21, 31, 366], [10, 14, 21, 30, 42, 366], [15, 21, 30, 41, 56, 366], [23, 31, 42, 56, 74, 366], [34, 45, 58, 75, 97, 366], [49, 63, 80, 101, 127, 366], [71, 88, 109, 134, 166, 366], [101, 122, 148, 179, 216, 366], [143, 169, 201, 237, 281, 366], [201, 234, 271, 315, 366, 366], [366, 391, 418, 446, 477, 510], [418, 447, 479, 512, 548, 586], [446, 485, 527, 572, 621, 674], [477, 526, 580, 639, 704, 775], [490, 555, 630, 714, 809, 917], [510, 586, 674, 775, 891, 1024]], variable=Sample_Element_44/Value}
        nv-require-com-spec=init-value=[[0, 3, 6, 10, 17, 366], [3, 5, 10, 15, 23, 366], [5, 9, 14, 21, 31, 366], [10, 14, 21, 30, 42, 366], [15, 21, 30, 41, 56, 366], [23, 31, 42, 56, 74, 366], [34, 45, 58, 75, 97, 366], [49, 63, 80, 101, 127, 366], [71, 88, 109, 134, 166, 366], [101, 122, 148, 179, 216, 366], [143, 169, 201, 237, 281, 366], [201, 234, 271, 315, 366, 366], [366, 391, 418, 446, 477, 510], [418, 447, 479, 512, 548, 586], [446, 485, 527, 572, 621, 674], [477, 526, 580, 639, 704, 775], [490, 555, 630, 714, 809, 917], [510, 586, 674, 775, 891, 1024]]
        provided-required-interface=Sample_Element_44
      Sample_Element_45: nv-provide-com-spec{ram-block-init-value=[10 x 0, 10 x 0, 10 x 0], rom-block-init-value=[10 x 0, 10 x 0, 10 x 0], variable=Sample_Element_45/Value}, nv-require-com-spec=init-value=[10 x 0, 10 x 0, 10 x 0], provided-required-interface=Sample_Element_45
      Sample_Element_46:
        nv-provide-com-spec{ram-block-init-value=fields=[b1_u8:0, b2_u16:0, b3_u16:0, b4_u16:0, b5_u8:0, b6_u8:0, b7_u8:0, b8_u8:0, b9_u8:0, b10_u8:0, b11_u32_2:[0, 0], b12_u16_2:[0, 0], b13_u8_4:[0, 0, 0, 0]], rom-block-init-value=fields=[b1_u8:0, b2_u16:0, b3_u16:0, b4_u16:0, b5_u8:0, b6_u8:0, b7_u8:0, b8_u8:0, b9_u8:0, b10_u8:0, b11_u32_2:[0, 0], b12_u16_2:[0, 0], b13_u8_4:[0, 0, 0, 0]], variable=Sample_Element_46/Value}
        nv-require-com-spec=init-value=fields=[b1_u8:0, b2_u16:0, b3_u16:0, b4_u16:0, b5_u8:0, b6_u8:0, b7_u8:0, b8_u8:0, b9_u8:0, b10_u8:0, b11_u32_2:[0, 0], b12_u16_2:[0, 0], b13_u8_4:[0, 0, 0, 0]]
        provided-required-interface=Sample_Element_46
      Sample_Element_47: nv-provide-com-spec{ram-block-init-value=5 x 0, rom-block-init-value=5 x 0, variable=Sample_Element_47/Value}, nv-require-com-spec=init-value=5 x 0, provided-required-interface=Sample_Element_47
      Sample_Element_48: nv-provide-com-spec{ram-block-init-value=1, rom-block-init-value=1, variable=Sample_Element_48/Value}, nv-require-com-spec=init-value=1, provided-required-interface=Sample_Element_48
      Sample_Element_49: nv-provide-com-spec{ram-block-init-value=65535, rom-block-init-value=65535, variable=Sample_Element_49/Value}, nv-require-com-spec=init-value=65535, provided-required-interface=Sample_Element_49
      Sample_Element_5: nv-provide-com-spec{ram-block-init-value=10 x 0, rom-block-init-value=10 x 0, variable=Sample_Element_5/Value}, nv-require-com-spec=init-value=10 x 0, provided-required-interface=Sample_Element_5
      Sample_Element_50: nv-provide-com-spec{ram-block-init-value=0, rom-block-init-value=0, variable=Sample_Element_50/Value}, nv-require-com-spec=init-value=0, provided-required-interface=Sample_Element_50
      Sample_Element_6:
        nv-provide-com-spec{ram-block-init-value=[0, 64, 768, 1536, 3072, 6656, 17920, 32512, 47360, 61952, 63488, 64256, 65408, 65408, 65408, 0, 0, 0, 0, 0, 0, 0, 0, 0], rom-block-init-value=[0, 64, 768, 1536, 3072, 6656, 17920, 32512, 47360, 61952, 63488, 64256, 65408, 65408, 65408, 0, 0, 0, 0, 0, 0, 0, 0, 0], variable=Sample_Element_6/Value}
        nv-require-com-spec=init-value=[0, 64, 768, 1536, 3072, 6656, 17920, 32512, 47360, 61952, 63488, 64256, 65408, 65408, 65408, 0, 0, 0, 0, 0, 0, 0, 0, 0]
        provided-required-interface=Sample_Element_6
      Sample_Element_7: nv-provide-com-spec{ram-block-init-value=[1000, 1000], rom-block-init-value=[1000, 1000], variable=Sample_Element_7/Value}, nv-require-com-spec=init-value=[1000, 1000], provided-required-interface=Sample_Element_7
      Sample_Element_8: nv-provide-com-spec{ram-block-init-value=[0, 0, 0, 0], rom-block-init-value=[0, 0, 0, 0], variable=Sample_Element_8/Value}, nv-require-com-spec=init-value=[0, 0, 0, 0], provided-required-interface=Sample_Element_8
      Sample_Element_9: nv-provide-com-spec{ram-block-init-value=255, rom-block-init-value=255, variable=Sample_Element_9/Value}, nv-require-com-spec=init-value=255, provided-required-interface=Sample_Element_9
    behavior NvBlockSwComponentType_InternalBehavior
      50 x data received event, all with start-on-event=NvBlockSwComponentTypeRunnable:
        DRT_NvBlockSwComponentTypeRunnable_Sample_Element_{10..19}_Value: data=Sample_Element_{10..19}.Value
        DRT_NvBlockSwComponentTypeRunnable_Sample_Element_1_Value: data=Sample_Element_1.Value
        DRT_NvBlockSwComponentTypeRunnable_Sample_Element_{20..29}_Value: data=Sample_Element_{20..29}.Value
        DRT_NvBlockSwComponentTypeRunnable_Sample_Element_2_Value: data=Sample_Element_2.Value
        DRT_NvBlockSwComponentTypeRunnable_Sample_Element_{30..39}_Value: data=Sample_Element_{30..39}.Value
        DRT_NvBlockSwComponentTypeRunnable_Sample_Element_3_Value: data=Sample_Element_3.Value
        DRT_NvBlockSwComponentTypeRunnable_Sample_Element_{40..49}_Value: data=Sample_Element_{40..49}.Value
        DRT_NvBlockSwComponentTypeRunnable_Sample_Element_4_Value: data=Sample_Element_4.Value
        DRT_NvBlockSwComponentTypeRunnable_Sample_Element_50_Value: data=Sample_Element_50.Value
        DRT_NvBlockSwComponentTypeRunnable_Sample_Element_{5..9}_Value: data=Sample_Element_{5..9}.Value
      runnable NvBlockSwComponentTypeRunnable
    15 x nv block descriptor, all with support-dirty-flag=true:
      NVBlockDescriptor_Sample_Block_1: client-server-ports=role-based-port-assignment={port-prototype=Sample_Block_1_NvM_JobFinished, role=Sample_Block_1_NvM_JobFinished}
        nv-block-data-mappings:
          nv-ram-block-element=autosar-variable-in-impl-datatype=Sample_Element_1, written-read-nv-data=Sample_Element_1.Value
          nv-ram-block-element=autosar-variable-in-impl-datatype=Sample_Element_2, written-read-nv-data=Sample_Element_2.Value
        nv block needs NVNeed_NVBlockDescriptor: n-data-sets=2, ram-block-status-control=API, reliability=NO-PROTECTION, restore-at-start=true, store-at-shutdown=false, store-immediate=true, write-verification=false
        ram block RAM_NVBlockDescriptor_Sample_Block_1: type=NV_Data_Sample_Block_1, init-value=fields=[Sample_Element_1:15 x 1, Sample_Element_2:[0, 64, 128, 192, 0, 64, 128, 192, 0, 64, 128, 192, 0, 64, 128, 192, 255, 0, 85, 170, 255, 3, 0, 0, 0, 0, 0, 0, 64, 128, 192, 0, 64, 128, 192, 0, 64, 128, 192, 0, 64, 128, 192, 255, 0, 85, 170, 255, 3, 0, 0, 0, 0, 0, 0, 64, 128, 192, 0, 64, 128, 192, 0, 64, 128, 192, 0, 64, 128, 192, 255, 0, 85, 170, 255, 3, 0, 0, 0, 0, 0, 96, 140, 178, 210, 238, 56, 102, 146, 202, 2, 52, 122, 168, 220, 46, 72, 111, 144, 208, 0, 84, 169, 250, 63, 96, 140, 178, 210, 238, 56, 102, 146, 202, 2, 52, 122, 168, 220, 46, 72, 111, 144, 208, 0, 84, 169, 250, 63, 96, 140, 178, 210, 238, 56, 102, 146, 202, 2, 52, 122, 168, 220, 46, 72, 111, 144, 208, 0, 84, 169, 250, 63, 96, 140, 178, 210, 238, 56, 102, 146, 202, 2, 52, 122, 168, 220, 46, 72, 111, 144, 208, 0, 84, 169, 250, 63, 96, 140, 178, 210, 238, 56, 102, 146, 202, 2, 52, 122, 168, 220, 46, 72, 111, 144, 208, 0, 84, 169, 250, 63, 96, 140, 178, 210, 238, 56, 102, 146, 202, 2, 52, 122, 168, 220, 46, 72, 111, 144, 208, 0, 84, 169, 250, 63, 255, 255, 255, 255, 255, 255, 255, 255, 255, 255, 255, 255, 255, 255, 255, 255, 255, 175, 216]]
        rom block ROM_NVBlockDescriptor_Sample_Block_1:
          sw-calibration-access=READ-WRITE
          type=NV_Data_Sample_Block_1
          init-value=fields=[Sample_Element_1:15 x 1, Sample_Element_2:[0, 64, 128, 192, 0, 64, 128, 192, 0, 64, 128, 192, 0, 64, 128, 192, 255, 0, 85, 170, 255, 3, 0, 0, 0, 0, 0, 0, 64, 128, 192, 0, 64, 128, 192, 0, 64, 128, 192, 0, 64, 128, 192, 255, 0, 85, 170, 255, 3, 0, 0, 0, 0, 0, 0, 64, 128, 192, 0, 64, 128, 192, 0, 64, 128, 192, 0, 64, 128, 192, 255, 0, 85, 170, 255, 3, 0, 0, 0, 0, 0, 96, 140, 178, 210, 238, 56, 102, 146, 202, 2, 52, 122, 168, 220, 46, 72, 111, 144, 208, 0, 84, 169, 250, 63, 96, 140, 178, 210, 238, 56, 102, 146, 202, 2, 52, 122, 168, 220, 46, 72, 111, 144, 208, 0, 84, 169, 250, 63, 96, 140, 178, 210, 238, 56, 102, 146, 202, 2, 52, 122, 168, 220, 46, 72, 111, 144, 208, 0, 84, 169, 250, 63, 96, 140, 178, 210, 238, 56, 102, 146, 202, 2, 52, 122, 168, 220, 46, 72, 111, 144, 208, 0, 84, 169, 250, 63, 96, 140, 178, 210, 238, 56, 102, 146, 202, 2, 52, 122, 168, 220, 46, 72, 111, 144, 208, 0, 84, 169, 250, 63, 96, 140, 178, 210, 238, 56, 102, 146, 202, 2, 52, 122, 168, 220, 46, 72, 111, 144, 208, 0, 84, 169, 250, 63, 255, 255, 255, 255, 255, 255, 255, 255, 255, 255, 255, 255, 255, 255, 255, 255, 255, 175, 216]]
      NVBlockDescriptor_Sample_Block_10: client-server-ports=role-based-port-assignment={port-prototype=Sample_Block_10_NvM_JobFinished, role=Sample_Block_10_NvM_JobFinished}
        nv-block-data-mappings:
          nv-ram-block-element=autosar-variable-in-impl-datatype=Sample_Element_{19..29}, written-read-nv-data=Sample_Element_{19..29}.Value
        nv block needs NVNeed_NVBlockDescriptor: n-data-sets=2, ram-block-status-control=API, reliability=NO-PROTECTION, restore-at-start=true, store-at-shutdown=false, store-immediate=true, write-verification=false
        ram block RAM_NVBlockDescriptor_Sample_Block_10: type=NV_Data_Sample_Block_10, init-value=fields=[Sample_Element_19:155, Sample_Element_20:0, Sample_Element_21:1, Sample_Element_22:1, Sample_Element_23:5 x 0, Sample_Element_24:[768, 768, 896, 896, 1280, 2739, 3993, 6720, 9433, 12160, 12544, 12544, 12544, 12544, 12544, 0, 0, 0, 0, 0, 0, 0, 0, 0], Sample_Element_25:[[0, 19, 43, 75, 119, 335], [7, 27, 53, 87, 132, 335], [16, 37, 64, 100, 147, 335], [25, 48, 77, 114, 162, 335], [36, 60, 90, 129, 178, 335], [48, 74, 105, 145, 196, 335], [61, 89, 122, 164, 215, 335], [77, 106, 140, 183, 235, 335], [94, 124, 161, 204, 257, 335], [114, 146, 183, 228, 281, 335], [136, 169, 208, 254, 307, 335], [162, 196, 236, 281, 335, 335], [335, 361, 389, 419, 451, 486], [389, 420, 453, 488, 525, 566], [419, 459, 503, 551, 602, 658], [451, 502, 558, 620, 688, 763], [464, 533, 611, 699, 799, 911], [486, 566, 658, 763, 885, 1024]], Sample_Element_26:[0, 0, 0, 0], Sample_Element_27:10 x [fields=[c1_u32:0, c2_u32:0, c3_u32:0, c4_u8:0]], Sample_Element_28:0, Sample_Element_29:2147483647]
        rom block ROM_NVBlockDescriptor_Sample_Block_10:
          sw-calibration-access=READ-WRITE
          type=NV_Data_Sample_Block_10
          init-value=fields=[Sample_Element_19:155, Sample_Element_20:0, Sample_Element_21:1, Sample_Element_22:1, Sample_Element_23:5 x 0, Sample_Element_24:[768, 768, 896, 896, 1280, 2739, 3993, 6720, 9433, 12160, 12544, 12544, 12544, 12544, 12544, 0, 0, 0, 0, 0, 0, 0, 0, 0], Sample_Element_25:[[0, 19, 43, 75, 119, 335], [7, 27, 53, 87, 132, 335], [16, 37, 64, 100, 147, 335], [25, 48, 77, 114, 162, 335], [36, 60, 90, 129, 178, 335], [48, 74, 105, 145, 196, 335], [61, 89, 122, 164, 215, 335], [77, 106, 140, 183, 235, 335], [94, 124, 161, 204, 257, 335], [114, 146, 183, 228, 281, 335], [136, 169, 208, 254, 307, 335], [162, 196, 236, 281, 335, 335], [335, 361, 389, 419, 451, 486], [389, 420, 453, 488, 525, 566], [419, 459, 503, 551, 602, 658], [451, 502, 558, 620, 688, 763], [464, 533, 611, 699, 799, 911], [486, 566, 658, 763, 885, 1024]], Sample_Element_26:[0, 0, 0, 0], Sample_Element_27:10 x [fields=[c1_u32:0, c2_u32:0, c3_u32:0, c4_u8:0]], Sample_Element_28:0, Sample_Element_29:2147483647]
      NVBlockDescriptor_Sample_Block_11: client-server-ports=role-based-port-assignment={port-prototype=Sample_Block_11_NvM_JobFinished, role=Sample_Block_11_NvM_JobFinished}
        nv-block-data-mappings:
          nv-ram-block-element=autosar-variable-in-impl-datatype=Sample_Element_30, written-read-nv-data=Sample_Element_30.Value
          nv-ram-block-element=autosar-variable-in-impl-datatype=Sample_Element_31, written-read-nv-data=Sample_Element_31.Value
        nv block needs NVNeed_NVBlockDescriptor: n-data-sets=2, ram-block-status-control=API, reliability=NO-PROTECTION, restore-at-start=true, store-at-shutdown=false, store-immediate=true, write-verification=false
        ram block RAM_NVBlockDescriptor_Sample_Block_11: type=NV_Data_Sample_Block_11, init-value=fields=[Sample_Element_30:5 x 6, Sample_Element_31:[1000, 1000]]
        rom block ROM_NVBlockDescriptor_Sample_Block_11: sw-calibration-access=READ-WRITE, type=NV_Data_Sample_Block_11, init-value=fields=[Sample_Element_30:5 x 6, Sample_Element_31:[1000, 1000]]
      NVBlockDescriptor_Sample_Block_12: client-server-ports=role-based-port-assignment={port-prototype=Sample_Block_12_NvM_JobFinished, role=Sample_Block_12_NvM_JobFinished}
        nv-block-data-mappings:
          nv-ram-block-element=autosar-variable-in-impl-datatype=Sample_Element_{32..34}, written-read-nv-data=Sample_Element_{32..34}.Value
        nv block needs NVNeed_NVBlockDescriptor: n-data-sets=2, ram-block-status-control=API, reliability=NO-PROTECTION, restore-at-start=true, store-at-shutdown=false, store-immediate=true, write-verification=false
        ram block RAM_NVBlockDescriptor_Sample_Block_12: type=NV_Data_Sample_Block_12, init-value=fields=[Sample_Element_32:0, Sample_Element_33:2147483647, Sample_Element_34:0]
        rom block ROM_NVBlockDescriptor_Sample_Block_12: sw-calibration-access=READ-WRITE, type=NV_Data_Sample_Block_12, init-value=fields=[Sample_Element_32:0, Sample_Element_33:2147483647, Sample_Element_34:0]
      NVBlockDescriptor_Sample_Block_13: client-server-ports=role-based-port-assignment={port-prototype=Sample_Block_13_NvM_JobFinished, role=Sample_Block_13_NvM_JobFinished}, nv-block-data-mapping{nv-ram-block-element=autosar-variable-in-impl-datatype=Sample_Element_35, written-read-nv-data=Sample_Element_35.Value}
        nv block needs NVNeed_NVBlockDescriptor: n-data-sets=2, ram-block-status-control=API, reliability=NO-PROTECTION, restore-at-start=true, store-at-shutdown=false, store-immediate=true, write-verification=false
        ram block RAM_NVBlockDescriptor_Sample_Block_13: type=NV_Data_Sample_Block_13, init-value=fields=Sample_Element_35:10 x [fields=[c1_u32:0, c2_u32:0, c3_u32:0, c4_u8:0]]
        rom block ROM_NVBlockDescriptor_Sample_Block_13: sw-calibration-access=READ-WRITE, type=NV_Data_Sample_Block_13, init-value=fields=Sample_Element_35:10 x [fields=[c1_u32:0, c2_u32:0, c3_u32:0, c4_u8:0]]
      NVBlockDescriptor_Sample_Block_14: client-server-ports=role-based-port-assignment={port-prototype=Sample_Block_14_NvM_JobFinished, role=Sample_Block_14_NvM_JobFinished}
        nv-block-data-mappings:
          nv-ram-block-element=autosar-variable-in-impl-datatype=Sample_Element_{36..40}, written-read-nv-data=Sample_Element_{36..40}.Value
        nv block needs NVNeed_NVBlockDescriptor: n-data-sets=2, ram-block-status-control=API, reliability=NO-PROTECTION, restore-at-start=true, store-at-shutdown=false, store-immediate=true, write-verification=false
        ram block RAM_NVBlockDescriptor_Sample_Block_14: type=NV_Data_Sample_Block_14, init-value=fields=[{short-label=Sample_Element_36, fields=[b1_u8:0, b2_u16:0, b3_u16:0, b4_u16:0, b5_u8:0, b6_u8:0, b7_u8:0, b8_u8:0, b9_u8:0, b10_u8:0, b11_u32_2:[0, 0], b12_u16_2:[0, 0], b13_u8_4:[0, 0, 0, 0]]}, Sample_Element_37:5 x 0, Sample_Element_38:[[0, 19, 43, 75, 119, 335], [7, 27, 53, 87, 132, 335], [16, 37, 64, 100, 147, 335], [25, 48, 77, 114, 162, 335], [36, 60, 90, 129, 178, 335], [48, 74, 105, 145, 196, 335], [61, 89, 122, 164, 215, 335], [77, 106, 140, 183, 235, 335], [94, 124, 161, 204, 257, 335], [114, 146, 183, 228, 281, 335], [136, 169, 208, 254, 307, 335], [162, 196, 236, 281, 335, 335], [335, 361, 389, 419, 451, 486], [389, 420, 453, 488, 525, 566], [419, 459, 503, 551, 602, 658], [451, 502, 558, 620, 688, 763], [464, 533, 611, 699, 799, 911], [486, 566, 658, 763, 885, 1024]], Sample_Element_39:[0, 0, 0, 0], Sample_Element_40:[10 x 0, 10 x 0, 10 x 0]]
        rom block ROM_NVBlockDescriptor_Sample_Block_14:
          sw-calibration-access=READ-WRITE
          type=NV_Data_Sample_Block_14
          init-value=fields=[{short-label=Sample_Element_36, fields=[b1_u8:0, b2_u16:0, b3_u16:0, b4_u16:0, b5_u8:0, b6_u8:0, b7_u8:0, b8_u8:0, b9_u8:0, b10_u8:0, b11_u32_2:[0, 0], b12_u16_2:[0, 0], b13_u8_4:[0, 0, 0, 0]]}, Sample_Element_37:5 x 0, Sample_Element_38:[[0, 19, 43, 75, 119, 335], [7, 27, 53, 87, 132, 335], [16, 37, 64, 100, 147, 335], [25, 48, 77, 114, 162, 335], [36, 60, 90, 129, 178, 335], [48, 74, 105, 145, 196, 335], [61, 89, 122, 164, 215, 335], [77, 106, 140, 183, 235, 335], [94, 124, 161, 204, 257, 335], [114, 146, 183, 228, 281, 335], [136, 169, 208, 254, 307, 335], [162, 196, 236, 281, 335, 335], [335, 361, 389, 419, 451, 486], [389, 420, 453, 488, 525, 566], [419, 459, 503, 551, 602, 658], [451, 502, 558, 620, 688, 763], [464, 533, 611, 699, 799, 911], [486, 566, 658, 763, 885, 1024]], Sample_Element_39:[0, 0, 0, 0], Sample_Element_40:[10 x 0, 10 x 0, 10 x 0]]
      NVBlockDescriptor_Sample_Block_15: client-server-ports=role-based-port-assignment={port-prototype=Sample_Block_15_NvM_JobFinished, role=Sample_Block_15_NvM_JobFinished}
        nv-block-data-mappings:
          nv-ram-block-element=autosar-variable-in-impl-datatype=Sample_Element_{41..50}, written-read-nv-data=Sample_Element_{41..50}.Value
        nv block needs NVNeed_NVBlockDescriptor: n-data-sets=2, ram-block-status-control=API, reliability=NO-PROTECTION, restore-at-start=true, store-at-shutdown=false, store-immediate=true, write-verification=false
        ram block RAM_NVBlockDescriptor_Sample_Block_15: type=NV_Data_Sample_Block_15, init-value=fields=[Sample_Element_41:65535, Sample_Element_42:1, Sample_Element_43:5 x 1, Sample_Element_44:[[0, 3, 6, 10, 17, 366], [3, 5, 10, 15, 23, 366], [5, 9, 14, 21, 31, 366], [10, 14, 21, 30, 42, 366], [15, 21, 30, 41, 56, 366], [23, 31, 42, 56, 74, 366], [34, 45, 58, 75, 97, 366], [49, 63, 80, 101, 127, 366], [71, 88, 109, 134, 166, 366], [101, 122, 148, 179, 216, 366], [143, 169, 201, 237, 281, 366], [201, 234, 271, 315, 366, 366], [366, 391, 418, 446, 477, 510], [418, 447, 479, 512, 548, 586], [446, 485, 527, 572, 621, 674], [477, 526, 580, 639, 704, 775], [490, 555, 630, 714, 809, 917], [510, 586, 674, 775, 891, 1024]], Sample_Element_45:[10 x 0, 10 x 0, 10 x 0], {short-label=Sample_Element_46, fields=[b1_u8:0, b2_u16:0, b3_u16:0, b4_u16:0, b5_u8:0, b6_u8:0, b7_u8:0, b8_u8:0, b9_u8:0, b10_u8:0, b11_u32_2:[0, 0], b12_u16_2:[0, 0], b13_u8_4:[0, 0, 0, 0]]}, Sample_Element_47:5 x 0, Sample_Element_48:1, Sample_Element_49:65535, Sample_Element_50:0]
        rom block ROM_NVBlockDescriptor_Sample_Block_15:
          sw-calibration-access=READ-WRITE
          type=NV_Data_Sample_Block_15
          init-value=fields=[Sample_Element_41:65535, Sample_Element_42:1, Sample_Element_43:5 x 1, Sample_Element_44:[[0, 3, 6, 10, 17, 366], [3, 5, 10, 15, 23, 366], [5, 9, 14, 21, 31, 366], [10, 14, 21, 30, 42, 366], [15, 21, 30, 41, 56, 366], [23, 31, 42, 56, 74, 366], [34, 45, 58, 75, 97, 366], [49, 63, 80, 101, 127, 366], [71, 88, 109, 134, 166, 366], [101, 122, 148, 179, 216, 366], [143, 169, 201, 237, 281, 366], [201, 234, 271, 315, 366, 366], [366, 391, 418, 446, 477, 510], [418, 447, 479, 512, 548, 586], [446, 485, 527, 572, 621, 674], [477, 526, 580, 639, 704, 775], [490, 555, 630, 714, 809, 917], [510, 586, 674, 775, 891, 1024]], Sample_Element_45:[10 x 0, 10 x 0, 10 x 0], {short-label=Sample_Element_46, fields=[b1_u8:0, b2_u16:0, b3_u16:0, b4_u16:0, b5_u8:0, b6_u8:0, b7_u8:0, b8_u8:0, b9_u8:0, b10_u8:0, b11_u32_2:[0, 0], b12_u16_2:[0, 0], b13_u8_4:[0, 0, 0, 0]]}, Sample_Element_47:5 x 0, Sample_Element_48:1, Sample_Element_49:65535, Sample_Element_50:0]
      NVBlockDescriptor_Sample_Block_2: client-server-ports=role-based-port-assignment={port-prototype=Sample_Block_2_NvM_JobFinished, role=Sample_Block_2_NvM_JobFinished}
        nv-block-data-mappings:
          nv-ram-block-element=autosar-variable-in-impl-datatype=Sample_Element_{3..9}, written-read-nv-data=Sample_Element_{3..9}.Value
        nv block needs NVNeed_NVBlockDescriptor: n-data-sets=2, ram-block-status-control=API, reliability=NO-PROTECTION, restore-at-start=true, store-at-shutdown=false, store-immediate=true, write-verification=false
        ram block RAM_NVBlockDescriptor_Sample_Block_2: type=NV_Data_Sample_Block_2, init-value=fields=[Sample_Element_3:29 x 0, Sample_Element_4:5 x 1, Sample_Element_5:10 x 0, Sample_Element_6:[0, 64, 768, 1536, 3072, 6656, 17920, 32512, 47360, 61952, 63488, 64256, 65408, 65408, 65408, 0, 0, 0, 0, 0, 0, 0, 0, 0], Sample_Element_7:[1000, 1000], Sample_Element_8:[0, 0, 0, 0], Sample_Element_9:255]
        rom block ROM_NVBlockDescriptor_Sample_Block_2: sw-calibration-access=READ-WRITE, type=NV_Data_Sample_Block_2, init-value=fields=[Sample_Element_3:29 x 0, Sample_Element_4:5 x 1, Sample_Element_5:10 x 0, Sample_Element_6:[0, 64, 768, 1536, 3072, 6656, 17920, 32512, 47360, 61952, 63488, 64256, 65408, 65408, 65408, 0, 0, 0, 0, 0, 0, 0, 0, 0], Sample_Element_7:[1000, 1000], Sample_Element_8:[0, 0, 0, 0], Sample_Element_9:255]
      NVBlockDescriptor_Sample_Block_3: client-server-ports=role-based-port-assignment={port-prototype=Sample_Block_3_NvM_JobFinished, role=Sample_Block_3_NvM_JobFinished}
        nv-block-data-mappings:
          nv-ram-block-element=autosar-variable-in-impl-datatype=Sample_Element_{10..12}, written-read-nv-data=Sample_Element_{10..12}.Value
        nv block needs NVNeed_NVBlockDescriptor: n-data-sets=2, ram-block-status-control=API, reliability=NO-PROTECTION, restore-at-start=true, store-at-shutdown=false, store-immediate=true, write-verification=false
        ram block RAM_NVBlockDescriptor_Sample_Block_3: type=NV_Data_Sample_Block_3, init-value=fields=[Sample_Element_10:999, Sample_Element_11:5 x 3, Sample_Element_12:5 x 0]
        rom block ROM_NVBlockDescriptor_Sample_Block_3: sw-calibration-access=READ-WRITE, type=NV_Data_Sample_Block_3, init-value=fields=[Sample_Element_10:999, Sample_Element_11:5 x 3, Sample_Element_12:5 x 0]
      NVBlockDescriptor_Sample_Block_4: client-server-ports=role-based-port-assignment={port-prototype=Sample_Block_4_NvM_JobFinished, role=Sample_Block_4_NvM_JobFinished}, nv-block-data-mapping{nv-ram-block-element=autosar-variable-in-impl-datatype=Sample_Element_13, written-read-nv-data=Sample_Element_13.Value}
        nv block needs NVNeed_NVBlockDescriptor: n-data-sets=2, ram-block-status-control=API, reliability=NO-PROTECTION, restore-at-start=true, store-at-shutdown=false, store-immediate=true, write-verification=false
        ram block RAM_NVBlockDescriptor_Sample_Block_4: type=NV_Data_Sample_Block_4, init-value=fields=Sample_Element_13:18 x 5 x 0
        rom block ROM_NVBlockDescriptor_Sample_Block_4: sw-calibration-access=READ-WRITE, type=NV_Data_Sample_Block_4, init-value=fields=Sample_Element_13:18 x 5 x 0
      NVBlockDescriptor_Sample_Block_5: client-server-ports=role-based-port-assignment={port-prototype=Sample_Block_5_NvM_JobFinished, role=Sample_Block_5_NvM_JobFinished}, nv-block-data-mapping{nv-ram-block-element=autosar-variable-in-impl-datatype=Sample_Element_14, written-read-nv-data=Sample_Element_14.Value}
        nv block needs NVNeed_NVBlockDescriptor: n-data-sets=2, ram-block-status-control=API, reliability=NO-PROTECTION, restore-at-start=true, store-at-shutdown=false, store-immediate=true, write-verification=false
        ram block RAM_NVBlockDescriptor_Sample_Block_5: type=NV_Data_Sample_Block_5, init-value=fields=Sample_Element_14:[[0, 3, 6, 10, 17, 366], [3, 5, 10, 15, 23, 366], [5, 9, 14, 21, 31, 366], [10, 14, 21, 30, 42, 366], [15, 21, 30, 41, 56, 366], [23, 31, 42, 56, 74, 366], [34, 45, 58, 75, 97, 366], [49, 63, 80, 101, 127, 366], [71, 88, 109, 134, 166, 366], [101, 122, 148, 179, 216, 366], [143, 169, 201, 237, 281, 366], [201, 234, 271, 315, 366, 366], [366, 391, 418, 446, 477, 510], [418, 447, 479, 512, 548, 586], [446, 485, 527, 572, 621, 674], [477, 526, 580, 639, 704, 775], [490, 555, 630, 714, 809, 917], [510, 586, 674, 775, 891, 1024]]
        rom block ROM_NVBlockDescriptor_Sample_Block_5:
          sw-calibration-access=READ-WRITE
          type=NV_Data_Sample_Block_5
          init-value=fields=Sample_Element_14:[[0, 3, 6, 10, 17, 366], [3, 5, 10, 15, 23, 366], [5, 9, 14, 21, 31, 366], [10, 14, 21, 30, 42, 366], [15, 21, 30, 41, 56, 366], [23, 31, 42, 56, 74, 366], [34, 45, 58, 75, 97, 366], [49, 63, 80, 101, 127, 366], [71, 88, 109, 134, 166, 366], [101, 122, 148, 179, 216, 366], [143, 169, 201, 237, 281, 366], [201, 234, 271, 315, 366, 366], [366, 391, 418, 446, 477, 510], [418, 447, 479, 512, 548, 586], [446, 485, 527, 572, 621, 674], [477, 526, 580, 639, 704, 775], [490, 555, 630, 714, 809, 917], [510, 586, 674, 775, 891, 1024]]
      NVBlockDescriptor_Sample_Block_6: client-server-ports=role-based-port-assignment={port-prototype=Sample_Block_6_NvM_JobFinished, role=Sample_Block_6_NvM_JobFinished}, nv-block-data-mapping{nv-ram-block-element=autosar-variable-in-impl-datatype=Sample_Element_15, written-read-nv-data=Sample_Element_15.Value}
        nv block needs NVNeed_NVBlockDescriptor: n-data-sets=2, ram-block-status-control=API, reliability=NO-PROTECTION, restore-at-start=true, store-at-shutdown=false, store-immediate=true, write-verification=false
        ram block RAM_NVBlockDescriptor_Sample_Block_6: type=NV_Data_Sample_Block_6, init-value=fields=Sample_Element_15:[0, 0, 0, 0]
        rom block ROM_NVBlockDescriptor_Sample_Block_6: sw-calibration-access=READ-WRITE, type=NV_Data_Sample_Block_6, init-value=fields=Sample_Element_15:[0, 0, 0, 0]
      NVBlockDescriptor_Sample_Block_7: client-server-ports=role-based-port-assignment={port-prototype=Sample_Block_7_NvM_JobFinished, role=Sample_Block_7_NvM_JobFinished}, nv-block-data-mapping{nv-ram-block-element=autosar-variable-in-impl-datatype=Sample_Element_16, written-read-nv-data=Sample_Element_16.Value}
        nv block needs NVNeed_NVBlockDescriptor: n-data-sets=2, ram-block-status-control=API, reliability=NO-PROTECTION, restore-at-start=true, store-at-shutdown=false, store-immediate=true, write-verification=false
        ram block RAM_NVBlockDescriptor_Sample_Block_7: type=NV_Data_Sample_Block_7, init-value=fields=Sample_Element_16:[10 x 0, 10 x 0, 10 x 0]
        rom block ROM_NVBlockDescriptor_Sample_Block_7: sw-calibration-access=READ-WRITE, type=NV_Data_Sample_Block_7, init-value=fields=Sample_Element_16:[10 x 0, 10 x 0, 10 x 0]
      NVBlockDescriptor_Sample_Block_8: client-server-ports=role-based-port-assignment={port-prototype=Sample_Block_8_NvM_JobFinished, role=Sample_Block_8_NvM_JobFinished}, nv-block-data-mapping{nv-ram-block-element=autosar-variable-in-impl-datatype=Sample_Element_17, written-read-nv-data=Sample_Element_17.Value}
        nv block needs NVNeed_NVBlockDescriptor: n-data-sets=2, ram-block-status-control=API, reliability=NO-PROTECTION, restore-at-start=true, store-at-shutdown=false, store-immediate=true, write-verification=false
        ram block RAM_NVBlockDescriptor_Sample_Block_8: type=NV_Data_Sample_Block_8, init-value=fields={short-label=Sample_Element_17, fields=[a1_u8:0, a2_u8:0, a3_u8_4:[0, 0, 0, 0], a4_u32:0]}
        rom block ROM_NVBlockDescriptor_Sample_Block_8: sw-calibration-access=READ-WRITE, type=NV_Data_Sample_Block_8, init-value=fields={short-label=Sample_Element_17, fields=[a1_u8:0, a2_u8:0, a3_u8_4:[0, 0, 0, 0], a4_u32:0]}
      NVBlockDescriptor_Sample_Block_9: client-server-ports=role-based-port-assignment={port-prototype=Sample_Block_9_NvM_JobFinished, role=Sample_Block_9_NvM_JobFinished}, nv-block-data-mapping{nv-ram-block-element=autosar-variable-in-impl-datatype=Sample_Element_18, written-read-nv-data=Sample_Element_18.Value}
        nv block needs NVNeed_NVBlockDescriptor: n-data-sets=2, ram-block-status-control=API, reliability=NO-PROTECTION, restore-at-start=true, store-at-shutdown=false, store-immediate=true, write-verification=false
        ram block RAM_NVBlockDescriptor_Sample_Block_9: type=NV_Data_Sample_Block_9, init-value=fields=Sample_Element_18:395
        rom block ROM_NVBlockDescriptor_Sample_Block_9: sw-calibration-access=READ-WRITE, type=NV_Data_Sample_Block_9, init-value=fields=Sample_Element_18:395
  swc implementation NvBlockSwComponentType_Implementation: behavior=NvBlockSwComponentType_InternalBehavior
    code-descriptors:
      code Default: artifact-descriptors=autosar-engineering-object={short-label=Default, category=SWSRC}
package /ARRoot/If
  50 x nv data interface:
    Sample_Element_1
      nv-datas:
        data Value: type=Arr_u8_15
    Sample_Element_10
      nv-datas:
        data Value: type=uint16
    Sample_Element_11
      nv-datas:
        data Value: type=Arr_u8_5
    Sample_Element_12
      nv-datas:
        data Value: type=Arr_u32_5
    Sample_Element_13
      nv-datas:
        data Value: type=Arr_u8_5x18
    Sample_Element_14
      nv-datas:
        data Value: type=Arr_u16_6x18
    Sample_Element_15
      nv-datas:
        data Value: type=Arr_u8_4
    Sample_Element_16
      nv-datas:
        data Value: type=Arr_u8_10x3
    Sample_Element_17
      nv-datas:
        data Value: type=Struct_a
    Sample_Element_18
      nv-datas:
        data Value: type=uint32
    Sample_Element_19
      nv-datas:
        data Value: type=uint8
    Sample_Element_2
      nv-datas:
        data Value: type=Arr_u8_244
    Sample_Element_20
      nv-datas:
        data Value: type=uint16
    Sample_Element_21
      nv-datas:
        data Value: type=uint32
    Sample_Element_22
      nv-datas:
        data Value: type=uint32
    Sample_Element_23
      nv-datas:
        data Value: type=Arr_u8_5
    Sample_Element_24
      nv-datas:
        data Value: type=Arr_u16_24
    Sample_Element_25
      nv-datas:
        data Value: type=Arr_u16_6x18
    Sample_Element_26
      nv-datas:
        data Value: type=Arr_u8_4
    Sample_Element_27
      nv-datas:
        data Value: type=Arr_Struct_c_16x10
    Sample_Element_28
      nv-datas:
        data Value: type=uint16
    Sample_Element_29
      nv-datas:
        data Value: type=uint32
    Sample_Element_3
      nv-datas:
        data Value: type=Arr_u32_29
    Sample_Element_30
      nv-datas:
        data Value: type=Arr_u8_5
    Sample_Element_31
      nv-datas:
        data Value: type=Arr_u16_2
    Sample_Element_32
      nv-datas:
        data Value: type=uint8
    Sample_Element_33
      nv-datas:
        data Value: type=uint32
    Sample_Element_34
      nv-datas:
        data Value: type=uint16
    Sample_Element_35
      nv-datas:
        data Value: type=Arr_Struct_c_16x10
    Sample_Element_36
      nv-datas:
        data Value: type=Struct_b
    Sample_Element_37
      nv-datas:
        data Value: type=Arr_u8_5
    Sample_Element_38
      nv-datas:
        data Value: type=Arr_u16_6x18
    Sample_Element_39
      nv-datas:
        data Value: type=Arr_u8_4
    Sample_Element_4
      nv-datas:
        data Value: type=Arr_u8_5
    Sample_Element_40
      nv-datas:
        data Value: type=Arr_u8_10x3
    Sample_Element_41
      nv-datas:
        data Value: type=uint16
    Sample_Element_42
      nv-datas:
        data Value: type=uint8
    Sample_Element_43
      nv-datas:
        data Value: type=Arr_u8_5
    Sample_Element_44
      nv-datas:
        data Value: type=Arr_u16_6x18
    Sample_Element_45
      nv-datas:
        data Value: type=Arr_u8_10x3
    Sample_Element_46
      nv-datas:
        data Value: type=Struct_b
    Sample_Element_47
      nv-datas:
        data Value: type=Arr_u8_5
    Sample_Element_48
      nv-datas:
        data Value: type=uint32
    Sample_Element_49
      nv-datas:
        data Value: type=uint16
    Sample_Element_5
      nv-datas:
        data Value: type=Arr_u8_10
    Sample_Element_50
      nv-datas:
        data Value: type=uint8
    Sample_Element_6
      nv-datas:
        data Value: type=Arr_u16_24
    Sample_Element_7
      nv-datas:
        data Value: type=Arr_u16_2
    Sample_Element_8
      nv-datas:
        data Value: type=Arr_u32_4
    Sample_Element_9
      nv-datas:
        data Value: type=uint8
package /ARRoot/Types
  15 x impl type, all with category=STRUCTURE, sw-calibration-access=READ-ONLY, dynamic-array-size-profile=None:
    NV_Data_Sample_Block_1
      element Sample_Element_1: implementation-data-type=Arr_u8_15
      element Sample_Element_2: implementation-data-type=Arr_u8_244
    NV_Data_Sample_Block_10
      11 x element, all with category=TYPE_REFERENCE:
        Sample_Element_19: implementation-data-type=uint8
        Sample_Element_20: implementation-data-type=uint16
        Sample_Element_21: implementation-data-type=uint32
        Sample_Element_22: implementation-data-type=uint32
        Sample_Element_23: implementation-data-type=Arr_u8_5
        Sample_Element_24: implementation-data-type=Arr_u16_24
        Sample_Element_25: implementation-data-type=Arr_u16_6x18
        Sample_Element_26: implementation-data-type=Arr_u8_4
        Sample_Element_27: implementation-data-type=Arr_Struct_c_16x10
        Sample_Element_28: implementation-data-type=uint16
        Sample_Element_29: implementation-data-type=uint32
    NV_Data_Sample_Block_11
      element Sample_Element_30: implementation-data-type=Arr_u8_5
      element Sample_Element_31: implementation-data-type=Arr_u16_2
    NV_Data_Sample_Block_12
      element Sample_Element_32: implementation-data-type=uint8
      element Sample_Element_33: implementation-data-type=uint32
      element Sample_Element_34: implementation-data-type=uint16
    NV_Data_Sample_Block_13
      element Sample_Element_35: implementation-data-type=Arr_Struct_c_16x10
    NV_Data_Sample_Block_14
      5 x element, all with category=TYPE_REFERENCE:
        Sample_Element_36: implementation-data-type=Struct_b
        Sample_Element_37: implementation-data-type=Arr_u8_5
        Sample_Element_38: implementation-data-type=Arr_u16_6x18
        Sample_Element_39: implementation-data-type=Arr_u8_4
        Sample_Element_40: implementation-data-type=Arr_u8_10x3
    NV_Data_Sample_Block_15
      10 x element, all with category=TYPE_REFERENCE:
        Sample_Element_41: implementation-data-type=uint16
        Sample_Element_42: implementation-data-type=uint8
        Sample_Element_43: implementation-data-type=Arr_u8_5
        Sample_Element_44: implementation-data-type=Arr_u16_6x18
        Sample_Element_45: implementation-data-type=Arr_u8_10x3
        Sample_Element_46: implementation-data-type=Struct_b
        Sample_Element_47: implementation-data-type=Arr_u8_5
        Sample_Element_48: implementation-data-type=uint32
        Sample_Element_49: implementation-data-type=uint16
        Sample_Element_50: implementation-data-type=uint8
    NV_Data_Sample_Block_2
      7 x element, all with category=TYPE_REFERENCE:
        Sample_Element_3: implementation-data-type=Arr_u32_29
        Sample_Element_4: implementation-data-type=Arr_u8_5
        Sample_Element_5: implementation-data-type=Arr_u8_10
        Sample_Element_6: implementation-data-type=Arr_u16_24
        Sample_Element_7: implementation-data-type=Arr_u16_2
        Sample_Element_8: implementation-data-type=Arr_u32_4
        Sample_Element_9: implementation-data-type=uint8
    NV_Data_Sample_Block_3
      element Sample_Element_10: implementation-data-type=uint16
      element Sample_Element_11: implementation-data-type=Arr_u8_5
      element Sample_Element_12: implementation-data-type=Arr_u32_5
    NV_Data_Sample_Block_4
      element Sample_Element_13: implementation-data-type=Arr_u8_5x18
    NV_Data_Sample_Block_5
      element Sample_Element_14: implementation-data-type=Arr_u16_6x18
    NV_Data_Sample_Block_6
      element Sample_Element_15: implementation-data-type=Arr_u8_4
    NV_Data_Sample_Block_7
      element Sample_Element_16: implementation-data-type=Arr_u8_10x3
    NV_Data_Sample_Block_8
      element Sample_Element_17: implementation-data-type=Struct_a
    NV_Data_Sample_Block_9
      element Sample_Element_18: implementation-data-type=uint32
