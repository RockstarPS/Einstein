AUTOSAR XML (schema 4-2-1)
package /ActiveEcuC
  module config Fee: implementation-config-variant=VARIANT-PRE-COMPILE, module-description=Fee_Impl
    FeeBlock_Template (FeeBlockConfiguration):
      FeeBlockIdFixed = false
      FeeBlockIsCritical = false
      FeeImmediateData = true
      FeeNumberOfChunkInstances = 1
      FeeBlockNumber = 1
      FeeBlockSize = 1
      FeeNumberOfWriteCycles = 10000
      FeeNumberOfDatasets = 1
      FeeBlockId = 1
      FeePartition = FeePartitionConfiguration
      FeeDeviceIndex = FlsGeneral
    FeeConfigBlock (FeeBlockConfiguration):
      FeeBlockIdFixed = false
      FeeBlockIsCritical = false
      FeeImmediateData = false
      FeeNumberOfChunkInstances = 1
      FeeBlockNumber = 42
      FeeBlockSize = 4
      FeeNumberOfWriteCycles = 10000
      FeeNumberOfDatasets = 2
      FeeBlockId = 2
      FeePartition = FeePartitionConfiguration_DIAG
      FeeDeviceIndex = FlsGeneral
    FeeGeneral:
      FeeDevErrorDetect = true
      FeeVersionInfoApi = false
      FeePollingMode = false
      FeeSetModeSupported = true
      FeeIndex = 0
      FeeNvmJobEndNotification = NvM_JobEndNotification
      FeeNvmJobErrorNotification = NvM_JobErrorNotification
      FeeInternalBufferSize = 64
      FeeMainFunctionPeriod = 0.01
      FeeNvmCbkIncludeFile = NvM_Cbk.h
      FeeMainFunctionTriggering = FixedCycleTime
      FeeDevErrorChecks: FeeDebugReporting=true, FeeDetErrorhook=Det_ReportError, FeeDetIncludeFile=Det.h
      FeeFlsApi:
        FeeFlsIncludeFile = NvMExt_Stubs.h
        FeeFlsSetMode = Fls_SetMode
        FeeFlsRead = NvmExt_Stubs_FlsRead
        FeeFlsWrite = NvmExt_Stubs_FlsWrite
        FeeFlsCancel = Fls_Cancel
        FeeFlsGetStatus = Fls_GetStatus
        FeeFlsGetJobResult = Fls_GetJobResult
        FeeFlsErase = Fls_Erase
        FeeFlsCompare = Fls_Compare
        FeeFlsDeviceIndex = FlsGeneral
    4 x FeePartitionConfiguration, all with FeeBssThresholdReserved=3072, FeeFssThresholdReserved=1024, FeeAddressAlignment=8, FeeWriteAlignment=8, FeeUpperSectorSize=8192, FeeLowerSectorSize=8192, FeePartitionDevice=FlsConfigSet_0:
      FeePartitionConfiguration_DIAG: FeeLowerSectorAddress=8192, FeeUpperSectorAddress=65536
      FeePartitionConfiguration_ODO: FeeLowerSectorAddress=24576, FeeUpperSectorAddress=81920
      FeePartitionConfiguration_SIGMA_FEE_BLK_1: FeeLowerSectorAddress=32768, FeeUpperSectorAddress=90112
      FeePartitionConfiguration_SIGMA_FEE_BLK_2: FeeLowerSectorAddress=49152, FeeUpperSectorAddress=106496
    FeePublishedInformation: FeeBlockOverhead=2, FeeMaximumBlockingTime=1, FeePageOverhead=0, FeeChunkHeader=16, FeeChunkLink=8, FeeSectorHeader=8
    FeeSpecificFeatures:
      FeeApplErrorCallbackFunction = Appl_FeeCriticalErrorCallback
      FeeApplErrorCallbackIncludeFile = ApplMain.h
      FeeGetEraseCycleApi = false
      FeeGetWriteCycleApi = false
      FeeUseApplErrorCallback = false
      FeeUseJobCache = false
      FeeForceSectorSwitchApi = false
      FeeDataConversionApi = false
      FeeFblConfig = false
      FeeMaxLinkTableSize = 4095
      FeeFssControlApi = false
    94 x FeeBlockConfiguration, all with FeeBlockIdFixed=false, FeeBlockIsCritical=false, FeeImmediateData=true, FeeNumberOfChunkInstances=1, FeeNumberOfWriteCycles=0, FeeNumberOfDatasets=1, FeePartition=FeePartitionConfiguration_CALIB, FeeDeviceIndex=FlsGeneral:
      Fee_Bargraph_Hysteresis_Coolant: FeeBlockNumber=20, FeeBlockSize=, FeeBlockId=20
      Fee_Bargraph_Treshold_Switch_Coolant: FeeBlockNumber=22, FeeBlockSize=, FeeBlockId=22
      Fee_Bargraph_VAR: FeeBlockNumber=16, FeeBlockSize=, FeeBlockId=16
      Fee_Bcct_Cfg_VAR_1: FeeBlockNumber=12, FeeBlockSize=, FeeBlockId=12
      Fee_Bcct_Cfg_VAR_2: FeeBlockNumber=13, FeeBlockSize=, FeeBlockId=13
      Fee_Bcct_Cfg_VAR_3: FeeBlockNumber=14, FeeBlockSize=, FeeBlockId=14
      Fee_CAN_VAR: FeeBlockNumber=86, FeeBlockSize=, FeeBlockId=86
      Fee_COMPONENTS_Cfg_CONST: FeeBlockNumber=71, FeeBlockSize=, FeeBlockId=71
      Fee_COMPONENTS_Cfg_VAR: FeeBlockNumber=60, FeeBlockSize=, FeeBlockId=60
      Fee_Cluster_Settings: FeeBlockNumber=58, FeeBlockSize=, FeeBlockId=58
      Fee_Com_Cfg_VAR: FeeBlockNumber=6, FeeBlockSize=64, FeeBlockId=6
      Fee_DATE_VAR: FeeBlockNumber=67, FeeBlockSize=, FeeBlockId=67
      Fee_DIAG_AC_Curve_Scales_VAR: FeeBlockNumber=76, FeeBlockSize=, FeeBlockId=76
      Fee_DIAG_AC_IlluminationCfg_VAR_0: FeeBlockNumber=77, FeeBlockSize=, FeeBlockId=77
      Fee_DIAG_AC_IlluminationCfg_VAR_1: FeeBlockNumber=78, FeeBlockSize=, FeeBlockId=78
      Fee_DIAG_AC_IlluminationCfg_VAR_3: FeeBlockNumber=79, FeeBlockSize=, FeeBlockId=79
      Fee_DIAG_AC_ServiceCfg_VAR: FeeBlockNumber=65, FeeBlockSize=, FeeBlockId=65
      Fee_DIAG_AdaptationChannel_VAR_0: FeeBlockNumber=68, FeeBlockSize=, FeeBlockId=68
      Fee_DIAG_AdaptationChannel_VAR_1: FeeBlockNumber=66, FeeBlockSize=, FeeBlockId=66
      Fee_DIAG_AdaptationChannel_VAR_2: FeeBlockNumber=69, FeeBlockSize=, FeeBlockId=69
      Fee_DIAG_Adjustment_VAR: FeeBlockNumber=9, FeeBlockSize=16, FeeBlockId=9
      Fee_DIAG_EOL_DiagCfg_CONST: FeeBlockNumber=35, FeeBlockSize=, FeeBlockId=35
      Fee_DIAG_EOL_HWCalib_CONST: FeeBlockNumber=39, FeeBlockSize=, FeeBlockId=39
      Fee_DIAG_EOL_HWCalib_CONST_1: FeeBlockNumber=57, FeeBlockSize=, FeeBlockId=57
      Fee_DIAG_EOL_PartNumber_CONST: FeeBlockNumber=40, FeeBlockSize=, FeeBlockId=40
      Fee_DIAG_EOL_VAR: FeeBlockNumber=34, FeeBlockSize=, FeeBlockId=34
      Fee_DIAG_VariantCodingCheck_CONST: FeeBlockNumber=63, FeeBlockSize=, FeeBlockId=63
      Fee_DIAG_VariantCoding_CONST: FeeBlockNumber=59, FeeBlockSize=, FeeBlockId=59
      Fee_Dev_Messages: FeeBlockNumber=73, FeeBlockSize=, FeeBlockId=73
      Fee_DtcAgingAdminDataBlock: FeeBlockNumber=62, FeeBlockSize=, FeeBlockId=62
      Fee_EEPVersionInfo_CONST: FeeBlockNumber=27, FeeBlockSize=, FeeBlockId=27
      Fee_Gamma_Adjustment_VAR: FeeBlockNumber=7, FeeBlockSize=16, FeeBlockId=7
      Fee_I5CM_ID_NVM_BlockDET: FeeBlockNumber=56, FeeBlockSize=, FeeBlockId=56
      Fee_I5CM_ID_NVM_BlockDL: FeeBlockNumber=55, FeeBlockSize=, FeeBlockId=55
      Fee_I5CM_ID_NVM_BlockKEYLC: FeeBlockNumber=47, FeeBlockSize=, FeeBlockId=47
      Fee_I5CM_ID_NVM_BlockKEY_0: FeeBlockNumber=53, FeeBlockSize=, FeeBlockId=53
      Fee_I5CM_ID_NVM_BlockKEY_1: FeeBlockNumber=51, FeeBlockSize=, FeeBlockId=51
      Fee_I5CM_ID_NVM_BlockKEY_2: FeeBlockNumber=49, FeeBlockSize=, FeeBlockId=49
      Fee_I5CM_ID_NVM_BlockLEARN_0: FeeBlockNumber=43, FeeBlockSize=, FeeBlockId=43
      Fee_I5CM_ID_NVM_BlockLEARN_1: FeeBlockNumber=38, FeeBlockSize=, FeeBlockId=38
      Fee_I5CM_ID_NVM_BlockLEARN_2: FeeBlockNumber=41, FeeBlockSize=, FeeBlockId=41
      Fee_I5CM_ID_NVM_BlockPARAM_0: FeeBlockNumber=37, FeeBlockSize=, FeeBlockId=37
      Fee_I5CM_ID_NVM_BlockPARAM_1: FeeBlockNumber=36, FeeBlockSize=, FeeBlockId=36
      Fee_I5CM_ID_NVM_BlockPARAM_2: FeeBlockNumber=33, FeeBlockSize=, FeeBlockId=33
      Fee_I5CM_ID_NVM_BlockSRM_0: FeeBlockNumber=31, FeeBlockSize=, FeeBlockId=31
      Fee_I5CM_ID_NVM_BlockSRM_1: FeeBlockNumber=28, FeeBlockSize=, FeeBlockId=28
      Fee_I5CM_ID_NVM_BlockSRM_2: FeeBlockNumber=26, FeeBlockSize=, FeeBlockId=26
      Fee_I5CM_ID_NVM_BlockSTATE_0: FeeBlockNumber=25, FeeBlockSize=, FeeBlockId=25
      Fee_I5CM_ID_NVM_BlockSTATE_1: FeeBlockNumber=24, FeeBlockSize=, FeeBlockId=24
      Fee_I5CM_ID_NVM_BlockSTATE_2: FeeBlockNumber=23, FeeBlockSize=, FeeBlockId=23
      Fee_I5CM_ID_NVM_BlockSTS_0: FeeBlockNumber=21, FeeBlockSize=, FeeBlockId=21
      Fee_I5CM_ID_NVM_BlockSTS_1: FeeBlockNumber=18, FeeBlockSize=, FeeBlockId=18
      Fee_I5CM_ID_NVM_BlockSTS_2: FeeBlockNumber=15, FeeBlockSize=, FeeBlockId=15
      Fee_KsNvmBlockGfaKey_0: FeeBlockNumber=82, FeeBlockSize=, FeeBlockId=82
      Fee_KsNvmBlockGfaKey_1: FeeBlockNumber=83, FeeBlockSize=, FeeBlockId=83
      Fee_KsNvmBlockMisc_0: FeeBlockNumber=84, FeeBlockSize=, FeeBlockId=84
      Fee_KsNvmBlockMisc_1: FeeBlockNumber=85, FeeBlockSize=, FeeBlockId=85
      Fee_NVM_BLOCK_IVD_0X0250: FeeBlockNumber=91, FeeBlockSize=, FeeBlockId=91
      Fee_NVM_BLOCK_SFD_ConfigurationFingerprint_Data: FeeBlockNumber=90, FeeBlockSize=, FeeBlockId=90
      Fee_NVM_BLOCK_SFD_PersistentData: FeeBlockNumber=89, FeeBlockSize=, FeeBlockId=89
      Fee_NVM_BLOCK_SFD_PublicKey: FeeBlockNumber=92, FeeBlockSize=, FeeBlockId=92
      Fee_NvMFblGeneral: FeeBlockNumber=2, FeeBlockSize=16, FeeBlockId=2
      Fee_NvMFblMetaData: FeeBlockNumber=1, FeeBlockSize=48, FeeBlockId=1
      Fee_NvMFblShareDataPartOne: FeeBlockNumber=3, FeeBlockSize=8, FeeBlockId=3
      Fee_NvMFblShareDataPartThree: FeeBlockNumber=5, FeeBlockSize=16, FeeBlockId=5
      Fee_NvMFblShareDataPartTwo: FeeBlockNumber=4, FeeBlockSize=16, FeeBlockId=4
      Fee_NvM_VKMS: FeeBlockNumber=88, FeeBlockSize=, FeeBlockId=88
      Fee_Nvm_Block_Reserved_1: FeeBlockNumber=17, FeeBlockSize=, FeeBlockId=17
      Fee_Nvm_Block_Reserved_2: FeeBlockNumber=19, FeeBlockSize=, FeeBlockId=19
      Fee_Nvm_Block_Reserved_4: FeeBlockNumber=10, FeeBlockSize=40, FeeBlockId=10
      Fee_Odometer_0: FeeBlockNumber=29, FeeBlockSize=, FeeBlockId=29
      Fee_Odometer_1: FeeBlockNumber=30, FeeBlockSize=, FeeBlockId=30
      Fee_Odometer_2: FeeBlockNumber=32, FeeBlockSize=, FeeBlockId=32
      Fee_OperatingTime_VAR: FeeBlockNumber=75, FeeBlockSize=, FeeBlockId=75
      Fee_REFUEL_Logger_VAR: FeeBlockNumber=70, FeeBlockSize=, FeeBlockId=70
      Fee_RGB_Calibration_VAR: FeeBlockNumber=8, FeeBlockSize=8, FeeBlockId=8
      Fee_RPM_Gauge_FIR_Coefficients: FeeBlockNumber=11, FeeBlockSize=8, FeeBlockId=11
      Fee_Recorder_VAR: FeeBlockNumber=74, FeeBlockSize=, FeeBlockId=74
      Fee_Recorder_VAR_2: FeeBlockNumber=87, FeeBlockSize=, FeeBlockId=87
      Fee_SAFETY_RECORD_VAR: FeeBlockNumber=81, FeeBlockSize=, FeeBlockId=81
      Fee_SRV_TKM_ZvCrH_TKM_ZvCrHPimTkKeyInCarNeed: FeeBlockNumber=80, FeeBlockSize=, FeeBlockId=80
      Fee_SecDiag: FeeBlockNumber=93, FeeBlockSize=, FeeBlockId=93
      Fee_ServiceKey_VAR: FeeBlockNumber=64, FeeBlockSize=, FeeBlockId=64
      Fee_Service_History_Data: FeeBlockNumber=61, FeeBlockSize=, FeeBlockId=61
      Fee_TANK_Variant_CONST: FeeBlockNumber=72, FeeBlockSize=, FeeBlockId=72
      Fee_USER_PROFILE0: FeeBlockNumber=54, FeeBlockSize=, FeeBlockId=54
      Fee_USER_PROFILE1: FeeBlockNumber=42, FeeBlockSize=, FeeBlockId=42
      Fee_USER_PROFILE2: FeeBlockNumber=44, FeeBlockSize=, FeeBlockId=44
      Fee_USER_PROFILE3: FeeBlockNumber=45, FeeBlockSize=, FeeBlockId=45
      Fee_USER_PROFILE4: FeeBlockNumber=46, FeeBlockSize=, FeeBlockId=46
      Fee_USER_PROFILE5: FeeBlockNumber=48, FeeBlockSize=, FeeBlockId=48
      Fee_USER_PROFILE6: FeeBlockNumber=50, FeeBlockSize=, FeeBlockId=50
      Fee_USER_PROFILE7: FeeBlockNumber=52, FeeBlockSize=, FeeBlockId=52
      Fee_WLTP_Odo_VAR: FeeBlockNumber=94, FeeBlockSize=, FeeBlockId=94
  module config NvM: implementation-config-variant=VARIANT-PRE-COMPILE, module-description=NvM_Impl
    95 x NvMBlockDescriptor, all with NvMInitBlockCallback=NULL_PTR, NvMResistantToChangedSw=true, NvMSelectBlockForReadAll=true, NvMUseInitCallback=false, NvMBswMBlockStatusInformation=false, NvMCalcRamBlockCrc=false, NvMNvBlockNum=2, NvMBlockWriteProt=false, NvMRamBlockDataAddress=NULL_PTR, NvMWriteBlockOnce=false, NvMAutomaticBlockLength=false, NvMBlockLengthCheckType=true:
      NvBlockSwComponentTypeNVBlockDescriptor_Bargraph_Hysteresis_Coolant: NvMBlockCrcType=NVM_CRC16, NvMBlockManagementType=NVM_BLOCK_REDUNDANT, NvMSelectBlockForWriteAll=false, NvMUseJobendCallback=true, NvMSingleBlockCallback=Bargraph_Hysteresis_Coolant_NvM_JobFinished, NvMBlockUseCrc=, NvMBlockUseSyncMechanism=true, NvMUseServicePorts=true, NvMNvramBlockIdentifier=20, NvMNvBlockLength=1, NvMRomBlockDataAddress=Rte_NvBlockSwComponentType_NVBlockDescriptor_ClusterSettings_ROM_NVBlockDescriptor_Bargraph_Hysteresis_Coolant, NvMBlockJobPriority=1, NvMReadRamBlockFromNvCallback=Rte_SetMirror_NvBlockSwComponentType_NVBlockDescriptor_Bargraph_Hysteresis_Coolant, NvMWriteRamBlockToNvCallback=Rte_GetMirror_NvBlockSwComponentType_NVBlockDescriptor_Bargraph_Hysteresis_Coolant, NvMBlockLengthCheck=true
        NvMTargetBlockReference
          NvMFeeRef: NvMNameOfFeeBlock=Fee_Bargraph_Hysteresis_Coolant
      NvBlockSwComponentTypeNVBlockDescriptor_Bargraph_Treshold_Switch_Coolant: NvMBlockCrcType=NVM_CRC16, NvMBlockManagementType=NVM_BLOCK_REDUNDANT, NvMSelectBlockForWriteAll=false, NvMUseJobendCallback=true, NvMSingleBlockCallback=Bargraph_Treshold_Switch_Coolant_NvM_JobFinished, NvMBlockUseCrc=, NvMBlockUseSyncMechanism=true, NvMUseServicePorts=true, NvMNvramBlockIdentifier=22, NvMNvBlockLength=1, NvMRomBlockDataAddress=Rte_NvBlockSwComponentType_NVBlockDescriptor_ClusterSettings_ROM_NVBlockDescriptor_Bargraph_Treshold_Switch_Coolant, NvMBlockJobPriority=1, NvMReadRamBlockFromNvCallback=Rte_SetMirror_NvBlockSwComponentType_NVBlockDescriptor_Bargraph_Treshold_Switch_Coolant, NvMWriteRamBlockToNvCallback=Rte_GetMirror_NvBlockSwComponentType_NVBlockDescriptor_Bargraph_Treshold_Switch_Coolant, NvMBlockLengthCheck=true
        NvMTargetBlockReference
          NvMFeeRef: NvMNameOfFeeBlock=Fee_Bargraph_Treshold_Switch_Coolant
      NvBlockSwComponentTypeNVBlockDescriptor_Bargraph_VAR: NvMBlockCrcType=NVM_CRC16, NvMBlockManagementType=NVM_BLOCK_REDUNDANT, NvMSelectBlockForWriteAll=false, NvMUseJobendCallback=true, NvMSingleBlockCallback=Bargraph_VAR_NvM_JobFinished, NvMBlockUseCrc=, NvMBlockUseSyncMechanism=true, NvMUseServicePorts=true, NvMNvramBlockIdentifier=16, NvMNvBlockLength=9, NvMRomBlockDataAddress=Rte_NvBlockSwComponentType_NVBlockDescriptor_ClusterSettings_ROM_NVBlockDescriptor_Bargraph_VAR, NvMBlockJobPriority=1, NvMReadRamBlockFromNvCallback=Rte_SetMirror_NvBlockSwComponentType_NVBlockDescriptor_Bargraph_VAR, NvMWriteRamBlockToNvCallback=Rte_GetMirror_NvBlockSwComponentType_NVBlockDescriptor_Bargraph_VAR, NvMBlockLengthCheck=true
        NvMTargetBlockReference
          NvMFeeRef: NvMNameOfFeeBlock=Fee_Bargraph_VAR
      NvBlockSwComponentTypeNVBlockDescriptor_Bcct_Cfg_VAR_1: NvMBlockCrcType=NVM_CRC16, NvMBlockManagementType=NVM_BLOCK_REDUNDANT, NvMSelectBlockForWriteAll=false, NvMUseJobendCallback=true, NvMSingleBlockCallback=Bcct_Cfg_VAR_1_NvM_JobFinished, NvMBlockUseCrc=, NvMBlockUseSyncMechanism=true, NvMUseServicePorts=true, NvMNvramBlockIdentifier=12, NvMNvBlockLength=2, NvMRomBlockDataAddress=Rte_NvBlockSwComponentType_NVBlockDescriptor_ClusterSettings_ROM_NVBlockDescriptor_Bcct_Cfg_VAR_1, NvMBlockJobPriority=1, NvMReadRamBlockFromNvCallback=Rte_SetMirror_NvBlockSwComponentType_NVBlockDescriptor_Bcct_Cfg_VAR_1, NvMWriteRamBlockToNvCallback=Rte_GetMirror_NvBlockSwComponentType_NVBlockDescriptor_Bcct_Cfg_VAR_1, NvMBlockLengthCheck=true
        NvMTargetBlockReference
          NvMFeeRef: NvMNameOfFeeBlock=Fee_Bcct_Cfg_VAR_1
      NvBlockSwComponentTypeNVBlockDescriptor_Bcct_Cfg_VAR_2: NvMBlockCrcType=NVM_CRC16, NvMBlockManagementType=NVM_BLOCK_REDUNDANT, NvMSelectBlockForWriteAll=false, NvMUseJobendCallback=true, NvMSingleBlockCallback=Bcct_Cfg_VAR_2_NvM_JobFinished, NvMBlockUseCrc=, NvMBlockUseSyncMechanism=true, NvMUseServicePorts=true, NvMNvramBlockIdentifier=13, NvMNvBlockLength=9, NvMRomBlockDataAddress=Rte_NvBlockSwComponentType_NVBlockDescriptor_ClusterSettings_ROM_NVBlockDescriptor_Bcct_Cfg_VAR_2, NvMBlockJobPriority=1, NvMReadRamBlockFromNvCallback=Rte_SetMirror_NvBlockSwComponentType_NVBlockDescriptor_Bcct_Cfg_VAR_2, NvMWriteRamBlockToNvCallback=Rte_GetMirror_NvBlockSwComponentType_NVBlockDescriptor_Bcct_Cfg_VAR_2, NvMBlockLengthCheck=true
        NvMTargetBlockReference
          NvMFeeRef: NvMNameOfFeeBlock=Fee_Bcct_Cfg_VAR_2
      NvBlockSwComponentTypeNVBlockDescriptor_Bcct_Cfg_VAR_3: NvMBlockCrcType=NVM_CRC16, NvMBlockManagementType=NVM_BLOCK_REDUNDANT, NvMSelectBlockForWriteAll=false, NvMUseJobendCallback=true, NvMSingleBlockCallback=Bcct_Cfg_VAR_3_NvM_JobFinished, NvMBlockUseCrc=, NvMBlockUseSyncMechanism=true, NvMUseServicePorts=true, NvMNvramBlockIdentifier=14, NvMNvBlockLength=1, NvMRomBlockDataAddress=Rte_NvBlockSwComponentType_NVBlockDescriptor_ClusterSettings_ROM_NVBlockDescriptor_Bcct_Cfg_VAR_3, NvMBlockJobPriority=1, NvMReadRamBlockFromNvCallback=Rte_SetMirror_NvBlockSwComponentType_NVBlockDescriptor_Bcct_Cfg_VAR_3, NvMWriteRamBlockToNvCallback=Rte_GetMirror_NvBlockSwComponentType_NVBlockDescriptor_Bcct_Cfg_VAR_3, NvMBlockLengthCheck=true
        NvMTargetBlockReference
          NvMFeeRef: NvMNameOfFeeBlock=Fee_Bcct_Cfg_VAR_3
      NvBlockSwComponentTypeNVBlockDescriptor_CAN_VAR: NvMBlockCrcType=NVM_CRC16, NvMBlockManagementType=NVM_BLOCK_REDUNDANT, NvMSelectBlockForWriteAll=false, NvMUseJobendCallback=true, NvMSingleBlockCallback=CAN_VAR_NvM_JobFinished, NvMBlockUseCrc=, NvMBlockUseSyncMechanism=true, NvMUseServicePorts=true, NvMNvramBlockIdentifier=86, NvMNvBlockLength=2, NvMRomBlockDataAddress=Rte_NvBlockSwComponentType_NVBlockDescriptor_ClusterSettings_ROM_NVBlockDescriptor_CAN_VAR, NvMBlockJobPriority=1, NvMReadRamBlockFromNvCallback=Rte_SetMirror_NvBlockSwComponentType_NVBlockDescriptor_CAN_VAR, NvMWriteRamBlockToNvCallback=Rte_GetMirror_NvBlockSwComponentType_NVBlockDescriptor_CAN_VAR, NvMBlockLengthCheck=true
        NvMTargetBlockReference
          NvMFeeRef: NvMNameOfFeeBlock=Fee_CAN_VAR
      NvBlockSwComponentTypeNVBlockDescriptor_COMPONENTS_Cfg_CONST: NvMBlockCrcType=NVM_CRC16, NvMBlockManagementType=NVM_BLOCK_REDUNDANT, NvMSelectBlockForWriteAll=false, NvMUseJobendCallback=true, NvMSingleBlockCallback=COMPONENTS_Cfg_CONST_NvM_JobFinished, NvMBlockUseCrc=, NvMBlockUseSyncMechanism=true, NvMUseServicePorts=true, NvMNvramBlockIdentifier=71, NvMNvBlockLength=40, NvMRomBlockDataAddress=Rte_NvBlockSwComponentType_NVBlockDescriptor_ClusterSettings_ROM_NVBlockDescriptor_COMPONENTS_Cfg_CONST, NvMBlockJobPriority=1, NvMReadRamBlockFromNvCallback=Rte_SetMirror_NvBlockSwComponentType_NVBlockDescriptor_COMPONENTS_Cfg_CONST, NvMWriteRamBlockToNvCallback=Rte_GetMirror_NvBlockSwComponentType_NVBlockDescriptor_COMPONENTS_Cfg_CONST, NvMBlockLengthCheck=true
        NvMTargetBlockReference
          NvMFeeRef: NvMNameOfFeeBlock=Fee_COMPONENTS_Cfg_CONST
      NvBlockSwComponentTypeNVBlockDescriptor_COMPONENTS_Cfg_VAR: NvMBlockCrcType=NVM_CRC16, NvMBlockManagementType=NVM_BLOCK_REDUNDANT, NvMSelectBlockForWriteAll=false, NvMUseJobendCallback=true, NvMSingleBlockCallback=COMPONENTS_Cfg_VAR_NvM_JobFinished, NvMBlockUseCrc=, NvMBlockUseSyncMechanism=true, NvMUseServicePorts=true, NvMNvramBlockIdentifier=60, NvMNvBlockLength=39, NvMRomBlockDataAddress=Rte_NvBlockSwComponentType_NVBlockDescriptor_ClusterSettings_ROM_NVBlockDescriptor_COMPONENTS_Cfg_VAR, NvMBlockJobPriority=1, NvMReadRamBlockFromNvCallback=Rte_SetMirror_NvBlockSwComponentType_NVBlockDescriptor_COMPONENTS_Cfg_VAR, NvMWriteRamBlockToNvCallback=Rte_GetMirror_NvBlockSwComponentType_NVBlockDescriptor_COMPONENTS_Cfg_VAR, NvMBlockLengthCheck=true
        NvMTargetBlockReference
          NvMFeeRef: NvMNameOfFeeBlock=Fee_COMPONENTS_Cfg_VAR
      NvBlockSwComponentTypeNVBlockDescriptor_Cluster_Settings: NvMBlockCrcType=NVM_CRC16, NvMBlockManagementType=NVM_BLOCK_REDUNDANT, NvMSelectBlockForWriteAll=false, NvMUseJobendCallback=true, NvMSingleBlockCallback=Cluster_Settings_NvM_JobFinished, NvMBlockUseCrc=, NvMBlockUseSyncMechanism=true, NvMUseServicePorts=true, NvMNvramBlockIdentifier=58, NvMNvBlockLength=16, NvMRomBlockDataAddress=Rte_NvBlockSwComponentType_NVBlockDescriptor_ClusterSettings_ROM_NVBlockDescriptor_Cluster_Settings, NvMBlockJobPriority=1, NvMReadRamBlockFromNvCallback=Rte_SetMirror_NvBlockSwComponentType_NVBlockDescriptor_Cluster_Settings, NvMWriteRamBlockToNvCallback=Rte_GetMirror_NvBlockSwComponentType_NVBlockDescriptor_Cluster_Settings, NvMBlockLengthCheck=true
        NvMTargetBlockReference
          NvMFeeRef: NvMNameOfFeeBlock=Fee_Cluster_Settings
      NvBlockSwComponentTypeNVBlockDescriptor_Com_Cfg_VAR: NvMBlockCrcType=NVM_CRC16, NvMBlockManagementType=NVM_BLOCK_REDUNDANT, NvMSelectBlockForWriteAll=false, NvMUseJobendCallback=true, NvMSingleBlockCallback=Com_Cfg_VAR_NvM_JobFinished, NvMBlockUseCrc=, NvMBlockUseSyncMechanism=true, NvMUseServicePorts=true, NvMNvramBlockIdentifier=6, NvMNvBlockLength=55, NvMRomBlockDataAddress=Rte_NvBlockSwComponentType_NVBlockDescriptor_ClusterSettings_ROM_NVBlockDescriptor_Com_Cfg_VAR, NvMBlockJobPriority=1, NvMReadRamBlockFromNvCallback=Rte_SetMirror_NvBlockSwComponentType_NVBlockDescriptor_Com_Cfg_VAR, NvMWriteRamBlockToNvCallback=Rte_GetMirror_NvBlockSwComponentType_NVBlockDescriptor_Com_Cfg_VAR, NvMBlockLengthCheck=true
        NvMTargetBlockReference
          NvMFeeRef: NvMNameOfFeeBlock=Fee_Com_Cfg_VAR
      NvBlockSwComponentTypeNVBlockDescriptor_DATE_VAR: NvMBlockCrcType=NVM_CRC16, NvMBlockManagementType=NVM_BLOCK_REDUNDANT, NvMSelectBlockForWriteAll=false, NvMUseJobendCallback=true, NvMSingleBlockCallback=DATE_VAR_NvM_JobFinished, NvMBlockUseCrc=, NvMBlockUseSyncMechanism=true, NvMUseServicePorts=true, NvMNvramBlockIdentifier=67, NvMNvBlockLength=3, NvMRomBlockDataAddress=Rte_NvBlockSwComponentType_NVBlockDescriptor_ClusterSettings_ROM_NVBlockDescriptor_DATE_VAR, NvMBlockJobPriority=1, NvMReadRamBlockFromNvCallback=Rte_SetMirror_NvBlockSwComponentType_NVBlockDescriptor_DATE_VAR, NvMWriteRamBlockToNvCallback=Rte_GetMirror_NvBlockSwComponentType_NVBlockDescriptor_DATE_VAR, NvMBlockLengthCheck=true
        NvMTargetBlockReference
          NvMFeeRef: NvMNameOfFeeBlock=Fee_DATE_VAR
      NvBlockSwComponentTypeNVBlockDescriptor_DIAG_AC_Curve_Scales_VAR: NvMBlockCrcType=NVM_CRC16, NvMBlockManagementType=NVM_BLOCK_REDUNDANT, NvMSelectBlockForWriteAll=false, NvMUseJobendCallback=true, NvMSingleBlockCallback=DIAG_AC_Curve_Scales_VAR_NvM_JobFinished, NvMBlockUseCrc=, NvMBlockUseSyncMechanism=true, NvMUseServicePorts=true, NvMNvramBlockIdentifier=76, NvMNvBlockLength=7, NvMRomBlockDataAddress=Rte_NvBlockSwComponentType_NVBlockDescriptor_ClusterSettings_ROM_NVBlockDescriptor_DIAG_AC_Curve_Scales_VAR, NvMBlockJobPriority=1, NvMReadRamBlockFromNvCallback=Rte_SetMirror_NvBlockSwComponentType_NVBlockDescriptor_DIAG_AC_Curve_Scales_VAR, NvMWriteRamBlockToNvCallback=Rte_GetMirror_NvBlockSwComponentType_NVBlockDescriptor_DIAG_AC_Curve_Scales_VAR, NvMBlockLengthCheck=true
        NvMTargetBlockReference
          NvMFeeRef: NvMNameOfFeeBlock=Fee_DIAG_AC_Curve_Scales_VAR
      NvBlockSwComponentTypeNVBlockDescriptor_DIAG_AC_IlluminationCfg_VAR_0: NvMBlockCrcType=NVM_CRC16, NvMBlockManagementType=NVM_BLOCK_REDUNDANT, NvMSelectBlockForWriteAll=false, NvMUseJobendCallback=true, NvMSingleBlockCallback=DIAG_AC_IlluminationCfg_VAR_0_NvM_JobFinished, NvMBlockUseCrc=, NvMBlockUseSyncMechanism=true, NvMUseServicePorts=true, NvMNvramBlockIdentifier=77, NvMNvBlockLength=8, NvMRomBlockDataAddress=Rte_NvBlockSwComponentType_NVBlockDescriptor_ClusterSettings_ROM_NVBlockDescriptor_DIAG_AC_IlluminationCfg_VAR_0, NvMBlockJobPriority=1, NvMReadRamBlockFromNvCallback=Rte_SetMirror_NvBlockSwComponentType_NVBlockDescriptor_DIAG_AC_IlluminationCfg_VAR_0, NvMWriteRamBlockToNvCallback=Rte_GetMirror_NvBlockSwComponentType_NVBlockDescriptor_DIAG_AC_IlluminationCfg_VAR_0, NvMBlockLengthCheck=true
        NvMTargetBlockReference
          NvMFeeRef: NvMNameOfFeeBlock=Fee_DIAG_AC_IlluminationCfg_VAR_0
      NvBlockSwComponentTypeNVBlockDescriptor_DIAG_AC_IlluminationCfg_VAR_1: NvMBlockCrcType=NVM_CRC16, NvMBlockManagementType=NVM_BLOCK_REDUNDANT, NvMSelectBlockForWriteAll=false, NvMUseJobendCallback=true, NvMSingleBlockCallback=DIAG_AC_IlluminationCfg_VAR_1_NvM_JobFinished, NvMBlockUseCrc=, NvMBlockUseSyncMechanism=true, NvMUseServicePorts=true, NvMNvramBlockIdentifier=78, NvMNvBlockLength=12, NvMRomBlockDataAddress=Rte_NvBlockSwComponentType_NVBlockDescriptor_ClusterSettings_ROM_NVBlockDescriptor_DIAG_AC_IlluminationCfg_VAR_1, NvMBlockJobPriority=1, NvMReadRamBlockFromNvCallback=Rte_SetMirror_NvBlockSwComponentType_NVBlockDescriptor_DIAG_AC_IlluminationCfg_VAR_1, NvMWriteRamBlockToNvCallback=Rte_GetMirror_NvBlockSwComponentType_NVBlockDescriptor_DIAG_AC_IlluminationCfg_VAR_1, NvMBlockLengthCheck=true
        NvMTargetBlockReference
          NvMFeeRef: NvMNameOfFeeBlock=Fee_DIAG_AC_IlluminationCfg_VAR_1
      NvBlockSwComponentTypeNVBlockDescriptor_DIAG_AC_IlluminationCfg_VAR_3: NvMBlockCrcType=NVM_CRC16, NvMBlockManagementType=NVM_BLOCK_REDUNDANT, NvMSelectBlockForWriteAll=false, NvMUseJobendCallback=true, NvMSingleBlockCallback=DIAG_AC_IlluminationCfg_VAR_3_NvM_JobFinished, NvMBlockUseCrc=, NvMBlockUseSyncMechanism=true, NvMUseServicePorts=true, NvMNvramBlockIdentifier=79, NvMNvBlockLength=18, NvMRomBlockDataAddress=Rte_NvBlockSwComponentType_NVBlockDescriptor_ClusterSettings_ROM_NVBlockDescriptor_DIAG_AC_IlluminationCfg_VAR_3, NvMBlockJobPriority=1, NvMReadRamBlockFromNvCallback=Rte_SetMirror_NvBlockSwComponentType_NVBlockDescriptor_DIAG_AC_IlluminationCfg_VAR_3, NvMWriteRamBlockToNvCallback=Rte_GetMirror_NvBlockSwComponentType_NVBlockDescriptor_DIAG_AC_IlluminationCfg_VAR_3, NvMBlockLengthCheck=true
        NvMTargetBlockReference
          NvMFeeRef: NvMNameOfFeeBlock=Fee_DIAG_AC_IlluminationCfg_VAR_3
      NvBlockSwComponentTypeNVBlockDescriptor_DIAG_AC_ServiceCfg_VAR: NvMBlockCrcType=NVM_CRC16, NvMBlockManagementType=NVM_BLOCK_REDUNDANT, NvMSelectBlockForWriteAll=false, NvMUseJobendCallback=true, NvMSingleBlockCallback=DIAG_AC_ServiceCfg_VAR_NvM_JobFinished, NvMBlockUseCrc=, NvMBlockUseSyncMechanism=true, NvMUseServicePorts=true, NvMNvramBlockIdentifier=65, NvMNvBlockLength=25, NvMRomBlockDataAddress=Rte_NvBlockSwComponentType_NVBlockDescriptor_ClusterSettings_ROM_NVBlockDescriptor_DIAG_AC_ServiceCfg_VAR, NvMBlockJobPriority=1, NvMReadRamBlockFromNvCallback=Rte_SetMirror_NvBlockSwComponentType_NVBlockDescriptor_DIAG_AC_ServiceCfg_VAR, NvMWriteRamBlockToNvCallback=Rte_GetMirror_NvBlockSwComponentType_NVBlockDescriptor_DIAG_AC_ServiceCfg_VAR, NvMBlockLengthCheck=true
        NvMTargetBlockReference
          NvMFeeRef: NvMNameOfFeeBlock=Fee_DIAG_AC_ServiceCfg_VAR
      NvBlockSwComponentTypeNVBlockDescriptor_DIAG_AdaptationChannel_VAR_0: NvMBlockCrcType=NVM_CRC16, NvMBlockManagementType=NVM_BLOCK_REDUNDANT, NvMSelectBlockForWriteAll=false, NvMUseJobendCallback=true, NvMSingleBlockCallback=DIAG_AdaptationChannel_VAR_0_NvM_JobFinished, NvMBlockUseCrc=, NvMBlockUseSyncMechanism=true, NvMUseServicePorts=true, NvMNvramBlockIdentifier=68, NvMNvBlockLength=45, NvMRomBlockDataAddress=Rte_NvBlockSwComponentType_NVBlockDescriptor_ClusterSettings_ROM_NVBlockDescriptor_DIAG_AdaptationChannel_VAR_0, NvMBlockJobPriority=1, NvMReadRamBlockFromNvCallback=Rte_SetMirror_NvBlockSwComponentType_NVBlockDescriptor_DIAG_AdaptationChannel_VAR_0, NvMWriteRamBlockToNvCallback=Rte_GetMirror_NvBlockSwComponentType_NVBlockDescriptor_DIAG_AdaptationChannel_VAR_0, NvMBlockLengthCheck=true
        NvMTargetBlockReference
          NvMFeeRef: NvMNameOfFeeBlock=Fee_DIAG_AdaptationChannel_VAR_0
      NvBlockSwComponentTypeNVBlockDescriptor_DIAG_AdaptationChannel_VAR_1: NvMBlockCrcType=NVM_CRC16, NvMBlockManagementType=NVM_BLOCK_REDUNDANT, NvMSelectBlockForWriteAll=false, NvMUseJobendCallback=true, NvMSingleBlockCallback=DIAG_AdaptationChannel_VAR_1_NvM_JobFinished, NvMBlockUseCrc=, NvMBlockUseSyncMechanism=true, NvMUseServicePorts=true, NvMNvramBlockIdentifier=66, NvMNvBlockLength=34, NvMRomBlockDataAddress=Rte_NvBlockSwComponentType_NVBlockDescriptor_ClusterSettings_ROM_NVBlockDescriptor_DIAG_AdaptationChannel_VAR_1, NvMBlockJobPriority=1, NvMReadRamBlockFromNvCallback=Rte_SetMirror_NvBlockSwComponentType_NVBlockDescriptor_DIAG_AdaptationChannel_VAR_1, NvMWriteRamBlockToNvCallback=Rte_GetMirror_NvBlockSwComponentType_NVBlockDescriptor_DIAG_AdaptationChannel_VAR_1, NvMBlockLengthCheck=true
        NvMTargetBlockReference
          NvMFeeRef: NvMNameOfFeeBlock=Fee_DIAG_AdaptationChannel_VAR_1
      NvBlockSwComponentTypeNVBlockDescriptor_DIAG_AdaptationChannel_VAR_2: NvMBlockCrcType=NVM_CRC16, NvMBlockManagementType=NVM_BLOCK_REDUNDANT, NvMSelectBlockForWriteAll=false, NvMUseJobendCallback=true, NvMSingleBlockCallback=DIAG_AdaptationChannel_VAR_2_NvM_JobFinished, NvMBlockUseCrc=, NvMBlockUseSyncMechanism=true, NvMUseServicePorts=true, NvMNvramBlockIdentifier=69, NvMNvBlockLength=9, NvMRomBlockDataAddress=Rte_NvBlockSwComponentType_NVBlockDescriptor_ClusterSettings_ROM_NVBlockDescriptor_DIAG_AdaptationChannel_VAR_2, NvMBlockJobPriority=1, NvMReadRamBlockFromNvCallback=Rte_SetMirror_NvBlockSwComponentType_NVBlockDescriptor_DIAG_AdaptationChannel_VAR_2, NvMWriteRamBlockToNvCallback=Rte_GetMirror_NvBlockSwComponentType_NVBlockDescriptor_DIAG_AdaptationChannel_VAR_2, NvMBlockLengthCheck=true
        NvMTargetBlockReference
          NvMFeeRef: NvMNameOfFeeBlock=Fee_DIAG_AdaptationChannel_VAR_2
      NvBlockSwComponentTypeNVBlockDescriptor_DIAG_Adjustment_VAR: NvMBlockCrcType=NVM_CRC16, NvMBlockManagementType=NVM_BLOCK_REDUNDANT, NvMSelectBlockForWriteAll=false, NvMUseJobendCallback=true, NvMSingleBlockCallback=DIAG_Adjustment_VAR_NvM_JobFinished, NvMBlockUseCrc=, NvMBlockUseSyncMechanism=true, NvMUseServicePorts=true, NvMNvramBlockIdentifier=9, NvMNvBlockLength=14, NvMRomBlockDataAddress=Rte_NvBlockSwComponentType_NVBlockDescriptor_ClusterSettings_ROM_NVBlockDescriptor_DIAG_Adjustment_VAR, NvMBlockJobPriority=1, NvMReadRamBlockFromNvCallback=Rte_SetMirror_NvBlockSwComponentType_NVBlockDescriptor_DIAG_Adjustment_VAR, NvMWriteRamBlockToNvCallback=Rte_GetMirror_NvBlockSwComponentType_NVBlockDescriptor_DIAG_Adjustment_VAR, NvMBlockLengthCheck=true
        NvMTargetBlockReference
          NvMFeeRef: NvMNameOfFeeBlock=Fee_DIAG_Adjustment_VAR
      NvBlockSwComponentTypeNVBlockDescriptor_DIAG_EOL_DiagCfg_CONST: NvMBlockCrcType=NVM_CRC16, NvMBlockManagementType=NVM_BLOCK_REDUNDANT, NvMSelectBlockForWriteAll=false, NvMUseJobendCallback=true, NvMSingleBlockCallback=DIAG_EOL_DiagCfg_CONST_NvM_JobFinished, NvMBlockUseCrc=, NvMBlockUseSyncMechanism=true, NvMUseServicePorts=true, NvMNvramBlockIdentifier=35, NvMNvBlockLength=19, NvMRomBlockDataAddress=Rte_NvBlockSwComponentType_NVBlockDescriptor_ClusterSettings_ROM_NVBlockDescriptor_DIAG_EOL_DiagCfg_CONST, NvMBlockJobPriority=1, NvMReadRamBlockFromNvCallback=Rte_SetMirror_NvBlockSwComponentType_NVBlockDescriptor_DIAG_EOL_DiagCfg_CONST, NvMWriteRamBlockToNvCallback=Rte_GetMirror_NvBlockSwComponentType_NVBlockDescriptor_DIAG_EOL_DiagCfg_CONST, NvMBlockLengthCheck=true
        NvMTargetBlockReference
          NvMFeeRef: NvMNameOfFeeBlock=Fee_DIAG_EOL_DiagCfg_CONST
      NvBlockSwComponentTypeNVBlockDescriptor_DIAG_EOL_HWCalib_CONST: NvMBlockCrcType=NVM_CRC16, NvMBlockManagementType=NVM_BLOCK_REDUNDANT, NvMSelectBlockForWriteAll=false, NvMUseJobendCallback=true, NvMSingleBlockCallback=DIAG_EOL_HWCalib_CONST_NvM_JobFinished, NvMBlockUseCrc=, NvMBlockUseSyncMechanism=true, NvMUseServicePorts=true, NvMNvramBlockIdentifier=39, NvMNvBlockLength=29, NvMRomBlockDataAddress=Rte_NvBlockSwComponentType_NVBlockDescriptor_ClusterSettings_ROM_NVBlockDescriptor_DIAG_EOL_HWCalib_CONST, NvMBlockJobPriority=1, NvMReadRamBlockFromNvCallback=Rte_SetMirror_NvBlockSwComponentType_NVBlockDescriptor_DIAG_EOL_HWCalib_CONST, NvMWriteRamBlockToNvCallback=Rte_GetMirror_NvBlockSwComponentType_NVBlockDescriptor_DIAG_EOL_HWCalib_CONST, NvMBlockLengthCheck=true
        NvMTargetBlockReference
          NvMFeeRef: NvMNameOfFeeBlock=Fee_DIAG_EOL_HWCalib_CONST
      NvBlockSwComponentTypeNVBlockDescriptor_DIAG_EOL_HWCalib_CONST_1: NvMBlockCrcType=NVM_CRC16, NvMBlockManagementType=NVM_BLOCK_REDUNDANT, NvMSelectBlockForWriteAll=false, NvMUseJobendCallback=true, NvMSingleBlockCallback=DIAG_EOL_HWCalib_CONST_1_NvM_JobFinished, NvMBlockUseCrc=, NvMBlockUseSyncMechanism=true, NvMUseServicePorts=true, NvMNvramBlockIdentifier=57, NvMNvBlockLength=9, NvMRomBlockDataAddress=Rte_NvBlockSwComponentType_NVBlockDescriptor_ClusterSettings_ROM_NVBlockDescriptor_DIAG_EOL_HWCalib_CONST_1, NvMBlockJobPriority=1, NvMReadRamBlockFromNvCallback=Rte_SetMirror_NvBlockSwComponentType_NVBlockDescriptor_DIAG_EOL_HWCalib_CONST_1, NvMWriteRamBlockToNvCallback=Rte_GetMirror_NvBlockSwComponentType_NVBlockDescriptor_DIAG_EOL_HWCalib_CONST_1, NvMBlockLengthCheck=true
        NvMTargetBlockReference
          NvMFeeRef: NvMNameOfFeeBlock=Fee_DIAG_EOL_HWCalib_CONST_1
      NvBlockSwComponentTypeNVBlockDescriptor_DIAG_EOL_PartNumber_CONST: NvMBlockCrcType=NVM_CRC16, NvMBlockManagementType=NVM_BLOCK_REDUNDANT, NvMSelectBlockForWriteAll=false, NvMUseJobendCallback=true, NvMSingleBlockCallback=DIAG_EOL_PartNumber_CONST_NvM_JobFinished, NvMBlockUseCrc=, NvMBlockUseSyncMechanism=true, NvMUseServicePorts=true, NvMNvramBlockIdentifier=40, NvMNvBlockLength=2, NvMRomBlockDataAddress=Rte_NvBlockSwComponentType_NVBlockDescriptor_ClusterSettings_ROM_NVBlockDescriptor_DIAG_EOL_PartNumber_CONST, NvMBlockJobPriority=1, NvMReadRamBlockFromNvCallback=Rte_SetMirror_NvBlockSwComponentType_NVBlockDescriptor_DIAG_EOL_PartNumber_CONST, NvMWriteRamBlockToNvCallback=Rte_GetMirror_NvBlockSwComponentType_NVBlockDescriptor_DIAG_EOL_PartNumber_CONST, NvMBlockLengthCheck=true
        NvMTargetBlockReference
          NvMFeeRef: NvMNameOfFeeBlock=Fee_DIAG_EOL_PartNumber_CONST
      NvBlockSwComponentTypeNVBlockDescriptor_DIAG_EOL_VAR: NvMBlockCrcType=NVM_CRC16, NvMBlockManagementType=NVM_BLOCK_REDUNDANT, NvMSelectBlockForWriteAll=false, NvMUseJobendCallback=true, NvMSingleBlockCallback=DIAG_EOL_VAR_NvM_JobFinished, NvMBlockUseCrc=, NvMBlockUseSyncMechanism=true, NvMUseServicePorts=true, NvMNvramBlockIdentifier=34, NvMNvBlockLength=6, NvMRomBlockDataAddress=Rte_NvBlockSwComponentType_NVBlockDescriptor_ClusterSettings_ROM_NVBlockDescriptor_DIAG_EOL_VAR, NvMBlockJobPriority=1, NvMReadRamBlockFromNvCallback=Rte_SetMirror_NvBlockSwComponentType_NVBlockDescriptor_DIAG_EOL_VAR, NvMWriteRamBlockToNvCallback=Rte_GetMirror_NvBlockSwComponentType_NVBlockDescriptor_DIAG_EOL_VAR, NvMBlockLengthCheck=true
        NvMTargetBlockReference
          NvMFeeRef: NvMNameOfFeeBlock=Fee_DIAG_EOL_VAR
      NvBlockSwComponentTypeNVBlockDescriptor_DIAG_VariantCodingCheck_CONST: NvMBlockCrcType=NVM_CRC16, NvMBlockManagementType=NVM_BLOCK_REDUNDANT, NvMSelectBlockForWriteAll=false, NvMUseJobendCallback=true, NvMSingleBlockCallback=DIAG_VariantCodingCheck_CONST_NvM_JobFinished, NvMBlockUseCrc=, NvMBlockUseSyncMechanism=true, NvMUseServicePorts=true, NvMNvramBlockIdentifier=63, NvMNvBlockLength=89, NvMRomBlockDataAddress=Rte_NvBlockSwComponentType_NVBlockDescriptor_ClusterSettings_ROM_NVBlockDescriptor_DIAG_VariantCodingCheck_CONST, NvMBlockJobPriority=1, NvMReadRamBlockFromNvCallback=Rte_SetMirror_NvBlockSwComponentType_NVBlockDescriptor_DIAG_VariantCodingCheck_CONST, NvMWriteRamBlockToNvCallback=Rte_GetMirror_NvBlockSwComponentType_NVBlockDescriptor_DIAG_VariantCodingCheck_CONST, NvMBlockLengthCheck=true
        NvMTargetBlockReference
          NvMFeeRef: NvMNameOfFeeBlock=Fee_DIAG_VariantCodingCheck_CONST
      NvBlockSwComponentTypeNVBlockDescriptor_DIAG_VariantCoding_CONST: NvMBlockCrcType=NVM_CRC16, NvMBlockManagementType=NVM_BLOCK_REDUNDANT, NvMSelectBlockForWriteAll=false, NvMUseJobendCallback=true, NvMSingleBlockCallback=DIAG_VariantCoding_CONST_NvM_JobFinished, NvMBlockUseCrc=, NvMBlockUseSyncMechanism=true, NvMUseServicePorts=true, NvMNvramBlockIdentifier=59, NvMNvBlockLength=94, NvMRomBlockDataAddress=Rte_NvBlockSwComponentType_NVBlockDescriptor_ClusterSettings_ROM_NVBlockDescriptor_DIAG_VariantCoding_CONST, NvMBlockJobPriority=1, NvMReadRamBlockFromNvCallback=Rte_SetMirror_NvBlockSwComponentType_NVBlockDescriptor_DIAG_VariantCoding_CONST, NvMWriteRamBlockToNvCallback=Rte_GetMirror_NvBlockSwComponentType_NVBlockDescriptor_DIAG_VariantCoding_CONST, NvMBlockLengthCheck=true
        NvMTargetBlockReference
          NvMFeeRef: NvMNameOfFeeBlock=Fee_DIAG_VariantCoding_CONST
      NvBlockSwComponentTypeNVBlockDescriptor_Dev_Messages: NvMBlockCrcType=NVM_CRC16, NvMBlockManagementType=NVM_BLOCK_REDUNDANT, NvMSelectBlockForWriteAll=false, NvMUseJobendCallback=true, NvMSingleBlockCallback=Dev_Messages_NvM_JobFinished, NvMBlockUseCrc=, NvMBlockUseSyncMechanism=true, NvMUseServicePorts=true, NvMNvramBlockIdentifier=73, NvMNvBlockLength=3, NvMRomBlockDataAddress=Rte_NvBlockSwComponentType_NVBlockDescriptor_ClusterSettings_ROM_NVBlockDescriptor_Dev_Messages, NvMBlockJobPriority=1, NvMReadRamBlockFromNvCallback=Rte_SetMirror_NvBlockSwComponentType_NVBlockDescriptor_Dev_Messages, NvMWriteRamBlockToNvCallback=Rte_GetMirror_NvBlockSwComponentType_NVBlockDescriptor_Dev_Messages, NvMBlockLengthCheck=true
        NvMTargetBlockReference
          NvMFeeRef: NvMNameOfFeeBlock=Fee_Dev_Messages
      NvBlockSwComponentTypeNVBlockDescriptor_DtcAgingAdminDataBlock: NvMBlockCrcType=NVM_CRC16, NvMBlockManagementType=NVM_BLOCK_REDUNDANT, NvMSelectBlockForWriteAll=false, NvMUseJobendCallback=true, NvMSingleBlockCallback=DtcAgingAdminDataBlock_NvM_JobFinished, NvMBlockUseCrc=, NvMBlockUseSyncMechanism=true, NvMUseServicePorts=true, NvMNvramBlockIdentifier=62, NvMNvBlockLength=1, NvMRomBlockDataAddress=Rte_NvBlockSwComponentType_NVBlockDescriptor_ClusterSettings_ROM_NVBlockDescriptor_DtcAgingAdminDataBlock, NvMBlockJobPriority=1, NvMReadRamBlockFromNvCallback=Rte_SetMirror_NvBlockSwComponentType_NVBlockDescriptor_DtcAgingAdminDataBlock, NvMWriteRamBlockToNvCallback=Rte_GetMirror_NvBlockSwComponentType_NVBlockDescriptor_DtcAgingAdminDataBlock, NvMBlockLengthCheck=true
        NvMTargetBlockReference
          NvMFeeRef: NvMNameOfFeeBlock=Fee_DtcAgingAdminDataBlock
      NvBlockSwComponentTypeNVBlockDescriptor_EEPVersionInfo_CONST: NvMBlockCrcType=NVM_CRC16, NvMBlockManagementType=NVM_BLOCK_REDUNDANT, NvMSelectBlockForWriteAll=false, NvMUseJobendCallback=true, NvMSingleBlockCallback=EEPVersionInfo_CONST_NvM_JobFinished, NvMBlockUseCrc=, NvMBlockUseSyncMechanism=true, NvMUseServicePorts=true, NvMNvramBlockIdentifier=27, NvMNvBlockLength=2, NvMRomBlockDataAddress=Rte_NvBlockSwComponentType_NVBlockDescriptor_ClusterSettings_ROM_NVBlockDescriptor_EEPVersionInfo_CONST, NvMBlockJobPriority=1, NvMReadRamBlockFromNvCallback=Rte_SetMirror_NvBlockSwComponentType_NVBlockDescriptor_EEPVersionInfo_CONST, NvMWriteRamBlockToNvCallback=Rte_GetMirror_NvBlockSwComponentType_NVBlockDescriptor_EEPVersionInfo_CONST, NvMBlockLengthCheck=true
        NvMTargetBlockReference
          NvMFeeRef: NvMNameOfFeeBlock=Fee_EEPVersionInfo_CONST
      NvBlockSwComponentTypeNVBlockDescriptor_Gamma_Adjustment_VAR: NvMBlockCrcType=NVM_CRC16, NvMBlockManagementType=NVM_BLOCK_REDUNDANT, NvMSelectBlockForWriteAll=false, NvMUseJobendCallback=true, NvMSingleBlockCallback=Gamma_Adjustment_VAR_NvM_JobFinished, NvMBlockUseCrc=, NvMBlockUseSyncMechanism=true, NvMUseServicePorts=true, NvMNvramBlockIdentifier=7, NvMNvBlockLength=8, NvMRomBlockDataAddress=Rte_NvBlockSwComponentType_NVBlockDescriptor_ClusterSettings_ROM_NVBlockDescriptor_Gamma_Adjustment_VAR, NvMBlockJobPriority=1, NvMReadRamBlockFromNvCallback=Rte_SetMirror_NvBlockSwComponentType_NVBlockDescriptor_Gamma_Adjustment_VAR, NvMWriteRamBlockToNvCallback=Rte_GetMirror_NvBlockSwComponentType_NVBlockDescriptor_Gamma_Adjustment_VAR, NvMBlockLengthCheck=true
        NvMTargetBlockReference
          NvMFeeRef: NvMNameOfFeeBlock=Fee_Gamma_Adjustment_VAR
      NvBlockSwComponentTypeNVBlockDescriptor_I5CM_ID_NVM_BlockDET: NvMBlockCrcType=NVM_CRC16, NvMBlockManagementType=NVM_BLOCK_NATIVE, NvMSelectBlockForWriteAll=false, NvMUseJobendCallback=true, NvMSingleBlockCallback=I5CM_ID_NVM_BlockDET_NvM_JobFinished, NvMBlockUseCrc=, NvMBlockUseSyncMechanism=true, NvMUseServicePorts=true, NvMNvramBlockIdentifier=56, NvMNvBlockLength=1, NvMRomBlockDataAddress=Rte_NvBlockSwComponentType_NVBlockDescriptor_ClusterSettings_ROM_NVBlockDescriptor_I5CM_ID_NVM_BlockDET, NvMBlockJobPriority=1, NvMReadRamBlockFromNvCallback=Rte_SetMirror_NvBlockSwComponentType_NVBlockDescriptor_I5CM_ID_NVM_BlockDET, NvMWriteRamBlockToNvCallback=Rte_GetMirror_NvBlockSwComponentType_NVBlockDescriptor_I5CM_ID_NVM_BlockDET, NvMBlockLengthCheck=true
        NvMTargetBlockReference
          NvMFeeRef: NvMNameOfFeeBlock=Fee_I5CM_ID_NVM_BlockDET
      NvBlockSwComponentTypeNVBlockDescriptor_I5CM_ID_NVM_BlockDL: NvMBlockCrcType=NVM_CRC16, NvMBlockManagementType=NVM_BLOCK_NATIVE, NvMSelectBlockForWriteAll=false, NvMUseJobendCallback=true, NvMSingleBlockCallback=I5CM_ID_NVM_BlockDL_NvM_JobFinished, NvMBlockUseCrc=, NvMBlockUseSyncMechanism=true, NvMUseServicePorts=true, NvMNvramBlockIdentifier=55, NvMNvBlockLength=1, NvMRomBlockDataAddress=Rte_NvBlockSwComponentType_NVBlockDescriptor_ClusterSettings_ROM_NVBlockDescriptor_I5CM_ID_NVM_BlockDL, NvMBlockJobPriority=1, NvMReadRamBlockFromNvCallback=Rte_SetMirror_NvBlockSwComponentType_NVBlockDescriptor_I5CM_ID_NVM_BlockDL, NvMWriteRamBlockToNvCallback=Rte_GetMirror_NvBlockSwComponentType_NVBlockDescriptor_I5CM_ID_NVM_BlockDL, NvMBlockLengthCheck=true
        NvMTargetBlockReference
          NvMFeeRef: NvMNameOfFeeBlock=Fee_I5CM_ID_NVM_BlockDL
      NvBlockSwComponentTypeNVBlockDescriptor_I5CM_ID_NVM_BlockKEYLC: NvMBlockCrcType=NVM_CRC16, NvMBlockManagementType=NVM_BLOCK_NATIVE, NvMSelectBlockForWriteAll=false, NvMUseJobendCallback=true, NvMSingleBlockCallback=I5CM_ID_NVM_BlockKEYLC_NvM_JobFinished, NvMBlockUseCrc=, NvMBlockUseSyncMechanism=true, NvMUseServicePorts=true, NvMNvramBlockIdentifier=47, NvMNvBlockLength=1, NvMRomBlockDataAddress=Rte_NvBlockSwComponentType_NVBlockDescriptor_ClusterSettings_ROM_NVBlockDescriptor_I5CM_ID_NVM_BlockKEYLC, NvMBlockJobPriority=1, NvMReadRamBlockFromNvCallback=Rte_SetMirror_NvBlockSwComponentType_NVBlockDescriptor_I5CM_ID_NVM_BlockKEYLC, NvMWriteRamBlockToNvCallback=Rte_GetMirror_NvBlockSwComponentType_NVBlockDescriptor_I5CM_ID_NVM_BlockKEYLC, NvMBlockLengthCheck=true
        NvMTargetBlockReference
          NvMFeeRef: NvMNameOfFeeBlock=Fee_I5CM_ID_NVM_BlockKEYLC
      NvBlockSwComponentTypeNVBlockDescriptor_I5CM_ID_NVM_BlockKEY_0: NvMBlockCrcType=NVM_CRC16, NvMBlockManagementType=NVM_BLOCK_NATIVE, NvMSelectBlockForWriteAll=false, NvMUseJobendCallback=true, NvMSingleBlockCallback=I5CM_ID_NVM_BlockKEY_0_NvM_JobFinished, NvMBlockUseCrc=, NvMBlockUseSyncMechanism=true, NvMUseServicePorts=true, NvMNvramBlockIdentifier=53, NvMNvBlockLength=1, NvMRomBlockDataAddress=Rte_NvBlockSwComponentType_NVBlockDescriptor_ClusterSettings_ROM_NVBlockDescriptor_I5CM_ID_NVM_BlockKEY_0, NvMBlockJobPriority=1, NvMReadRamBlockFromNvCallback=Rte_SetMirror_NvBlockSwComponentType_NVBlockDescriptor_I5CM_ID_NVM_BlockKEY_0, NvMWriteRamBlockToNvCallback=Rte_GetMirror_NvBlockSwComponentType_NVBlockDescriptor_I5CM_ID_NVM_BlockKEY_0, NvMBlockLengthCheck=true
        NvMTargetBlockReference
          NvMFeeRef: NvMNameOfFeeBlock=Fee_I5CM_ID_NVM_BlockKEY_0
      NvBlockSwComponentTypeNVBlockDescriptor_I5CM_ID_NVM_BlockKEY_1: NvMBlockCrcType=NVM_CRC16, NvMBlockManagementType=NVM_BLOCK_NATIVE, NvMSelectBlockForWriteAll=false, NvMUseJobendCallback=true, NvMSingleBlockCallback=I5CM_ID_NVM_BlockKEY_1_NvM_JobFinished, NvMBlockUseCrc=, NvMBlockUseSyncMechanism=true, NvMUseServicePorts=true, NvMNvramBlockIdentifier=51, NvMNvBlockLength=1, NvMRomBlockDataAddress=Rte_NvBlockSwComponentType_NVBlockDescriptor_ClusterSettings_ROM_NVBlockDescriptor_I5CM_ID_NVM_BlockKEY_1, NvMBlockJobPriority=1, NvMReadRamBlockFromNvCallback=Rte_SetMirror_NvBlockSwComponentType_NVBlockDescriptor_I5CM_ID_NVM_BlockKEY_1, NvMWriteRamBlockToNvCallback=Rte_GetMirror_NvBlockSwComponentType_NVBlockDescriptor_I5CM_ID_NVM_BlockKEY_1, NvMBlockLengthCheck=true
        NvMTargetBlockReference
          NvMFeeRef: NvMNameOfFeeBlock=Fee_I5CM_ID_NVM_BlockKEY_1
      NvBlockSwComponentTypeNVBlockDescriptor_I5CM_ID_NVM_BlockKEY_2: NvMBlockCrcType=NVM_CRC16, NvMBlockManagementType=NVM_BLOCK_NATIVE, NvMSelectBlockForWriteAll=false, NvMUseJobendCallback=true, NvMSingleBlockCallback=I5CM_ID_NVM_BlockKEY_2_NvM_JobFinished, NvMBlockUseCrc=, NvMBlockUseSyncMechanism=true, NvMUseServicePorts=true, NvMNvramBlockIdentifier=49, NvMNvBlockLength=1, NvMRomBlockDataAddress=Rte_NvBlockSwComponentType_NVBlockDescriptor_ClusterSettings_ROM_NVBlockDescriptor_I5CM_ID_NVM_BlockKEY_2, NvMBlockJobPriority=1, NvMReadRamBlockFromNvCallback=Rte_SetMirror_NvBlockSwComponentType_NVBlockDescriptor_I5CM_ID_NVM_BlockKEY_2, NvMWriteRamBlockToNvCallback=Rte_GetMirror_NvBlockSwComponentType_NVBlockDescriptor_I5CM_ID_NVM_BlockKEY_2, NvMBlockLengthCheck=true
        NvMTargetBlockReference
          NvMFeeRef: NvMNameOfFeeBlock=Fee_I5CM_ID_NVM_BlockKEY_2
      NvBlockSwComponentTypeNVBlockDescriptor_I5CM_ID_NVM_BlockLEARN_0: NvMBlockCrcType=NVM_CRC16, NvMBlockManagementType=NVM_BLOCK_NATIVE, NvMSelectBlockForWriteAll=false, NvMUseJobendCallback=true, NvMSingleBlockCallback=I5CM_ID_NVM_BlockLEARN_0_NvM_JobFinished, NvMBlockUseCrc=, NvMBlockUseSyncMechanism=true, NvMUseServicePorts=true, NvMNvramBlockIdentifier=43, NvMNvBlockLength=1, NvMRomBlockDataAddress=Rte_NvBlockSwComponentType_NVBlockDescriptor_ClusterSettings_ROM_NVBlockDescriptor_I5CM_ID_NVM_BlockLEARN_0, NvMBlockJobPriority=1, NvMReadRamBlockFromNvCallback=Rte_SetMirror_NvBlockSwComponentType_NVBlockDescriptor_I5CM_ID_NVM_BlockLEARN_0, NvMWriteRamBlockToNvCallback=Rte_GetMirror_NvBlockSwComponentType_NVBlockDescriptor_I5CM_ID_NVM_BlockLEARN_0, NvMBlockLengthCheck=true
        NvMTargetBlockReference
          NvMFeeRef: NvMNameOfFeeBlock=Fee_I5CM_ID_NVM_BlockLEARN_0
      NvBlockSwComponentTypeNVBlockDescriptor_I5CM_ID_NVM_BlockLEARN_1: NvMBlockCrcType=NVM_CRC16, NvMBlockManagementType=NVM_BLOCK_NATIVE, NvMSelectBlockForWriteAll=false, NvMUseJobendCallback=true, NvMSingleBlockCallback=I5CM_ID_NVM_BlockLEARN_1_NvM_JobFinished, NvMBlockUseCrc=, NvMBlockUseSyncMechanism=true, NvMUseServicePorts=true, NvMNvramBlockIdentifier=38, NvMNvBlockLength=1, NvMRomBlockDataAddress=Rte_NvBlockSwComponentType_NVBlockDescriptor_ClusterSettings_ROM_NVBlockDescriptor_I5CM_ID_NVM_BlockLEARN_1, NvMBlockJobPriority=1, NvMReadRamBlockFromNvCallback=Rte_SetMirror_NvBlockSwComponentType_NVBlockDescriptor_I5CM_ID_NVM_BlockLEARN_1, NvMWriteRamBlockToNvCallback=Rte_GetMirror_NvBlockSwComponentType_NVBlockDescriptor_I5CM_ID_NVM_BlockLEARN_1, NvMBlockLengthCheck=true
        NvMTargetBlockReference
          NvMFeeRef: NvMNameOfFeeBlock=Fee_I5CM_ID_NVM_BlockLEARN_1
      NvBlockSwComponentTypeNVBlockDescriptor_I5CM_ID_NVM_BlockLEARN_2: NvMBlockCrcType=NVM_CRC16, NvMBlockManagementType=NVM_BLOCK_NATIVE, NvMSelectBlockForWriteAll=false, NvMUseJobendCallback=true, NvMSingleBlockCallback=I5CM_ID_NVM_BlockLEARN_2_NvM_JobFinished, NvMBlockUseCrc=, NvMBlockUseSyncMechanism=true, NvMUseServicePorts=true, NvMNvramBlockIdentifier=41, NvMNvBlockLength=1, NvMRomBlockDataAddress=Rte_NvBlockSwComponentType_NVBlockDescriptor_ClusterSettings_ROM_NVBlockDescriptor_I5CM_ID_NVM_BlockLEARN_2, NvMBlockJobPriority=1, NvMReadRamBlockFromNvCallback=Rte_SetMirror_NvBlockSwComponentType_NVBlockDescriptor_I5CM_ID_NVM_BlockLEARN_2, NvMWriteRamBlockToNvCallback=Rte_GetMirror_NvBlockSwComponentType_NVBlockDescriptor_I5CM_ID_NVM_BlockLEARN_2, NvMBlockLengthCheck=true
        NvMTargetBlockReference
          NvMFeeRef: NvMNameOfFeeBlock=Fee_I5CM_ID_NVM_BlockLEARN_2
      NvBlockSwComponentTypeNVBlockDescriptor_I5CM_ID_NVM_BlockPARAM_0: NvMBlockCrcType=NVM_CRC16, NvMBlockManagementType=NVM_BLOCK_NATIVE, NvMSelectBlockForWriteAll=false, NvMUseJobendCallback=true, NvMSingleBlockCallback=I5CM_ID_NVM_BlockPARAM_0_NvM_JobFinished, NvMBlockUseCrc=, NvMBlockUseSyncMechanism=true, NvMUseServicePorts=true, NvMNvramBlockIdentifier=37, NvMNvBlockLength=1, NvMRomBlockDataAddress=Rte_NvBlockSwComponentType_NVBlockDescriptor_ClusterSettings_ROM_NVBlockDescriptor_I5CM_ID_NVM_BlockPARAM_0, NvMBlockJobPriority=1, NvMReadRamBlockFromNvCallback=Rte_SetMirror_NvBlockSwComponentType_NVBlockDescriptor_I5CM_ID_NVM_BlockPARAM_0, NvMWriteRamBlockToNvCallback=Rte_GetMirror_NvBlockSwComponentType_NVBlockDescriptor_I5CM_ID_NVM_BlockPARAM_0, NvMBlockLengthCheck=true
        NvMTargetBlockReference
          NvMFeeRef: NvMNameOfFeeBlock=Fee_I5CM_ID_NVM_BlockPARAM_0
      NvBlockSwComponentTypeNVBlockDescriptor_I5CM_ID_NVM_BlockPARAM_1: NvMBlockCrcType=NVM_CRC16, NvMBlockManagementType=NVM_BLOCK_NATIVE, NvMSelectBlockForWriteAll=false, NvMUseJobendCallback=true, NvMSingleBlockCallback=I5CM_ID_NVM_BlockPARAM_1_NvM_JobFinished, NvMBlockUseCrc=, NvMBlockUseSyncMechanism=true, NvMUseServicePorts=true, NvMNvramBlockIdentifier=36, NvMNvBlockLength=1, NvMRomBlockDataAddress=Rte_NvBlockSwComponentType_NVBlockDescriptor_ClusterSettings_ROM_NVBlockDescriptor_I5CM_ID_NVM_BlockPARAM_1, NvMBlockJobPriority=1, NvMReadRamBlockFromNvCallback=Rte_SetMirror_NvBlockSwComponentType_NVBlockDescriptor_I5CM_ID_NVM_BlockPARAM_1, NvMWriteRamBlockToNvCallback=Rte_GetMirror_NvBlockSwComponentType_NVBlockDescriptor_I5CM_ID_NVM_BlockPARAM_1, NvMBlockLengthCheck=true
        NvMTargetBlockReference
          NvMFeeRef: NvMNameOfFeeBlock=Fee_I5CM_ID_NVM_BlockPARAM_1
      NvBlockSwComponentTypeNVBlockDescriptor_I5CM_ID_NVM_BlockPARAM_2: NvMBlockCrcType=NVM_CRC16, NvMBlockManagementType=NVM_BLOCK_NATIVE, NvMSelectBlockForWriteAll=false, NvMUseJobendCallback=true, NvMSingleBlockCallback=I5CM_ID_NVM_BlockPARAM_2_NvM_JobFinished, NvMBlockUseCrc=, NvMBlockUseSyncMechanism=true, NvMUseServicePorts=true, NvMNvramBlockIdentifier=33, NvMNvBlockLength=1, NvMRomBlockDataAddress=Rte_NvBlockSwComponentType_NVBlockDescriptor_ClusterSettings_ROM_NVBlockDescriptor_I5CM_ID_NVM_BlockPARAM_2, NvMBlockJobPriority=1, NvMReadRamBlockFromNvCallback=Rte_SetMirror_NvBlockSwComponentType_NVBlockDescriptor_I5CM_ID_NVM_BlockPARAM_2, NvMWriteRamBlockToNvCallback=Rte_GetMirror_NvBlockSwComponentType_NVBlockDescriptor_I5CM_ID_NVM_BlockPARAM_2, NvMBlockLengthCheck=true
        NvMTargetBlockReference
          NvMFeeRef: NvMNameOfFeeBlock=Fee_I5CM_ID_NVM_BlockPARAM_2
      NvBlockSwComponentTypeNVBlockDescriptor_I5CM_ID_NVM_BlockSRM_0: NvMBlockCrcType=NVM_CRC16, NvMBlockManagementType=NVM_BLOCK_NATIVE, NvMSelectBlockForWriteAll=false, NvMUseJobendCallback=true, NvMSingleBlockCallback=I5CM_ID_NVM_BlockSRM_0_NvM_JobFinished, NvMBlockUseCrc=, NvMBlockUseSyncMechanism=true, NvMUseServicePorts=true, NvMNvramBlockIdentifier=31, NvMNvBlockLength=1, NvMRomBlockDataAddress=Rte_NvBlockSwComponentType_NVBlockDescriptor_ClusterSettings_ROM_NVBlockDescriptor_I5CM_ID_NVM_BlockSRM_0, NvMBlockJobPriority=1, NvMReadRamBlockFromNvCallback=Rte_SetMirror_NvBlockSwComponentType_NVBlockDescriptor_I5CM_ID_NVM_BlockSRM_0, NvMWriteRamBlockToNvCallback=Rte_GetMirror_NvBlockSwComponentType_NVBlockDescriptor_I5CM_ID_NVM_BlockSRM_0, NvMBlockLengthCheck=true
        NvMTargetBlockReference
          NvMFeeRef: NvMNameOfFeeBlock=Fee_I5CM_ID_NVM_BlockSRM_0
      NvBlockSwComponentTypeNVBlockDescriptor_I5CM_ID_NVM_BlockSRM_1: NvMBlockCrcType=NVM_CRC16, NvMBlockManagementType=NVM_BLOCK_NATIVE, NvMSelectBlockForWriteAll=false, NvMUseJobendCallback=true, NvMSingleBlockCallback=I5CM_ID_NVM_BlockSRM_1_NvM_JobFinished, NvMBlockUseCrc=, NvMBlockUseSyncMechanism=true, NvMUseServicePorts=true, NvMNvramBlockIdentifier=28, NvMNvBlockLength=1, NvMRomBlockDataAddress=Rte_NvBlockSwComponentType_NVBlockDescriptor_ClusterSettings_ROM_NVBlockDescriptor_I5CM_ID_NVM_BlockSRM_1, NvMBlockJobPriority=1, NvMReadRamBlockFromNvCallback=Rte_SetMirror_NvBlockSwComponentType_NVBlockDescriptor_I5CM_ID_NVM_BlockSRM_1, NvMWriteRamBlockToNvCallback=Rte_GetMirror_NvBlockSwComponentType_NVBlockDescriptor_I5CM_ID_NVM_BlockSRM_1, NvMBlockLengthCheck=true
        NvMTargetBlockReference
          NvMFeeRef: NvMNameOfFeeBlock=Fee_I5CM_ID_NVM_BlockSRM_1
      NvBlockSwComponentTypeNVBlockDescriptor_I5CM_ID_NVM_BlockSRM_2: NvMBlockCrcType=NVM_CRC16, NvMBlockManagementType=NVM_BLOCK_NATIVE, NvMSelectBlockForWriteAll=false, NvMUseJobendCallback=true, NvMSingleBlockCallback=I5CM_ID_NVM_BlockSRM_2_NvM_JobFinished, NvMBlockUseCrc=, NvMBlockUseSyncMechanism=true, NvMUseServicePorts=true, NvMNvramBlockIdentifier=26, NvMNvBlockLength=1, NvMRomBlockDataAddress=Rte_NvBlockSwComponentType_NVBlockDescriptor_ClusterSettings_ROM_NVBlockDescriptor_I5CM_ID_NVM_BlockSRM_2, NvMBlockJobPriority=1, NvMReadRamBlockFromNvCallback=Rte_SetMirror_NvBlockSwComponentType_NVBlockDescriptor_I5CM_ID_NVM_BlockSRM_2, NvMWriteRamBlockToNvCallback=Rte_GetMirror_NvBlockSwComponentType_NVBlockDescriptor_I5CM_ID_NVM_BlockSRM_2, NvMBlockLengthCheck=true
        NvMTargetBlockReference
          NvMFeeRef: NvMNameOfFeeBlock=Fee_I5CM_ID_NVM_BlockSRM_2
      NvBlockSwComponentTypeNVBlockDescriptor_I5CM_ID_NVM_BlockSTATE_0: NvMBlockCrcType=NVM_CRC16, NvMBlockManagementType=NVM_BLOCK_NATIVE, NvMSelectBlockForWriteAll=false, NvMUseJobendCallback=true, NvMSingleBlockCallback=I5CM_ID_NVM_BlockSTATE_0_NvM_JobFinished, NvMBlockUseCrc=, NvMBlockUseSyncMechanism=true, NvMUseServicePorts=true, NvMNvramBlockIdentifier=25, NvMNvBlockLength=1, NvMRomBlockDataAddress=Rte_NvBlockSwComponentType_NVBlockDescriptor_ClusterSettings_ROM_NVBlockDescriptor_I5CM_ID_NVM_BlockSTATE_0, NvMBlockJobPriority=1, NvMReadRamBlockFromNvCallback=Rte_SetMirror_NvBlockSwComponentType_NVBlockDescriptor_I5CM_ID_NVM_BlockSTATE_0, NvMWriteRamBlockToNvCallback=Rte_GetMirror_NvBlockSwComponentType_NVBlockDescriptor_I5CM_ID_NVM_BlockSTATE_0, NvMBlockLengthCheck=true
        NvMTargetBlockReference
          NvMFeeRef: NvMNameOfFeeBlock=Fee_I5CM_ID_NVM_BlockSTATE_0
      NvBlockSwComponentTypeNVBlockDescriptor_I5CM_ID_NVM_BlockSTATE_1: NvMBlockCrcType=NVM_CRC16, NvMBlockManagementType=NVM_BLOCK_NATIVE, NvMSelectBlockForWriteAll=false, NvMUseJobendCallback=true, NvMSingleBlockCallback=I5CM_ID_NVM_BlockSTATE_1_NvM_JobFinished, NvMBlockUseCrc=, NvMBlockUseSyncMechanism=true, NvMUseServicePorts=true, NvMNvramBlockIdentifier=24, NvMNvBlockLength=1, NvMRomBlockDataAddress=Rte_NvBlockSwComponentType_NVBlockDescriptor_ClusterSettings_ROM_NVBlockDescriptor_I5CM_ID_NVM_BlockSTATE_1, NvMBlockJobPriority=1, NvMReadRamBlockFromNvCallback=Rte_SetMirror_NvBlockSwComponentType_NVBlockDescriptor_I5CM_ID_NVM_BlockSTATE_1, NvMWriteRamBlockToNvCallback=Rte_GetMirror_NvBlockSwComponentType_NVBlockDescriptor_I5CM_ID_NVM_BlockSTATE_1, NvMBlockLengthCheck=true
        NvMTargetBlockReference
          NvMFeeRef: NvMNameOfFeeBlock=Fee_I5CM_ID_NVM_BlockSTATE_1
      NvBlockSwComponentTypeNVBlockDescriptor_I5CM_ID_NVM_BlockSTATE_2: NvMBlockCrcType=NVM_CRC16, NvMBlockManagementType=NVM_BLOCK_NATIVE, NvMSelectBlockForWriteAll=false, NvMUseJobendCallback=true, NvMSingleBlockCallback=I5CM_ID_NVM_BlockSTATE_2_NvM_JobFinished, NvMBlockUseCrc=, NvMBlockUseSyncMechanism=true, NvMUseServicePorts=true, NvMNvramBlockIdentifier=23, NvMNvBlockLength=1, NvMRomBlockDataAddress=Rte_NvBlockSwComponentType_NVBlockDescriptor_ClusterSettings_ROM_NVBlockDescriptor_I5CM_ID_NVM_BlockSTATE_2, NvMBlockJobPriority=1, NvMReadRamBlockFromNvCallback=Rte_SetMirror_NvBlockSwComponentType_NVBlockDescriptor_I5CM_ID_NVM_BlockSTATE_2, NvMWriteRamBlockToNvCallback=Rte_GetMirror_NvBlockSwComponentType_NVBlockDescriptor_I5CM_ID_NVM_BlockSTATE_2, NvMBlockLengthCheck=true
        NvMTargetBlockReference
          NvMFeeRef: NvMNameOfFeeBlock=Fee_I5CM_ID_NVM_BlockSTATE_2
      NvBlockSwComponentTypeNVBlockDescriptor_I5CM_ID_NVM_BlockSTS_0: NvMBlockCrcType=NVM_CRC16, NvMBlockManagementType=NVM_BLOCK_NATIVE, NvMSelectBlockForWriteAll=false, NvMUseJobendCallback=true, NvMSingleBlockCallback=I5CM_ID_NVM_BlockSTS_0_NvM_JobFinished, NvMBlockUseCrc=, NvMBlockUseSyncMechanism=true, NvMUseServicePorts=true, NvMNvramBlockIdentifier=21, NvMNvBlockLength=1, NvMRomBlockDataAddress=Rte_NvBlockSwComponentType_NVBlockDescriptor_ClusterSettings_ROM_NVBlockDescriptor_I5CM_ID_NVM_BlockSTS_0, NvMBlockJobPriority=1, NvMReadRamBlockFromNvCallback=Rte_SetMirror_NvBlockSwComponentType_NVBlockDescriptor_I5CM_ID_NVM_BlockSTS_0, NvMWriteRamBlockToNvCallback=Rte_GetMirror_NvBlockSwComponentType_NVBlockDescriptor_I5CM_ID_NVM_BlockSTS_0, NvMBlockLengthCheck=true
        NvMTargetBlockReference
          NvMFeeRef: NvMNameOfFeeBlock=Fee_I5CM_ID_NVM_BlockSTS_0
      NvBlockSwComponentTypeNVBlockDescriptor_I5CM_ID_NVM_BlockSTS_1: NvMBlockCrcType=NVM_CRC16, NvMBlockManagementType=NVM_BLOCK_NATIVE, NvMSelectBlockForWriteAll=false, NvMUseJobendCallback=true, NvMSingleBlockCallback=I5CM_ID_NVM_BlockSTS_1_NvM_JobFinished, NvMBlockUseCrc=, NvMBlockUseSyncMechanism=true, NvMUseServicePorts=true, NvMNvramBlockIdentifier=18, NvMNvBlockLength=1, NvMRomBlockDataAddress=Rte_NvBlockSwComponentType_NVBlockDescriptor_ClusterSettings_ROM_NVBlockDescriptor_I5CM_ID_NVM_BlockSTS_1, NvMBlockJobPriority=1, NvMReadRamBlockFromNvCallback=Rte_SetMirror_NvBlockSwComponentType_NVBlockDescriptor_I5CM_ID_NVM_BlockSTS_1, NvMWriteRamBlockToNvCallback=Rte_GetMirror_NvBlockSwComponentType_NVBlockDescriptor_I5CM_ID_NVM_BlockSTS_1, NvMBlockLengthCheck=true
        NvMTargetBlockReference
          NvMFeeRef: NvMNameOfFeeBlock=Fee_I5CM_ID_NVM_BlockSTS_1
      NvBlockSwComponentTypeNVBlockDescriptor_I5CM_ID_NVM_BlockSTS_2: NvMBlockCrcType=NVM_CRC16, NvMBlockManagementType=NVM_BLOCK_NATIVE, NvMSelectBlockForWriteAll=false, NvMUseJobendCallback=true, NvMSingleBlockCallback=I5CM_ID_NVM_BlockSTS_2_NvM_JobFinished, NvMBlockUseCrc=, NvMBlockUseSyncMechanism=true, NvMUseServicePorts=true, NvMNvramBlockIdentifier=15, NvMNvBlockLength=1, NvMRomBlockDataAddress=Rte_NvBlockSwComponentType_NVBlockDescriptor_ClusterSettings_ROM_NVBlockDescriptor_I5CM_ID_NVM_BlockSTS_2, NvMBlockJobPriority=1, NvMReadRamBlockFromNvCallback=Rte_SetMirror_NvBlockSwComponentType_NVBlockDescriptor_I5CM_ID_NVM_BlockSTS_2, NvMWriteRamBlockToNvCallback=Rte_GetMirror_NvBlockSwComponentType_NVBlockDescriptor_I5CM_ID_NVM_BlockSTS_2, NvMBlockLengthCheck=true
        NvMTargetBlockReference
          NvMFeeRef: NvMNameOfFeeBlock=Fee_I5CM_ID_NVM_BlockSTS_2
      NvBlockSwComponentTypeNVBlockDescriptor_KsNvmBlockGfaKey_0: NvMBlockCrcType=NVM_CRC16, NvMBlockManagementType=NVM_BLOCK_NATIVE, NvMSelectBlockForWriteAll=false, NvMUseJobendCallback=true, NvMSingleBlockCallback=KsNvmBlockGfaKey_0_NvM_JobFinished, NvMBlockUseCrc=, NvMBlockUseSyncMechanism=true, NvMUseServicePorts=true, NvMNvramBlockIdentifier=82, NvMNvBlockLength=1, NvMRomBlockDataAddress=Rte_NvBlockSwComponentType_NVBlockDescriptor_ClusterSettings_ROM_NVBlockDescriptor_KsNvmBlockGfaKey_0, NvMBlockJobPriority=1, NvMReadRamBlockFromNvCallback=Rte_SetMirror_NvBlockSwComponentType_NVBlockDescriptor_KsNvmBlockGfaKey_0, NvMWriteRamBlockToNvCallback=Rte_GetMirror_NvBlockSwComponentType_NVBlockDescriptor_KsNvmBlockGfaKey_0, NvMBlockLengthCheck=true
        NvMTargetBlockReference
          NvMFeeRef: NvMNameOfFeeBlock=Fee_KsNvmBlockGfaKey_0
      NvBlockSwComponentTypeNVBlockDescriptor_KsNvmBlockGfaKey_1: NvMBlockCrcType=NVM_CRC16, NvMBlockManagementType=NVM_BLOCK_NATIVE, NvMSelectBlockForWriteAll=false, NvMUseJobendCallback=true, NvMSingleBlockCallback=KsNvmBlockGfaKey_1_NvM_JobFinished, NvMBlockUseCrc=, NvMBlockUseSyncMechanism=true, NvMUseServicePorts=true, NvMNvramBlockIdentifier=83, NvMNvBlockLength=1, NvMRomBlockDataAddress=Rte_NvBlockSwComponentType_NVBlockDescriptor_ClusterSettings_ROM_NVBlockDescriptor_KsNvmBlockGfaKey_1, NvMBlockJobPriority=1, NvMReadRamBlockFromNvCallback=Rte_SetMirror_NvBlockSwComponentType_NVBlockDescriptor_KsNvmBlockGfaKey_1, NvMWriteRamBlockToNvCallback=Rte_GetMirror_NvBlockSwComponentType_NVBlockDescriptor_KsNvmBlockGfaKey_1, NvMBlockLengthCheck=true
        NvMTargetBlockReference
          NvMFeeRef: NvMNameOfFeeBlock=Fee_KsNvmBlockGfaKey_1
      NvBlockSwComponentTypeNVBlockDescriptor_KsNvmBlockMisc_0: NvMBlockCrcType=NVM_CRC16, NvMBlockManagementType=NVM_BLOCK_NATIVE, NvMSelectBlockForWriteAll=false, NvMUseJobendCallback=true, NvMSingleBlockCallback=KsNvmBlockMisc_0_NvM_JobFinished, NvMBlockUseCrc=, NvMBlockUseSyncMechanism=true, NvMUseServicePorts=true, NvMNvramBlockIdentifier=84, NvMNvBlockLength=1, NvMRomBlockDataAddress=Rte_NvBlockSwComponentType_NVBlockDescriptor_ClusterSettings_ROM_NVBlockDescriptor_KsNvmBlockMisc_0, NvMBlockJobPriority=1, NvMReadRamBlockFromNvCallback=Rte_SetMirror_NvBlockSwComponentType_NVBlockDescriptor_KsNvmBlockMisc_0, NvMWriteRamBlockToNvCallback=Rte_GetMirror_NvBlockSwComponentType_NVBlockDescriptor_KsNvmBlockMisc_0, NvMBlockLengthCheck=true
        NvMTargetBlockReference
          NvMFeeRef: NvMNameOfFeeBlock=Fee_KsNvmBlockMisc_0
      NvBlockSwComponentTypeNVBlockDescriptor_KsNvmBlockMisc_1: NvMBlockCrcType=NVM_CRC16, NvMBlockManagementType=NVM_BLOCK_NATIVE, NvMSelectBlockForWriteAll=false, NvMUseJobendCallback=true, NvMSingleBlockCallback=KsNvmBlockMisc_1_NvM_JobFinished, NvMBlockUseCrc=, NvMBlockUseSyncMechanism=true, NvMUseServicePorts=true, NvMNvramBlockIdentifier=85, NvMNvBlockLength=1, NvMRomBlockDataAddress=Rte_NvBlockSwComponentType_NVBlockDescriptor_ClusterSettings_ROM_NVBlockDescriptor_KsNvmBlockMisc_1, NvMBlockJobPriority=1, NvMReadRamBlockFromNvCallback=Rte_SetMirror_NvBlockSwComponentType_NVBlockDescriptor_KsNvmBlockMisc_1, NvMWriteRamBlockToNvCallback=Rte_GetMirror_NvBlockSwComponentType_NVBlockDescriptor_KsNvmBlockMisc_1, NvMBlockLengthCheck=true
        NvMTargetBlockReference
          NvMFeeRef: NvMNameOfFeeBlock=Fee_KsNvmBlockMisc_1
      NvBlockSwComponentTypeNVBlockDescriptor_NVM_BLOCK_IVD_0X0250: NvMBlockCrcType=NVM_CRC16, NvMBlockManagementType=NVM_BLOCK_NATIVE, NvMSelectBlockForWriteAll=false, NvMUseJobendCallback=true, NvMSingleBlockCallback=NVM_BLOCK_IVD_0X0250_NvM_JobFinished, NvMBlockUseCrc=, NvMBlockUseSyncMechanism=true, NvMUseServicePorts=true, NvMNvramBlockIdentifier=91, NvMNvBlockLength=1, NvMRomBlockDataAddress=Rte_NvBlockSwComponentType_NVBlockDescriptor_ClusterSettings_ROM_NVBlockDescriptor_NVM_BLOCK_IVD_0X0250, NvMBlockJobPriority=1, NvMReadRamBlockFromNvCallback=Rte_SetMirror_NvBlockSwComponentType_NVBlockDescriptor_NVM_BLOCK_IVD_0X0250, NvMWriteRamBlockToNvCallback=Rte_GetMirror_NvBlockSwComponentType_NVBlockDescriptor_NVM_BLOCK_IVD_0X0250, NvMBlockLengthCheck=true
        NvMTargetBlockReference
          NvMFeeRef: NvMNameOfFeeBlock=Fee_NVM_BLOCK_IVD_0X0250
      NvBlockSwComponentTypeNVBlockDescriptor_NVM_BLOCK_SFD_ConfigurationFingerprint_Data: NvMBlockCrcType=NVM_CRC32, NvMBlockManagementType=NVM_BLOCK_NATIVE, NvMSelectBlockForWriteAll=false, NvMUseJobendCallback=true, NvMSingleBlockCallback=NVM_BLOCK_SFD_ConfigurationFingerprint_Data_NvM_JobFinished, NvMBlockUseCrc=, NvMBlockUseSyncMechanism=true, NvMUseServicePorts=true, NvMNvramBlockIdentifier=90, NvMNvBlockLength=1, NvMRomBlockDataAddress=Rte_NvBlockSwComponentType_NVBlockDescriptor_ClusterSettings_ROM_NVBlockDescriptor_NVM_BLOCK_SFD_ConfigurationFingerprint_Data, NvMBlockJobPriority=1, NvMReadRamBlockFromNvCallback=Rte_SetMirror_NvBlockSwComponentType_NVBlockDescriptor_NVM_BLOCK_SFD_ConfigurationFingerprint_Data, NvMWriteRamBlockToNvCallback=Rte_GetMirror_NvBlockSwComponentType_NVBlockDescriptor_NVM_BLOCK_SFD_ConfigurationFingerprint_Data, NvMBlockLengthCheck=true
        NvMTargetBlockReference
          NvMFeeRef: NvMNameOfFeeBlock=Fee_NVM_BLOCK_SFD_ConfigurationFingerprint_Data
      NvBlockSwComponentTypeNVBlockDescriptor_NVM_BLOCK_SFD_PersistentData: NvMBlockCrcType=NVM_CRC32, NvMBlockManagementType=NVM_BLOCK_NATIVE, NvMSelectBlockForWriteAll=false, NvMUseJobendCallback=true, NvMSingleBlockCallback=NVM_BLOCK_SFD_PersistentData_NvM_JobFinished, NvMBlockUseCrc=, NvMBlockUseSyncMechanism=true, NvMUseServicePorts=true, NvMNvramBlockIdentifier=89, NvMNvBlockLength=1, NvMRomBlockDataAddress=Rte_NvBlockSwComponentType_NVBlockDescriptor_ClusterSettings_ROM_NVBlockDescriptor_NVM_BLOCK_SFD_PersistentData, NvMBlockJobPriority=1, NvMReadRamBlockFromNvCallback=Rte_SetMirror_NvBlockSwComponentType_NVBlockDescriptor_NVM_BLOCK_SFD_PersistentData, NvMWriteRamBlockToNvCallback=Rte_GetMirror_NvBlockSwComponentType_NVBlockDescriptor_NVM_BLOCK_SFD_PersistentData, NvMBlockLengthCheck=true
        NvMTargetBlockReference
          NvMFeeRef: NvMNameOfFeeBlock=Fee_NVM_BLOCK_SFD_PersistentData
      NvBlockSwComponentTypeNVBlockDescriptor_NVM_BLOCK_SFD_PublicKey: NvMBlockCrcType=NVM_CRC32, NvMBlockManagementType=NVM_BLOCK_NATIVE, NvMSelectBlockForWriteAll=false, NvMUseJobendCallback=true, NvMSingleBlockCallback=NVM_BLOCK_SFD_PublicKey_NvM_JobFinished, NvMBlockUseCrc=, NvMBlockUseSyncMechanism=true, NvMUseServicePorts=true, NvMNvramBlockIdentifier=92, NvMNvBlockLength=1, NvMRomBlockDataAddress=Rte_NvBlockSwComponentType_NVBlockDescriptor_ClusterSettings_ROM_NVBlockDescriptor_NVM_BLOCK_SFD_PublicKey, NvMBlockJobPriority=1, NvMReadRamBlockFromNvCallback=Rte_SetMirror_NvBlockSwComponentType_NVBlockDescriptor_NVM_BLOCK_SFD_PublicKey, NvMWriteRamBlockToNvCallback=Rte_GetMirror_NvBlockSwComponentType_NVBlockDescriptor_NVM_BLOCK_SFD_PublicKey, NvMBlockLengthCheck=true
        NvMTargetBlockReference
          NvMFeeRef: NvMNameOfFeeBlock=Fee_NVM_BLOCK_SFD_PublicKey
      NvBlockSwComponentTypeNVBlockDescriptor_NvMFblGeneral: NvMBlockCrcType=NO CRC, NvMBlockManagementType=NVM_BLOCK_REDUNDANT, NvMSelectBlockForWriteAll=false, NvMUseJobendCallback=true, NvMSingleBlockCallback=NvMFblGeneral_NvM_JobFinished, NvMBlockUseCrc=, NvMBlockUseSyncMechanism=true, NvMUseServicePorts=true, NvMNvramBlockIdentifier=2, NvMNvBlockLength=10, NvMRomBlockDataAddress=Rte_NvBlockSwComponentType_NVBlockDescriptor_ClusterSettings_ROM_NVBlockDescriptor_NvMFblGeneral, NvMBlockJobPriority=1, NvMReadRamBlockFromNvCallback=Rte_SetMirror_NvBlockSwComponentType_NVBlockDescriptor_NvMFblGeneral, NvMWriteRamBlockToNvCallback=Rte_GetMirror_NvBlockSwComponentType_NVBlockDescriptor_NvMFblGeneral, NvMBlockLengthCheck=true
        NvMTargetBlockReference
          NvMFeeRef: NvMNameOfFeeBlock=Fee_NvMFblGeneral
      NvBlockSwComponentTypeNVBlockDescriptor_NvMFblMetaData: NvMBlockCrcType=NO CRC, NvMBlockManagementType=NVM_BLOCK_REDUNDANT, NvMSelectBlockForWriteAll=false, NvMUseJobendCallback=true, NvMSingleBlockCallback=NvMFblMetaData_NvM_JobFinished, NvMBlockUseCrc=, NvMBlockUseSyncMechanism=true, NvMUseServicePorts=true, NvMNvramBlockIdentifier=1, NvMNvBlockLength=42, NvMRomBlockDataAddress=Rte_NvBlockSwComponentType_NVBlockDescriptor_ClusterSettings_ROM_NVBlockDescriptor_NvMFblMetaData, NvMBlockJobPriority=1, NvMReadRamBlockFromNvCallback=Rte_SetMirror_NvBlockSwComponentType_NVBlockDescriptor_NvMFblMetaData, NvMWriteRamBlockToNvCallback=Rte_GetMirror_NvBlockSwComponentType_NVBlockDescriptor_NvMFblMetaData, NvMBlockLengthCheck=true
        NvMTargetBlockReference
          NvMFeeRef: NvMNameOfFeeBlock=Fee_NvMFblMetaData
      NvBlockSwComponentTypeNVBlockDescriptor_NvMFblShareDataPartOne: NvMBlockCrcType=NO CRC, NvMBlockManagementType=NVM_BLOCK_REDUNDANT, NvMSelectBlockForWriteAll=false, NvMUseJobendCallback=true, NvMSingleBlockCallback=NvMFblShareDataPartOne_NvM_JobFinished, NvMBlockUseCrc=, NvMBlockUseSyncMechanism=true, NvMUseServicePorts=true, NvMNvramBlockIdentifier=3, NvMNvBlockLength=6, NvMRomBlockDataAddress=Rte_NvBlockSwComponentType_NVBlockDescriptor_ClusterSettings_ROM_NVBlockDescriptor_NvMFblShareDataPartOne, NvMBlockJobPriority=1, NvMReadRamBlockFromNvCallback=Rte_SetMirror_NvBlockSwComponentType_NVBlockDescriptor_NvMFblShareDataPartOne, NvMWriteRamBlockToNvCallback=Rte_GetMirror_NvBlockSwComponentType_NVBlockDescriptor_NvMFblShareDataPartOne, NvMBlockLengthCheck=true
        NvMTargetBlockReference
          NvMFeeRef: NvMNameOfFeeBlock=Fee_NvMFblShareDataPartOne
      NvBlockSwComponentTypeNVBlockDescriptor_NvMFblShareDataPartThree: NvMBlockCrcType=NO CRC, NvMBlockManagementType=NVM_BLOCK_REDUNDANT, NvMSelectBlockForWriteAll=false, NvMUseJobendCallback=true, NvMSingleBlockCallback=NvMFblShareDataPartThree_NvM_JobFinished, NvMBlockUseCrc=, NvMBlockUseSyncMechanism=true, NvMUseServicePorts=true, NvMNvramBlockIdentifier=5, NvMNvBlockLength=7, NvMRomBlockDataAddress=Rte_NvBlockSwComponentType_NVBlockDescriptor_ClusterSettings_ROM_NVBlockDescriptor_NvMFblShareDataPartThree, NvMBlockJobPriority=1, NvMReadRamBlockFromNvCallback=Rte_SetMirror_NvBlockSwComponentType_NVBlockDescriptor_NvMFblShareDataPartThree, NvMWriteRamBlockToNvCallback=Rte_GetMirror_NvBlockSwComponentType_NVBlockDescriptor_NvMFblShareDataPartThree, NvMBlockLengthCheck=true
        NvMTargetBlockReference
          NvMFeeRef: NvMNameOfFeeBlock=Fee_NvMFblShareDataPartThree
      NvBlockSwComponentTypeNVBlockDescriptor_NvMFblShareDataPartTwo: NvMBlockCrcType=NO CRC, NvMBlockManagementType=NVM_BLOCK_REDUNDANT, NvMSelectBlockForWriteAll=false, NvMUseJobendCallback=true, NvMSingleBlockCallback=NvMFblShareDataPartTwo_NvM_JobFinished, NvMBlockUseCrc=, NvMBlockUseSyncMechanism=true, NvMUseServicePorts=true, NvMNvramBlockIdentifier=4, NvMNvBlockLength=9, NvMRomBlockDataAddress=Rte_NvBlockSwComponentType_NVBlockDescriptor_ClusterSettings_ROM_NVBlockDescriptor_NvMFblShareDataPartTwo, NvMBlockJobPriority=1, NvMReadRamBlockFromNvCallback=Rte_SetMirror_NvBlockSwComponentType_NVBlockDescriptor_NvMFblShareDataPartTwo, NvMWriteRamBlockToNvCallback=Rte_GetMirror_NvBlockSwComponentType_NVBlockDescriptor_NvMFblShareDataPartTwo, NvMBlockLengthCheck=true
        NvMTargetBlockReference
          NvMFeeRef: NvMNameOfFeeBlock=Fee_NvMFblShareDataPartTwo
      NvBlockSwComponentTypeNVBlockDescriptor_NvM_VKMS: NvMBlockCrcType=NVM_CRC16, NvMBlockManagementType=NVM_BLOCK_REDUNDANT, NvMSelectBlockForWriteAll=false, NvMUseJobendCallback=true, NvMSingleBlockCallback=NvM_VKMS_NvM_JobFinished, NvMBlockUseCrc=, NvMBlockUseSyncMechanism=true, NvMUseServicePorts=true, NvMNvramBlockIdentifier=88, NvMNvBlockLength=1, NvMRomBlockDataAddress=Rte_NvBlockSwComponentType_NVBlockDescriptor_ClusterSettings_ROM_NVBlockDescriptor_NvM_VKMS, NvMBlockJobPriority=1, NvMReadRamBlockFromNvCallback=Rte_SetMirror_NvBlockSwComponentType_NVBlockDescriptor_NvM_VKMS, NvMWriteRamBlockToNvCallback=Rte_GetMirror_NvBlockSwComponentType_NVBlockDescriptor_NvM_VKMS, NvMBlockLengthCheck=true
        NvMTargetBlockReference
          NvMFeeRef: NvMNameOfFeeBlock=Fee_NvM_VKMS
      NvBlockSwComponentTypeNVBlockDescriptor_Nvm_Block_Reserved_1: NvMBlockCrcType=NVM_CRC16, NvMBlockManagementType=NVM_BLOCK_REDUNDANT, NvMSelectBlockForWriteAll=false, NvMUseJobendCallback=true, NvMSingleBlockCallback=Nvm_Block_Reserved_1_NvM_JobFinished, NvMBlockUseCrc=, NvMBlockUseSyncMechanism=true, NvMUseServicePorts=true, NvMNvramBlockIdentifier=17, NvMNvBlockLength=9, NvMRomBlockDataAddress=Rte_NvBlockSwComponentType_NVBlockDescriptor_ClusterSettings_ROM_NVBlockDescriptor_Nvm_Block_Reserved_1, NvMBlockJobPriority=1, NvMReadRamBlockFromNvCallback=Rte_SetMirror_NvBlockSwComponentType_NVBlockDescriptor_Nvm_Block_Reserved_1, NvMWriteRamBlockToNvCallback=Rte_GetMirror_NvBlockSwComponentType_NVBlockDescriptor_Nvm_Block_Reserved_1, NvMBlockLengthCheck=true
        NvMTargetBlockReference
          NvMFeeRef: NvMNameOfFeeBlock=Fee_Nvm_Block_Reserved_1
      NvBlockSwComponentTypeNVBlockDescriptor_Nvm_Block_Reserved_2: NvMBlockCrcType=NVM_CRC16, NvMBlockManagementType=NVM_BLOCK_REDUNDANT, NvMSelectBlockForWriteAll=false, NvMUseJobendCallback=true, NvMSingleBlockCallback=Nvm_Block_Reserved_2_NvM_JobFinished, NvMBlockUseCrc=, NvMBlockUseSyncMechanism=true, NvMUseServicePorts=true, NvMNvramBlockIdentifier=19, NvMNvBlockLength=32, NvMRomBlockDataAddress=Rte_NvBlockSwComponentType_NVBlockDescriptor_ClusterSettings_ROM_NVBlockDescriptor_Nvm_Block_Reserved_2, NvMBlockJobPriority=1, NvMReadRamBlockFromNvCallback=Rte_SetMirror_NvBlockSwComponentType_NVBlockDescriptor_Nvm_Block_Reserved_2, NvMWriteRamBlockToNvCallback=Rte_GetMirror_NvBlockSwComponentType_NVBlockDescriptor_Nvm_Block_Reserved_2, NvMBlockLengthCheck=true
        NvMTargetBlockReference
          NvMFeeRef: NvMNameOfFeeBlock=Fee_Nvm_Block_Reserved_2
      NvBlockSwComponentTypeNVBlockDescriptor_Nvm_Block_Reserved_4: NvMBlockCrcType=NVM_CRC16, NvMBlockManagementType=NVM_BLOCK_REDUNDANT, NvMSelectBlockForWriteAll=false, NvMUseJobendCallback=true, NvMSingleBlockCallback=Nvm_Block_Reserved_4_NvM_JobFinished, NvMBlockUseCrc=, NvMBlockUseSyncMechanism=true, NvMUseServicePorts=true, NvMNvramBlockIdentifier=10, NvMNvBlockLength=34, NvMRomBlockDataAddress=Rte_NvBlockSwComponentType_NVBlockDescriptor_ClusterSettings_ROM_NVBlockDescriptor_Nvm_Block_Reserved_4, NvMBlockJobPriority=1, NvMReadRamBlockFromNvCallback=Rte_SetMirror_NvBlockSwComponentType_NVBlockDescriptor_Nvm_Block_Reserved_4, NvMWriteRamBlockToNvCallback=Rte_GetMirror_NvBlockSwComponentType_NVBlockDescriptor_Nvm_Block_Reserved_4, NvMBlockLengthCheck=true
        NvMTargetBlockReference
          NvMFeeRef: NvMNameOfFeeBlock=Fee_Nvm_Block_Reserved_4
      NvBlockSwComponentTypeNVBlockDescriptor_Odometer_0: NvMBlockCrcType=NO CRC, NvMBlockManagementType=NVM_BLOCK_NATIVE, NvMSelectBlockForWriteAll=false, NvMUseJobendCallback=true, NvMSingleBlockCallback=Odometer_0_NvM_JobFinished, NvMBlockUseCrc=, NvMBlockUseSyncMechanism=true, NvMUseServicePorts=true, NvMNvramBlockIdentifier=29, NvMNvBlockLength=1, NvMRomBlockDataAddress=Rte_NvBlockSwComponentType_NVBlockDescriptor_ClusterSettings_ROM_NVBlockDescriptor_Odometer_0, NvMBlockJobPriority=1, NvMReadRamBlockFromNvCallback=Rte_SetMirror_NvBlockSwComponentType_NVBlockDescriptor_Odometer_0, NvMWriteRamBlockToNvCallback=Rte_GetMirror_NvBlockSwComponentType_NVBlockDescriptor_Odometer_0, NvMBlockLengthCheck=true
        NvMTargetBlockReference
          NvMFeeRef: NvMNameOfFeeBlock=Fee_Odometer_0
      NvBlockSwComponentTypeNVBlockDescriptor_Odometer_1: NvMBlockCrcType=NO CRC, NvMBlockManagementType=NVM_BLOCK_NATIVE, NvMSelectBlockForWriteAll=false, NvMUseJobendCallback=true, NvMSingleBlockCallback=Odometer_1_NvM_JobFinished, NvMBlockUseCrc=, NvMBlockUseSyncMechanism=true, NvMUseServicePorts=true, NvMNvramBlockIdentifier=30, NvMNvBlockLength=1, NvMRomBlockDataAddress=Rte_NvBlockSwComponentType_NVBlockDescriptor_ClusterSettings_ROM_NVBlockDescriptor_Odometer_1, NvMBlockJobPriority=1, NvMReadRamBlockFromNvCallback=Rte_SetMirror_NvBlockSwComponentType_NVBlockDescriptor_Odometer_1, NvMWriteRamBlockToNvCallback=Rte_GetMirror_NvBlockSwComponentType_NVBlockDescriptor_Odometer_1, NvMBlockLengthCheck=true
        NvMTargetBlockReference
          NvMFeeRef: NvMNameOfFeeBlock=Fee_Odometer_1
      NvBlockSwComponentTypeNVBlockDescriptor_Odometer_2: NvMBlockCrcType=NO CRC, NvMBlockManagementType=NVM_BLOCK_NATIVE, NvMSelectBlockForWriteAll=false, NvMUseJobendCallback=true, NvMSingleBlockCallback=Odometer_2_NvM_JobFinished, NvMBlockUseCrc=, NvMBlockUseSyncMechanism=true, NvMUseServicePorts=true, NvMNvramBlockIdentifier=32, NvMNvBlockLength=1, NvMRomBlockDataAddress=Rte_NvBlockSwComponentType_NVBlockDescriptor_ClusterSettings_ROM_NVBlockDescriptor_Odometer_2, NvMBlockJobPriority=1, NvMReadRamBlockFromNvCallback=Rte_SetMirror_NvBlockSwComponentType_NVBlockDescriptor_Odometer_2, NvMWriteRamBlockToNvCallback=Rte_GetMirror_NvBlockSwComponentType_NVBlockDescriptor_Odometer_2, NvMBlockLengthCheck=true
        NvMTargetBlockReference
          NvMFeeRef: NvMNameOfFeeBlock=Fee_Odometer_2
      NvBlockSwComponentTypeNVBlockDescriptor_OperatingTime_VAR: NvMBlockCrcType=NVM_CRC16, NvMBlockManagementType=NVM_BLOCK_REDUNDANT, NvMSelectBlockForWriteAll=false, NvMUseJobendCallback=true, NvMSingleBlockCallback=OperatingTime_VAR_NvM_JobFinished, NvMBlockUseCrc=, NvMBlockUseSyncMechanism=true, NvMUseServicePorts=true, NvMNvramBlockIdentifier=75, NvMNvBlockLength=3, NvMRomBlockDataAddress=Rte_NvBlockSwComponentType_NVBlockDescriptor_ClusterSettings_ROM_NVBlockDescriptor_OperatingTime_VAR, NvMBlockJobPriority=1, NvMReadRamBlockFromNvCallback=Rte_SetMirror_NvBlockSwComponentType_NVBlockDescriptor_OperatingTime_VAR, NvMWriteRamBlockToNvCallback=Rte_GetMirror_NvBlockSwComponentType_NVBlockDescriptor_OperatingTime_VAR, NvMBlockLengthCheck=true
        NvMTargetBlockReference
          NvMFeeRef: NvMNameOfFeeBlock=Fee_OperatingTime_VAR
      NvBlockSwComponentTypeNVBlockDescriptor_REFUEL_Logger_VAR: NvMBlockCrcType=NVM_CRC16, NvMBlockManagementType=NVM_BLOCK_REDUNDANT, NvMSelectBlockForWriteAll=false, NvMUseJobendCallback=true, NvMSingleBlockCallback=REFUEL_Logger_VAR_NvM_JobFinished, NvMBlockUseCrc=, NvMBlockUseSyncMechanism=true, NvMUseServicePorts=true, NvMNvramBlockIdentifier=70, NvMNvBlockLength=25, NvMRomBlockDataAddress=Rte_NvBlockSwComponentType_NVBlockDescriptor_ClusterSettings_ROM_NVBlockDescriptor_REFUEL_Logger_VAR, NvMBlockJobPriority=1, NvMReadRamBlockFromNvCallback=Rte_SetMirror_NvBlockSwComponentType_NVBlockDescriptor_REFUEL_Logger_VAR, NvMWriteRamBlockToNvCallback=Rte_GetMirror_NvBlockSwComponentType_NVBlockDescriptor_REFUEL_Logger_VAR, NvMBlockLengthCheck=true
        NvMTargetBlockReference
          NvMFeeRef: NvMNameOfFeeBlock=Fee_REFUEL_Logger_VAR
      NvBlockSwComponentTypeNVBlockDescriptor_RGB_Calibration_VAR: NvMBlockCrcType=NVM_CRC16, NvMBlockManagementType=NVM_BLOCK_REDUNDANT, NvMSelectBlockForWriteAll=false, NvMUseJobendCallback=true, NvMSingleBlockCallback=RGB_Calibration_VAR_NvM_JobFinished, NvMBlockUseCrc=, NvMBlockUseSyncMechanism=true, NvMUseServicePorts=true, NvMNvramBlockIdentifier=8, NvMNvBlockLength=4, NvMRomBlockDataAddress=Rte_NvBlockSwComponentType_NVBlockDescriptor_ClusterSettings_ROM_NVBlockDescriptor_RGB_Calibration_VAR, NvMBlockJobPriority=1, NvMReadRamBlockFromNvCallback=Rte_SetMirror_NvBlockSwComponentType_NVBlockDescriptor_RGB_Calibration_VAR, NvMWriteRamBlockToNvCallback=Rte_GetMirror_NvBlockSwComponentType_NVBlockDescriptor_RGB_Calibration_VAR, NvMBlockLengthCheck=true
        NvMTargetBlockReference
          NvMFeeRef: NvMNameOfFeeBlock=Fee_RGB_Calibration_VAR
      NvBlockSwComponentTypeNVBlockDescriptor_RPM_Gauge_FIR_Coefficients: NvMBlockCrcType=NVM_CRC16, NvMBlockManagementType=NVM_BLOCK_REDUNDANT, NvMSelectBlockForWriteAll=false, NvMUseJobendCallback=true, NvMSingleBlockCallback=RPM_Gauge_FIR_Coefficients_NvM_JobFinished, NvMBlockUseCrc=, NvMBlockUseSyncMechanism=true, NvMUseServicePorts=true, NvMNvramBlockIdentifier=11, NvMNvBlockLength=1, NvMRomBlockDataAddress=Rte_NvBlockSwComponentType_NVBlockDescriptor_ClusterSettings_ROM_NVBlockDescriptor_RPM_Gauge_FIR_Coefficients, NvMBlockJobPriority=1, NvMReadRamBlockFromNvCallback=Rte_SetMirror_NvBlockSwComponentType_NVBlockDescriptor_RPM_Gauge_FIR_Coefficients, NvMWriteRamBlockToNvCallback=Rte_GetMirror_NvBlockSwComponentType_NVBlockDescriptor_RPM_Gauge_FIR_Coefficients, NvMBlockLengthCheck=true
        NvMTargetBlockReference
          NvMFeeRef: NvMNameOfFeeBlock=Fee_RPM_Gauge_FIR_Coefficients
      NvBlockSwComponentTypeNVBlockDescriptor_Recorder_VAR: NvMBlockCrcType=NVM_CRC16, NvMBlockManagementType=NVM_BLOCK_REDUNDANT, NvMSelectBlockForWriteAll=false, NvMUseJobendCallback=true, NvMSingleBlockCallback=Recorder_VAR_NvM_JobFinished, NvMBlockUseCrc=, NvMBlockUseSyncMechanism=true, NvMUseServicePorts=true, NvMNvramBlockIdentifier=74, NvMNvBlockLength=87, NvMRomBlockDataAddress=Rte_NvBlockSwComponentType_NVBlockDescriptor_ClusterSettings_ROM_NVBlockDescriptor_Recorder_VAR, NvMBlockJobPriority=1, NvMReadRamBlockFromNvCallback=Rte_SetMirror_NvBlockSwComponentType_NVBlockDescriptor_Recorder_VAR, NvMWriteRamBlockToNvCallback=Rte_GetMirror_NvBlockSwComponentType_NVBlockDescriptor_Recorder_VAR, NvMBlockLengthCheck=true
        NvMTargetBlockReference
          NvMFeeRef: NvMNameOfFeeBlock=Fee_Recorder_VAR
      NvBlockSwComponentTypeNVBlockDescriptor_Recorder_VAR_2: NvMBlockCrcType=NVM_CRC16, NvMBlockManagementType=NVM_BLOCK_REDUNDANT, NvMSelectBlockForWriteAll=false, NvMUseJobendCallback=true, NvMSingleBlockCallback=Recorder_VAR_2_NvM_JobFinished, NvMBlockUseCrc=, NvMBlockUseSyncMechanism=true, NvMUseServicePorts=true, NvMNvramBlockIdentifier=87, NvMNvBlockLength=27, NvMRomBlockDataAddress=Rte_NvBlockSwComponentType_NVBlockDescriptor_ClusterSettings_ROM_NVBlockDescriptor_Recorder_VAR_2, NvMBlockJobPriority=1, NvMReadRamBlockFromNvCallback=Rte_SetMirror_NvBlockSwComponentType_NVBlockDescriptor_Recorder_VAR_2, NvMWriteRamBlockToNvCallback=Rte_GetMirror_NvBlockSwComponentType_NVBlockDescriptor_Recorder_VAR_2, NvMBlockLengthCheck=true
        NvMTargetBlockReference
          NvMFeeRef: NvMNameOfFeeBlock=Fee_Recorder_VAR_2
      NvBlockSwComponentTypeNVBlockDescriptor_SAFETY_RECORD_VAR: NvMBlockCrcType=NVM_CRC16, NvMBlockManagementType=NVM_BLOCK_REDUNDANT, NvMSelectBlockForWriteAll=false, NvMUseJobendCallback=true, NvMSingleBlockCallback=SAFETY_RECORD_VAR_NvM_JobFinished, NvMBlockUseCrc=, NvMBlockUseSyncMechanism=true, NvMUseServicePorts=true, NvMNvramBlockIdentifier=81, NvMNvBlockLength=17, NvMRomBlockDataAddress=Rte_NvBlockSwComponentType_NVBlockDescriptor_ClusterSettings_ROM_NVBlockDescriptor_SAFETY_RECORD_VAR, NvMBlockJobPriority=1, NvMReadRamBlockFromNvCallback=Rte_SetMirror_NvBlockSwComponentType_NVBlockDescriptor_SAFETY_RECORD_VAR, NvMWriteRamBlockToNvCallback=Rte_GetMirror_NvBlockSwComponentType_NVBlockDescriptor_SAFETY_RECORD_VAR, NvMBlockLengthCheck=true
        NvMTargetBlockReference
          NvMFeeRef: NvMNameOfFeeBlock=Fee_SAFETY_RECORD_VAR
      NvBlockSwComponentTypeNVBlockDescriptor_SRV_TKM_ZvCrH_TKM_ZvCrHPimTkKeyInCarNeed: NvMBlockCrcType=NVM_CRC16, NvMBlockManagementType=NVM_BLOCK_REDUNDANT, NvMSelectBlockForWriteAll=false, NvMUseJobendCallback=true, NvMSingleBlockCallback=SRV_TKM_ZvCrH_TKM_ZvCrHPimTkKeyInCarNeed_NvM_JobFinished, NvMBlockUseCrc=, NvMBlockUseSyncMechanism=true, NvMUseServicePorts=true, NvMNvramBlockIdentifier=80, NvMNvBlockLength=1, NvMRomBlockDataAddress=Rte_NvBlockSwComponentType_NVBlockDescriptor_ClusterSettings_ROM_NVBlockDescriptor_SRV_TKM_ZvCrH_TKM_ZvCrHPimTkKeyInCarNeed, NvMBlockJobPriority=1, NvMReadRamBlockFromNvCallback=Rte_SetMirror_NvBlockSwComponentType_NVBlockDescriptor_SRV_TKM_ZvCrH_TKM_ZvCrHPimTkKeyInCarNeed, NvMWriteRamBlockToNvCallback=Rte_GetMirror_NvBlockSwComponentType_NVBlockDescriptor_SRV_TKM_ZvCrH_TKM_ZvCrHPimTkKeyInCarNeed, NvMBlockLengthCheck=true
        NvMTargetBlockReference
          NvMFeeRef: NvMNameOfFeeBlock=Fee_SRV_TKM_ZvCrH_TKM_ZvCrHPimTkKeyInCarNeed
      NvBlockSwComponentTypeNVBlockDescriptor_SecDiag: NvMBlockCrcType=NVM_CRC32, NvMBlockManagementType=NVM_BLOCK_NATIVE, NvMSelectBlockForWriteAll=false, NvMUseJobendCallback=true, NvMSingleBlockCallback=SecDiag_NvM_JobFinished, NvMBlockUseCrc=, NvMBlockUseSyncMechanism=true, NvMUseServicePorts=true, NvMNvramBlockIdentifier=93, NvMNvBlockLength=6, NvMRomBlockDataAddress=Rte_NvBlockSwComponentType_NVBlockDescriptor_ClusterSettings_ROM_NVBlockDescriptor_SecDiag, NvMBlockJobPriority=1, NvMReadRamBlockFromNvCallback=Rte_SetMirror_NvBlockSwComponentType_NVBlockDescriptor_SecDiag, NvMWriteRamBlockToNvCallback=Rte_GetMirror_NvBlockSwComponentType_NVBlockDescriptor_SecDiag, NvMBlockLengthCheck=true
        NvMTargetBlockReference
          NvMFeeRef: NvMNameOfFeeBlock=Fee_SecDiag
      NvBlockSwComponentTypeNVBlockDescriptor_ServiceKey_VAR: NvMBlockCrcType=NVM_CRC16, NvMBlockManagementType=NVM_BLOCK_REDUNDANT, NvMSelectBlockForWriteAll=false, NvMUseJobendCallback=true, NvMSingleBlockCallback=ServiceKey_VAR_NvM_JobFinished, NvMBlockUseCrc=, NvMBlockUseSyncMechanism=true, NvMUseServicePorts=true, NvMNvramBlockIdentifier=64, NvMNvBlockLength=11, NvMRomBlockDataAddress=Rte_NvBlockSwComponentType_NVBlockDescriptor_ClusterSettings_ROM_NVBlockDescriptor_ServiceKey_VAR, NvMBlockJobPriority=1, NvMReadRamBlockFromNvCallback=Rte_SetMirror_NvBlockSwComponentType_NVBlockDescriptor_ServiceKey_VAR, NvMWriteRamBlockToNvCallback=Rte_GetMirror_NvBlockSwComponentType_NVBlockDescriptor_ServiceKey_VAR, NvMBlockLengthCheck=true
        NvMTargetBlockReference
          NvMFeeRef: NvMNameOfFeeBlock=Fee_ServiceKey_VAR
      NvBlockSwComponentTypeNVBlockDescriptor_Service_History_Data: NvMBlockCrcType=NVM_CRC16, NvMBlockManagementType=NVM_BLOCK_REDUNDANT, NvMSelectBlockForWriteAll=false, NvMUseJobendCallback=true, NvMSingleBlockCallback=Service_History_Data_NvM_JobFinished, NvMBlockUseCrc=, NvMBlockUseSyncMechanism=true, NvMUseServicePorts=true, NvMNvramBlockIdentifier=61, NvMNvBlockLength=1, NvMRomBlockDataAddress=Rte_NvBlockSwComponentType_NVBlockDescriptor_ClusterSettings_ROM_NVBlockDescriptor_Service_History_Data, NvMBlockJobPriority=1, NvMReadRamBlockFromNvCallback=Rte_SetMirror_NvBlockSwComponentType_NVBlockDescriptor_Service_History_Data, NvMWriteRamBlockToNvCallback=Rte_GetMirror_NvBlockSwComponentType_NVBlockDescriptor_Service_History_Data, NvMBlockLengthCheck=true
        NvMTargetBlockReference
          NvMFeeRef: NvMNameOfFeeBlock=Fee_Service_History_Data
      NvBlockSwComponentTypeNVBlockDescriptor_TANK_Variant_CONST: NvMBlockCrcType=NVM_CRC16, NvMBlockManagementType=NVM_BLOCK_REDUNDANT, NvMSelectBlockForWriteAll=false, NvMUseJobendCallback=true, NvMSingleBlockCallback=TANK_Variant_CONST_NvM_JobFinished, NvMBlockUseCrc=, NvMBlockUseSyncMechanism=true, NvMUseServicePorts=true, NvMNvramBlockIdentifier=72, NvMNvBlockLength=9, NvMRomBlockDataAddress=Rte_NvBlockSwComponentType_NVBlockDescriptor_ClusterSettings_ROM_NVBlockDescriptor_TANK_Variant_CONST, NvMBlockJobPriority=1, NvMReadRamBlockFromNvCallback=Rte_SetMirror_NvBlockSwComponentType_NVBlockDescriptor_TANK_Variant_CONST, NvMWriteRamBlockToNvCallback=Rte_GetMirror_NvBlockSwComponentType_NVBlockDescriptor_TANK_Variant_CONST, NvMBlockLengthCheck=true
        NvMTargetBlockReference
          NvMFeeRef: NvMNameOfFeeBlock=Fee_TANK_Variant_CONST
      NvBlockSwComponentTypeNVBlockDescriptor_USER_PROFILE0: NvMBlockCrcType=NVM_CRC16, NvMBlockManagementType=NVM_BLOCK_REDUNDANT, NvMSelectBlockForWriteAll=false, NvMUseJobendCallback=true, NvMSingleBlockCallback=USER_PROFILE0_NvM_JobFinished, NvMBlockUseCrc=, NvMBlockUseSyncMechanism=true, NvMUseServicePorts=true, NvMNvramBlockIdentifier=54, NvMNvBlockLength=1, NvMRomBlockDataAddress=Rte_NvBlockSwComponentType_NVBlockDescriptor_ClusterSettings_ROM_NVBlockDescriptor_USER_PROFILE0, NvMBlockJobPriority=1, NvMReadRamBlockFromNvCallback=Rte_SetMirror_NvBlockSwComponentType_NVBlockDescriptor_USER_PROFILE0, NvMWriteRamBlockToNvCallback=Rte_GetMirror_NvBlockSwComponentType_NVBlockDescriptor_USER_PROFILE0, NvMBlockLengthCheck=true
        NvMTargetBlockReference
          NvMFeeRef: NvMNameOfFeeBlock=Fee_USER_PROFILE0
      NvBlockSwComponentTypeNVBlockDescriptor_USER_PROFILE1: NvMBlockCrcType=NVM_CRC16, NvMBlockManagementType=NVM_BLOCK_REDUNDANT, NvMSelectBlockForWriteAll=false, NvMUseJobendCallback=true, NvMSingleBlockCallback=USER_PROFILE1_NvM_JobFinished, NvMBlockUseCrc=, NvMBlockUseSyncMechanism=true, NvMUseServicePorts=true, NvMNvramBlockIdentifier=42, NvMNvBlockLength=1, NvMRomBlockDataAddress=Rte_NvBlockSwComponentType_NVBlockDescriptor_ClusterSettings_ROM_NVBlockDescriptor_USER_PROFILE1, NvMBlockJobPriority=1, NvMReadRamBlockFromNvCallback=Rte_SetMirror_NvBlockSwComponentType_NVBlockDescriptor_USER_PROFILE1, NvMWriteRamBlockToNvCallback=Rte_GetMirror_NvBlockSwComponentType_NVBlockDescriptor_USER_PROFILE1, NvMBlockLengthCheck=true
        NvMTargetBlockReference
          NvMFeeRef: NvMNameOfFeeBlock=Fee_USER_PROFILE1
      NvBlockSwComponentTypeNVBlockDescriptor_USER_PROFILE2: NvMBlockCrcType=NVM_CRC16, NvMBlockManagementType=NVM_BLOCK_REDUNDANT, NvMSelectBlockForWriteAll=false, NvMUseJobendCallback=true, NvMSingleBlockCallback=USER_PROFILE2_NvM_JobFinished, NvMBlockUseCrc=, NvMBlockUseSyncMechanism=true, NvMUseServicePorts=true, NvMNvramBlockIdentifier=44, NvMNvBlockLength=1, NvMRomBlockDataAddress=Rte_NvBlockSwComponentType_NVBlockDescriptor_ClusterSettings_ROM_NVBlockDescriptor_USER_PROFILE2, NvMBlockJobPriority=1, NvMReadRamBlockFromNvCallback=Rte_SetMirror_NvBlockSwComponentType_NVBlockDescriptor_USER_PROFILE2, NvMWriteRamBlockToNvCallback=Rte_GetMirror_NvBlockSwComponentType_NVBlockDescriptor_USER_PROFILE2, NvMBlockLengthCheck=true
        NvMTargetBlockReference
          NvMFeeRef: NvMNameOfFeeBlock=Fee_USER_PROFILE2
      NvBlockSwComponentTypeNVBlockDescriptor_USER_PROFILE3: NvMBlockCrcType=NVM_CRC16, NvMBlockManagementType=NVM_BLOCK_REDUNDANT, NvMSelectBlockForWriteAll=false, NvMUseJobendCallback=true, NvMSingleBlockCallback=USER_PROFILE3_NvM_JobFinished, NvMBlockUseCrc=, NvMBlockUseSyncMechanism=true, NvMUseServicePorts=true, NvMNvramBlockIdentifier=45, NvMNvBlockLength=1, NvMRomBlockDataAddress=Rte_NvBlockSwComponentType_NVBlockDescriptor_ClusterSettings_ROM_NVBlockDescriptor_USER_PROFILE3, NvMBlockJobPriority=1, NvMReadRamBlockFromNvCallback=Rte_SetMirror_NvBlockSwComponentType_NVBlockDescriptor_USER_PROFILE3, NvMWriteRamBlockToNvCallback=Rte_GetMirror_NvBlockSwComponentType_NVBlockDescriptor_USER_PROFILE3, NvMBlockLengthCheck=true
        NvMTargetBlockReference
          NvMFeeRef: NvMNameOfFeeBlock=Fee_USER_PROFILE3
      NvBlockSwComponentTypeNVBlockDescriptor_USER_PROFILE4: NvMBlockCrcType=NVM_CRC16, NvMBlockManagementType=NVM_BLOCK_REDUNDANT, NvMSelectBlockForWriteAll=false, NvMUseJobendCallback=true, NvMSingleBlockCallback=USER_PROFILE4_NvM_JobFinished, NvMBlockUseCrc=, NvMBlockUseSyncMechanism=true, NvMUseServicePorts=true, NvMNvramBlockIdentifier=46, NvMNvBlockLength=1, NvMRomBlockDataAddress=Rte_NvBlockSwComponentType_NVBlockDescriptor_ClusterSettings_ROM_NVBlockDescriptor_USER_PROFILE4, NvMBlockJobPriority=1, NvMReadRamBlockFromNvCallback=Rte_SetMirror_NvBlockSwComponentType_NVBlockDescriptor_USER_PROFILE4, NvMWriteRamBlockToNvCallback=Rte_GetMirror_NvBlockSwComponentType_NVBlockDescriptor_USER_PROFILE4, NvMBlockLengthCheck=true
        NvMTargetBlockReference
          NvMFeeRef: NvMNameOfFeeBlock=Fee_USER_PROFILE4
      NvBlockSwComponentTypeNVBlockDescriptor_USER_PROFILE5: NvMBlockCrcType=NVM_CRC16, NvMBlockManagementType=NVM_BLOCK_REDUNDANT, NvMSelectBlockForWriteAll=false, NvMUseJobendCallback=true, NvMSingleBlockCallback=USER_PROFILE5_NvM_JobFinished, NvMBlockUseCrc=, NvMBlockUseSyncMechanism=true, NvMUseServicePorts=true, NvMNvramBlockIdentifier=48, NvMNvBlockLength=1, NvMRomBlockDataAddress=Rte_NvBlockSwComponentType_NVBlockDescriptor_ClusterSettings_ROM_NVBlockDescriptor_USER_PROFILE5, NvMBlockJobPriority=1, NvMReadRamBlockFromNvCallback=Rte_SetMirror_NvBlockSwComponentType_NVBlockDescriptor_USER_PROFILE5, NvMWriteRamBlockToNvCallback=Rte_GetMirror_NvBlockSwComponentType_NVBlockDescriptor_USER_PROFILE5, NvMBlockLengthCheck=true
        NvMTargetBlockReference
          NvMFeeRef: NvMNameOfFeeBlock=Fee_USER_PROFILE5
      NvBlockSwComponentTypeNVBlockDescriptor_USER_PROFILE6: NvMBlockCrcType=NVM_CRC16, NvMBlockManagementType=NVM_BLOCK_REDUNDANT, NvMSelectBlockForWriteAll=false, NvMUseJobendCallback=true, NvMSingleBlockCallback=USER_PROFILE6_NvM_JobFinished, NvMBlockUseCrc=, NvMBlockUseSyncMechanism=true, NvMUseServicePorts=true, NvMNvramBlockIdentifier=50, NvMNvBlockLength=1, NvMRomBlockDataAddress=Rte_NvBlockSwComponentType_NVBlockDescriptor_ClusterSettings_ROM_NVBlockDescriptor_USER_PROFILE6, NvMBlockJobPriority=1, NvMReadRamBlockFromNvCallback=Rte_SetMirror_NvBlockSwComponentType_NVBlockDescriptor_USER_PROFILE6, NvMWriteRamBlockToNvCallback=Rte_GetMirror_NvBlockSwComponentType_NVBlockDescriptor_USER_PROFILE6, NvMBlockLengthCheck=true
        NvMTargetBlockReference
          NvMFeeRef: NvMNameOfFeeBlock=Fee_USER_PROFILE6
      NvBlockSwComponentTypeNVBlockDescriptor_USER_PROFILE7: NvMBlockCrcType=NVM_CRC16, NvMBlockManagementType=NVM_BLOCK_REDUNDANT, NvMSelectBlockForWriteAll=false, NvMUseJobendCallback=true, NvMSingleBlockCallback=USER_PROFILE7_NvM_JobFinished, NvMBlockUseCrc=, NvMBlockUseSyncMechanism=true, NvMUseServicePorts=true, NvMNvramBlockIdentifier=52, NvMNvBlockLength=1, NvMRomBlockDataAddress=Rte_NvBlockSwComponentType_NVBlockDescriptor_ClusterSettings_ROM_NVBlockDescriptor_USER_PROFILE7, NvMBlockJobPriority=1, NvMReadRamBlockFromNvCallback=Rte_SetMirror_NvBlockSwComponentType_NVBlockDescriptor_USER_PROFILE7, NvMWriteRamBlockToNvCallback=Rte_GetMirror_NvBlockSwComponentType_NVBlockDescriptor_USER_PROFILE7, NvMBlockLengthCheck=true
        NvMTargetBlockReference
          NvMFeeRef: NvMNameOfFeeBlock=Fee_USER_PROFILE7
      NvBlockSwComponentTypeNVBlockDescriptor_WLTP_Odo_VAR: NvMBlockCrcType=NVM_CRC16, NvMBlockManagementType=NVM_BLOCK_REDUNDANT, NvMSelectBlockForWriteAll=false, NvMUseJobendCallback=true, NvMSingleBlockCallback=WLTP_Odo_VAR_NvM_JobFinished, NvMBlockUseCrc=, NvMBlockUseSyncMechanism=true, NvMUseServicePorts=true, NvMNvramBlockIdentifier=94, NvMNvBlockLength=34, NvMRomBlockDataAddress=Rte_NvBlockSwComponentType_NVBlockDescriptor_ClusterSettings_ROM_NVBlockDescriptor_WLTP_Odo_VAR, NvMBlockJobPriority=1, NvMReadRamBlockFromNvCallback=Rte_SetMirror_NvBlockSwComponentType_NVBlockDescriptor_WLTP_Odo_VAR, NvMWriteRamBlockToNvCallback=Rte_GetMirror_NvBlockSwComponentType_NVBlockDescriptor_WLTP_Odo_VAR, NvMBlockLengthCheck=true
        NvMTargetBlockReference
          NvMFeeRef: NvMNameOfFeeBlock=Fee_WLTP_Odo_VAR
      NvBlock_Template: NvMBlockCrcType=NVM_CRC16, NvMBlockManagementType=NVM_BLOCK_REDUNDANT, NvMSelectBlockForWriteAll=true, NvMUseJobendCallback=false, NvMSingleBlockCallback=NULL_PTR, NvMBlockUseCrc=true, NvMBlockUseSyncMechanism=false, NvMUseServicePorts=false, NvMNvramBlockIdentifier=1, NvMNvBlockLength=2, NvMRomBlockDataAddress=NULL_PTR, NvMBlockJobPriority=127, NvMReadRamBlockFromNvCallback=NULL_PTR, NvMWriteRamBlockToNvCallback=NULL_PTR, NvMBlockLengthCheck=false
        NvMTargetBlockReference
          NvMFeeRef: NvMNameOfFeeBlock=XXX
    NvMCommon:
      NvMDevErrorDetect = true
      NvMVersionInfoApi = false
      NvMApiConfigClass = NVM_API_CONFIG_CLASS_3
      NvMBswMMultiBlockJobStatusInformation = false
      NvMCompiledConfigId = 1
      NvMCrcNumOfBytes = 64
      NvMDatasetSelectionBits = 1
      NvMDrvModeSwitch = flase
      NvMDynamicConfiguration = false
      NvMJobPrioritization = false
      NvMMultiBlockCallback = NvM_MultiBlockJobEndNotification
      NvMPollingMode = false
      NvMSetRamBlockStatusApi = true
      NvMSizeStandardJobQueue = 4
      NvMMaxNoOfWriteRetries = 1
      NvMMainFunctionPeriod = 0.01
      NvMRepairRedundantBlocksApi = true
      NvMUseBlockIdCheck = true
    NvMCommonVendorParams:
      NvMCfgIncludeDem = Dem.h
      NvMSeterror = Dem_ReportErrorStatus
      NvMMultiblockId = MultiBlockRequest
      NvMCrcIntBuffer = true
      NvMKillWriteAllApi = true
      NvMCfgCbkIncludeList = Rte_Cbk.h
      NvMCfgCbkIncludeList = EcuMExt.h
      NvMCfgCbkIncludeList = Rte_Cbk.h
      NvMCfgCbkIncludeList = Dem_Cbk.h
      NvMDevErrorChecks: NvMCfgIncludeDet=Det.h, NvMErrorhook=Det_ReportError, NvMDebugReporting=true
    NvMConfigBlock (NvMBlockDescriptor):
      NvMBlockCrcType = NVM_CRC16
      NvMBlockManagementType = NVM_BLOCK_REDUNDANT
      NvMInitBlockCallback = NULL_PTR
      NvMResistantToChangedSw = true
      NvMSelectBlockForReadAll = true
      NvMSelectBlockForWriteAll = true
      NvMUseInitCallback = false
      NvMUseJobendCallback = false
      NvMSingleBlockCallback = NULL_PTR
      NvMBswMBlockStatusInformation = false
      NvMBlockUseCrc = true
      NvMBlockUseSyncMechanism = false
      NvMCalcRamBlockCrc = false
      NvMUseServicePorts = false
      NvMNvramBlockIdentifier = 1
      NvMNvBlockNum = 2
      NvMNvBlockLength = 2
      NvMRomBlockDataAddress = NULL_PTR
      NvMBlockJobPriority = 127
      NvMBlockWriteProt = false
      NvMRamBlockDataAddress = NULL_PTR
      NvMReadRamBlockFromNvCallback = NULL_PTR
      NvMWriteBlockOnce = false
      NvMWriteRamBlockToNvCallback = NULL_PTR
      NvMAutomaticBlockLength = false
      NvMBlockLengthCheck = false
      NvMBlockLengthCheckType = true
      NvMTargetBlockReference
        NvMFeeRef: NvMNameOfFeeBlock=FeeConfigBlock
    NvmDemEventParameterRefs:
      NVM_E_INTEGRITY_FAILED = NVM_E_INTEGRITY_FAILED
      NVM_E_LOSS_OF_REDUNDANCY = NVM_E_LOSS_OF_REDUNDANCY
      NVM_E_QUEUE_OVERFLOW = NVM_E_QUEUE_OVERFLOW
      NVM_E_REQ_FAILED = NVM_E_REQ_FAILED
      NVM_E_VERIFY_FAILED = NVM_E_VERIFY_FAILED
      NVM_E_WRITE_PROTECTED = NVM_E_WRITE_PROTECTED
      NVM_E_WRONG_BLOCK_ID = NVM_E_WRONG_BLOCK_ID
