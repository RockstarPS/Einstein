AUTOSAR XML (schema 4-2-1)
package /ActiveEcuC
  module config Fee: implementation-config-variant=VARIANT-PRE-COMPILE, module-description=Fee_Impl
    FeeBlock_Template (FeeBlockConfiguration):
      FeeBlockIdFixed = false
      FeeBlockIsCritical = false
      FeeImmediateData = true
      FeeNumberOfChunkInstances = 1
      FeeBlockNumber = 1
      FeeBlockSize = 1
      FeeNumberOfWriteCycles = 10000
      FeeNumberOfDatasets = 1
      FeeBlockId = 1
      FeePartition = FeePartitionConfiguration
      FeeDeviceIndex = FlsGeneral
    FeeConfigBlock (FeeBlockConfiguration):
      FeeBlockIdFixed = false
      FeeBlockIsCritical = false
      FeeImmediateData = false
      FeeNumberOfChunkInstances = 1
      FeeBlockNumber = 42
      FeeBlockSize = 4
      FeeNumberOfWriteCycles = 10000
      FeeNumberOfDatasets = 2
      FeeBlockId = 2
      FeePartition = FeePartitionConfiguration_DIAG
      FeeDeviceIndex = FlsGeneral
    FeeGeneral:
      FeeDevErrorDetect = true
      FeeVersionInfoApi = false
      FeePollingMode = false
      FeeSetModeSupported = true
      FeeIndex = 0
      FeeNvmJobEndNotification = NvM_JobEndNotification
      FeeNvmJobErrorNotification = NvM_JobErrorNotification
      FeeInternalBufferSize = 64
      FeeMainFunctionPeriod = 0.01
      FeeNvmCbkIncludeFile = NvM_Cbk.h
      FeeMainFunctionTriggering = FixedCycleTime
      FeeDevErrorChecks: FeeDebugReporting=true, FeeDetErrorhook=Det_ReportError, FeeDetIncludeFile=Det.h
      FeeFlsApi:
        FeeFlsIncludeFile = NvMExt_Stubs.h
        FeeFlsSetMode = Fls_SetMode
        FeeFlsRead = NvmExt_Stubs_FlsRead
        FeeFlsWrite = NvmExt_Stubs_FlsWrite
        FeeFlsCancel = Fls_Cancel
        FeeFlsGetStatus = Fls_GetStatus
        FeeFlsGetJobResult = Fls_GetJobResult
        FeeFlsErase = Fls_Erase
        FeeFlsCompare = Fls_Compare
        FeeFlsDeviceIndex = FlsGeneral
    4 x FeePartitionConfiguration, all with FeeBssThresholdReserved=3072, FeeFssThresholdReserved=1024, FeeAddressAlignment=8, FeeWriteAlignment=8, FeeUpperSectorSize=8192, FeeLowerSectorSize=8192, FeePartitionDevice=FlsConfigSet_0:
      FeePartitionConfiguration_DIAG: FeeLowerSectorAddress=8192, FeeUpperSectorAddress=65536
      FeePartitionConfiguration_ODO: FeeLowerSectorAddress=24576, FeeUpperSectorAddress=81920
      FeePartitionConfiguration_SIGMA_FEE_BLK_1: FeeLowerSectorAddress=32768, FeeUpperSectorAddress=90112
      FeePartitionConfiguration_SIGMA_FEE_BLK_2: FeeLowerSectorAddress=49152, FeeUpperSectorAddress=106496
    FeePublishedInformation: FeeBlockOverhead=2, FeeMaximumBlockingTime=1, FeePageOverhead=0, FeeChunkHeader=16, FeeChunkLink=8, FeeSectorHeader=8
    FeeSpecificFeatures:
      FeeApplErrorCallbackFunction = Appl_FeeCriticalErrorCallback
      FeeApplErrorCallbackIncludeFile = ApplMain.h
      FeeGetEraseCycleApi = false
      FeeGetWriteCycleApi = false
      FeeUseApplErrorCallback = false
      FeeUseJobCache = false
      FeeForceSectorSwitchApi = false
      FeeDataConversionApi = false
      FeeFblConfig = false
      FeeMaxLinkTableSize = 4095
      FeeFssControlApi = false
    15 x FeeBlockConfiguration, all with FeeBlockIdFixed=false, FeeBlockIsCritical=false, FeeImmediateData=true, FeeNumberOfChunkInstances=1, FeeNumberOfDatasets=1, FeePartition=FeePartitionConfiguration_CALIB, FeeDeviceIndex=FlsGeneral:
      Fee_Sample_Block_1: FeeBlockNumber=1, FeeBlockSize=264, FeeNumberOfWriteCycles=10000, FeeBlockId=1
      Fee_Sample_Block_10: FeeBlockNumber=10, FeeBlockSize=2864, FeeNumberOfWriteCycles=10000, FeeBlockId=10
      Fee_Sample_Block_11: FeeBlockNumber=11, FeeBlockSize=16, FeeNumberOfWriteCycles=10000, FeeBlockId=11
      Fee_Sample_Block_12: FeeBlockNumber=12, FeeBlockSize=16, FeeNumberOfWriteCycles=10000, FeeBlockId=12
      Fee_Sample_Block_13: FeeBlockNumber=13, FeeBlockSize=2568, FeeNumberOfWriteCycles=10000, FeeBlockId=13
      Fee_Sample_Block_14: FeeBlockNumber=14, FeeBlockSize=296, FeeNumberOfWriteCycles=10000, FeeBlockId=14
      Fee_Sample_Block_15: FeeBlockNumber=15, FeeBlockSize=312, FeeNumberOfWriteCycles=10000, FeeBlockId=15
      Fee_Sample_Block_2: FeeBlockNumber=2, FeeBlockSize=208, FeeNumberOfWriteCycles=300, FeeBlockId=2
      Fee_Sample_Block_3: FeeBlockNumber=3, FeeBlockSize=32, FeeNumberOfWriteCycles=10000, FeeBlockId=3
      Fee_Sample_Block_4: FeeBlockNumber=4, FeeBlockSize=96, FeeNumberOfWriteCycles=10000, FeeBlockId=4
      Fee_Sample_Block_5: FeeBlockNumber=5, FeeBlockSize=224, FeeNumberOfWriteCycles=10000, FeeBlockId=5
      Fee_Sample_Block_6: FeeBlockNumber=6, FeeBlockSize=8, FeeNumberOfWriteCycles=10000, FeeBlockId=6
      Fee_Sample_Block_7: FeeBlockNumber=7, FeeBlockSize=32, FeeNumberOfWriteCycles=10000, FeeBlockId=7
      Fee_Sample_Block_8: FeeBlockNumber=8, FeeBlockSize=16, FeeNumberOfWriteCycles=10000, FeeBlockId=8
      Fee_Sample_Block_9: FeeBlockNumber=9, FeeBlockSize=8, FeeNumberOfWriteCycles=10000, FeeBlockId=9
  module config NvM: implementation-config-variant=VARIANT-PRE-COMPILE, module-description=NvM_Impl
    16 x NvMBlockDescriptor, all with NvMBlockManagementType=NVM_BLOCK_REDUNDANT, NvMInitBlockCallback=NULL_PTR, NvMResistantToChangedSw=true, NvMSelectBlockForReadAll=true, NvMUseInitCallback=false, NvMBswMBlockStatusInformation=false, NvMBlockUseCrc=true, NvMCalcRamBlockCrc=false, NvMNvBlockNum=2, NvMBlockWriteProt=false, NvMRamBlockDataAddress=NULL_PTR, NvMWriteBlockOnce=false, NvMAutomaticBlockLength=false, NvMBlockLengthCheckType=true:
      NvBlockSwComponentTypeNVBlockDescriptor_Sample_Block_1: NvMBlockCrcType=NVM_CRC16, NvMSelectBlockForWriteAll=false, NvMUseJobendCallback=true, NvMSingleBlockCallback=Sample_Block_1_NvM_JobFinished, NvMBlockUseSyncMechanism=true, NvMUseServicePorts=true, NvMNvramBlockIdentifier=1, NvMNvBlockLength=259, NvMRomBlockDataAddress=Rte_NvBlockSwComponentType_NVBlockDescriptor_ClusterSettings_ROM_NVBlockDescriptor_Sample_Block_1, NvMBlockJobPriority=1, NvMReadRamBlockFromNvCallback=Rte_SetMirror_NvBlockSwComponentType_NVBlockDescriptor_Sample_Block_1, NvMWriteRamBlockToNvCallback=Rte_GetMirror_NvBlockSwComponentType_NVBlockDescriptor_Sample_Block_1, NvMBlockLengthCheck=true
        NvMTargetBlockReference
          NvMFeeRef: NvMNameOfFeeBlock=Fee_Sample_Block_1
      NvBlockSwComponentTypeNVBlockDescriptor_Sample_Block_10: NvMBlockCrcType=NVM_CRC16, NvMSelectBlockForWriteAll=false, NvMUseJobendCallback=true, NvMSingleBlockCallback=Sample_Block_10_NvM_JobFinished, NvMBlockUseSyncMechanism=true, NvMUseServicePorts=true, NvMNvramBlockIdentifier=10, NvMNvBlockLength=2856, NvMRomBlockDataAddress=Rte_NvBlockSwComponentType_NVBlockDescriptor_ClusterSettings_ROM_NVBlockDescriptor_Sample_Block_10, NvMBlockJobPriority=1, NvMReadRamBlockFromNvCallback=Rte_SetMirror_NvBlockSwComponentType_NVBlockDescriptor_Sample_Block_10, NvMWriteRamBlockToNvCallback=Rte_GetMirror_NvBlockSwComponentType_NVBlockDescriptor_Sample_Block_10, NvMBlockLengthCheck=true
        NvMTargetBlockReference
          NvMFeeRef: NvMNameOfFeeBlock=Fee_Sample_Block_10
      NvBlockSwComponentTypeNVBlockDescriptor_Sample_Block_11: NvMBlockCrcType=NVM_CRC8, NvMSelectBlockForWriteAll=false, NvMUseJobendCallback=true, NvMSingleBlockCallback=Sample_Block_11_NvM_JobFinished, NvMBlockUseSyncMechanism=true, NvMUseServicePorts=true, NvMNvramBlockIdentifier=11, NvMNvBlockLength=10, NvMRomBlockDataAddress=Rte_NvBlockSwComponentType_NVBlockDescriptor_ClusterSettings_ROM_NVBlockDescriptor_Sample_Block_11, NvMBlockJobPriority=1, NvMReadRamBlockFromNvCallback=Rte_SetMirror_NvBlockSwComponentType_NVBlockDescriptor_Sample_Block_11, NvMWriteRamBlockToNvCallback=Rte_GetMirror_NvBlockSwComponentType_NVBlockDescriptor_Sample_Block_11, NvMBlockLengthCheck=true
        NvMTargetBlockReference
          NvMFeeRef: NvMNameOfFeeBlock=Fee_Sample_Block_11
      NvBlockSwComponentTypeNVBlockDescriptor_Sample_Block_12: NvMBlockCrcType=NVM_CRC8, NvMSelectBlockForWriteAll=false, NvMUseJobendCallback=true, NvMSingleBlockCallback=Sample_Block_12_NvM_JobFinished, NvMBlockUseSyncMechanism=true, NvMUseServicePorts=true, NvMNvramBlockIdentifier=12, NvMNvBlockLength=12, NvMRomBlockDataAddress=Rte_NvBlockSwComponentType_NVBlockDescriptor_ClusterSettings_ROM_NVBlockDescriptor_Sample_Block_12, NvMBlockJobPriority=1, NvMReadRamBlockFromNvCallback=Rte_SetMirror_NvBlockSwComponentType_NVBlockDescriptor_Sample_Block_12, NvMWriteRamBlockToNvCallback=Rte_GetMirror_NvBlockSwComponentType_NVBlockDescriptor_Sample_Block_12, NvMBlockLengthCheck=true
        NvMTargetBlockReference
          NvMFeeRef: NvMNameOfFeeBlock=Fee_Sample_Block_12
      NvBlockSwComponentTypeNVBlockDescriptor_Sample_Block_13: NvMBlockCrcType=NVM_CRC16, NvMSelectBlockForWriteAll=false, NvMUseJobendCallback=true, NvMSingleBlockCallback=Sample_Block_13_NvM_JobFinished, NvMBlockUseSyncMechanism=true, NvMUseServicePorts=true, NvMNvramBlockIdentifier=13, NvMNvBlockLength=2560, NvMRomBlockDataAddress=Rte_NvBlockSwComponentType_NVBlockDescriptor_ClusterSettings_ROM_NVBlockDescriptor_Sample_Block_13, NvMBlockJobPriority=1, NvMReadRamBlockFromNvCallback=Rte_SetMirror_NvBlockSwComponentType_NVBlockDescriptor_Sample_Block_13, NvMWriteRamBlockToNvCallback=Rte_GetMirror_NvBlockSwComponentType_NVBlockDescriptor_Sample_Block_13, NvMBlockLengthCheck=true
        NvMTargetBlockReference
          NvMFeeRef: NvMNameOfFeeBlock=Fee_Sample_Block_13
      NvBlockSwComponentTypeNVBlockDescriptor_Sample_Block_14: NvMBlockCrcType=NVM_CRC16, NvMSelectBlockForWriteAll=false, NvMUseJobendCallback=true, NvMSingleBlockCallback=Sample_Block_14_NvM_JobFinished, NvMBlockUseSyncMechanism=true, NvMUseServicePorts=true, NvMNvramBlockIdentifier=14, NvMNvBlockLength=288, NvMRomBlockDataAddress=Rte_NvBlockSwComponentType_NVBlockDescriptor_ClusterSettings_ROM_NVBlockDescriptor_Sample_Block_14, NvMBlockJobPriority=1, NvMReadRamBlockFromNvCallback=Rte_SetMirror_NvBlockSwComponentType_NVBlockDescriptor_Sample_Block_14, NvMWriteRamBlockToNvCallback=Rte_GetMirror_NvBlockSwComponentType_NVBlockDescriptor_Sample_Block_14, NvMBlockLengthCheck=true
        NvMTargetBlockReference
          NvMFeeRef: NvMNameOfFeeBlock=Fee_Sample_Block_14
      NvBlockSwComponentTypeNVBlockDescriptor_Sample_Block_15: NvMBlockCrcType=NVM_CRC32, NvMSelectBlockForWriteAll=false, NvMUseJobendCallback=true, NvMSingleBlockCallback=Sample_Block_15_NvM_JobFinished, NvMBlockUseSyncMechanism=true, NvMUseServicePorts=true, NvMNvramBlockIdentifier=15, NvMNvBlockLength=304, NvMRomBlockDataAddress=Rte_NvBlockSwComponentType_NVBlockDescriptor_ClusterSettings_ROM_NVBlockDescriptor_Sample_Block_15, NvMBlockJobPriority=1, NvMReadRamBlockFromNvCallback=Rte_SetMirror_NvBlockSwComponentType_NVBlockDescriptor_Sample_Block_15, NvMWriteRamBlockToNvCallback=Rte_GetMirror_NvBlockSwComponentType_NVBlockDescriptor_Sample_Block_15, NvMBlockLengthCheck=true
        NvMTargetBlockReference
          NvMFeeRef: NvMNameOfFeeBlock=Fee_Sample_Block_15
      NvBlockSwComponentTypeNVBlockDescriptor_Sample_Block_2: NvMBlockCrcType=NVM_CRC16, NvMSelectBlockForWriteAll=false, NvMUseJobendCallback=true, NvMSingleBlockCallback=Sample_Block_2_NvM_JobFinished, NvMBlockUseSyncMechanism=true, NvMUseServicePorts=true, NvMNvramBlockIdentifier=2, NvMNvBlockLength=204, NvMRomBlockDataAddress=Rte_NvBlockSwComponentType_NVBlockDescriptor_ClusterSettings_ROM_NVBlockDescriptor_Sample_Block_2, NvMBlockJobPriority=1, NvMReadRamBlockFromNvCallback=Rte_SetMirror_NvBlockSwComponentType_NVBlockDescriptor_Sample_Block_2, NvMWriteRamBlockToNvCallback=Rte_GetMirror_NvBlockSwComponentType_NVBlockDescriptor_Sample_Block_2, NvMBlockLengthCheck=true
        NvMTargetBlockReference
          NvMFeeRef: NvMNameOfFeeBlock=Fee_Sample_Block_2
      NvBlockSwComponentTypeNVBlockDescriptor_Sample_Block_3: NvMBlockCrcType=NVM_CRC16, NvMSelectBlockForWriteAll=false, NvMUseJobendCallback=true, NvMSingleBlockCallback=Sample_Block_3_NvM_JobFinished, NvMBlockUseSyncMechanism=true, NvMUseServicePorts=true, NvMNvramBlockIdentifier=3, NvMNvBlockLength=28, NvMRomBlockDataAddress=Rte_NvBlockSwComponentType_NVBlockDescriptor_ClusterSettings_ROM_NVBlockDescriptor_Sample_Block_3, NvMBlockJobPriority=1, NvMReadRamBlockFromNvCallback=Rte_SetMirror_NvBlockSwComponentType_NVBlockDescriptor_Sample_Block_3, NvMWriteRamBlockToNvCallback=Rte_GetMirror_NvBlockSwComponentType_NVBlockDescriptor_Sample_Block_3, NvMBlockLengthCheck=true
        NvMTargetBlockReference
          NvMFeeRef: NvMNameOfFeeBlock=Fee_Sample_Block_3
      NvBlockSwComponentTypeNVBlockDescriptor_Sample_Block_4: NvMBlockCrcType=NVM_CRC16, NvMSelectBlockForWriteAll=false, NvMUseJobendCallback=true, NvMSingleBlockCallback=Sample_Block_4_NvM_JobFinished, NvMBlockUseSyncMechanism=true, NvMUseServicePorts=true, NvMNvramBlockIdentifier=4, NvMNvBlockLength=90, NvMRomBlockDataAddress=Rte_NvBlockSwComponentType_NVBlockDescriptor_ClusterSettings_ROM_NVBlockDescriptor_Sample_Block_4, NvMBlockJobPriority=1, NvMReadRamBlockFromNvCallback=Rte_SetMirror_NvBlockSwComponentType_NVBlockDescriptor_Sample_Block_4, NvMWriteRamBlockToNvCallback=Rte_GetMirror_NvBlockSwComponentType_NVBlockDescriptor_Sample_Block_4, NvMBlockLengthCheck=true
        NvMTargetBlockReference
          NvMFeeRef: NvMNameOfFeeBlock=Fee_Sample_Block_4
      NvBlockSwComponentTypeNVBlockDescriptor_Sample_Block_5: NvMBlockCrcType=NVM_CRC16, NvMSelectBlockForWriteAll=false, NvMUseJobendCallback=true, NvMSingleBlockCallback=Sample_Block_5_NvM_JobFinished, NvMBlockUseSyncMechanism=true, NvMUseServicePorts=true, NvMNvramBlockIdentifier=5, NvMNvBlockLength=216, NvMRomBlockDataAddress=Rte_NvBlockSwComponentType_NVBlockDescriptor_ClusterSettings_ROM_NVBlockDescriptor_Sample_Block_5, NvMBlockJobPriority=1, NvMReadRamBlockFromNvCallback=Rte_SetMirror_NvBlockSwComponentType_NVBlockDescriptor_Sample_Block_5, NvMWriteRamBlockToNvCallback=Rte_GetMirror_NvBlockSwComponentType_NVBlockDescriptor_Sample_Block_5, NvMBlockLengthCheck=true
        NvMTargetBlockReference
          NvMFeeRef: NvMNameOfFeeBlock=Fee_Sample_Block_5
      NvBlockSwComponentTypeNVBlockDescriptor_Sample_Block_6: NvMBlockCrcType=NVM_CRC16, NvMSelectBlockForWriteAll=false, NvMUseJobendCallback=true, NvMSingleBlockCallback=Sample_Block_6_NvM_JobFinished, NvMBlockUseSyncMechanism=true, NvMUseServicePorts=true, NvMNvramBlockIdentifier=6, NvMNvBlockLength=4, NvMRomBlockDataAddress=Rte_NvBlockSwComponentType_NVBlockDescriptor_ClusterSettings_ROM_NVBlockDescriptor_Sample_Block_6, NvMBlockJobPriority=1, NvMReadRamBlockFromNvCallback=Rte_SetMirror_NvBlockSwComponentType_NVBlockDescriptor_Sample_Block_6, NvMWriteRamBlockToNvCallback=Rte_GetMirror_NvBlockSwComponentType_NVBlockDescriptor_Sample_Block_6, NvMBlockLengthCheck=true
        NvMTargetBlockReference
          NvMFeeRef: NvMNameOfFeeBlock=Fee_Sample_Block_6
      NvBlockSwComponentTypeNVBlockDescriptor_Sample_Block_7: NvMBlockCrcType=NVM_CRC16, NvMSelectBlockForWriteAll=false, NvMUseJobendCallback=true, NvMSingleBlockCallback=Sample_Block_7_NvM_JobFinished, NvMBlockUseSyncMechanism=true, NvMUseServicePorts=true, NvMNvramBlockIdentifier=7, NvMNvBlockLength=30, NvMRomBlockDataAddress=Rte_NvBlockSwComponentType_NVBlockDescriptor_ClusterSettings_ROM_NVBlockDescriptor_Sample_Block_7, NvMBlockJobPriority=1, NvMReadRamBlockFromNvCallback=Rte_SetMirror_NvBlockSwComponentType_NVBlockDescriptor_Sample_Block_7, NvMWriteRamBlockToNvCallback=Rte_GetMirror_NvBlockSwComponentType_NVBlockDescriptor_Sample_Block_7, NvMBlockLengthCheck=true
        NvMTargetBlockReference
          NvMFeeRef: NvMNameOfFeeBlock=Fee_Sample_Block_7
      NvBlockSwComponentTypeNVBlockDescriptor_Sample_Block_8: NvMBlockCrcType=NVM_CRC16, NvMSelectBlockForWriteAll=false, NvMUseJobendCallback=true, NvMSingleBlockCallback=Sample_Block_8_NvM_JobFinished, NvMBlockUseSyncMechanism=true, NvMUseServicePorts=true, NvMNvramBlockIdentifier=8, NvMNvBlockLength=12, NvMRomBlockDataAddress=Rte_NvBlockSwComponentType_NVBlockDescriptor_ClusterSettings_ROM_NVBlockDescriptor_Sample_Block_8, NvMBlockJobPriority=1, NvMReadRamBlockFromNvCallback=Rte_SetMirror_NvBlockSwComponentType_NVBlockDescriptor_Sample_Block_8, NvMWriteRamBlockToNvCallback=Rte_GetMirror_NvBlockSwComponentType_NVBlockDescriptor_Sample_Block_8, NvMBlockLengthCheck=true
        NvMTargetBlockReference
          NvMFeeRef: NvMNameOfFeeBlock=Fee_Sample_Block_8
      NvBlockSwComponentTypeNVBlockDescriptor_Sample_Block_9: NvMBlockCrcType=NVM_CRC16, NvMSelectBlockForWriteAll=false, NvMUseJobendCallback=true, NvMSingleBlockCallback=Sample_Block_9_NvM_JobFinished, NvMBlockUseSyncMechanism=true, NvMUseServicePorts=true, NvMNvramBlockIdentifier=9, NvMNvBlockLength=4, NvMRomBlockDataAddress=Rte_NvBlockSwComponentType_NVBlockDescriptor_ClusterSettings_ROM_NVBlockDescriptor_Sample_Block_9, NvMBlockJobPriority=1, NvMReadRamBlockFromNvCallback=Rte_SetMirror_NvBlockSwComponentType_NVBlockDescriptor_Sample_Block_9, NvMWriteRamBlockToNvCallback=Rte_GetMirror_NvBlockSwComponentType_NVBlockDescriptor_Sample_Block_9, NvMBlockLengthCheck=true
        NvMTargetBlockReference
          NvMFeeRef: NvMNameOfFeeBlock=Fee_Sample_Block_9
      NvBlock_Template: NvMBlockCrcType=NVM_CRC16, NvMSelectBlockForWriteAll=true, NvMUseJobendCallback=false, NvMSingleBlockCallback=NULL_PTR, NvMBlockUseSyncMechanism=false, NvMUseServicePorts=false, NvMNvramBlockIdentifier=1, NvMNvBlockLength=2, NvMRomBlockDataAddress=NULL_PTR, NvMBlockJobPriority=127, NvMReadRamBlockFromNvCallback=NULL_PTR, NvMWriteRamBlockToNvCallback=NULL_PTR, NvMBlockLengthCheck=false
        NvMTargetBlockReference
          NvMFeeRef: NvMNameOfFeeBlock=XXX
    NvMCommon:
      NvMDevErrorDetect = true
      NvMVersionInfoApi = false
      NvMApiConfigClass = NVM_API_CONFIG_CLASS_3
      NvMBswMMultiBlockJobStatusInformation = false
      NvMCompiledConfigId = 1
      NvMCrcNumOfBytes = 64
      NvMDatasetSelectionBits = 1
      NvMDrvModeSwitch = flase
      NvMDynamicConfiguration = false
      NvMJobPrioritization = false
      NvMMultiBlockCallback = NvM_MultiBlockJobEndNotification
      NvMPollingMode = false
      NvMSetRamBlockStatusApi = true
      NvMSizeStandardJobQueue = 4
      NvMMaxNoOfWriteRetries = 1
      NvMMainFunctionPeriod = 0.01
      NvMRepairRedundantBlocksApi = true
      NvMUseBlockIdCheck = true
    NvMCommonVendorParams:
      NvMCfgIncludeDem = Dem.h
      NvMSeterror = Dem_ReportErrorStatus
      NvMMultiblockId = MultiBlockRequest
      NvMCrcIntBuffer = true
      NvMKillWriteAllApi = true
      NvMCfgCbkIncludeList = Rte_Cbk.h
      NvMCfgCbkIncludeList = EcuMExt.h
      NvMCfgCbkIncludeList = Rte_Cbk.h
      NvMCfgCbkIncludeList = Dem_Cbk.h
      NvMDevErrorChecks: NvMCfgIncludeDet=Det.h, NvMErrorhook=Det_ReportError, NvMDebugReporting=true
    NvMConfigBlock (NvMBlockDescriptor):
      NvMBlockCrcType = NVM_CRC16
      NvMBlockManagementType = NVM_BLOCK_REDUNDANT
      NvMInitBlockCallback = NULL_PTR
      NvMResistantToChangedSw = true
      NvMSelectBlockForReadAll = true
      NvMSelectBlockForWriteAll = true
      NvMUseInitCallback = false
      NvMUseJobendCallback = false
      NvMSingleBlockCallback = NULL_PTR
      NvMBswMBlockStatusInformation = false
      NvMBlockUseCrc = true
      NvMBlockUseSyncMechanism = false
      NvMCalcRamBlockCrc = false
      NvMUseServicePorts = false
      NvMNvramBlockIdentifier = 1
      NvMNvBlockNum = 2
      NvMNvBlockLength = 2
      NvMRomBlockDataAddress = NULL_PTR
      NvMBlockJobPriority = 127
      NvMBlockWriteProt = false
      NvMRamBlockDataAddress = NULL_PTR
      NvMReadRamBlockFromNvCallback = NULL_PTR
      NvMWriteBlockOnce = false
      NvMWriteRamBlockToNvCallback = NULL_PTR
      NvMAutomaticBlockLength = false
      NvMBlockLengthCheck = false
      NvMBlockLengthCheckType = true
      NvMTargetBlockReference
        NvMFeeRef: NvMNameOfFeeBlock=FeeConfigBlock
    NvmDemEventParameterRefs:
      NVM_E_INTEGRITY_FAILED = NVM_E_INTEGRITY_FAILED
      NVM_E_LOSS_OF_REDUNDANCY = NVM_E_LOSS_OF_REDUNDANCY
      NVM_E_QUEUE_OVERFLOW = NVM_E_QUEUE_OVERFLOW
      NVM_E_REQ_FAILED = NVM_E_REQ_FAILED
      NVM_E_VERIFY_FAILED = NVM_E_VERIFY_FAILED
      NVM_E_WRITE_PROTECTED = NVM_E_WRITE_PROTECTED
      NVM_E_WRONG_BLOCK_ID = NVM_E_WRONG_BLOCK_ID
