[part 2 of 4: package /ComponentTypes]
AUTOSAR XML (schema 4-2-1)
package /ComponentTypes  (continued)
  nv block sw component type NvBlockSwComponentType  (continued)
    1028 x provide/require port:  (continued)
      VKM_Range_RangeAvgConsumptiom_Default: nv-provide-com-spec{ram-block-init-value=80, rom-block-init-value=80, variable=VKM_Range_RangeAvgConsumptiom_Default/Value}, nv-require-com-spec=init-value=80, provided-required-interface=VKM_Range_RangeAvgConsumptiom_Default
      VWLogicalSoftwareBlockVersion_EEP: nv-provide-com-spec{ram-block-init-value=[89, 56, 50, 49], rom-block-init-value=[89, 56, 50, 49], variable=VWLogicalSoftwareBlockVersion_EEP/Value}, nv-require-com-spec=init-value=[89, 56, 50, 49], provided-required-interface=VWLogicalSoftwareBlockVersion_EEP
      VWSoftwareVersionNumber: nv-provide-com-spec{ram-block-init-value=[45, 45, 45, 45], rom-block-init-value=[45, 45, 45, 45], variable=VWSoftwareVersionNumber/Value}, nv-require-com-spec=init-value=[45, 45, 45, 45], provided-required-interface=VWSoftwareVersionNumber
      VW_Data_Set_Number: nv-provide-com-spec{ram-block-init-value=11 x 45, rom-block-init-value=11 x 45, variable=VW_Data_Set_Number/Value}, nv-require-com-spec=init-value=11 x 45, provided-required-interface=VW_Data_Set_Number
      VW_Data_Set_Version: nv-provide-com-spec{ram-block-init-value=[45, 45, 45, 45], rom-block-init-value=[45, 45, 45, 45], variable=VW_Data_Set_Version/Value}, nv-require-com-spec=init-value=[45, 45, 45, 45], provided-required-interface=VW_Data_Set_Version
      VW_Workshop_System_Name: nv-provide-com-spec{ram-block-init-value=[74, 50, 56, 53, 32], rom-block-init-value=[74, 50, 56, 53, 32], variable=VW_Workshop_System_Name/Value}, nv-require-com-spec=init-value=[74, 50, 56, 53, 32], provided-required-interface=VW_Workshop_System_Name
      V_Config_WarningThreshold1_Indien: nv-provide-com-spec{ram-block-init-value=12, rom-block-init-value=12, variable=V_Config_WarningThreshold1_Indien/Value}, nv-require-com-spec=init-value=12, provided-required-interface=V_Config_WarningThreshold1_Indien
      V_Customer_Active: nv-provide-com-spec{ram-block-init-value=0, rom-block-init-value=0, variable=V_Customer_Active/Value}, nv-require-com-spec=init-value=0, provided-required-interface=V_Customer_Active
      V_Customer_SpeedThreshold: nv-provide-com-spec{ram-block-init-value=130, rom-block-init-value=130, variable=V_Customer_SpeedThreshold/Value}, nv-require-com-spec=init-value=130, provided-required-interface=V_Customer_SpeedThreshold
      V_Warning_Legal_India: nv-provide-com-spec{ram-block-init-value=0, rom-block-init-value=0, variable=V_Warning_Legal_India/Value}, nv-require-com-spec=init-value=0, provided-required-interface=V_Warning_Legal_India
      Vehicle_Equipment_Code: nv-provide-com-spec{ram-block-init-value=12 x 0, rom-block-init-value=12 x 0, variable=Vehicle_Equipment_Code/Value}, nv-require-com-spec=init-value=12 x 0, provided-required-interface=Vehicle_Equipment_Code
      Vehicle_Network: nv-provide-com-spec{ram-block-init-value=0, rom-block-init-value=0, variable=Vehicle_Network/Value}, nv-require-com-spec=init-value=0, provided-required-interface=Vehicle_Network
      VersionListEntry{1..5}: nv-provide-com-spec{ram-block-init-value=[0, 0, 0, 0], rom-block-init-value=[0, 0, 0, 0], variable=VersionListEntry{1..5}/Value}, nv-require-com-spec=init-value=[0, 0, 0, 0], provided-required-interface=VersionListEntry{1..5}
      VersionListFlash_Counter: nv-provide-com-spec{ram-block-init-value=0, rom-block-init-value=0, variable=VersionListFlash_Counter/Value}, nv-require-com-spec=init-value=0, provided-required-interface=VersionListFlash_Counter
      VersionListIndex: nv-provide-com-spec{ram-block-init-value=0, rom-block-init-value=0, variable=VersionListIndex/Value}, nv-require-com-spec=init-value=0, provided-required-interface=VersionListIndex
      WLTP_Concept: nv-provide-com-spec{ram-block-init-value=0, rom-block-init-value=0, variable=WLTP_Concept/Value}, nv-require-com-spec=init-value=0, provided-required-interface=WLTP_Concept
      Whisper_Mode: nv-provide-com-spec{ram-block-init-value=0, rom-block-init-value=0, variable=Whisper_Mode/Value}, nv-require-com-spec=init-value=0, provided-required-interface=Whisper_Mode
      Whisper_Mode_Loudness: nv-provide-com-spec{ram-block-init-value=30, rom-block-init-value=30, variable=Whisper_Mode_Loudness/Value}, nv-require-com-spec=init-value=30, provided-required-interface=Whisper_Mode_Loudness
      WhitePointCorrectionMethod: nv-provide-com-spec{ram-block-init-value=1, rom-block-init-value=1, variable=WhitePointCorrectionMethod/Value}, nv-require-com-spec=init-value=1, provided-required-interface=WhitePointCorrectionMethod
      Write_Delay_Speed: nv-provide-com-spec{ram-block-init-value=20, rom-block-init-value=20, variable=Write_Delay_Speed/Value}, nv-require-com-spec=init-value=20, provided-required-interface=Write_Delay_Speed
      Write_Delay_Time: nv-provide-com-spec{ram-block-init-value=40, rom-block-init-value=40, variable=Write_Delay_Time/Value}, nv-require-com-spec=init-value=40, provided-required-interface=Write_Delay_Time
      Write_Distance: nv-provide-com-spec{ram-block-init-value=2, rom-block-init-value=2, variable=Write_Distance/Value}, nv-require-com-spec=init-value=2, provided-required-interface=Write_Distance
      Zero_Potential_Display_Active: nv-provide-com-spec{ram-block-init-value=2, rom-block-init-value=2, variable=Zero_Potential_Display_Active/Value}, nv-require-com-spec=init-value=2, provided-required-interface=Zero_Potential_Display_Active
      Zreserved_Bargraph_VAR: nv-provide-com-spec{ram-block-init-value=12 x 255, rom-block-init-value=12 x 255, variable=Zreserved_Bargraph_VAR/Value}, nv-require-com-spec=init-value=12 x 255, provided-required-interface=Zreserved_Bargraph_VAR
      bap_bc_mfa_SpeedWarning_Speed_Unit: nv-provide-com-spec{ram-block-init-value=0, rom-block-init-value=0, variable=bap_bc_mfa_SpeedWarning_Speed_Unit/Value}, nv-require-com-spec=init-value=0, provided-required-interface=bap_bc_mfa_SpeedWarning_Speed_Unit
      bap_bc_mfa_SpeedWarning_Speed_Value: nv-provide-com-spec{ram-block-init-value=0, rom-block-init-value=0, variable=bap_bc_mfa_SpeedWarning_Speed_Value/Value}, nv-require-com-spec=init-value=0, provided-required-interface=bap_bc_mfa_SpeedWarning_Speed_Value
      bap_bc_mfa_SpeedWarning_State: nv-provide-com-spec{ram-block-init-value=0, rom-block-init-value=0, variable=bap_bc_mfa_SpeedWarning_State/Value}, nv-require-com-spec=init-value=0, provided-required-interface=bap_bc_mfa_SpeedWarning_State
      bcme_consumer_available: nv-provide-com-spec{ram-block-init-value=0, rom-block-init-value=0, variable=bcme_consumer_available/Value}, nv-require-com-spec=init-value=0, provided-required-interface=bcme_consumer_available
      bcme_consumption_unit: nv-provide-com-spec{ram-block-init-value=2, rom-block-init-value=2, variable=bcme_consumption_unit/Value}, nv-require-com-spec=init-value=2, provided-required-interface=bcme_consumption_unit
      consum_correction_electro: nv-provide-com-spec{ram-block-init-value=100, rom-block-init-value=100, variable=consum_correction_electro/Value}, nv-require-com-spec=init-value=100, provided-required-interface=consum_correction_electro
      counter_lost_communication_Distance: nv-provide-com-spec{ram-block-init-value=0, rom-block-init-value=0, variable=counter_lost_communication_Distance/Value}, nv-require-com-spec=init-value=0, provided-required-interface=counter_lost_communication_Distance
      counter_lost_communication_EdgeCount: nv-provide-com-spec{ram-block-init-value=0, rom-block-init-value=0, variable=counter_lost_communication_EdgeCount/Value}, nv-require-com-spec=init-value=0, provided-required-interface=counter_lost_communication_EdgeCount
      counter_lost_communication_clamp15: nv-provide-com-spec{ram-block-init-value=0, rom-block-init-value=0, variable=counter_lost_communication_clamp15/Value}, nv-require-com-spec=init-value=0, provided-required-interface=counter_lost_communication_clamp15
      counter_lost_communication_time: nv-provide-com-spec{ram-block-init-value=0, rom-block-init-value=0, variable=counter_lost_communication_time/Value}, nv-require-com-spec=init-value=0, provided-required-interface=counter_lost_communication_time
      da_3D_Geschw_verwenden: nv-provide-com-spec{ram-block-init-value=0, rom-block-init-value=0, variable=da_3D_Geschw_verwenden/Value}, nv-require-com-spec=init-value=0, provided-required-interface=da_3D_Geschw_verwenden
      da_anzahl_tueren: nv-provide-com-spec{ram-block-init-value=0, rom-block-init-value=0, variable=da_anzahl_tueren/Value}, nv-require-com-spec=init-value=0, provided-required-interface=da_anzahl_tueren
      da_gap_reset_tage: nv-provide-com-spec{ram-block-init-value=0, rom-block-init-value=0, variable=da_gap_reset_tage/Value}, nv-require-com-spec=init-value=0, provided-required-interface=da_gap_reset_tage
      da_gap_tage: nv-provide-com-spec{ram-block-init-value=1460, rom-block-init-value=1460, variable=da_gap_tage/Value}, nv-require-com-spec=init-value=1460, provided-required-interface=da_gap_tage
      da_schalter_genaue_geschw: nv-provide-com-spec{ram-block-init-value=0, rom-block-init-value=0, variable=da_schalter_genaue_geschw/Value}, nv-require-com-spec=init-value=0, provided-required-interface=da_schalter_genaue_geschw
      da_total_distance_pass_jump: nv-provide-com-spec{ram-block-init-value=0, rom-block-init-value=0, variable=da_total_distance_pass_jump/Value}, nv-require-com-spec=init-value=0, provided-required-interface=da_total_distance_pass_jump
      distance_unit_default: nv-provide-com-spec{ram-block-init-value=0, rom-block-init-value=0, variable=distance_unit_default/Value}, nv-require-com-spec=init-value=0, provided-required-interface=distance_unit_default
      dm_Balance_sheet_jumps_distance_pulse: nv-provide-com-spec{ram-block-init-value=0, rom-block-init-value=0, variable=dm_Balance_sheet_jumps_distance_pulse/Value}, nv-require-com-spec=init-value=0, provided-required-interface=dm_Balance_sheet_jumps_distance_pulse
      dm_Biggest_negative_jump_distance_pulse: nv-provide-com-spec{ram-block-init-value=0, rom-block-init-value=0, variable=dm_Biggest_negative_jump_distance_pulse/Value}, nv-require-com-spec=init-value=0, provided-required-interface=dm_Biggest_negative_jump_distance_pulse
      dm_Biggest_positive_jump_distance_pulse: nv-provide-com-spec{ram-block-init-value=0, rom-block-init-value=0, variable=dm_Biggest_positive_jump_distance_pulse/Value}, nv-require-com-spec=init-value=0, provided-required-interface=dm_Biggest_positive_jump_distance_pulse
      dm_Esc_distance_pulse: nv-provide-com-spec{ram-block-init-value=0, rom-block-init-value=0, variable=dm_Esc_distance_pulse/Value}, nv-require-com-spec=init-value=0, provided-required-interface=dm_Esc_distance_pulse
      dm_Longest_communication_failures_ESC: nv-provide-com-spec{ram-block-init-value=0, rom-block-init-value=0, variable=dm_Longest_communication_failures_ESC/Value}, nv-require-com-spec=init-value=0, provided-required-interface=dm_Longest_communication_failures_ESC
      dm_Number_of_communication_failures_ESC: nv-provide-com-spec{ram-block-init-value=0, rom-block-init-value=0, variable=dm_Number_of_communication_failures_ESC/Value}, nv-require-com-spec=init-value=0, provided-required-interface=dm_Number_of_communication_failures_ESC
      dm_Number_of_jumps_distance_pulse: nv-provide-com-spec{ram-block-init-value=0, rom-block-init-value=0, variable=dm_Number_of_jumps_distance_pulse/Value}, nv-require-com-spec=init-value=0, provided-required-interface=dm_Number_of_jumps_distance_pulse
      dm_Sum_jumps_distance_pulse: nv-provide-com-spec{ram-block-init-value=0, rom-block-init-value=0, variable=dm_Sum_jumps_distance_pulse/Value}, nv-require-com-spec=init-value=0, provided-required-interface=dm_Sum_jumps_distance_pulse
      dm_TimeStampDay: nv-provide-com-spec{ram-block-init-value=0, rom-block-init-value=0, variable=dm_TimeStampDay/Value}, nv-require-com-spec=init-value=0, provided-required-interface=dm_TimeStampDay
      dm_TimeStampHour: nv-provide-com-spec{ram-block-init-value=0, rom-block-init-value=0, variable=dm_TimeStampHour/Value}, nv-require-com-spec=init-value=0, provided-required-interface=dm_TimeStampHour
      dm_TimeStampMinute: nv-provide-com-spec{ram-block-init-value=0, rom-block-init-value=0, variable=dm_TimeStampMinute/Value}, nv-require-com-spec=init-value=0, provided-required-interface=dm_TimeStampMinute
      dm_TimeStampMonth: nv-provide-com-spec{ram-block-init-value=0, rom-block-init-value=0, variable=dm_TimeStampMonth/Value}, nv-require-com-spec=init-value=0, provided-required-interface=dm_TimeStampMonth
      dm_TimeStampSecond: nv-provide-com-spec{ram-block-init-value=0, rom-block-init-value=0, variable=dm_TimeStampSecond/Value}, nv-require-com-spec=init-value=0, provided-required-interface=dm_TimeStampSecond
      dm_TimeStampYear: nv-provide-com-spec{ram-block-init-value=0, rom-block-init-value=0, variable=dm_TimeStampYear/Value}, nv-require-com-spec=init-value=0, provided-required-interface=dm_TimeStampYear
      dm_Total_duration_communication_failures_ESC: nv-provide-com-spec{ram-block-init-value=0, rom-block-init-value=0, variable=dm_Total_duration_communication_failures_ESC/Value}, nv-require-com-spec=init-value=0, provided-required-interface=dm_Total_duration_communication_failures_ESC
      dm_error_calculation_dates: nv-provide-com-spec{ram-block-init-value=0, rom-block-init-value=0, variable=dm_error_calculation_dates/Value}, nv-require-com-spec=init-value=0, provided-required-interface=dm_error_calculation_dates
      dm_error_secure_storage_AR: nv-provide-com-spec{ram-block-init-value=0, rom-block-init-value=0, variable=dm_error_secure_storage_AR/Value}, nv-require-com-spec=init-value=0, provided-required-interface=dm_error_secure_storage_AR
      dm_total_distance: nv-provide-com-spec{ram-block-init-value=0, rom-block-init-value=0, variable=dm_total_distance/Value}, nv-require-com-spec=init-value=0, provided-required-interface=dm_total_distance
      edv_charge_suppress: nv-provide-com-spec{ram-block-init-value=0, rom-block-init-value=0, variable=edv_charge_suppress/Value}, nv-require-com-spec=init-value=0, provided-required-interface=edv_charge_suppress
      ego_fahrzeug: nv-provide-com-spec{ram-block-init-value=[15, 185, 0, 0, 0, 0, 0, 0, 0, 0, 0, 0, 0, 0, 0, 0], rom-block-init-value=[15, 185, 0, 0, 0, 0, 0, 0, 0, 0, 0, 0, 0, 0, 0, 0], variable=ego_fahrzeug/Value}, nv-require-com-spec=init-value=[15, 185, 0, 0, 0, 0, 0, 0, 0, 0, 0, 0, 0, 0, 0, 0], provided-required-interface=ego_fahrzeug
      gap_FIFO_Day: nv-provide-com-spec{ram-block-init-value=5 x 1, rom-block-init-value=5 x 1, variable=gap_FIFO_Day/Value}, nv-require-com-spec=init-value=5 x 1, provided-required-interface=gap_FIFO_Day
      gap_FIFO_Distance: nv-provide-com-spec{ram-block-init-value=5 x 0, rom-block-init-value=5 x 0, variable=gap_FIFO_Distance/Value}, nv-require-com-spec=init-value=5 x 0, provided-required-interface=gap_FIFO_Distance
      gap_FIFO_Month: nv-provide-com-spec{ram-block-init-value=5 x 1, rom-block-init-value=5 x 1, variable=gap_FIFO_Month/Value}, nv-require-com-spec=init-value=5 x 1, provided-required-interface=gap_FIFO_Month
      gap_FIFO_NumberResets: nv-provide-com-spec{ram-block-init-value=5 x 0, rom-block-init-value=5 x 0, variable=gap_FIFO_NumberResets/Value}, nv-require-com-spec=init-value=5 x 0, provided-required-interface=gap_FIFO_NumberResets
      gap_FIFO_TimeLastGAP: nv-provide-com-spec{ram-block-init-value=5 x 65535, rom-block-init-value=5 x 65535, variable=gap_FIFO_TimeLastGAP/Value}, nv-require-com-spec=init-value=5 x 65535, provided-required-interface=gap_FIFO_TimeLastGAP
      gap_FIFO_Year: nv-provide-com-spec{ram-block-init-value=5 x 0, rom-block-init-value=5 x 0, variable=gap_FIFO_Year/Value}, nv-require-com-spec=init-value=5 x 0, provided-required-interface=gap_FIFO_Year
      gap_mfa_max: nv-provide-com-spec{ram-block-init-value=365, rom-block-init-value=365, variable=gap_mfa_max/Value}, nv-require-com-spec=init-value=365, provided-required-interface=gap_mfa_max
      gap_mfa_min: nv-provide-com-spec{ram-block-init-value=1, rom-block-init-value=1, variable=gap_mfa_min/Value}, nv-require-com-spec=init-value=1, provided-required-interface=gap_mfa_min
      gap_tage_default: nv-provide-com-spec{ram-block-init-value=1460, rom-block-init-value=1460, variable=gap_tage_default/Value}, nv-require-com-spec=init-value=1460, provided-required-interface=gap_tage_default
      gap_vorhanden: nv-provide-com-spec{ram-block-init-value=1, rom-block-init-value=1, variable=gap_vorhanden/Value}, nv-require-com-spec=init-value=1, provided-required-interface=gap_vorhanden
      gastank_warnung_cng_LED: nv-provide-com-spec{ram-block-init-value=0, rom-block-init-value=0, variable=gastank_warnung_cng_LED/Value}, nv-require-com-spec=init-value=0, provided-required-interface=gastank_warnung_cng_LED
      glaettungsfaktor_g: nv-provide-com-spec{ram-block-init-value=10, rom-block-init-value=10, variable=glaettungsfaktor_g/Value}, nv-require-com-spec=init-value=10, provided-required-interface=glaettungsfaktor_g
      hmi_anteil_gas_aktiv: nv-provide-com-spec{ram-block-init-value=0, rom-block-init-value=0, variable=hmi_anteil_gas_aktiv/Value}, nv-require-com-spec=init-value=0, provided-required-interface=hmi_anteil_gas_aktiv
      hmi_t_RearBelt: nv-provide-com-spec{ram-block-init-value=65, rom-block-init-value=65, variable=hmi_t_RearBelt/Value}, nv-require-com-spec=init-value=65, provided-required-interface=hmi_t_RearBelt
      kombi_variante_e_traktion: nv-provide-com-spec{ram-block-init-value=0, rom-block-init-value=0, variable=kombi_variante_e_traktion/Value}, nv-require-com-spec=init-value=0, provided-required-interface=kombi_variante_e_traktion
      lautstaerke_offset: nv-provide-com-spec{ram-block-init-value=100, rom-block-init-value=100, variable=lautstaerke_offset/Value}, nv-require-com-spec=init-value=100, provided-required-interface=lautstaerke_offset
      negative_calculations_allowed: nv-provide-com-spec{ram-block-init-value=1, rom-block-init-value=1, variable=negative_calculations_allowed/Value}, nv-require-com-spec=init-value=1, provided-required-interface=negative_calculations_allowed
      offroad: nv-provide-com-spec{ram-block-init-value=0, rom-block-init-value=0, variable=offroad/Value}, nv-require-com-spec=init-value=0, provided-required-interface=offroad
      p_BR_Systemart: nv-provide-com-spec{ram-block-init-value=0, rom-block-init-value=0, variable=p_BR_Systemart/Value}, nv-require-com-spec=init-value=0, provided-required-interface=p_BR_Systemart
      p_Bargraph_Luminosity_Calibration_PWM: nv-provide-com-spec{ram-block-init-value=[16, 39, 16, 39], rom-block-init-value=[16, 39, 16, 39], variable=p_Bargraph_Luminosity_Calibration_PWM/Value}, nv-require-com-spec=init-value=[16, 39, 16, 39], provided-required-interface=p_Bargraph_Luminosity_Calibration_PWM
      p_Hmi_TripDistance_Max_Km: nv-provide-com-spec{ram-block-init-value=99999, rom-block-init-value=99999, variable=p_Hmi_TripDistance_Max_Km/Value}, nv-require-com-spec=init-value=99999, provided-required-interface=p_Hmi_TripDistance_Max_Km
      p_Hmi_TripDistance_Max_Miles: nv-provide-com-spec{ram-block-init-value=99999, rom-block-init-value=99999, variable=p_Hmi_TripDistance_Max_Miles/Value}, nv-require-com-spec=init-value=99999, provided-required-interface=p_Hmi_TripDistance_Max_Miles
      p_Oil_Exceeded_Days: nv-provide-com-spec{ram-block-init-value=0, rom-block-init-value=0, variable=p_Oil_Exceeded_Days/Value}, nv-require-com-spec=init-value=0, provided-required-interface=p_Oil_Exceeded_Days
      p_Oil_Exceeded_Km: nv-provide-com-spec{ram-block-init-value=0, rom-block-init-value=0, variable=p_Oil_Exceeded_Km/Value}, nv-require-com-spec=init-value=0, provided-required-interface=p_Oil_Exceeded_Km
      p_PWM_DampingCurve: nv-provide-com-spec{ram-block-init-value=100, rom-block-init-value=100, variable=p_PWM_DampingCurve/Value}, nv-require-com-spec=init-value=100, provided-required-interface=p_PWM_DampingCurve
      p_Perso_NumberOfUserProfiles: nv-provide-com-spec{ram-block-init-value=7, rom-block-init-value=7, variable=p_Perso_NumberOfUserProfiles/Value}, nv-require-com-spec=init-value=7, provided-required-interface=p_Perso_NumberOfUserProfiles
      p_canrw_initzeit: nv-provide-com-spec{ram-block-init-value=50, rom-block-init-value=50, variable=p_canrw_initzeit/Value}, nv-require-com-spec=init-value=50, provided-required-interface=p_canrw_initzeit
      p_kilometerstand_last_value: nv-provide-com-spec{ram-block-init-value=1048573, rom-block-init-value=1048573, variable=p_kilometerstand_last_value/Value}, nv-require-com-spec=init-value=1048573, provided-required-interface=p_kilometerstand_last_value
      p_kilometerstand_last_value_obsolete: nv-provide-com-spec{ram-block-init-value=1048573, rom-block-init-value=1048573, variable=p_kilometerstand_last_value_obsolete/Value}, nv-require-com-spec=init-value=1048573, provided-required-interface=p_kilometerstand_last_value_obsolete
      p_mute_delay: nv-provide-com-spec{ram-block-init-value=20, rom-block-init-value=20, variable=p_mute_delay/Value}, nv-require-com-spec=init-value=20, provided-required-interface=p_mute_delay
      personalisation_2x_active: nv-provide-com-spec{ram-block-init-value=1, rom-block-init-value=1, variable=personalisation_2x_active/Value}, nv-require-com-spec=init-value=1, provided-required-interface=personalisation_2x_active
      primary_engine_type: nv-provide-com-spec{ram-block-init-value=1, rom-block-init-value=1, variable=primary_engine_type/Value}, nv-require-com-spec=init-value=1, provided-required-interface=primary_engine_type
      rawVIN_lastmode: nv-provide-com-spec{ram-block-init-value=18 x 0, rom-block-init-value=18 x 0, variable=rawVIN_lastmode/Value}, nv-require-com-spec=init-value=18 x 0, provided-required-interface=rawVIN_lastmode
      rawVin_change_in_clamp15_lastmode: nv-provide-com-spec{ram-block-init-value=0, rom-block-init-value=0, variable=rawVin_change_in_clamp15_lastmode/Value}, nv-require-com-spec=init-value=0, provided-required-interface=rawVin_change_in_clamp15_lastmode
      rw_calc_time: nv-provide-com-spec{ram-block-init-value=1, rom-block-init-value=1, variable=rw_calc_time/Value}, nv-require-com-spec=init-value=1, provided-required-interface=rw_calc_time
      rw_fahrzg_faehrt: nv-provide-com-spec{ram-block-init-value=50, rom-block-init-value=50, variable=rw_fahrzg_faehrt/Value}, nv-require-com-spec=init-value=50, provided-required-interface=rw_fahrzg_faehrt
      rw_fahrzg_steht: nv-provide-com-spec{ram-block-init-value=30, rom-block-init-value=30, variable=rw_fahrzg_steht/Value}, nv-require-com-spec=init-value=30, provided-required-interface=rw_fahrzg_steht
      secondary_engine_type: nv-provide-com-spec{ram-block-init-value=0, rom-block-init-value=0, variable=secondary_engine_type/Value}, nv-require-com-spec=init-value=0, provided-required-interface=secondary_engine_type
      size_n: nv-provide-com-spec{ram-block-init-value=15, rom-block-init-value=15, variable=size_n/Value}, nv-require-com-spec=init-value=15, provided-required-interface=size_n
      skinning: nv-provide-com-spec{ram-block-init-value=0, rom-block-init-value=0, variable=skinning/Value}, nv-require-com-spec=init-value=0, provided-required-interface=skinning
      sperrung_AnzahlListeneintraege: nv-provide-com-spec{ram-block-init-value=0, rom-block-init-value=0, variable=sperrung_AnzahlListeneintraege/Value}, nv-require-com-spec=init-value=0, provided-required-interface=sperrung_AnzahlListeneintraege
      sperrung_CarDecorator: nv-provide-com-spec{ram-block-init-value=0, rom-block-init-value=0, variable=sperrung_CarDecorator/Value}, nv-require-com-spec=init-value=0, provided-required-interface=sperrung_CarDecorator
      sperrung_Karte: nv-provide-com-spec{ram-block-init-value=0, rom-block-init-value=0, variable=sperrung_Karte/Value}, nv-require-com-spec=init-value=0, provided-required-interface=sperrung_Karte
      sperrung_NPSCoverIntensitaet: nv-provide-com-spec{ram-block-init-value=100, rom-block-init-value=100, variable=sperrung_NPSCoverIntensitaet/Value}, nv-require-com-spec=init-value=100, provided-required-interface=sperrung_NPSCoverIntensitaet
      sperrung_PiloFahrt: nv-provide-com-spec{ram-block-init-value=0, rom-block-init-value=0, variable=sperrung_PiloFahrt/Value}, nv-require-com-spec=init-value=0, provided-required-interface=sperrung_PiloFahrt
      sperrung_bedienunterstuetzende_animationen: nv-provide-com-spec{ram-block-init-value=0, rom-block-init-value=0, variable=sperrung_bedienunterstuetzende_animationen/Value}, nv-require-com-spec=init-value=0, provided-required-interface=sperrung_bedienunterstuetzende_animationen
      sperrung_dynamische_bilder: nv-provide-com-spec{ram-block-init-value=0, rom-block-init-value=0, variable=sperrung_dynamische_bilder/Value}, nv-require-com-spec=init-value=0, provided-required-interface=sperrung_dynamische_bilder
      sperrung_funktionale_animationen: nv-provide-com-spec{ram-block-init-value=0, rom-block-init-value=0, variable=sperrung_funktionale_animationen/Value}, nv-require-com-spec=init-value=0, provided-required-interface=sperrung_funktionale_animationen
      sperrung_funktionslisten: nv-provide-com-spec{ram-block-init-value=0, rom-block-init-value=0, variable=sperrung_funktionslisten/Value}, nv-require-com-spec=init-value=0, provided-required-interface=sperrung_funktionslisten
      sperrung_infotainmentlisten: nv-provide-com-spec{ram-block-init-value=0, rom-block-init-value=0, variable=sperrung_infotainmentlisten/Value}, nv-require-com-spec=init-value=0, provided-required-interface=sperrung_infotainmentlisten
      sperrung_listentimeout: nv-provide-com-spec{ram-block-init-value=72000, rom-block-init-value=72000, variable=sperrung_listentimeout/Value}, nv-require-com-spec=init-value=72000, provided-required-interface=sperrung_listentimeout
      sperrung_mfa_anzeigen: nv-provide-com-spec{ram-block-init-value=0, rom-block-init-value=0, variable=sperrung_mfa_anzeigen/Value}, nv-require-com-spec=init-value=0, provided-required-interface=sperrung_mfa_anzeigen
      sperrung_schmuckanimationen: nv-provide-com-spec{ram-block-init-value=0, rom-block-init-value=0, variable=sperrung_schmuckanimationen/Value}, nv-require-com-spec=init-value=0, provided-required-interface=sperrung_schmuckanimationen
      sperrung_systemzustandsanimationen: nv-provide-com-spec{ram-block-init-value=0, rom-block-init-value=0, variable=sperrung_systemzustandsanimationen/Value}, nv-require-com-spec=init-value=0, provided-required-interface=sperrung_systemzustandsanimationen
      sport: nv-provide-com-spec{ram-block-init-value=0, rom-block-init-value=0, variable=sport/Value}, nv-require-com-spec=init-value=0, provided-required-interface=sport
      t_Celeb_Pause_Until_EndDim_Scale: nv-provide-com-spec{ram-block-init-value=0, rom-block-init-value=0, variable=t_Celeb_Pause_Until_EndDim_Scale/Value}, nv-require-com-spec=init-value=0, provided-required-interface=t_Celeb_Pause_Until_EndDim_Scale
      t_DisplayDelay_KL15Off: nv-provide-com-spec{ram-block-init-value=3, rom-block-init-value=3, variable=t_DisplayDelay_KL15Off/Value}, nv-require-com-spec=init-value=3, provided-required-interface=t_DisplayDelay_KL15Off
      t_DisplayDelay_KL15On: nv-provide-com-spec{ram-block-init-value=0, rom-block-init-value=0, variable=t_DisplayDelay_KL15On/Value}, nv-require-com-spec=init-value=0, provided-required-interface=t_DisplayDelay_KL15On
      t_Max_Delay_CLWError: nv-provide-com-spec{ram-block-init-value=8, rom-block-init-value=8, variable=t_Max_Delay_CLWError/Value}, nv-require-com-spec=init-value=8, provided-required-interface=t_Max_Delay_CLWError
      tachoendwert: nv-provide-com-spec{ram-block-init-value=0, rom-block-init-value=0, variable=tachoendwert/Value}, nv-require-com-spec=init-value=0, provided-required-interface=tachoendwert
      total_distance_jump_is_valid: nv-provide-com-spec{ram-block-init-value=0, rom-block-init-value=0, variable=total_distance_jump_is_valid/Value}, nv-require-com-spec=init-value=0, provided-required-interface=total_distance_jump_is_valid
      total_distance_pass_jump: nv-provide-com-spec{ram-block-init-value=0, rom-block-init-value=0, variable=total_distance_pass_jump/Value}, nv-require-com-spec=init-value=0, provided-required-interface=total_distance_pass_jump
      total_distance_pass_jump_lastmode: nv-provide-com-spec{ram-block-init-value=0, rom-block-init-value=0, variable=total_distance_pass_jump_lastmode/Value}, nv-require-com-spec=init-value=0, provided-required-interface=total_distance_pass_jump_lastmode
      total_distance_sum_implaus_jump_high_ESP: nv-provide-com-spec{ram-block-init-value=0, rom-block-init-value=0, variable=total_distance_sum_implaus_jump_high_ESP/Value}, nv-require-com-spec=init-value=0, provided-required-interface=total_distance_sum_implaus_jump_high_ESP
      total_distance_sum_implaus_jump_low_ESP: nv-provide-com-spec{ram-block-init-value=0, rom-block-init-value=0, variable=total_distance_sum_implaus_jump_low_ESP/Value}, nv-require-com-spec=init-value=0, provided-required-interface=total_distance_sum_implaus_jump_low_ESP
      tuben_darstellung: nv-provide-com-spec{ram-block-init-value=0, rom-block-init-value=0, variable=tuben_darstellung/Value}, nv-require-com-spec=init-value=0, provided-required-interface=tuben_darstellung
      vehicle_type: nv-provide-com-spec{ram-block-init-value=2, rom-block-init-value=2, variable=vehicle_type/Value}, nv-require-com-spec=init-value=2, provided-required-interface=vehicle_type
      verlassenswarnung_VWN: nv-provide-com-spec{ram-block-init-value=0, rom-block-init-value=0, variable=verlassenswarnung_VWN/Value}, nv-require-com-spec=init-value=0, provided-required-interface=verlassenswarnung_VWN
      vkmrw_Verbrauchsaequivalent: nv-provide-com-spec{ram-block-init-value=175, rom-block-init-value=175, variable=vkmrw_Verbrauchsaequivalent/Value}, nv-require-com-spec=init-value=175, provided-required-interface=vkmrw_Verbrauchsaequivalent
      vkmrw_Verbrauchsaequivalent_ein: nv-provide-com-spec{ram-block-init-value=1, rom-block-init-value=1, variable=vkmrw_Verbrauchsaequivalent_ein/Value}, nv-require-com-spec=init-value=1, provided-required-interface=vkmrw_Verbrauchsaequivalent_ein
      vkmrw_gesamtreichweite_vorhanden: nv-provide-com-spec{ram-block-init-value=0, rom-block-init-value=0, variable=vkmrw_gesamtreichweite_vorhanden/Value}, nv-require-com-spec=init-value=0, provided-required-interface=vkmrw_gesamtreichweite_vorhanden
      vkmrw_rwdv_cng_default: nv-provide-com-spec{ram-block-init-value=60, rom-block-init-value=60, variable=vkmrw_rwdv_cng_default/Value}, nv-require-com-spec=init-value=60, provided-required-interface=vkmrw_rwdv_cng_default
      vkmrw_rwdv_lpg_default: nv-provide-com-spec{ram-block-init-value=100, rom-block-init-value=100, variable=vkmrw_rwdv_lpg_default/Value}, nv-require-com-spec=init-value=100, provided-required-interface=vkmrw_rwdv_lpg_default
      vkmrw_verbrauchsfaktor_kombi: nv-provide-com-spec{ram-block-init-value=0, rom-block-init-value=0, variable=vkmrw_verbrauchsfaktor_kombi/Value}, nv-require-com-spec=init-value=0, provided-required-interface=vkmrw_verbrauchsfaktor_kombi
      wheel_circumference_lastmode: nv-provide-com-spec{ram-block-init-value=0, rom-block-init-value=0, variable=wheel_circumference_lastmode/Value}, nv-require-com-spec=init-value=0, provided-required-interface=wheel_circumference_lastmode
      zIniSwVer: nv-provide-com-spec{ram-block-init-value=1, rom-block-init-value=1, variable=zIniSwVer/Value}, nv-require-com-spec=init-value=1, provided-required-interface=zIniSwVer
      zIniSwVer_COMPONENTS_Cfg_CONST: nv-provide-com-spec{ram-block-init-value=1, rom-block-init-value=1, variable=zIniSwVer_COMPONENTS_Cfg_CONST/Value}, nv-require-com-spec=init-value=1, provided-required-interface=zIniSwVer_COMPONENTS_Cfg_CONST
      zIniSwVer_DIAG_VariantCoding_CONST: nv-provide-com-spec{ram-block-init-value=1, rom-block-init-value=1, variable=zIniSwVer_DIAG_VariantCoding_CONST/Value}, nv-require-com-spec=init-value=1, provided-required-interface=zIniSwVer_DIAG_VariantCoding_CONST
      zReservedAligmnet_DIAG_EOL_HWCalib_CONST: nv-provide-com-spec{ram-block-init-value=255, rom-block-init-value=255, variable=zReservedAligmnet_DIAG_EOL_HWCalib_CONST/Value}, nv-require-com-spec=init-value=255, provided-required-interface=zReservedAligmnet_DIAG_EOL_HWCalib_CONST
      zReserved_1_COMPONENTS_Cfg_CONST: nv-provide-com-spec{ram-block-init-value=255, rom-block-init-value=255, variable=zReserved_1_COMPONENTS_Cfg_CONST/Value}, nv-require-com-spec=init-value=255, provided-required-interface=zReserved_1_COMPONENTS_Cfg_CONST
      zReserved_1_COMPONENTS_Cfg_VAR: nv-provide-com-spec{ram-block-init-value=[255, 255, 255, 255], rom-block-init-value=[255, 255, 255, 255], variable=zReserved_1_COMPONENTS_Cfg_VAR/Value}, nv-require-com-spec=init-value=[255, 255, 255, 255], provided-required-interface=zReserved_1_COMPONENTS_Cfg_VAR
      zReserved_1_Com_Cfg_VAR: nv-provide-com-spec{ram-block-init-value=8 x 255, rom-block-init-value=8 x 255, variable=zReserved_1_Com_Cfg_VAR/Value}, nv-require-com-spec=init-value=8 x 255, provided-required-interface=zReserved_1_Com_Cfg_VAR
      zReserved_1_DIAG_EOL_DiagCfg_CONST: nv-provide-com-spec{ram-block-init-value=6 x 255, rom-block-init-value=6 x 255, variable=zReserved_1_DIAG_EOL_DiagCfg_CONST/Value}, nv-require-com-spec=init-value=6 x 255, provided-required-interface=zReserved_1_DIAG_EOL_DiagCfg_CONST
      zReserved_1_DIAG_VariantCodingCheck_CONST: nv-provide-com-spec{ram-block-init-value=5 x 255, rom-block-init-value=5 x 255, variable=zReserved_1_DIAG_VariantCodingCheck_CONST/Value}, nv-require-com-spec=init-value=5 x 255, provided-required-interface=zReserved_1_DIAG_VariantCodingCheck_CONST
      zReserved_1_DIAG_VariantCoding_CONST: nv-provide-com-spec{ram-block-init-value=[0, 255, 255, 255, 255, 255, 255, 255], rom-block-init-value=[0, 255, 255, 255, 255, 255, 255, 255], variable=zReserved_1_DIAG_VariantCoding_CONST/Value}, nv-require-com-spec=init-value=[0, 255, 255, 255, 255, 255, 255, 255], provided-required-interface=zReserved_1_DIAG_VariantCoding_CONST
      zReserved_2_DIAG_VariantCodingCheck_CONST: nv-provide-com-spec{ram-block-init-value=[255, 255, 255], rom-block-init-value=[255, 255, 255], variable=zReserved_2_DIAG_VariantCodingCheck_CONST/Value}, nv-require-com-spec=init-value=[255, 255, 255], provided-required-interface=zReserved_2_DIAG_VariantCodingCheck_CONST
      zReserved_2_TANK_Variant_CONST: nv-provide-com-spec{ram-block-init-value=255, rom-block-init-value=255, variable=zReserved_2_TANK_Variant_CONST/Value}, nv-require-com-spec=init-value=255, provided-required-interface=zReserved_2_TANK_Variant_CONST
      zReserved_3_TANK_Variant_CONST: nv-provide-com-spec{ram-block-init-value=10 x 255, rom-block-init-value=10 x 255, variable=zReserved_3_TANK_Variant_CONST/Value}, nv-require-com-spec=init-value=10 x 255, provided-required-interface=zReserved_3_TANK_Variant_CONST
      zReserved_Bcct_Cfg_VAR_1: nv-provide-com-spec{ram-block-init-value=[255, 255, 255, 255], rom-block-init-value=[255, 255, 255, 255], variable=zReserved_Bcct_Cfg_VAR_1/Value}, nv-require-com-spec=init-value=[255, 255, 255, 255], provided-required-interface=zReserved_Bcct_Cfg_VAR_1
      zReserved_CAN_VAR: nv-provide-com-spec{ram-block-init-value=[255, 255, 255], rom-block-init-value=[255, 255, 255], variable=zReserved_CAN_VAR/Value}, nv-require-com-spec=init-value=[255, 255, 255], provided-required-interface=zReserved_CAN_VAR
      zReserved_COMPONENTS_Cfg_CONST: nv-provide-com-spec{ram-block-init-value=8 x 255, rom-block-init-value=8 x 255, variable=zReserved_COMPONENTS_Cfg_CONST/Value}, nv-require-com-spec=init-value=8 x 255, provided-required-interface=zReserved_COMPONENTS_Cfg_CONST
      zReserved_COMPONENTS_Cfg_VAR: nv-provide-com-spec{ram-block-init-value=255, rom-block-init-value=255, variable=zReserved_COMPONENTS_Cfg_VAR/Value}, nv-require-com-spec=init-value=255, provided-required-interface=zReserved_COMPONENTS_Cfg_VAR
      zReserved_Cluster_Settings: nv-provide-com-spec{ram-block-init-value=5 x 255, rom-block-init-value=5 x 255, variable=zReserved_Cluster_Settings/Value}, nv-require-com-spec=init-value=5 x 255, provided-required-interface=zReserved_Cluster_Settings
      zReserved_Com_Cfg_VAR: nv-provide-com-spec{ram-block-init-value=5 x 255, rom-block-init-value=5 x 255, variable=zReserved_Com_Cfg_VAR/Value}, nv-require-com-spec=init-value=5 x 255, provided-required-interface=zReserved_Com_Cfg_VAR
      zReserved_DEV_Messages: nv-provide-com-spec{ram-block-init-value=7 x 255, rom-block-init-value=7 x 255, variable=zReserved_DEV_Messages/Value}, nv-require-com-spec=init-value=7 x 255, provided-required-interface=zReserved_DEV_Messages
      zReserved_DIAG_AC_IlluminationCfg_1_VAR: nv-provide-com-spec{ram-block-init-value=14 x 255, rom-block-init-value=14 x 255, variable=zReserved_DIAG_AC_IlluminationCfg_1_VAR/Value}, nv-require-com-spec=init-value=14 x 255, provided-required-interface=zReserved_DIAG_AC_IlluminationCfg_1_VAR
      zReserved_DIAG_AC_ServiceCfg_VAR: nv-provide-com-spec{ram-block-init-value=[255, 255], rom-block-init-value=[255, 255], variable=zReserved_DIAG_AC_ServiceCfg_VAR/Value}, nv-require-com-spec=init-value=[255, 255], provided-required-interface=zReserved_DIAG_AC_ServiceCfg_VAR
      zReserved_DIAG_AdaptationChannel_VAR_2: nv-provide-com-spec{ram-block-init-value=8 x 255, rom-block-init-value=8 x 255, variable=zReserved_DIAG_AdaptationChannel_VAR_2/Value}, nv-require-com-spec=init-value=8 x 255, provided-required-interface=zReserved_DIAG_AdaptationChannel_VAR_2
      zReserved_DIAG_EOL_DiagCfg_CONST: nv-provide-com-spec{ram-block-init-value=[0, 0], rom-block-init-value=[0, 0], variable=zReserved_DIAG_EOL_DiagCfg_CONST/Value}, nv-require-com-spec=init-value=[0, 0], provided-required-interface=zReserved_DIAG_EOL_DiagCfg_CONST
      zReserved_DIAG_EOL_HWCalib_CONST: nv-provide-com-spec{ram-block-init-value=[255, 255, 255, 255], rom-block-init-value=[255, 255, 255, 255], variable=zReserved_DIAG_EOL_HWCalib_CONST/Value}, nv-require-com-spec=init-value=[255, 255, 255, 255], provided-required-interface=zReserved_DIAG_EOL_HWCalib_CONST
      zReserved_DIAG_EOL_HWCalib_CONST_1: nv-provide-com-spec{ram-block-init-value=36 x 255, rom-block-init-value=36 x 255, variable=zReserved_DIAG_EOL_HWCalib_CONST_1/Value}, nv-require-com-spec=init-value=36 x 255, provided-required-interface=zReserved_DIAG_EOL_HWCalib_CONST_1
      zReserved_DIAG_EOL_VAR: nv-provide-com-spec{ram-block-init-value=[255, 255, 255], rom-block-init-value=[255, 255, 255], variable=zReserved_DIAG_EOL_VAR/Value}, nv-require-com-spec=init-value=[255, 255, 255], provided-required-interface=zReserved_DIAG_EOL_VAR
      zReserved_DIAG_VariantCodingCheck_CONST: nv-provide-com-spec{ram-block-init-value=51 x 255, rom-block-init-value=51 x 255, variable=zReserved_DIAG_VariantCodingCheck_CONST/Value}, nv-require-com-spec=init-value=51 x 255, provided-required-interface=zReserved_DIAG_VariantCodingCheck_CONST
      zReserved_DIAG_VariantCoding_CONST_Handle: nv-provide-com-spec{ram-block-init-value=32 x 255, rom-block-init-value=32 x 255, variable=zReserved_DIAG_VariantCoding_CONST_Handle/Value}, nv-require-com-spec=init-value=32 x 255, provided-required-interface=zReserved_DIAG_VariantCoding_CONST_Handle
      zReserved_Diag_Adjustment_VAR: nv-provide-com-spec{ram-block-init-value=18 x 255, rom-block-init-value=18 x 255, variable=zReserved_Diag_Adjustment_VAR/Value}, nv-require-com-spec=init-value=18 x 255, provided-required-interface=zReserved_Diag_Adjustment_VAR
      zReserved_Gamma_Adjustment_VAR: nv-provide-com-spec{ram-block-init-value=17 x 255, rom-block-init-value=17 x 255, variable=zReserved_Gamma_Adjustment_VAR/Value}, nv-require-com-spec=init-value=17 x 255, provided-required-interface=zReserved_Gamma_Adjustment_VAR
      zReserved_Nvm_Block_Reserved_1: nv-provide-com-spec{ram-block-init-value=8 x 255, rom-block-init-value=8 x 255, variable=zReserved_Nvm_Block_Reserved_1/Value}, nv-require-com-spec=init-value=8 x 255, provided-required-interface=zReserved_Nvm_Block_Reserved_1
      zReserved_Nvm_Block_Reserved_4: nv-provide-com-spec{ram-block-init-value=27 x 255, rom-block-init-value=27 x 255, variable=zReserved_Nvm_Block_Reserved_4/Value}, nv-require-com-spec=init-value=27 x 255, provided-required-interface=zReserved_Nvm_Block_Reserved_4
      zReserved_OperatingTime_VAR: nv-provide-com-spec{ram-block-init-value=7 x 255, rom-block-init-value=7 x 255, variable=zReserved_OperatingTime_VAR/Value}, nv-require-com-spec=init-value=7 x 255, provided-required-interface=zReserved_OperatingTime_VAR
      zReserved_REFUEL_Logger_VAR: nv-provide-com-spec{ram-block-init-value=8 x 255, rom-block-init-value=8 x 255, variable=zReserved_REFUEL_Logger_VAR/Value}, nv-require-com-spec=init-value=8 x 255, provided-required-interface=zReserved_REFUEL_Logger_VAR
      zReserved_RGB_Calibration_VAR: nv-provide-com-spec{ram-block-init-value=[0, 0, 255, 255, 255, 255, 255, 255, 255, 255, 255, 255], rom-block-init-value=[0, 0, 255, 255, 255, 255, 255, 255, 255, 255, 255, 255], variable=zReserved_RGB_Calibration_VAR/Value}, nv-require-com-spec=init-value=[0, 0, 255, 255, 255, 255, 255, 255, 255, 255, 255, 255], provided-required-interface=zReserved_RGB_Calibration_VAR
      zReserved_Recorder_VAR: nv-provide-com-spec{ram-block-init-value=255, rom-block-init-value=255, variable=zReserved_Recorder_VAR/Value}, nv-require-com-spec=init-value=255, provided-required-interface=zReserved_Recorder_VAR
      zReserved_Recorder_VAR_2: nv-provide-com-spec{ram-block-init-value=6 x 0, rom-block-init-value=6 x 0, variable=zReserved_Recorder_VAR_2/Value}, nv-require-com-spec=init-value=6 x 0, provided-required-interface=zReserved_Recorder_VAR_2
      zReserved_SAFETY_RECORD_VAR: nv-provide-com-spec{ram-block-init-value=[255, 255, 255, 255], rom-block-init-value=[255, 255, 255, 255], variable=zReserved_SAFETY_RECORD_VAR/Value}, nv-require-com-spec=init-value=[255, 255, 255, 255], provided-required-interface=zReserved_SAFETY_RECORD_VAR
      zReserved_SecDiag: nv-provide-com-spec{ram-block-init-value=27 x 255, rom-block-init-value=27 x 255, variable=zReserved_SecDiag/Value}, nv-require-com-spec=init-value=27 x 255, provided-required-interface=zReserved_SecDiag
      zReserved_ServiceKey_VAR: nv-provide-com-spec{ram-block-init-value=8 x 255, rom-block-init-value=8 x 255, variable=zReserved_ServiceKey_VAR/Value}, nv-require-com-spec=init-value=8 x 255, provided-required-interface=zReserved_ServiceKey_VAR
      zReserved_WLTP_Odo: nv-provide-com-spec{ram-block-init-value=15 x 0, rom-block-init-value=15 x 0, variable=zReserved_WLTP_Odo/Value}, nv-require-com-spec=init-value=15 x 0, provided-required-interface=zReserved_WLTP_Odo
      zReserveed_Bcct_Cfg_VAR_2: nv-provide-com-spec{ram-block-init-value=8 x 255, rom-block-init-value=8 x 255, variable=zReserveed_Bcct_Cfg_VAR_2/Value}, nv-require-com-spec=init-value=8 x 255, provided-required-interface=zReserveed_Bcct_Cfg_VAR_2
      zweitgeschwindigkeit_einheitenwechsel: nv-provide-com-spec{ram-block-init-value=1, rom-block-init-value=1, variable=zweitgeschwindigkeit_einheitenwechsel/Value}, nv-require-com-spec=init-value=1, provided-required-interface=zweitgeschwindigkeit_einheitenwechsel
    behavior NvBlockSwComponentType_InternalBehavior
      1028 x data received event, all with start-on-event=NvBlockSwComponentTypeRunnable:
        DRT_NvBlockSwComponentTypeRunnable_ACC_Darstellung_Value: data=ACC_Darstellung.Value
        DRT_NvBlockSwComponentTypeRunnable_AD_Value_Max_lx_Value: data=AD_Value_Max_lx.Value
        DRT_NvBlockSwComponentTypeRunnable_AD_Value_Min_lx_Value: data=AD_Value_Min_lx.Value
        DRT_NvBlockSwComponentTypeRunnable_ASAMFileIdentifier_Value: data=ASAMFileIdentifier.Value
        DRT_NvBlockSwComponentTypeRunnable_ASAMFileVersion_Value: data=ASAMFileVersion.Value
        DRT_NvBlockSwComponentTypeRunnable_AbsErrorCounter_Value: data=AbsErrorCounter.Value
        DRT_NvBlockSwComponentTypeRunnable_AbsErrorPath_Value: data=AbsErrorPath.Value
        DRT_NvBlockSwComponentTypeRunnable_Acceleration_Display_Available_Value: data=Acceleration_Display_Available.Value
        DRT_NvBlockSwComponentTypeRunnable_Actual_Language_Value: data=Actual_Language.Value
        DRT_NvBlockSwComponentTypeRunnable_AcuRequest_0xA00044_Value: data=AcuRequest_0xA00044.Value
        DRT_NvBlockSwComponentTypeRunnable_AcuStatus_0xA00044_Value: data=AcuStatus_0xA00044.Value
        DRT_NvBlockSwComponentTypeRunnable_Adaption_SeatbeltWarning_Value: data=Adaption_SeatbeltWarning.Value
        DRT_NvBlockSwComponentTypeRunnable_AdcTicks_0xA00044_Value: data=AdcTicks_0xA00044.Value
        DRT_NvBlockSwComponentTypeRunnable_AdcTicks_0xA00049_Value: data=AdcTicks_0xA00049.Value
        DRT_NvBlockSwComponentTypeRunnable_AirbagErrorCounter_Value: data=AirbagErrorCounter.Value
        DRT_NvBlockSwComponentTypeRunnable_AirbagErrorPath_Value: data=AirbagErrorPath.Value
        DRT_NvBlockSwComponentTypeRunnable_AmbientLight_Left_Blue_LED_Coef_Value: data=AmbientLight_Left_Blue_LED_Coef.Value
        DRT_NvBlockSwComponentTypeRunnable_AmbientLight_Left_Green_LED_Coef_Value: data=AmbientLight_Left_Green_LED_Coef.Value
        DRT_NvBlockSwComponentTypeRunnable_AmbientLight_Left_Red_LED_Coef_Value: data=AmbientLight_Left_Red_LED_Coef.Value
        DRT_NvBlockSwComponentTypeRunnable_AmbientLight_Right_Blue_LED_Coef_Value: data=AmbientLight_Right_Blue_LED_Coef.Value
        DRT_NvBlockSwComponentTypeRunnable_AmbientLight_Right_Green_LED_Coef_Value: data=AmbientLight_Right_Green_LED_Coef.Value
        DRT_NvBlockSwComponentTypeRunnable_AmbientLight_Right_Red_LED_Coef_Value: data=AmbientLight_Right_Red_LED_Coef.Value
        DRT_NvBlockSwComponentTypeRunnable_Analog_CoolantTemperature_Available_Value: data=Analog_CoolantTemperature_Available.Value
        DRT_NvBlockSwComponentTypeRunnable_ApplValidity_Value: data=ApplValidity.Value
        DRT_NvBlockSwComponentTypeRunnable_BAP_BC_MFA_ExternalFunctionControl_Set_Controlcode_Value: data=BAP_BC_MFA_ExternalFunctionControl_Set_Controlcode.Value
        DRT_NvBlockSwComponentTypeRunnable_BAP_BC_MFA_ExternalFunctionControl_Status_Installation_Value: data=BAP_BC_MFA_ExternalFunctionControl_Status_Installation.Value
        DRT_NvBlockSwComponentTypeRunnable_BAP_BC_MFA_FSG_Setup_Status_Installation1_Value: data=BAP_BC_MFA_FSG_Setup_Status_Installation1.Value
        DRT_NvBlockSwComponentTypeRunnable_BAP_BC_MFA_FSG_Setup_Status_Installation2_Value: data=BAP_BC_MFA_FSG_Setup_Status_Installation2.Value
        DRT_NvBlockSwComponentTypeRunnable_BAP_BC_MFA_FSG_Setup_Status_PrimaryEngineType_Value: data=BAP_BC_MFA_FSG_Setup_Status_PrimaryEngineType.Value
        DRT_NvBlockSwComponentTypeRunnable_BAP_BC_MFA_FSG_Setup_Status_SecondaryEngineType_Value: data=BAP_BC_MFA_FSG_Setup_Status_SecondaryEngineType.Value
        DRT_NvBlockSwComponentTypeRunnable_BAP_BC_MFA_MenueSetup_Status_Menue1_1_Value: data=BAP_BC_MFA_MenueSetup_Status_Menue1_1.Value
        DRT_NvBlockSwComponentTypeRunnable_BAP_BC_MFA_MenueSetup_Status_Menue1_2_Value: data=BAP_BC_MFA_MenueSetup_Status_Menue1_2.Value
        DRT_NvBlockSwComponentTypeRunnable_BAP_BC_MFA_MenueSetup_Status_Menue2_1_Value: data=BAP_BC_MFA_MenueSetup_Status_Menue2_1.Value
        DRT_NvBlockSwComponentTypeRunnable_BAP_BC_MFA_MenueSetup_Status_Menue2_2_Value: data=BAP_BC_MFA_MenueSetup_Status_Menue2_2.Value
        DRT_NvBlockSwComponentTypeRunnable_BAP_BC_MFA_MenueSetup_Status_Menue3_1_Value: data=BAP_BC_MFA_MenueSetup_Status_Menue3_1.Value
        DRT_NvBlockSwComponentTypeRunnable_BAP_BC_MFA_MenueSetup_Status_Menue3_2_Value: data=BAP_BC_MFA_MenueSetup_Status_Menue3_2.Value
        DRT_NvBlockSwComponentTypeRunnable_BAP_BC_MFA_MenueSetup_Status_Special_Value: data=BAP_BC_MFA_MenueSetup_Status_Special.Value
        DRT_NvBlockSwComponentTypeRunnable_BAP_BC_MFA_Statistics_distance_ZE_Value: data=BAP_BC_MFA_Statistics_distance_ZE.Value
        DRT_NvBlockSwComponentTypeRunnable_BAP_BC_MFA_Statistics_distance_currentInterval_ZE_Value: data=BAP_BC_MFA_Statistics_distance_currentInterval_ZE.Value
        DRT_NvBlockSwComponentTypeRunnable_BAP_Debug_Mode_enabled_Value: data=BAP_Debug_Mode_enabled.Value
        DRT_NvBlockSwComponentTypeRunnable_BCCT_Lookup_Curve_AmbientLight_Dimming_Coef_X_Value: data=BCCT_Lookup_Curve_AmbientLight_Dimming_Coef_X.Value
        DRT_NvBlockSwComponentTypeRunnable_BCCT_Lookup_Curve_AmbientLight_Dimming_Coef_Y_Value: data=BCCT_Lookup_Curve_AmbientLight_Dimming_Coef_Y.Value
        DRT_NvBlockSwComponentTypeRunnable_BCCT_Lookup_Curve_AmbientLight_Left_Temp_Coef_X_Value: data=BCCT_Lookup_Curve_AmbientLight_Left_Temp_Coef_X.Value
        DRT_NvBlockSwComponentTypeRunnable_BCCT_Lookup_Curve_AmbientLight_Left_Temp_Coef_Y_Value: data=BCCT_Lookup_Curve_AmbientLight_Left_Temp_Coef_Y.Value
        DRT_NvBlockSwComponentTypeRunnable_BCCT_Lookup_Curve_AmbientLight_Right_Temp_Coef_X_Value: data=BCCT_Lookup_Curve_AmbientLight_Right_Temp_Coef_X.Value
        DRT_NvBlockSwComponentTypeRunnable_BCCT_Lookup_Curve_AmbientLight_Right_Temp_Coef_Y_Value: data=BCCT_Lookup_Curve_AmbientLight_Right_Temp_Coef_Y.Value
        DRT_NvBlockSwComponentTypeRunnable_BCCT_Temperature_Sensor_AmbientLight_Conv_X_Value: data=BCCT_Temperature_Sensor_AmbientLight_Conv_X.Value
        DRT_NvBlockSwComponentTypeRunnable_BCCT_Temperature_Sensor_AmbientLight_Conv_Y_Value: data=BCCT_Temperature_Sensor_AmbientLight_Conv_Y.Value
        DRT_NvBlockSwComponentTypeRunnable_BSBlockSizeActive_Value: data=BSBlockSizeActive.Value
        DRT_NvBlockSwComponentTypeRunnable_BSBlockSize_Value: data=BSBlockSize.Value
        DRT_NvBlockSwComponentTypeRunnable_Bargraph_Color_Calibration_Value: data=Bargraph_Color_Calibration.Value
        DRT_NvBlockSwComponentTypeRunnable_Bargraph_Hysteresis_Coolant_Value: data=Bargraph_Hysteresis_Coolant.Value
        DRT_NvBlockSwComponentTypeRunnable_Bargraph_Primary_Engine_Type_Value: data=Bargraph_Primary_Engine_Type.Value
        DRT_NvBlockSwComponentTypeRunnable_Bargraph_Secondary_Engine_Type_Value: data=Bargraph_Secondary_Engine_Type.Value
        DRT_NvBlockSwComponentTypeRunnable_Bargraph_Treshold_Switch_Coolant_Value: data=Bargraph_Treshold_Switch_Coolant.Value
        DRT_NvBlockSwComponentTypeRunnable_Bargraphs_X_Value: data=Bargraphs_X.Value
        DRT_NvBlockSwComponentTypeRunnable_Bargraphs_Y_Value: data=Bargraphs_Y.Value
        DRT_NvBlockSwComponentTypeRunnable_BattVoltage_0xA00000_Value: data=BattVoltage_0xA00000.Value
        DRT_NvBlockSwComponentTypeRunnable_BattVoltage_0xA{00040..00044}_Value: data=BattVoltage_0xA{00040..00044}.Value
        DRT_NvBlockSwComponentTypeRunnable_BattVoltage_0xA00049_Value: data=BattVoltage_0xA00049.Value
        DRT_NvBlockSwComponentTypeRunnable_Bc_Display_Available_Value: data=Bc_Display_Available.Value
        DRT_NvBlockSwComponentTypeRunnable_Bc_Layer3_Auto_Reset_EV_Value: data=Bc_Layer3_Auto_Reset_EV.Value
        DRT_NvBlockSwComponentTypeRunnable_Bc_Layer3_Auto_Reset_Gas_Value: data=Bc_Layer3_Auto_Reset_Gas.Value
        DRT_NvBlockSwComponentTypeRunnable_Bc_Layer3_Auto_Reset_Value: data=Bc_Layer3_Auto_Reset.Value
        DRT_NvBlockSwComponentTypeRunnable_Bc_Layer3_Manual_Reset_Value: data=Bc_Layer3_Manual_Reset.Value
        DRT_NvBlockSwComponentTypeRunnable_BlackIceThresholdHighTemp_Value: data=BlackIceThresholdHighTemp.Value
        DRT_NvBlockSwComponentTypeRunnable_BlackIceThresholdLowTemp_Value: data=BlackIceThresholdLowTemp.Value
        DRT_NvBlockSwComponentTypeRunnable_BlackScreen_Reason_Value: data=BlackScreen_Reason.Value
        DRT_NvBlockSwComponentTypeRunnable_BlockInfo_EEP_Engine_Value: data=BlockInfo_EEP_Engine.Value
        DRT_NvBlockSwComponentTypeRunnable_BlockInfo_EEP_Market_Value: data=BlockInfo_EEP_Market.Value
        DRT_NvBlockSwComponentTypeRunnable_BlockInfo_EEP_Platform_Value: data=BlockInfo_EEP_Platform.Value
        DRT_NvBlockSwComponentTypeRunnable_BlockInfo_EEP_Units_Value: data=BlockInfo_EEP_Units.Value
        DRT_NvBlockSwComponentTypeRunnable_BlockingDistanceVehicleMoving_Value: data=BlockingDistanceVehicleMoving.Value
        DRT_NvBlockSwComponentTypeRunnable_BlockingTimeVehicleMoving_Value: data=BlockingTimeVehicleMoving.Value
        DRT_NvBlockSwComponentTypeRunnable_Blue_Gamma_Adjustment_Display1_Value: data=Blue_Gamma_Adjustment_Display1.Value
        DRT_NvBlockSwComponentTypeRunnable_Blue_Gamma_Adjustment_Display2_Value: data=Blue_Gamma_Adjustment_Display2.Value
        DRT_NvBlockSwComponentTypeRunnable_BootloaderTPBlocksize_Value: data=BootloaderTPBlocksize.Value
        DRT_NvBlockSwComponentTypeRunnable_Brand_Info_Value: data=Brand_Info.Value
        DRT_NvBlockSwComponentTypeRunnable_Brightness_Photosensor_Cal_Error_Value: data=Brightness_Photosensor_Cal_Error.Value
        DRT_NvBlockSwComponentTypeRunnable_Brightness_Photosensor_Cal_Init_Value: data=Brightness_Photosensor_Cal_Init.Value
        DRT_NvBlockSwComponentTypeRunnable_Brightness_Photosensor_Damp_Dimm_Down_Value: data=Brightness_Photosensor_Damp_Dimm_Down.Value
        DRT_NvBlockSwComponentTypeRunnable_Brightness_Photosensor_Damp_Dimm_Up_Value: data=Brightness_Photosensor_Damp_Dimm_Up.Value
        DRT_NvBlockSwComponentTypeRunnable_CAN_DEV_Monitoring_Blocks_Value: data=CAN_DEV_Monitoring_Blocks.Value
        DRT_NvBlockSwComponentTypeRunnable_CAN_DEV_Monitoring_Status_Value: data=CAN_DEV_Monitoring_Status.Value
        DRT_NvBlockSwComponentTypeRunnable_COMPONENTS_Cfg_CONST_Safety_CRC_Value: data=COMPONENTS_Cfg_CONST_Safety_CRC.Value
        DRT_NvBlockSwComponentTypeRunnable_COMPONENTS_Cfg_VAR_Safety_CRC_Value: data=COMPONENTS_Cfg_VAR_Safety_CRC.Value
        DRT_NvBlockSwComponentTypeRunnable_CRCLength_Block{1..6}_Value: data=CRCLength_Block{1..6}.Value
        DRT_NvBlockSwComponentTypeRunnable_CRCStart_Block{1..6}_Value: data=CRCStart_Block{1..6}.Value
        DRT_NvBlockSwComponentTypeRunnable_CRCValue_Block{1..6}_Value: data=CRCValue_Block{1..6}.Value
        DRT_NvBlockSwComponentTypeRunnable_Calibrated_RGB_Font_Colour_Triple_Value: data=Calibrated_RGB_Font_Colour_Triple.Value
        DRT_NvBlockSwComponentTypeRunnable_Calibration_Date_Value: data=Calibration_Date.Value
        DRT_NvBlockSwComponentTypeRunnable_Calibration_Shop_Code_Value: data=Calibration_Shop_Code.Value
        DRT_NvBlockSwComponentTypeRunnable_CanBusActive_Value: data=CanBusActive.Value
        DRT_NvBlockSwComponentTypeRunnable_Celeb_DimOffset_Scale_Value: data=Celeb_DimOffset_Scale.Value
        DRT_NvBlockSwComponentTypeRunnable_Celeb_EndDim_Scale_Curve_X_Value: data=Celeb_EndDim_Scale_Curve_X.Value
        DRT_NvBlockSwComponentTypeRunnable_Celeb_EndDim_Scale_Curve_Y_Value: data=Celeb_EndDim_Scale_Curve_Y.Value
        DRT_NvBlockSwComponentTypeRunnable_Celeb_PreStart_Scale_Curve_X_Value: data=Celeb_PreStart_Scale_Curve_X.Value
        DRT_NvBlockSwComponentTypeRunnable_Celeb_PreStart_Scale_Curve_Y_Value: data=Celeb_PreStart_Scale_Curve_Y.Value
        DRT_NvBlockSwComponentTypeRunnable_Celeb_StartDim_Scale_Curve_X_Value: data=Celeb_StartDim_Scale_Curve_X.Value
        DRT_NvBlockSwComponentTypeRunnable_Celeb_StartDim_Scale_Curve_Y_Value: data=Celeb_StartDim_Scale_Curve_Y.Value
        DRT_NvBlockSwComponentTypeRunnable_ClusterFunction_0xA00000_Value: data=ClusterFunction_0xA00000.Value
        DRT_NvBlockSwComponentTypeRunnable_ClusterFunction_0xA{00040..00044}_Value: data=ClusterFunction_0xA{00040..00044}.Value
        DRT_NvBlockSwComponentTypeRunnable_ClusterFunction_0xA00049_Value: data=ClusterFunction_0xA00049.Value
        DRT_NvBlockSwComponentTypeRunnable_ClusterState_0xA00000_Value: data=ClusterState_0xA00000.Value
        DRT_NvBlockSwComponentTypeRunnable_ClusterState_0xA{00040..00044}_Value: data=ClusterState_0xA{00040..00044}.Value
        DRT_NvBlockSwComponentTypeRunnable_ClusterState_0xA00049_Value: data=ClusterState_0xA00049.Value
        DRT_NvBlockSwComponentTypeRunnable_Cluster_Variant_ASIA_Value: data=Cluster_Variant_ASIA.Value
        DRT_NvBlockSwComponentTypeRunnable_Cluster_Variant_CHINA_Value: data=Cluster_Variant_CHINA.Value
        DRT_NvBlockSwComponentTypeRunnable_Cluster_Variant_Canada_Value: data=Cluster_Variant_Canada.Value
        DRT_NvBlockSwComponentTypeRunnable_Cluster_Variant_FBU_Value: data=Cluster_Variant_FBU.Value
        DRT_NvBlockSwComponentTypeRunnable_Cluster_Variant_USA_Value: data=Cluster_Variant_USA.Value
        DRT_NvBlockSwComponentTypeRunnable_Cluster_Variant_Value: data=Cluster_Variant.Value
        DRT_NvBlockSwComponentTypeRunnable_CodingCheck_4WD_Installed_Value: data=CodingCheck_4WD_Installed.Value
        DRT_NvBlockSwComponentTypeRunnable_CodingCheck_ACC_Installed_Value: data=CodingCheck_ACC_Installed.Value
        DRT_NvBlockSwComponentTypeRunnable_CodingCheck_ADA_Installed_Value: data=CodingCheck_ADA_Installed.Value
        DRT_NvBlockSwComponentTypeRunnable_CodingCheck_AFS_Installed_Value: data=CodingCheck_AFS_Installed.Value
        DRT_NvBlockSwComponentTypeRunnable_CodingCheck_AGA_Installed_Value: data=CodingCheck_AGA_Installed.Value
        DRT_NvBlockSwComponentTypeRunnable_CodingCheck_ARA_Installed_Value: data=CodingCheck_ARA_Installed.Value
        DRT_NvBlockSwComponentTypeRunnable_CodingCheck_ASTA_Installed_Value: data=CodingCheck_ASTA_Installed.Value
        DRT_NvBlockSwComponentTypeRunnable_CodingCheck_AWV_BAP_Installed_Value: data=CodingCheck_AWV_BAP_Installed.Value
        DRT_NvBlockSwComponentTypeRunnable_CodingCheck_AWV_Installed_Value: data=CodingCheck_AWV_Installed.Value
        DRT_NvBlockSwComponentTypeRunnable_CodingCheck_Acceleration_Display_Available_Value: data=CodingCheck_Acceleration_Display_Available.Value
        DRT_NvBlockSwComponentTypeRunnable_CodingCheck_Audio_Installed_Value: data=CodingCheck_Audio_Installed.Value
        DRT_NvBlockSwComponentTypeRunnable_CodingCheck_BCmE_Installed_Value: data=CodingCheck_BCmE_Installed.Value
        DRT_NvBlockSwComponentTypeRunnable_CodingCheck_BVA_with_BKL_Value: data=CodingCheck_BVA_with_BKL.Value
        DRT_NvBlockSwComponentTypeRunnable_CodingCheck_Bc_Display_Available_Value: data=CodingCheck_Bc_Display_Available.Value
        DRT_NvBlockSwComponentTypeRunnable_CodingCheck_CarBody_Value: data=CodingCheck_CarBody.Value
        DRT_NvBlockSwComponentTypeRunnable_CodingCheck_Car_Leaving_Warning_Available_Value: data=CodingCheck_Car_Leaving_Warning_Available.Value
        DRT_NvBlockSwComponentTypeRunnable_CodingCheck_Compass_Position_Value: data=CodingCheck_Compass_Position.Value
        DRT_NvBlockSwComponentTypeRunnable_CodingCheck_Damper_Installed_Value: data=CodingCheck_Damper_Installed.Value
        DRT_NvBlockSwComponentTypeRunnable_CodingCheck_DayIlluminationPointers_Value: data=CodingCheck_DayIlluminationPointers.Value
        DRT_NvBlockSwComponentTypeRunnable_CodingCheck_DayIlluminationScales_Value: data=CodingCheck_DayIlluminationScales.Value
        DRT_NvBlockSwComponentTypeRunnable_CodingCheck_Dig_OilTemp_Display_Available_Value: data=CodingCheck_Dig_OilTemp_Display_Available.Value
        DRT_NvBlockSwComponentTypeRunnable_CodingCheck_Digital_Key_Installed_Value: data=CodingCheck_Digital_Key_Installed.Value
        DRT_NvBlockSwComponentTypeRunnable_CodingCheck_EBKV_Installed_Value: data=CodingCheck_EBKV_Installed.Value
        DRT_NvBlockSwComponentTypeRunnable_CodingCheck_ELV_Installed_Value: data=CodingCheck_ELV_Installed.Value
        DRT_NvBlockSwComponentTypeRunnable_CodingCheck_Epb_Installed_Value: data=CodingCheck_Epb_Installed.Value
        DRT_NvBlockSwComponentTypeRunnable_CodingCheck_Eps_Installed_Value: data=CodingCheck_Eps_Installed.Value
        DRT_NvBlockSwComponentTypeRunnable_CodingCheck_FCWP_Installed_Value: data=CodingCheck_FCWP_Installed.Value
        DRT_NvBlockSwComponentTypeRunnable_CodingCheck_Fuel_Variant_Value: data=CodingCheck_Fuel_Variant.Value
        DRT_NvBlockSwComponentTypeRunnable_CodingCheck_GRA_High_Display_Value: data=CodingCheck_GRA_High_Display.Value
        DRT_NvBlockSwComponentTypeRunnable_CodingCheck_HRE_Installed_Value: data=CodingCheck_HRE_Installed.Value
        DRT_NvBlockSwComponentTypeRunnable_CodingCheck_Hybrid_BAP_Installed_Value: data=CodingCheck_Hybrid_BAP_Installed.Value
        DRT_NvBlockSwComponentTypeRunnable_CodingCheck_Hybrid_Installed_Value: data=CodingCheck_Hybrid_Installed.Value
        DRT_NvBlockSwComponentTypeRunnable_CodingCheck_IAA_PSO_BAP_Installed_Value: data=CodingCheck_IAA_PSO_BAP_Installed.Value
        DRT_NvBlockSwComponentTypeRunnable_CodingCheck_Ignition_EV_LowVoltage_Value: data=CodingCheck_Ignition_EV_LowVoltage.Value
        DRT_NvBlockSwComponentTypeRunnable_CodingCheck_Joker_Button_Installed_Value: data=CodingCheck_Joker_Button_Installed.Value
        DRT_NvBlockSwComponentTypeRunnable_CodingCheck_KFG_Installed_Value: data=CodingCheck_KFG_Installed.Value
        DRT_NvBlockSwComponentTypeRunnable_CodingCheck_K_Number_Value: data=CodingCheck_K_Number.Value
        DRT_NvBlockSwComponentTypeRunnable_CodingCheck_Key_Warning_Value: data=CodingCheck_Key_Warning.Value
        DRT_NvBlockSwComponentTypeRunnable_CodingCheck_LDW_BAP_Installed_Value: data=CodingCheck_LDW_BAP_Installed.Value
        DRT_NvBlockSwComponentTypeRunnable_CodingCheck_LDW_Installed_Value: data=CodingCheck_LDW_Installed.Value
        DRT_NvBlockSwComponentTypeRunnable_CodingCheck_Laptimer_Value: data=CodingCheck_Laptimer.Value
        DRT_NvBlockSwComponentTypeRunnable_CodingCheck_Navigation_Compass_Installed_Value: data=CodingCheck_Navigation_Compass_Installed.Value
        DRT_NvBlockSwComponentTypeRunnable_CodingCheck_OutsideTemperature_Indication_Value: data=CodingCheck_OutsideTemperature_Indication.Value
        DRT_NvBlockSwComponentTypeRunnable_CodingCheck_PEA_BAP_Installed_Value: data=CodingCheck_PEA_BAP_Installed.Value
        DRT_NvBlockSwComponentTypeRunnable_CodingCheck_PLA3_Installed_Value: data=CodingCheck_PLA3_Installed.Value
        DRT_NvBlockSwComponentTypeRunnable_CodingCheck_PLA_Installed_Value: data=CodingCheck_PLA_Installed.Value
        DRT_NvBlockSwComponentTypeRunnable_CodingCheck_PedestrianAssist_BAP_Installed_Value: data=CodingCheck_PedestrianAssist_BAP_Installed.Value
        DRT_NvBlockSwComponentTypeRunnable_CodingCheck_Personalization_Installed_Value: data=CodingCheck_Personalization_Installed.Value
        DRT_NvBlockSwComponentTypeRunnable_CodingCheck_Pointer_Kl_58_Value: data=CodingCheck_Pointer_Kl_58.Value
        DRT_NvBlockSwComponentTypeRunnable_CodingCheck_QSP_Installed_Value: data=CodingCheck_QSP_Installed.Value
        DRT_NvBlockSwComponentTypeRunnable_CodingCheck_RDK_BAP_Installed_Value: data=CodingCheck_RDK_BAP_Installed.Value
        DRT_NvBlockSwComponentTypeRunnable_CodingCheck_RDK_Installed_Value: data=CodingCheck_RDK_Installed.Value
        DRT_NvBlockSwComponentTypeRunnable_CodingCheck_RKA_Installed_Value: data=CodingCheck_RKA_Installed.Value
        DRT_NvBlockSwComponentTypeRunnable_CodingCheck_RefulledVolume_Available_Value: data=CodingCheck_RefulledVolume_Available.Value
        DRT_NvBlockSwComponentTypeRunnable_CodingCheck_Right_Drive_Value: data=CodingCheck_Right_Drive.Value
        DRT_NvBlockSwComponentTypeRunnable_CodingCheck_SDS_BAP_Installed_Value: data=CodingCheck_SDS_BAP_Installed.Value
        DRT_NvBlockSwComponentTypeRunnable_CodingCheck_SWA_BAP_Installed_Value: data=CodingCheck_SWA_BAP_Installed.Value
        DRT_NvBlockSwComponentTypeRunnable_CodingCheck_SWA_Installed_Value: data=CodingCheck_SWA_Installed.Value
        DRT_NvBlockSwComponentTypeRunnable_CodingCheck_SeatbeltWarning_Value: data=CodingCheck_SeatbeltWarning.Value
        DRT_NvBlockSwComponentTypeRunnable_CodingCheck_Staging_Value: data=CodingCheck_Staging.Value
        DRT_NvBlockSwComponentTypeRunnable_CodingCheck_StartStopReasons_BAP_Installed_Value: data=CodingCheck_StartStopReasons_BAP_Installed.Value
        DRT_NvBlockSwComponentTypeRunnable_CodingCheck_StartUp_Screen_Value: data=CodingCheck_StartUp_Screen.Value
        DRT_NvBlockSwComponentTypeRunnable_CodingCheck_Telephone2_Installed_Obsolete_Value: data=CodingCheck_Telephone2_Installed_Obsolete.Value
        DRT_NvBlockSwComponentTypeRunnable_CodingCheck_Telephone2_Installed_Value: data=CodingCheck_Telephone2_Installed.Value
        DRT_NvBlockSwComponentTypeRunnable_CodingCheck_Telephone_Installed_Value: data=CodingCheck_Telephone_Installed.Value
        DRT_NvBlockSwComponentTypeRunnable_CodingCheck_Two_Keys_Installed_Value: data=CodingCheck_Two_Keys_Installed.Value
        DRT_NvBlockSwComponentTypeRunnable_CodingCheck_Unit_ClockFormat_Value: data=CodingCheck_Unit_ClockFormat.Value
        DRT_NvBlockSwComponentTypeRunnable_CodingCheck_Unit_Consumption_Electric_Obsolete_Value: data=CodingCheck_Unit_Consumption_Electric_Obsolete.Value
        DRT_NvBlockSwComponentTypeRunnable_CodingCheck_Unit_Consumption_Electric_Value: data=CodingCheck_Unit_Consumption_Electric.Value
        DRT_NvBlockSwComponentTypeRunnable_CodingCheck_Unit_DateFormat_Value: data=CodingCheck_Unit_DateFormat.Value
        DRT_NvBlockSwComponentTypeRunnable_CodingCheck_Unit_FuelConsumption_Gas_Value: data=CodingCheck_Unit_FuelConsumption_Gas.Value
        DRT_NvBlockSwComponentTypeRunnable_CodingCheck_Unit_FuelConsumption_Value: data=CodingCheck_Unit_FuelConsumption.Value
        DRT_NvBlockSwComponentTypeRunnable_CodingCheck_Unit_Language_Ext1_Value: data=CodingCheck_Unit_Language_Ext1.Value
        DRT_NvBlockSwComponentTypeRunnable_CodingCheck_Unit_Language_Ext_Value: data=CodingCheck_Unit_Language_Ext.Value
        DRT_NvBlockSwComponentTypeRunnable_CodingCheck_Unit_Language_Value: data=CodingCheck_Unit_Language.Value
        DRT_NvBlockSwComponentTypeRunnable_CodingCheck_Unit_OdoTripDistance_Value: data=CodingCheck_Unit_OdoTripDistance.Value
        DRT_NvBlockSwComponentTypeRunnable_CodingCheck_Unit_Pressure_Value: data=CodingCheck_Unit_Pressure.Value
        DRT_NvBlockSwComponentTypeRunnable_CodingCheck_Unit_Speed_Value: data=CodingCheck_Unit_Speed.Value
        DRT_NvBlockSwComponentTypeRunnable_CodingCheck_Unit_Temperature_Value: data=CodingCheck_Unit_Temperature.Value
        DRT_NvBlockSwComponentTypeRunnable_CodingCheck_Unit_Volume_Value: data=CodingCheck_Unit_Volume.Value
        DRT_NvBlockSwComponentTypeRunnable_CodingCheck_Unit_Weight_Value: data=CodingCheck_Unit_Weight.Value
        DRT_NvBlockSwComponentTypeRunnable_CodingCheck_VZA_Installed_Value: data=CodingCheck_VZA_Installed.Value
        DRT_NvBlockSwComponentTypeRunnable_CodingCheck_V_Warning_Legal_Value: data=CodingCheck_V_Warning_Legal.Value
        DRT_NvBlockSwComponentTypeRunnable_CodingCheck_WBA_Installed_Value: data=CodingCheck_WBA_Installed.Value
        DRT_NvBlockSwComponentTypeRunnable_CodingCheck_eCall_Installed_Value: data=CodingCheck_eCall_Installed.Value
        DRT_NvBlockSwComponentTypeRunnable_Coding_4WD_Installed_Value: data=Coding_4WD_Installed.Value
        DRT_NvBlockSwComponentTypeRunnable_Coding_ACC_Installed_Value: data=Coding_ACC_Installed.Value
        DRT_NvBlockSwComponentTypeRunnable_Coding_ADA_Installed_Value: data=Coding_ADA_Installed.Value
        DRT_NvBlockSwComponentTypeRunnable_Coding_AFS_Installed_Value: data=Coding_AFS_Installed.Value
        DRT_NvBlockSwComponentTypeRunnable_Coding_AGA_Installed_Value: data=Coding_AGA_Installed.Value
        DRT_NvBlockSwComponentTypeRunnable_Coding_ARA_Installed_Value: data=Coding_ARA_Installed.Value
        DRT_NvBlockSwComponentTypeRunnable_Coding_ASTA_Installed_Value: data=Coding_ASTA_Installed.Value
        DRT_NvBlockSwComponentTypeRunnable_Coding_AWV_BAP_Installed_Value: data=Coding_AWV_BAP_Installed.Value
        DRT_NvBlockSwComponentTypeRunnable_Coding_AWV_Installed_Value: data=Coding_AWV_Installed.Value
        DRT_NvBlockSwComponentTypeRunnable_Coding_Audio_Installed_Value: data=Coding_Audio_Installed.Value
        DRT_NvBlockSwComponentTypeRunnable_Coding_BCmE_Installed_Value: data=Coding_BCmE_Installed.Value
        DRT_NvBlockSwComponentTypeRunnable_Coding_BMS_Installed_Value: data=Coding_BMS_Installed.Value
        DRT_NvBlockSwComponentTypeRunnable_Coding_BVA_with_BKL_Value: data=Coding_BVA_with_BKL.Value
        DRT_NvBlockSwComponentTypeRunnable_Coding_CarBody_Value: data=Coding_CarBody.Value
        DRT_NvBlockSwComponentTypeRunnable_Coding_Car_Leaving_Warning_Active_Value: data=Coding_Car_Leaving_Warning_Active.Value
        DRT_NvBlockSwComponentTypeRunnable_Coding_Compass_Position_Value: data=Coding_Compass_Position.Value
        DRT_NvBlockSwComponentTypeRunnable_Coding_Damper_Installed_Value: data=Coding_Damper_Installed.Value
        DRT_NvBlockSwComponentTypeRunnable_Coding_Date_Value: data=Coding_Date.Value
        DRT_NvBlockSwComponentTypeRunnable_Coding_DayIlluminationPointers_Value: data=Coding_DayIlluminationPointers.Value
        DRT_NvBlockSwComponentTypeRunnable_Coding_DayIlluminationScales_Value: data=Coding_DayIlluminationScales.Value
        DRT_NvBlockSwComponentTypeRunnable_Coding_Digital_Key_Installed_Value: data=Coding_Digital_Key_Installed.Value
        DRT_NvBlockSwComponentTypeRunnable_Coding_EBKV_Installed_Value: data=Coding_EBKV_Installed.Value
        DRT_NvBlockSwComponentTypeRunnable_Coding_ELV_Installed_Value: data=Coding_ELV_Installed.Value
        DRT_NvBlockSwComponentTypeRunnable_Coding_EPS_Installed_Value: data=Coding_EPS_Installed.Value
        DRT_NvBlockSwComponentTypeRunnable_Coding_Epb_Installed_Value: data=Coding_Epb_Installed.Value
        DRT_NvBlockSwComponentTypeRunnable_Coding_FCWP_Installed_Value: data=Coding_FCWP_Installed.Value
        DRT_NvBlockSwComponentTypeRunnable_Coding_HRE_Installed_Value: data=Coding_HRE_Installed.Value
        DRT_NvBlockSwComponentTypeRunnable_Coding_Hybrid_BAP_Installed_Value: data=Coding_Hybrid_BAP_Installed.Value
        DRT_NvBlockSwComponentTypeRunnable_Coding_Hybrid_Installed_Value: data=Coding_Hybrid_Installed.Value
        DRT_NvBlockSwComponentTypeRunnable_Coding_IAA_PSO_BAP_Installed_Value: data=Coding_IAA_PSO_BAP_Installed.Value
        DRT_NvBlockSwComponentTypeRunnable_Coding_Ignition_EV_LowVoltage_Value: data=Coding_Ignition_EV_LowVoltage.Value
        DRT_NvBlockSwComponentTypeRunnable_Coding_Joker_Button_Installed_Value: data=Coding_Joker_Button_Installed.Value
        DRT_NvBlockSwComponentTypeRunnable_Coding_KFG_Installed_Value: data=Coding_KFG_Installed.Value
        DRT_NvBlockSwComponentTypeRunnable_Coding_KeyWarning_Value: data=Coding_KeyWarning.Value
        DRT_NvBlockSwComponentTypeRunnable_Coding_LDW_BAP_Installed_Value: data=Coding_LDW_BAP_Installed.Value
        DRT_NvBlockSwComponentTypeRunnable_Coding_LDW_Installed_Value: data=Coding_LDW_Installed.Value
        DRT_NvBlockSwComponentTypeRunnable_Coding_Language_Value: data=Coding_Language.Value
        DRT_NvBlockSwComponentTypeRunnable_Coding_Laptimer_Value: data=Coding_Laptimer.Value
        DRT_NvBlockSwComponentTypeRunnable_Coding_Navigation_Compass_Installed_Value: data=Coding_Navigation_Compass_Installed.Value
        DRT_NvBlockSwComponentTypeRunnable_Coding_PEA_BAP_Installed_Value: data=Coding_PEA_BAP_Installed.Value
        DRT_NvBlockSwComponentTypeRunnable_Coding_PLA3_Installed_Value: data=Coding_PLA3_Installed.Value
        DRT_NvBlockSwComponentTypeRunnable_Coding_PLA_Installed_Value: data=Coding_PLA_Installed.Value
        DRT_NvBlockSwComponentTypeRunnable_Coding_PedestrianAssist_BAP_Installed_Value: data=Coding_PedestrianAssist_BAP_Installed.Value
        DRT_NvBlockSwComponentTypeRunnable_Coding_Personalization_Installed_Value: data=Coding_Personalization_Installed.Value
        DRT_NvBlockSwComponentTypeRunnable_Coding_Pointer_Kl_58_Value: data=Coding_Pointer_Kl_58.Value
        DRT_NvBlockSwComponentTypeRunnable_Coding_Production_Mode_Acoustic_Value: data=Coding_Production_Mode_Acoustic.Value
        DRT_NvBlockSwComponentTypeRunnable_Coding_Production_Mode_Key_Lock_Value: data=Coding_Production_Mode_Key_Lock.Value
        DRT_NvBlockSwComponentTypeRunnable_Coding_QSP_Installed_Value: data=Coding_QSP_Installed.Value
        DRT_NvBlockSwComponentTypeRunnable_Coding_RDK_BAP_Installed_Value: data=Coding_RDK_BAP_Installed.Value
        DRT_NvBlockSwComponentTypeRunnable_Coding_RDK_Installed_Value: data=Coding_RDK_Installed.Value
        DRT_NvBlockSwComponentTypeRunnable_Coding_RKA_Installed_Value: data=Coding_RKA_Installed.Value
        DRT_NvBlockSwComponentTypeRunnable_Coding_Right_Drive_Value: data=Coding_Right_Drive.Value
        DRT_NvBlockSwComponentTypeRunnable_Coding_SDS_BAP_Installed_Value: data=Coding_SDS_BAP_Installed.Value
        DRT_NvBlockSwComponentTypeRunnable_Coding_SWA_BAP_Installed_Value: data=Coding_SWA_BAP_Installed.Value
        DRT_NvBlockSwComponentTypeRunnable_Coding_SWA_Installed_Value: data=Coding_SWA_Installed.Value
        DRT_NvBlockSwComponentTypeRunnable_Coding_SeatbeltWarning_Value: data=Coding_SeatbeltWarning.Value
        DRT_NvBlockSwComponentTypeRunnable_Coding_Shop_Code_Value: data=Coding_Shop_Code.Value
        DRT_NvBlockSwComponentTypeRunnable_Coding_Staging_Value: data=Coding_Staging.Value
        DRT_NvBlockSwComponentTypeRunnable_Coding_StartStopReasons_BAP_Installed_Value: data=Coding_StartStopReasons_BAP_Installed.Value
        DRT_NvBlockSwComponentTypeRunnable_Coding_StartUp_Screen_Value: data=Coding_StartUp_Screen.Value
        DRT_NvBlockSwComponentTypeRunnable_Coding_TCO_Installed_Value: data=Coding_TCO_Installed.Value
        DRT_NvBlockSwComponentTypeRunnable_Coding_Telephone2_Installed_Value: data=Coding_Telephone2_Installed.Value
        DRT_NvBlockSwComponentTypeRunnable_Coding_Telephone_Installed_Value: data=Coding_Telephone_Installed.Value
        DRT_NvBlockSwComponentTypeRunnable_Coding_Unit_ClockFormat_Value: data=Coding_Unit_ClockFormat.Value
        DRT_NvBlockSwComponentTypeRunnable_Coding_Unit_Consumption_Electrical_Value: data=Coding_Unit_Consumption_Electrical.Value
        DRT_NvBlockSwComponentTypeRunnable_Coding_Unit_DateFormat_Value: data=Coding_Unit_DateFormat.Value
        DRT_NvBlockSwComponentTypeRunnable_Coding_Unit_FuelConsumption_Gas_Value: data=Coding_Unit_FuelConsumption_Gas.Value
        DRT_NvBlockSwComponentTypeRunnable_Coding_Unit_FuelConsumption_Value: data=Coding_Unit_FuelConsumption.Value
        DRT_NvBlockSwComponentTypeRunnable_Coding_Unit_OdoTripDistance_Value: data=Coding_Unit_OdoTripDistance.Value
        DRT_NvBlockSwComponentTypeRunnable_Coding_Unit_Pressure_Value: data=Coding_Unit_Pressure.Value
        DRT_NvBlockSwComponentTypeRunnable_Coding_Unit_Speed_Value: data=Coding_Unit_Speed.Value
        DRT_NvBlockSwComponentTypeRunnable_Coding_Unit_Temperature_Value: data=Coding_Unit_Temperature.Value
        DRT_NvBlockSwComponentTypeRunnable_Coding_Unit_Volume_Value: data=Coding_Unit_Volume.Value
        DRT_NvBlockSwComponentTypeRunnable_Coding_Unit_Weight_Value: data=Coding_Unit_Weight.Value
        DRT_NvBlockSwComponentTypeRunnable_Coding_VZA_Installed_Value: data=Coding_VZA_Installed.Value
        DRT_NvBlockSwComponentTypeRunnable_Coding_V_Warning_Legal_Value: data=Coding_V_Warning_Legal.Value
        DRT_NvBlockSwComponentTypeRunnable_Coding_WBA_Installed_Value: data=Coding_WBA_Installed.Value
        DRT_NvBlockSwComponentTypeRunnable_Coding_eCall_Installed_Value: data=Coding_eCall_Installed.Value
        DRT_NvBlockSwComponentTypeRunnable_Coding_two_keys_Value: data=Coding_two_keys.Value
        DRT_NvBlockSwComponentTypeRunnable_Compensation_Line_Shift_b_Left_Value: data=Compensation_Line_Shift_b_Left.Value
        DRT_NvBlockSwComponentTypeRunnable_Compensation_Line_Shift_b_Right_Value: data=Compensation_Line_Shift_b_Right.Value
        DRT_NvBlockSwComponentTypeRunnable_Compensation_Line_Shift_b_Value: data=Compensation_Line_Shift_b.Value
        DRT_NvBlockSwComponentTypeRunnable_Compensation_Line_Slope_m_Left_Value: data=Compensation_Line_Slope_m_Left.Value
        DRT_NvBlockSwComponentTypeRunnable_Compensation_Line_Slope_m_Right_Value: data=Compensation_Line_Slope_m_Right.Value
        DRT_NvBlockSwComponentTypeRunnable_Compensation_Line_Slope_m_Value: data=Compensation_Line_Slope_m.Value
        DRT_NvBlockSwComponentTypeRunnable_ConfigWarning_Schwelle1_Indien_Value: data=ConfigWarning_Schwelle1_Indien.Value
        DRT_NvBlockSwComponentTypeRunnable_ConsumptionCorrection_Cng_Value: data=ConsumptionCorrection_Cng.Value
        DRT_NvBlockSwComponentTypeRunnable_ConsumptionCorrection_Value: data=ConsumptionCorrection.Value
        DRT_NvBlockSwComponentTypeRunnable_CoolantTemp_Gauge_Hysteresis_Angle_Value: data=CoolantTemp_Gauge_Hysteresis_Angle.Value
        DRT_NvBlockSwComponentTypeRunnable_CoolantTemperatureDelta_Value: data=CoolantTemperatureDelta.Value
        DRT_NvBlockSwComponentTypeRunnable_Coolant_Cold_Indication_Present_Value: data=Coolant_Cold_Indication_Present.Value
        DRT_NvBlockSwComponentTypeRunnable_CorrectionCoefficient_k1_Value: data=CorrectionCoefficient_k1.Value
        DRT_NvBlockSwComponentTypeRunnable_CorrectionCoefficient_k2_Value: data=CorrectionCoefficient_k2.Value
        DRT_NvBlockSwComponentTypeRunnable_Counter_RamError_Value: data=Counter_RamError.Value
        DRT_NvBlockSwComponentTypeRunnable_Customer_Request_Flag_Value: data=Customer_Request_Flag.Value
        DRT_NvBlockSwComponentTypeRunnable_CwlErrorCounter_Value: data=CwlErrorCounter.Value
        DRT_NvBlockSwComponentTypeRunnable_CwlErrorPath_Value: data=CwlErrorPath.Value
        DRT_NvBlockSwComponentTypeRunnable_CylinderDeactivation_Active_Value: data=CylinderDeactivation_Active.Value
        DRT_NvBlockSwComponentTypeRunnable_DIAG_AdaptationChannel_VAR_0_Safety_CRC_Value: data=DIAG_AdaptationChannel_VAR_0_Safety_CRC.Value
        DRT_NvBlockSwComponentTypeRunnable_DIAG_EOL_DiagCfg_CONST_Safety_CRC_Value: data=DIAG_EOL_DiagCfg_CONST_Safety_CRC.Value
        DRT_NvBlockSwComponentTypeRunnable_DIAG_EOL_HWCalib_CONST_Safety_CRC_Value: data=DIAG_EOL_HWCalib_CONST_Safety_CRC.Value
        DRT_NvBlockSwComponentTypeRunnable_DIAG_VariantCoding_CONST_Safety_CRC_Value: data=DIAG_VariantCoding_CONST_Safety_CRC.Value
        DRT_NvBlockSwComponentTypeRunnable_DLS_Auto_Day_Value: data=DLS_Auto_Day.Value
        DRT_NvBlockSwComponentTypeRunnable_DLS_Auto_Hour_Value: data=DLS_Auto_Hour.Value
        DRT_NvBlockSwComponentTypeRunnable_DLS_Auto_Minute_Value: data=DLS_Auto_Minute.Value
        DRT_NvBlockSwComponentTypeRunnable_DLS_Auto_Month_Value: data=DLS_Auto_Month.Value
        DRT_NvBlockSwComponentTypeRunnable_DLS_Auto_State_Value: data=DLS_Auto_State.Value
        DRT_NvBlockSwComponentTypeRunnable_DTC_ECU_not_coded_Value: data=DTC_ECU_not_coded.Value
        DRT_NvBlockSwComponentTypeRunnable_DURMW_Value: data=DURMW.Value
        DRT_NvBlockSwComponentTypeRunnable_DailyMileage_Value: data=DailyMileage.Value
        DRT_NvBlockSwComponentTypeRunnable_Damping_Indic_Coolnt_Bargrph_OFF_Value: data=Damping_Indic_Coolnt_Bargrph_OFF.Value
        DRT_NvBlockSwComponentTypeRunnable_Damping_Indic_Coolnt_Bargrph_ON_Value: data=Damping_Indic_Coolnt_Bargrph_ON.Value
        DRT_NvBlockSwComponentTypeRunnable_Date_Day_Value: data=Date_Day.Value
        DRT_NvBlockSwComponentTypeRunnable_Date_Month_Value: data=Date_Month.Value
        DRT_NvBlockSwComponentTypeRunnable_Date_Year_Value: data=Date_Year.Value
        DRT_NvBlockSwComponentTypeRunnable_DcmDslRxTesterSourceAddr_Value: data=DcmDslRxTesterSourceAddr.Value
        DRT_NvBlockSwComponentTypeRunnable_Deactivate_SK_Function_Value: data=Deactivate_SK_Function.Value
        DRT_NvBlockSwComponentTypeRunnable_Debouncing_AutomaticDrivingLight_Value: data=Debouncing_AutomaticDrivingLight.Value
        DRT_NvBlockSwComponentTypeRunnable_Debouncing_FogLight_Value: data=Debouncing_FogLight.Value
        DRT_NvBlockSwComponentTypeRunnable_Debouncing_LowBeam_Value: data=Debouncing_LowBeam.Value
        DRT_NvBlockSwComponentTypeRunnable_Debouncing_Sidelight_Value: data=Debouncing_Sidelight.Value
        DRT_NvBlockSwComponentTypeRunnable_Default_AmbientLight_Color_Blue_Value: data=Default_AmbientLight_Color_Blue.Value
        DRT_NvBlockSwComponentTypeRunnable_Default_AmbientLight_Color_CHINA_index_Value: data=Default_AmbientLight_Color_CHINA_index.Value
        DRT_NvBlockSwComponentTypeRunnable_Default_AmbientLight_Color_Green_Value: data=Default_AmbientLight_Color_Green.Value
        DRT_NvBlockSwComponentTypeRunnable_Default_AmbientLight_Color_Red_Value: data=Default_AmbientLight_Color_Red.Value
        DRT_NvBlockSwComponentTypeRunnable_Default_AmbientLight_Color_index_Value: data=Default_AmbientLight_Color_index.Value
        DRT_NvBlockSwComponentTypeRunnable_Diag_Blue_Gamma_Adjustment_Value: data=Diag_Blue_Gamma_Adjustment.Value
        DRT_NvBlockSwComponentTypeRunnable_Diag_Blue_Gamma_Neg_Adjustment_Value: data=Diag_Blue_Gamma_Neg_Adjustment.Value
        DRT_NvBlockSwComponentTypeRunnable_Diag_Blue_Gamma_Pos_Adjustment_Value: data=Diag_Blue_Gamma_Pos_Adjustment.Value
        DRT_NvBlockSwComponentTypeRunnable_Diag_Compensation_Line_Shift_b_Value: data=Diag_Compensation_Line_Shift_b.Value
        DRT_NvBlockSwComponentTypeRunnable_Diag_Compensation_Line_Slope_m_Value: data=Diag_Compensation_Line_Slope_m.Value
        DRT_NvBlockSwComponentTypeRunnable_Diag_Gain_Adjustment_Value: data=Diag_Gain_Adjustment.Value
        DRT_NvBlockSwComponentTypeRunnable_Diag_Green_Gamma_Adjustment_Value: data=Diag_Green_Gamma_Adjustment.Value
        DRT_NvBlockSwComponentTypeRunnable_Diag_Green_Gamma_Neg_Adjustment_Value: data=Diag_Green_Gamma_Neg_Adjustment.Value
        DRT_NvBlockSwComponentTypeRunnable_Diag_Green_Gamma_Pos_Adjustment_Value: data=Diag_Green_Gamma_Pos_Adjustment.Value
        DRT_NvBlockSwComponentTypeRunnable_Diag_Red_Gamma_Adjustment_Value: data=Diag_Red_Gamma_Adjustment.Value
        DRT_NvBlockSwComponentTypeRunnable_Diag_Red_Gamma_Neg_Adjustment_Value: data=Diag_Red_Gamma_Neg_Adjustment.Value
        DRT_NvBlockSwComponentTypeRunnable_Diag_Red_Gamma_Pos_Adjustment_Value: data=Diag_Red_Gamma_Pos_Adjustment.Value
        DRT_NvBlockSwComponentTypeRunnable_Dig_OilTemp_Display_Available_Value: data=Dig_OilTemp_Display_Available.Value
        DRT_NvBlockSwComponentTypeRunnable_DisplayDamping_Off_Bargraph_Tank_Value: data=DisplayDamping_Off_Bargraph_Tank.Value
        DRT_NvBlockSwComponentTypeRunnable_DisplayDamping_On_Bargraph_Tank_Value: data=DisplayDamping_On_Bargraph_Tank.Value
        DRT_NvBlockSwComponentTypeRunnable_Display_FPA_Value: data=Display_FPA.Value
        DRT_NvBlockSwComponentTypeRunnable_Display_Illum_Max_Level_Value: data=Display_Illum_Max_Level.Value
        DRT_NvBlockSwComponentTypeRunnable_Display_Save_CP_Value: data=Display_Save_CP.Value
        DRT_NvBlockSwComponentTypeRunnable_Display_Type_Value: data=Display_Type.Value
        DRT_NvBlockSwComponentTypeRunnable_DtcAging_Value: data=DtcAging.Value
        DRT_NvBlockSwComponentTypeRunnable_ECT_Gauge_Magnetic_Offset_Value: data=ECT_Gauge_Magnetic_Offset.Value
        DRT_NvBlockSwComponentTypeRunnable_EMSG_Mode_Active_Value: data=EMSG_Mode_Active.Value
        DRT_NvBlockSwComponentTypeRunnable_ESP_number_of_teeth_lastmode_Value: data=ESP_number_of_teeth_lastmode.Value
        DRT_NvBlockSwComponentTypeRunnable_EpbErrorCounter_Value: data=EpbErrorCounter.Value
        DRT_NvBlockSwComponentTypeRunnable_EpbErrorPath_Value: data=EpbErrorPath.Value
        DRT_NvBlockSwComponentTypeRunnable_EraseState_Block{1..6}_Value: data=EraseState_Block{1..6}.Value
        DRT_NvBlockSwComponentTypeRunnable_ErrorType_0xA00041_Value: data=ErrorType_0xA00041.Value
        DRT_NvBlockSwComponentTypeRunnable_ErrorType_0xA00042_Value: data=ErrorType_0xA00042.Value
        DRT_NvBlockSwComponentTypeRunnable_ErrorType_0xA00044_Value: data=ErrorType_0xA00044.Value
        DRT_NvBlockSwComponentTypeRunnable_EspErrorCounter_Value: data=EspErrorCounter.Value
        DRT_NvBlockSwComponentTypeRunnable_EspErrorPath_Value: data=EspErrorPath.Value
        DRT_NvBlockSwComponentTypeRunnable_FAS_menu_ACC_Value: data=FAS_menu_ACC.Value
        DRT_NvBlockSwComponentTypeRunnable_FAS_menu_GRA_Value: data=FAS_menu_GRA.Value
        DRT_NvBlockSwComponentTypeRunnable_FAS_menu_LIM_Value: data=FAS_menu_LIM.Value
        DRT_NvBlockSwComponentTypeRunnable_FAZIT_Number_Value: data=FAZIT_Number.Value
        DRT_NvBlockSwComponentTypeRunnable_FPK_zeigerdaempfung_drehzahl_Value: data=FPK_zeigerdaempfung_drehzahl.Value
        DRT_NvBlockSwComponentTypeRunnable_FblShareDataPartOneReserved1_Value: data=FblShareDataPartOneReserved1.Value
        DRT_NvBlockSwComponentTypeRunnable_FblShareDataPartOneReserved2_Value: data=FblShareDataPartOneReserved2.Value
        DRT_NvBlockSwComponentTypeRunnable_FblShareDataPartOneReserved_Value: data=FblShareDataPartOneReserved.Value
        DRT_NvBlockSwComponentTypeRunnable_FblShareDataPartThreeReserved_Value: data=FblShareDataPartThreeReserved.Value
        DRT_NvBlockSwComponentTypeRunnable_FblShareDataPartTwoReserved1_Value: data=FblShareDataPartTwoReserved1.Value
        DRT_NvBlockSwComponentTypeRunnable_Forcewrite_Qual_Time_Value: data=Forcewrite_Qual_Time.Value
        DRT_NvBlockSwComponentTypeRunnable_FuelLevel_Gauge_Hysteresis_Angle_Value: data=FuelLevel_Gauge_Hysteresis_Angle.Value
        DRT_NvBlockSwComponentTypeRunnable_Fuel_AuxHeater_Consumption_Active_Value: data=Fuel_AuxHeater_Consumption_Active.Value
        DRT_NvBlockSwComponentTypeRunnable_Fuel_Calib_DryCalibration_Value: data=Fuel_Calib_DryCalibration.Value
        DRT_NvBlockSwComponentTypeRunnable_Fuel_Calib_Dry_Max_Value: data=Fuel_Calib_Dry_Max.Value
        DRT_NvBlockSwComponentTypeRunnable_Fuel_Calib_FullCalibration_Value: data=Fuel_Calib_FullCalibration.Value
        DRT_NvBlockSwComponentTypeRunnable_Fuel_Calib_Full_Max_Value: data=Fuel_Calib_Full_Max.Value
        DRT_NvBlockSwComponentTypeRunnable_Fuel_Calib_Full_Offset_Value: data=Fuel_Calib_Full_Offset.Value
        DRT_NvBlockSwComponentTypeRunnable_Fuel_Calib_Vol_Dead_Value: data=Fuel_Calib_Vol_Dead.Value
        DRT_NvBlockSwComponentTypeRunnable_Fuel_Calib_Vol_Filled_Value: data=Fuel_Calib_Vol_Filled.Value
        DRT_NvBlockSwComponentTypeRunnable_Fuel_Calib_WetCalibration_Value: data=Fuel_Calib_WetCalibration.Value
        DRT_NvBlockSwComponentTypeRunnable_Fuel_Calib_Wet_Max_Value: data=Fuel_Calib_Wet_Max.Value
        DRT_NvBlockSwComponentTypeRunnable_Fuel_Consumption_Min_Value: data=Fuel_Consumption_Min.Value
        DRT_NvBlockSwComponentTypeRunnable_Fuel_Odometer_Log_n{1..3}_Value: data=Fuel_Odometer_Log_n{1..3}.Value
        DRT_NvBlockSwComponentTypeRunnable_Fuel_Odometer_Log_n_Value: data=Fuel_Odometer_Log_n.Value
        DRT_NvBlockSwComponentTypeRunnable_Fuel_Offset_Sensor_{1..4}_Value: data=Fuel_Offset_Sensor_{1..4}.Value
        DRT_NvBlockSwComponentTypeRunnable_Fuel_RefuelDetect_Log_Error_n{1..3}_Value: data=Fuel_RefuelDetect_Log_Error_n{1..3}.Value
        DRT_NvBlockSwComponentTypeRunnable_Fuel_RefuelDetect_Log_Error_n_Value: data=Fuel_RefuelDetect_Log_Error_n.Value
        DRT_NvBlockSwComponentTypeRunnable_Fuel_Variant_Value: data=Fuel_Variant.Value
        DRT_NvBlockSwComponentTypeRunnable_Fuel_Vol_Display_Old_Log_n{1..3}_Value: data=Fuel_Vol_Display_Old_Log_n{1..3}.Value
        DRT_NvBlockSwComponentTypeRunnable_Fuel_Vol_Display_Old_Log_n_Value: data=Fuel_Vol_Display_Old_Log_n.Value
        DRT_NvBlockSwComponentTypeRunnable_Fuel_Vol_Ref_Log_n{1..3}_Value: data=Fuel_Vol_Ref_Log_n{1..3}.Value
        DRT_NvBlockSwComponentTypeRunnable_Fuel_Vol_Ref_Log_n_Value: data=Fuel_Vol_Ref_Log_n.Value
        DRT_NvBlockSwComponentTypeRunnable_Fuel_Vol_RefuelHandling_Log_n{1..3}_Value: data=Fuel_Vol_RefuelHandling_Log_n{1..3}.Value
        DRT_NvBlockSwComponentTypeRunnable_Fuel_Vol_RefuelHandling_Log_n_Value: data=Fuel_Vol_RefuelHandling_Log_n.Value
        DRT_NvBlockSwComponentTypeRunnable_Fuel_Vol_Refueling_Drainage_{10..19}_Value: data=Fuel_Vol_Refueling_Drainage_{10..19}.Value
        DRT_NvBlockSwComponentTypeRunnable_Fuel_Vol_Refueling_Drainage_1_Value: data=Fuel_Vol_Refueling_Drainage_1.Value
        DRT_NvBlockSwComponentTypeRunnable_Fuel_Vol_Refueling_Drainage_{20..29}_Value: data=Fuel_Vol_Refueling_Drainage_{20..29}.Value
        DRT_NvBlockSwComponentTypeRunnable_Fuel_Vol_Refueling_Drainage_2_Value: data=Fuel_Vol_Refueling_Drainage_2.Value
        DRT_NvBlockSwComponentTypeRunnable_Fuel_Vol_Refueling_Drainage_{30..32}_Value: data=Fuel_Vol_Refueling_Drainage_{30..32}.Value
        DRT_NvBlockSwComponentTypeRunnable_Fuel_Vol_Refueling_Drainage_{3..9}_Value: data=Fuel_Vol_Refueling_Drainage_{3..9}.Value
        DRT_NvBlockSwComponentTypeRunnable_Fuel_Vol_Sensor_Avrg_RefuelHandling_Log_n{1..3}_Value: data=Fuel_Vol_Sensor_Avrg_RefuelHandling_Log_n{1..3}.Value
        DRT_NvBlockSwComponentTypeRunnable_Fuel_Vol_Sensor_Avrg_RefuelHandling_Log_n_Value: data=Fuel_Vol_Sensor_Avrg_RefuelHandling_Log_n.Value
        DRT_NvBlockSwComponentTypeRunnable_GRA_High_Display_Available_Value: data=GRA_High_Display_Available.Value
        DRT_NvBlockSwComponentTypeRunnable_Gamma_Adjustment_VAR_CRC_Value: data=Gamma_Adjustment_VAR_CRC.Value
        DRT_NvBlockSwComponentTypeRunnable_GasTank_Display_Attenuation_Off_Value: data=GasTank_Display_Attenuation_Off.Value
        DRT_NvBlockSwComponentTypeRunnable_GasTank_Display_Attenuation_On_Value: data=GasTank_Display_Attenuation_On.Value
        DRT_NvBlockSwComponentTypeRunnable_GasTank_Duration_Red_LED_Flashing_Value: data=GasTank_Duration_Red_LED_Flashing.Value
        DRT_NvBlockSwComponentTypeRunnable_GasTank_Warning_Special_State_Value: data=GasTank_Warning_Special_State.Value
        DRT_NvBlockSwComponentTypeRunnable_GeneralBrakeErrorCounter_Value: data=GeneralBrakeErrorCounter.Value
        DRT_NvBlockSwComponentTypeRunnable_GeneralBrakeErrorPath_Value: data=GeneralBrakeErrorPath.Value
        DRT_NvBlockSwComponentTypeRunnable_Green_Gamma_Adjustment_Display1_Value: data=Green_Gamma_Adjustment_Display1.Value
        DRT_NvBlockSwComponentTypeRunnable_Green_Gamma_Adjustment_Display2_Value: data=Green_Gamma_Adjustment_Display2.Value
        DRT_NvBlockSwComponentTypeRunnable_HmiZpm_0xA00044_Value: data=HmiZpm_0xA00044.Value
        DRT_NvBlockSwComponentTypeRunnable_Hmi_Skinning_Value: data=Hmi_Skinning.Value
        DRT_NvBlockSwComponentTypeRunnable_Hmi_Variant_Value: data=Hmi_Variant.Value
        DRT_NvBlockSwComponentTypeRunnable_HookInfo_ApiId_Det_ErrorHook_Value: data=HookInfo_ApiId_Det_ErrorHook.Value
        DRT_NvBlockSwComponentTypeRunnable_HookInfo_BswModuleId_EcuM_BswErrorHook_Value: data=HookInfo_BswModuleId_EcuM_BswErrorHook.Value
        DRT_NvBlockSwComponentTypeRunnable_HookInfo_EcuM_ErrorHook_Value: data=HookInfo_EcuM_ErrorHook.Value
        DRT_NvBlockSwComponentTypeRunnable_HookInfo_ErrorHook_Value: data=HookInfo_ErrorHook.Value
        DRT_NvBlockSwComponentTypeRunnable_HookInfo_ErrorId_Det_ErrorHook_Value: data=HookInfo_ErrorId_Det_ErrorHook.Value
        DRT_NvBlockSwComponentTypeRunnable_HookInfo_ErrorId_EcuM_BswErrorHook_Value: data=HookInfo_ErrorId_EcuM_BswErrorHook.Value
        DRT_NvBlockSwComponentTypeRunnable_HookInfo_InstanceId_Det_ErrorHook_Value: data=HookInfo_InstanceId_Det_ErrorHook.Value
        DRT_NvBlockSwComponentTypeRunnable_HookInfo_ModuleId_Det_ErrorHook_Value: data=HookInfo_ModuleId_Det_ErrorHook.Value
        DRT_NvBlockSwComponentTypeRunnable_HookInfo_ProtectionHook_Value: data=HookInfo_ProtectionHook.Value
        DRT_NvBlockSwComponentTypeRunnable_HookInfo_ShutdownHook_Value: data=HookInfo_ShutdownHook.Value
        DRT_NvBlockSwComponentTypeRunnable_Hot_Spot_Temp_Dimm_Time_Value: data=Hot_Spot_Temp_Dimm_Time.Value
        DRT_NvBlockSwComponentTypeRunnable_I5CM_ID_NVM_BlockDET_Value: data=I5CM_ID_NVM_BlockDET.Value
        DRT_NvBlockSwComponentTypeRunnable_I5CM_ID_NVM_BlockDL_Value: data=I5CM_ID_NVM_BlockDL.Value
        DRT_NvBlockSwComponentTypeRunnable_I5CM_ID_NVM_BlockKEYLC_Value: data=I5CM_ID_NVM_BlockKEYLC.Value
        DRT_NvBlockSwComponentTypeRunnable_I5CM_ID_NVM_BlockKEY_{0..2}_Value: data=I5CM_ID_NVM_BlockKEY_{0..2}.Value
        DRT_NvBlockSwComponentTypeRunnable_I5CM_ID_NVM_BlockLEARN_{0..2}_Value: data=I5CM_ID_NVM_BlockLEARN_{0..2}.Value
        DRT_NvBlockSwComponentTypeRunnable_I5CM_ID_NVM_BlockPARAM_{0..2}_Value: data=I5CM_ID_NVM_BlockPARAM_{0..2}.Value
        DRT_NvBlockSwComponentTypeRunnable_I5CM_ID_NVM_BlockSRM_{0..2}_Value: data=I5CM_ID_NVM_BlockSRM_{0..2}.Value
        DRT_NvBlockSwComponentTypeRunnable_I5CM_ID_NVM_BlockSTATE_{0..2}_Value: data=I5CM_ID_NVM_BlockSTATE_{0..2}.Value
        DRT_NvBlockSwComponentTypeRunnable_I5CM_ID_NVM_BlockSTS_{0..2}_Value: data=I5CM_ID_NVM_BlockSTS_{0..2}.Value
        DRT_NvBlockSwComponentTypeRunnable_Ignition_Active_Message_Value: data=Ignition_Active_Message.Value
        DRT_NvBlockSwComponentTypeRunnable_IllumThreshold_CRC_Value: data=IllumThreshold_CRC.Value
        DRT_NvBlockSwComponentTypeRunnable_Immo_DtcLastTestResult_Value: data=Immo_DtcLastTestResult.Value
        DRT_NvBlockSwComponentTypeRunnable_Immo_Individual_Schluessel_Fahrberecht_Value: data=Immo_Individual_Schluessel_Fahrberecht.Value
        DRT_NvBlockSwComponentTypeRunnable_Inspection_Elapsed_Days_Value: data=Inspection_Elapsed_Days.Value
        DRT_NvBlockSwComponentTypeRunnable_Inspection_Elapsed_Km_Value: data=Inspection_Elapsed_Km.Value
        DRT_NvBlockSwComponentTypeRunnable_Inspection_MaxNext_Days_Value: data=Inspection_MaxNext_Days.Value
        DRT_NvBlockSwComponentTypeRunnable_Inspection_MaxNext_Km_Value: data=Inspection_MaxNext_Km.Value
        DRT_NvBlockSwComponentTypeRunnable_Inspection_ResetValue_Days_Value: data=Inspection_ResetValue_Days.Value
        DRT_NvBlockSwComponentTypeRunnable_Inspection_ResetValue_Km_Value: data=Inspection_ResetValue_Km.Value
        DRT_NvBlockSwComponentTypeRunnable_InternalLogicalSoftwareBlockVersion_EEP_Value: data=InternalLogicalSoftwareBlockVersion_EEP.Value
        DRT_NvBlockSwComponentTypeRunnable_K_Number_Value: data=K_Number.Value
        DRT_NvBlockSwComponentTypeRunnable_Knockout_Ctr_Value: data=Knockout_Ctr.Value
        DRT_NvBlockSwComponentTypeRunnable_Knockout_Tmr_Value: data=Knockout_Tmr.Value
        DRT_NvBlockSwComponentTypeRunnable_KsNvmBlockGfaKey_0_Value: data=KsNvmBlockGfaKey_0.Value
        DRT_NvBlockSwComponentTypeRunnable_KsNvmBlockGfaKey_1_Value: data=KsNvmBlockGfaKey_1.Value
        DRT_NvBlockSwComponentTypeRunnable_KsNvmBlockMisc_0_Value: data=KsNvmBlockMisc_0.Value
        DRT_NvBlockSwComponentTypeRunnable_KsNvmBlockMisc_1_Value: data=KsNvmBlockMisc_1.Value
        DRT_NvBlockSwComponentTypeRunnable_LIM_Display_Available_Value: data=LIM_Display_Available.Value
        DRT_NvBlockSwComponentTypeRunnable_LeftIndicatorErrorCounter_Value: data=LeftIndicatorErrorCounter.Value
        DRT_NvBlockSwComponentTypeRunnable_LeftIndicatorErrorPath_Value: data=LeftIndicatorErrorPath.Value
        DRT_NvBlockSwComponentTypeRunnable_Lookup_Compression_Curve_Photosensor_Bus_Coef_X_Value: data=Lookup_Compression_Curve_Photosensor_Bus_Coef_X.Value
        DRT_NvBlockSwComponentTypeRunnable_Lookup_Compression_Curve_Photosensor_Bus_Coef_Y_Value: data=Lookup_Compression_Curve_Photosensor_Bus_Coef_Y.Value
        DRT_NvBlockSwComponentTypeRunnable_Lookup_Curve_Bargraphs_Red_Coef_X_Value: data=Lookup_Curve_Bargraphs_Red_Coef_X.Value
        DRT_NvBlockSwComponentTypeRunnable_Lookup_Curve_Bargraphs_Red_Coef_Y_Value: data=Lookup_Curve_Bargraphs_Red_Coef_Y.Value
        DRT_NvBlockSwComponentTypeRunnable_MDO_EN_0xA00049_Value: data=MDO_EN_0xA00049.Value
        DRT_NvBlockSwComponentTypeRunnable_MFL_Valid_Value: data=MFL_Valid.Value
        DRT_NvBlockSwComponentTypeRunnable_MO_StartStop_Coded_Value: data=MO_StartStop_Coded.Value
        DRT_NvBlockSwComponentTypeRunnable_Main_Switch_Basis_Value: data=Main_Switch_Basis.Value
        DRT_NvBlockSwComponentTypeRunnable_Main_Switch_Keyless_Value: data=Main_Switch_Keyless.Value
        DRT_NvBlockSwComponentTypeRunnable_Manuf_Assembly_Plant_Number_Value: data=Manuf_Assembly_Plant_Number.Value
        DRT_NvBlockSwComponentTypeRunnable_Manuf_Equiped_PCB_Reference_Value: data=Manuf_Equiped_PCB_Reference.Value
        DRT_NvBlockSwComponentTypeRunnable_Manuf_Equiped_PCB_Revision_Value: data=Manuf_Equiped_PCB_Revision.Value
        DRT_NvBlockSwComponentTypeRunnable_Manuf_Equipped_PCB_Partnumber_Value: data=Manuf_Equipped_PCB_Partnumber.Value
        DRT_NvBlockSwComponentTypeRunnable_Manuf_PCB_Serial_Number_Value: data=Manuf_PCB_Serial_Number.Value
        DRT_NvBlockSwComponentTypeRunnable_Manuf_Product_Partnumber_Value: data=Manuf_Product_Partnumber.Value
        DRT_NvBlockSwComponentTypeRunnable_Manuf_Product_Reference_Value: data=Manuf_Product_Reference.Value
        DRT_NvBlockSwComponentTypeRunnable_Manuf_Product_Revision_Value: data=Manuf_Product_Revision.Value
        DRT_NvBlockSwComponentTypeRunnable_Manuf_SMD_Manufacturing_Date_Value: data=Manuf_SMD_Manufacturing_Date.Value
        DRT_NvBlockSwComponentTypeRunnable_Manuf_SMD_Plant_Number_Value: data=Manuf_SMD_Plant_Number.Value
        DRT_NvBlockSwComponentTypeRunnable_Manuf_Traceability_PIM_Value: data=Manuf_Traceability_PIM.Value
        DRT_NvBlockSwComponentTypeRunnable_Manuf_Traceability_Station_Nr_Value: data=Manuf_Traceability_Station_Nr.Value
        DRT_NvBlockSwComponentTypeRunnable_Manufacturing_Mode_Value: data=Manufacturing_Mode.Value
        DRT_NvBlockSwComponentTypeRunnable_Manufacturing_PublicKey_Value: data=Manufacturing_PublicKey.Value
        DRT_NvBlockSwComponentTypeRunnable_Manufacturing_SID_Value: data=Manufacturing_SID.Value
        DRT_NvBlockSwComponentTypeRunnable_Measured_Value_Max_Range_lx_Value: data=Measured_Value_Max_Range_lx.Value
        DRT_NvBlockSwComponentTypeRunnable_Measured_Value_Max_lx_Value: data=Measured_Value_Max_lx.Value
        DRT_NvBlockSwComponentTypeRunnable_Measured_Value_Min_Range_lx_Value: data=Measured_Value_Min_Range_lx.Value
        DRT_NvBlockSwComponentTypeRunnable_Measured_Value_Min_lx_Value: data=Measured_Value_Min_lx.Value
        DRT_NvBlockSwComponentTypeRunnable_NTC_TFT_Derating_step_Value: data=NTC_TFT_Derating_step.Value
        DRT_NvBlockSwComponentTypeRunnable_NVM_BLOCK_IVD_0X0250_Value: data=NVM_BLOCK_IVD_0X0250.Value
        DRT_NvBlockSwComponentTypeRunnable_NVM_BLOCK_SFD_ConfigurationFingerprint_Data_Value: data=NVM_BLOCK_SFD_ConfigurationFingerprint_Data.Value
        DRT_NvBlockSwComponentTypeRunnable_NVM_BLOCK_SFD_PersistentData_Value: data=NVM_BLOCK_SFD_PersistentData.Value
        DRT_NvBlockSwComponentTypeRunnable_NVM_BLOCK_SFD_PublicKey_Value: data=NVM_BLOCK_SFD_PublicKey.Value
        DRT_NvBlockSwComponentTypeRunnable_NvM_VKMS_Value: data=NvM_VKMS.Value
        DRT_NvBlockSwComponentTypeRunnable_Odometer_{0..2}_Value: data=Odometer_{0..2}.Value
        DRT_NvBlockSwComponentTypeRunnable_Offset_Color_Blue_Value: data=Offset_Color_Blue.Value
        DRT_NvBlockSwComponentTypeRunnable_Offset_Color_Green_Value: data=Offset_Color_Green.Value
        DRT_NvBlockSwComponentTypeRunnable_Offset_Color_Red_Value: data=Offset_Color_Red.Value
        DRT_NvBlockSwComponentTypeRunnable_Oil_Elapsed_Days_Value: data=Oil_Elapsed_Days.Value
        DRT_NvBlockSwComponentTypeRunnable_Oil_Elapsed_Km_Value: data=Oil_Elapsed_Km.Value
        DRT_NvBlockSwComponentTypeRunnable_Oil_FixedNext_Days_Value: data=Oil_FixedNext_Days.Value
        DRT_NvBlockSwComponentTypeRunnable_Oil_FixedNext_Km_Value: data=Oil_FixedNext_Km.Value
        DRT_NvBlockSwComponentTypeRunnable_Oil_Quality_Value: data=Oil_Quality.Value
        DRT_NvBlockSwComponentTypeRunnable_Oil_Reset_Value: data=Oil_Reset.Value
        DRT_NvBlockSwComponentTypeRunnable_Oil_SootContamination_Sum_Value: data=Oil_SootContamination_Sum.Value
        DRT_NvBlockSwComponentTypeRunnable_Oil_Theoretic_Km_Value: data=Oil_Theoretic_Km.Value
        DRT_NvBlockSwComponentTypeRunnable_Oil_ThermalWear_Sum_Value: data=Oil_ThermalWear_Sum.Value
        DRT_NvBlockSwComponentTypeRunnable_Oil_VariableMaxNext_Days_Value: data=Oil_VariableMaxNext_Days.Value
        DRT_NvBlockSwComponentTypeRunnable_Oil_VariableMaxNext_Km_Value: data=Oil_VariableMaxNext_Km.Value
        DRT_NvBlockSwComponentTypeRunnable_Oil_VariableMinNext_Days_Value: data=Oil_VariableMinNext_Days.Value
        DRT_NvBlockSwComponentTypeRunnable_Oil_VariableMinNext_Km_Value: data=Oil_VariableMinNext_Km.Value
        DRT_NvBlockSwComponentTypeRunnable_Old_Tank_Warning_Other_State_do_not_use_Value: data=Old_Tank_Warning_Other_State_do_not_use.Value
        DRT_NvBlockSwComponentTypeRunnable_OperatingTimeStoredLSB_Value: data=OperatingTimeStoredLSB.Value
        DRT_NvBlockSwComponentTypeRunnable_OperatingTimeStoredMSB_Value: data=OperatingTimeStoredMSB.Value
        DRT_NvBlockSwComponentTypeRunnable_OutsideTemperature_Exclusive_DisplayArea_Value: data=OutsideTemperature_Exclusive_DisplayArea.Value
        DRT_NvBlockSwComponentTypeRunnable_OutsideTemperature_Indication_Value: data=OutsideTemperature_Indication.Value
        DRT_NvBlockSwComponentTypeRunnable_Overheat_DIMM_primary_Value: data=Overheat_DIMM_primary.Value
        DRT_NvBlockSwComponentTypeRunnable_Overheat_DIMM_secondary_Value: data=Overheat_DIMM_secondary.Value
        DRT_NvBlockSwComponentTypeRunnable_PCB_Hot_Spot_Threshold_Value: data=PCB_Hot_Spot_Threshold.Value
        DRT_NvBlockSwComponentTypeRunnable_PCB_Threshold1_Value: data=PCB_Threshold1.Value
        DRT_NvBlockSwComponentTypeRunnable_PCB_Threshold2_Value: data=PCB_Threshold2.Value
        DRT_NvBlockSwComponentTypeRunnable_PCB_Timer_Temp_Too_Hot_Value: data=PCB_Timer_Temp_Too_Hot.Value
        DRT_NvBlockSwComponentTypeRunnable_PCB_TrackResistance_Value: data=PCB_TrackResistance.Value
        DRT_NvBlockSwComponentTypeRunnable_PHEV_Statistic_Cycle_Value: data=PHEV_Statistic_Cycle.Value
        DRT_NvBlockSwComponentTypeRunnable_PHEV_Statistic_Distance_Value: data=PHEV_Statistic_Distance.Value
        DRT_NvBlockSwComponentTypeRunnable_PSO_DataTag_USER_{0..7}_Value: data=PSO_DataTag_USER_{0..7}.Value
        DRT_NvBlockSwComponentTypeRunnable_PTC_PCB_Derating_step_Value: data=PTC_PCB_Derating_step.Value
        DRT_NvBlockSwComponentTypeRunnable_PWM_Damping_CurveSwitch_Value: data=PWM_Damping_CurveSwitch.Value
        DRT_NvBlockSwComponentTypeRunnable_PWM_Display_X_Value: data=PWM_Display_X.Value
        DRT_NvBlockSwComponentTypeRunnable_PWM_Display_Y_Value: data=PWM_Display_Y.Value
        DRT_NvBlockSwComponentTypeRunnable_PWM_Pointer_xd_X_Value: data=PWM_Pointer_xd_X.Value
        DRT_NvBlockSwComponentTypeRunnable_PWM_Pointer_xd_Y_Value: data=PWM_Pointer_xd_Y.Value
        DRT_NvBlockSwComponentTypeRunnable_PWM_Pointer_xt_X_Value: data=PWM_Pointer_xt_X.Value
        DRT_NvBlockSwComponentTypeRunnable_PWM_Pointer_xt_Y_Value: data=PWM_Pointer_xt_Y.Value
        DRT_NvBlockSwComponentTypeRunnable_Photosensor_Calib_Max_Lx_Value: data=Photosensor_Calib_Max_Lx.Value
        DRT_NvBlockSwComponentTypeRunnable_Photosensor_Calib_Max_Range_Lx_Value: data=Photosensor_Calib_Max_Range_Lx.Value
        DRT_NvBlockSwComponentTypeRunnable_Photosensor_Calib_Min_Lx_Value: data=Photosensor_Calib_Min_Lx.Value
        DRT_NvBlockSwComponentTypeRunnable_Photosensor_Calib_Min_Range_Lx_Value: data=Photosensor_Calib_Min_Range_Lx.Value
        DRT_NvBlockSwComponentTypeRunnable_Photosensor_Plausi_Threshold_Value: data=Photosensor_Plausi_Threshold.Value
        DRT_NvBlockSwComponentTypeRunnable_Photosensor_available_Value: data=Photosensor_available.Value
        DRT_NvBlockSwComponentTypeRunnable_Photosensor_enabled_Value: data=Photosensor_enabled.Value
        DRT_NvBlockSwComponentTypeRunnable_Picture_Upload_Download_Value: data=Picture_Upload_Download.Value
        DRT_NvBlockSwComponentTypeRunnable_PointerType_Value: data=PointerType.Value
        DRT_NvBlockSwComponentTypeRunnable_Pointer_Kl_58xt_Kl_58xd_Value: data=Pointer_Kl_58xt_Kl_58xd.Value
        DRT_NvBlockSwComponentTypeRunnable_ProductionMode_Value: data=ProductionMode.Value
        DRT_NvBlockSwComponentTypeRunnable_ProgMarker_Value: data=ProgMarker.Value
        DRT_NvBlockSwComponentTypeRunnable_ProgReqFlag_Value: data=ProgReqFlag.Value
        DRT_NvBlockSwComponentTypeRunnable_QRS_Mode_Active_Value: data=QRS_Mode_Active.Value
        DRT_NvBlockSwComponentTypeRunnable_QuartzFrequencyOffset_Value: data=QuartzFrequencyOffset.Value
        DRT_NvBlockSwComponentTypeRunnable_RCC_IZ_Value: data=RCC_IZ.Value
        DRT_NvBlockSwComponentTypeRunnable_RGB_Color_Calibration_PWM_AmbientLight_X_Value: data=RGB_Color_Calibration_PWM_AmbientLight_X.Value
        DRT_NvBlockSwComponentTypeRunnable_RGB_Color_Calibration_PWM_AmbientLight_Y_Display_Value: data=RGB_Color_Calibration_PWM_AmbientLight_Y_Display.Value
        DRT_NvBlockSwComponentTypeRunnable_RGB_Color_Calibration_PWM_AmbientLight_Y_Left_Value: data=RGB_Color_Calibration_PWM_AmbientLight_Y_Left.Value
        DRT_NvBlockSwComponentTypeRunnable_RGB_Color_Calibration_PWM_AmbientLight_Y_Right_Value: data=RGB_Color_Calibration_PWM_AmbientLight_Y_Right.Value
        DRT_NvBlockSwComponentTypeRunnable_ROE_Config_Value: data=ROE_Config.Value
        DRT_NvBlockSwComponentTypeRunnable_RPM_Gauge_FIR_Coefficients_Value: data=RPM_Gauge_FIR_Coefficients.Value
        DRT_NvBlockSwComponentTypeRunnable_RPM_Gauge_Hysteresis_Angle_Value: data=RPM_Gauge_Hysteresis_Angle.Value
        DRT_NvBlockSwComponentTypeRunnable_RPM_Gauge_Magnetic_Offset_Value: data=RPM_Gauge_Magnetic_Offset.Value
        DRT_NvBlockSwComponentTypeRunnable_RangeAvgConsumption_High_CNG_Value: data=RangeAvgConsumption_High_CNG.Value
        DRT_NvBlockSwComponentTypeRunnable_RangeAvgConsumption_High_LPG_Value: data=RangeAvgConsumption_High_LPG.Value
        DRT_NvBlockSwComponentTypeRunnable_RangeAvgConsumption_High_Value: data=RangeAvgConsumption_High.Value
        DRT_NvBlockSwComponentTypeRunnable_Rate_Value: data=Rate.Value
        DRT_NvBlockSwComponentTypeRunnable_Red_Gamma_Adjustment_Display1_Value: data=Red_Gamma_Adjustment_Display1.Value
        DRT_NvBlockSwComponentTypeRunnable_Red_Gamma_Adjustment_Display2_Value: data=Red_Gamma_Adjustment_Display2.Value
        DRT_NvBlockSwComponentTypeRunnable_RefulledVolume_Available_Value: data=RefulledVolume_Available.Value
        DRT_NvBlockSwComponentTypeRunnable_Reserved_1_Bargraph_VAR_Value: data=Reserved_1_Bargraph_VAR.Value
        DRT_NvBlockSwComponentTypeRunnable_Reserved_1_DIAG_AC_IlluminationCfg_VAR_3_Value: data=Reserved_1_DIAG_AC_IlluminationCfg_VAR_3.Value
        DRT_NvBlockSwComponentTypeRunnable_Reserved_1_Value: data=Reserved_1.Value
        DRT_NvBlockSwComponentTypeRunnable_Reserved_DIAG_AC_Curve_Scales_VAR_Value: data=Reserved_DIAG_AC_Curve_Scales_VAR.Value
        DRT_NvBlockSwComponentTypeRunnable_Reserved_DIAG_AC_IlluminationCfg_VAR_0_Value: data=Reserved_DIAG_AC_IlluminationCfg_VAR_0.Value
        DRT_NvBlockSwComponentTypeRunnable_Reserved_DIAG_AC_IlluminationCfg_VAR_3_Value: data=Reserved_DIAG_AC_IlluminationCfg_VAR_3.Value
        DRT_NvBlockSwComponentTypeRunnable_ResetCounter_BURAMMarkerInvalid_Value: data=ResetCounter_BURAMMarkerInvalid.Value
        DRT_NvBlockSwComponentTypeRunnable_ResetCounter_BuramChecksumError_Value: data=ResetCounter_BuramChecksumError.Value
        DRT_NvBlockSwComponentTypeRunnable_ResetCounter_CSV_Error_Value: data=ResetCounter_CSV_Error.Value
        DRT_NvBlockSwComponentTypeRunnable_ResetCounter_CTRL_App_Value: data=ResetCounter_CTRL_App.Value
        DRT_NvBlockSwComponentTypeRunnable_ResetCounter_CTRL_Warning_Value: data=ResetCounter_CTRL_Warning.Value
        DRT_NvBlockSwComponentTypeRunnable_ResetCounter_CXDR_ADC_Value: data=ResetCounter_CXDR_ADC.Value
        DRT_NvBlockSwComponentTypeRunnable_ResetCounter_CXDR_DisplayMonitor_Value: data=ResetCounter_CXDR_DisplayMonitor.Value
        DRT_NvBlockSwComponentTypeRunnable_ResetCounter_CXDR_IOC_Value: data=ResetCounter_CXDR_IOC.Value
        DRT_NvBlockSwComponentTypeRunnable_ResetCounter_CXDR_Illum_Value: data=ResetCounter_CXDR_Illum.Value
        DRT_NvBlockSwComponentTypeRunnable_ResetCounter_CXDR_SafeTTMonitor_Value: data=ResetCounter_CXDR_SafeTTMonitor.Value
        DRT_NvBlockSwComponentTypeRunnable_ResetCounter_CXDR_Sensors_Value: data=ResetCounter_CXDR_Sensors.Value
        DRT_NvBlockSwComponentTypeRunnable_ResetCounter_CXDR_Sound_Value: data=ResetCounter_CXDR_Sound.Value
        DRT_NvBlockSwComponentTypeRunnable_ResetCounter_ClockMon_Value: data=ResetCounter_ClockMon.Value
        DRT_NvBlockSwComponentTypeRunnable_ResetCounter_DeepStopNotEntered_Value: data=ResetCounter_DeepStopNotEntered.Value
        DRT_NvBlockSwComponentTypeRunnable_ResetCounter_Det_ErrorHook_Value: data=ResetCounter_Det_ErrorHook.Value
        DRT_NvBlockSwComponentTypeRunnable_ResetCounter_DpMainTaskError_Value: data=ResetCounter_DpMainTaskError.Value
        DRT_NvBlockSwComponentTypeRunnable_ResetCounter_DpQueueError_Value: data=ResetCounter_DpQueueError.Value
        DRT_NvBlockSwComponentTypeRunnable_ResetCounter_ECC_Error_Value: data=ResetCounter_ECC_Error.Value
        DRT_NvBlockSwComponentTypeRunnable_ResetCounter_EcuMErrorHook_Value: data=ResetCounter_EcuMErrorHook.Value
        DRT_NvBlockSwComponentTypeRunnable_ResetCounter_EcuM_BswErrorHook_Value: data=ResetCounter_EcuM_BswErrorHook.Value
        DRT_NvBlockSwComponentTypeRunnable_ResetCounter_EcuReset_Value: data=ResetCounter_EcuReset.Value
        DRT_NvBlockSwComponentTypeRunnable_ResetCounter_ErrorHook_Value: data=ResetCounter_ErrorHook.Value
        DRT_NvBlockSwComponentTypeRunnable_ResetCounter_EventQueueError_Value: data=ResetCounter_EventQueueError.Value
        DRT_NvBlockSwComponentTypeRunnable_ResetCounter_GuiQueueError_Value: data=ResetCounter_GuiQueueError.Value
        DRT_NvBlockSwComponentTypeRunnable_ResetCounter_HMITaskError_Value: data=ResetCounter_HMITaskError.Value
        DRT_NvBlockSwComponentTypeRunnable_ResetCounter_IoHwAb_Value: data=ResetCounter_IoHwAb.Value
        DRT_NvBlockSwComponentTypeRunnable_ResetCounter_JumpToZero_Value: data=ResetCounter_JumpToZero.Value
        DRT_NvBlockSwComponentTypeRunnable_ResetCounter_LastResetReason_Value: data=ResetCounter_LastResetReason.Value
        DRT_NvBlockSwComponentTypeRunnable_ResetCounter_MDL_BCCT_Value: data=ResetCounter_MDL_BCCT.Value
        DRT_NvBlockSwComponentTypeRunnable_ResetCounter_MDL_CarModes_Value: data=ResetCounter_MDL_CarModes.Value
        DRT_NvBlockSwComponentTypeRunnable_ResetCounter_MDL_Immobilizer_Value: data=ResetCounter_MDL_Immobilizer.Value
        DRT_NvBlockSwComponentTypeRunnable_ResetCounter_MDL_SiWaLa_Value: data=ResetCounter_MDL_SiWaLa.Value
        DRT_NvBlockSwComponentTypeRunnable_ResetCounter_MPU_Error_Value: data=ResetCounter_MPU_Error.Value
        DRT_NvBlockSwComponentTypeRunnable_ResetCounter_POR_Value: data=ResetCounter_POR.Value
        DRT_NvBlockSwComponentTypeRunnable_ResetCounter_ProtectionHook_Value: data=ResetCounter_ProtectionHook.Value
        DRT_NvBlockSwComponentTypeRunnable_ResetCounter_RamHashError_Value: data=ResetCounter_RamHashError.Value
        DRT_NvBlockSwComponentTypeRunnable_ResetCounter_RendererTaskError_Value: data=ResetCounter_RendererTaskError.Value
        DRT_NvBlockSwComponentTypeRunnable_ResetCounter_SRV_Cfg_Safety_Value: data=ResetCounter_SRV_Cfg_Safety.Value
        DRT_NvBlockSwComponentTypeRunnable_ResetCounter_SRV_ComExt_Task50_Value: data=ResetCounter_SRV_ComExt_Task50.Value
        DRT_NvBlockSwComponentTypeRunnable_ResetCounter_SRV_ComExt_TaskFast_Value: data=ResetCounter_SRV_ComExt_TaskFast.Value
        DRT_NvBlockSwComponentTypeRunnable_ResetCounter_SRV_MemTest_Value: data=ResetCounter_SRV_MemTest.Value
        DRT_NvBlockSwComponentTypeRunnable_ResetCounter_SRV_Monitor_Value: data=ResetCounter_SRV_Monitor.Value
        DRT_NvBlockSwComponentTypeRunnable_ResetCounter_SRV_Power_Value: data=ResetCounter_SRV_Power.Value
        DRT_NvBlockSwComponentTypeRunnable_ResetCounter_ShutdownHook_Value: data=ResetCounter_ShutdownHook.Value
        DRT_NvBlockSwComponentTypeRunnable_ResetCounter_StackMonitor_Value: data=ResetCounter_StackMonitor.Value
        DRT_NvBlockSwComponentTypeRunnable_ResetCounter_TFT_alive_Value: data=ResetCounter_TFT_alive.Value
        DRT_NvBlockSwComponentTypeRunnable_ResetCounter_TimeoutModule_Value: data=ResetCounter_TimeoutModule.Value
        DRT_NvBlockSwComponentTypeRunnable_ResetCounter_TmrFailure_Value: data=ResetCounter_TmrFailure.Value
        DRT_NvBlockSwComponentTypeRunnable_ResetCounter_Trap_GS_Value: data=ResetCounter_Trap_GS.Value
        DRT_NvBlockSwComponentTypeRunnable_ResetCounter_Trap_Value: data=ResetCounter_Trap.Value
        DRT_NvBlockSwComponentTypeRunnable_ResetCounter_VIEW_Sound_Value: data=ResetCounter_VIEW_Sound.Value
        DRT_NvBlockSwComponentTypeRunnable_ResetCounter_WD_GS_Value: data=ResetCounter_WD_GS.Value
        DRT_NvBlockSwComponentTypeRunnable_ResetCounter_WD_Value: data=ResetCounter_WD.Value
        DRT_NvBlockSwComponentTypeRunnable_ResetCounter_backlight_Value: data=ResetCounter_backlight.Value
        DRT_NvBlockSwComponentTypeRunnable_ResetResponseFlag_Value: data=ResetResponseFlag.Value
        DRT_NvBlockSwComponentTypeRunnable_Rework_Param_1_Value: data=Rework_Param_1.Value
        DRT_NvBlockSwComponentTypeRunnable_Rework_Param_2_Value: data=Rework_Param_2.Value
        DRT_NvBlockSwComponentTypeRunnable_RightIndicatorErrorCounter_Value: data=RightIndicatorErrorCounter.Value
        DRT_NvBlockSwComponentTypeRunnable_RightIndicatorErrorPath_Value: data=RightIndicatorErrorPath.Value
        DRT_NvBlockSwComponentTypeRunnable_RollTestStandMode_Value: data=RollTestStandMode.Value
        DRT_NvBlockSwComponentTypeRunnable_RunInMode_Config_Value: data=RunInMode_Config.Value
        DRT_NvBlockSwComponentTypeRunnable_RunInMode_Result_Value: data=RunInMode_Result.Value
        DRT_NvBlockSwComponentTypeRunnable_RunIn_FinalPointerPositions_Value: data=RunIn_FinalPointerPositions.Value
        DRT_NvBlockSwComponentTypeRunnable_RunIn_FuelADC_Max_Value: data=RunIn_FuelADC_Max.Value
        DRT_NvBlockSwComponentTypeRunnable_RunIn_FuelADC_Min_Value: data=RunIn_FuelADC_Min.Value
        DRT_NvBlockSwComponentTypeRunnable_SFD_Group_Attribute_Value: data=SFD_Group_Attribute.Value
        DRT_NvBlockSwComponentTypeRunnable_SFD_Project_ID_Value: data=SFD_Project_ID.Value
        DRT_NvBlockSwComponentTypeRunnable_SG_BusKnockout_Ctr_Value: data=SG_BusKnockout_Ctr.Value
        DRT_NvBlockSwComponentTypeRunnable_SG_BusKnockout_Tmr_Value: data=SG_BusKnockout_Tmr.Value
        DRT_NvBlockSwComponentTypeRunnable_SKey_Error_Counter_Value: data=SKey_Error_Counter.Value
        DRT_NvBlockSwComponentTypeRunnable_SRV_TKM_ZvCrH_TKM_ZvCrHPimTkKeyInCarNeed_Value: data=SRV_TKM_ZvCrH_TKM_ZvCrHPimTkKeyInCarNeed.Value
        DRT_NvBlockSwComponentTypeRunnable_SSO_EdgeCount_Sum_lastmode_Value: data=SSO_EdgeCount_Sum_lastmode.Value
        DRT_NvBlockSwComponentTypeRunnable_SWA_Telltales_Installed_Value: data=SWA_Telltales_Installed.Value
        DRT_NvBlockSwComponentTypeRunnable_SaveTimeDisplayOff_Value: data=SaveTimeDisplayOff.Value
        DRT_NvBlockSwComponentTypeRunnable_SaveTimeEngineOff_Value: data=SaveTimeEngineOff.Value
        DRT_NvBlockSwComponentTypeRunnable_Scale_Luminosity_Calibration_PWM_Value: data=Scale_Luminosity_Calibration_PWM.Value
        DRT_NvBlockSwComponentTypeRunnable_Scales_DayResponseCurve_Value: data=Scales_DayResponseCurve.Value
        DRT_NvBlockSwComponentTypeRunnable_Scales_Day_X_Value: data=Scales_Day_X.Value
        DRT_NvBlockSwComponentTypeRunnable_Scales_Day_Y_Value: data=Scales_Day_Y.Value
        DRT_NvBlockSwComponentTypeRunnable_Scales_Night_X_Value: data=Scales_Night_X.Value
        DRT_NvBlockSwComponentTypeRunnable_Scales_Night_Y_Value: data=Scales_Night_Y.Value
        DRT_NvBlockSwComponentTypeRunnable_Seatbelt_Rear_Delaytime_acoustic_Value: data=Seatbelt_Rear_Delaytime_acoustic.Value
        DRT_NvBlockSwComponentTypeRunnable_Seatbelt_Rear_Displaytime_buckle_Value: data=Seatbelt_Rear_Displaytime_buckle.Value
        DRT_NvBlockSwComponentTypeRunnable_Seatbelt_Rear_speed_blinking_off_Value: data=Seatbelt_Rear_speed_blinking_off.Value
        DRT_NvBlockSwComponentTypeRunnable_Seatbelt_Rear_speed_blinking_on_Value: data=Seatbelt_Rear_speed_blinking_on.Value
        DRT_NvBlockSwComponentTypeRunnable_Seatbelt_SBR_Installed_Value: data=Seatbelt_SBR_Installed.Value
        DRT_NvBlockSwComponentTypeRunnable_SecAccessDelayFlag_Value: data=SecAccessDelayFlag.Value
        DRT_NvBlockSwComponentTypeRunnable_SecAccessInvalidCount_Value: data=SecAccessInvalidCount.Value
        DRT_NvBlockSwComponentTypeRunnable_Security_InvalidKeyCounter_Value: data=Security_InvalidKeyCounter.Value
        DRT_NvBlockSwComponentTypeRunnable_SegmentLengthList_Block{1..6}_Value: data=SegmentLengthList_Block{1..6}.Value
        DRT_NvBlockSwComponentTypeRunnable_ServiceKey_Counter_Key_ID{1..8}_Value: data=ServiceKey_Counter_Key_ID{1..8}.Value
        DRT_NvBlockSwComponentTypeRunnable_ServiceKey_Counter_Key_ID_Kessy_Value: data=ServiceKey_Counter_Key_ID_Kessy.Value
        DRT_NvBlockSwComponentTypeRunnable_Service_Early_Warning_Prediction_Value: data=Service_Early_Warning_Prediction.Value
        DRT_NvBlockSwComponentTypeRunnable_Service_History_Value: data=Service_History.Value
        DRT_NvBlockSwComponentTypeRunnable_Service_PreWarning_Days_Value: data=Service_PreWarning_Days.Value
        DRT_NvBlockSwComponentTypeRunnable_Share_ASAM_ODXFileIdentifier_Old_Value: data=Share_ASAM_ODXFileIdentifier_Old.Value
        DRT_NvBlockSwComponentTypeRunnable_Share_ASAM_ODXFileIdentifier_obsolate_Value: data=Share_ASAM_ODXFileIdentifier_obsolate.Value
        DRT_NvBlockSwComponentTypeRunnable_Share_ASAM_ODXFileVersion_Old_Value: data=Share_ASAM_ODXFileVersion_Old.Value
        DRT_NvBlockSwComponentTypeRunnable_Share_BootloaderTPBlocksize_Value: data=Share_BootloaderTPBlocksize.Value
        DRT_NvBlockSwComponentTypeRunnable_Share_ECUProgrammingInformation_Value: data=Share_ECUProgrammingInformation.Value
        DRT_NvBlockSwComponentTypeRunnable_Share_FDSProjectData_Value: data=Share_FDSProjectData.Value
        DRT_NvBlockSwComponentTypeRunnable_Share_FblShareDataPartTwoReserved_Value: data=Share_FblShareDataPartTwoReserved.Value
        DRT_NvBlockSwComponentTypeRunnable_Share_Fingerprint_Block{1..6}_Value: data=Share_Fingerprint_Block{1..6}.Value
        DRT_NvBlockSwComponentTypeRunnable_Share_InvalidKeyCounter_Value: data=Share_InvalidKeyCounter.Value
        DRT_NvBlockSwComponentTypeRunnable_Share_ProgAttempts_Block{1..6}_Value: data=Share_ProgAttempts_Block{1..6}.Value
        DRT_NvBlockSwComponentTypeRunnable_Share_VWECUHardwareNumber_Old_Value: data=Share_VWECUHardwareNumber_Old.Value
        DRT_NvBlockSwComponentTypeRunnable_Share_VWECUHardwareNumber_Value: data=Share_VWECUHardwareNumber.Value
        DRT_NvBlockSwComponentTypeRunnable_Share_VWECUHardwareVersionNumber_Old_Value: data=Share_VWECUHardwareVersionNumber_Old.Value
        DRT_NvBlockSwComponentTypeRunnable_Share_VWECUHardwareVersionNumber_Value: data=Share_VWECUHardwareVersionNumber.Value
        DRT_NvBlockSwComponentTypeRunnable_Share_VWFAZITIdentificationString_Value: data=Share_VWFAZITIdentificationString.Value
        DRT_NvBlockSwComponentTypeRunnable_Share_VWSparePartNumber_Value: data=Share_VWSparePartNumber.Value
        DRT_NvBlockSwComponentTypeRunnable_Share_ValidityFlags_Value: data=Share_ValidityFlags.Value
        DRT_NvBlockSwComponentTypeRunnable_SiWalaACT_0xA00049_Value: data=SiWalaACT_0xA00049.Value
        DRT_NvBlockSwComponentTypeRunnable_SiWalaActive_0xA00049_Value: data=SiWalaActive_0xA00049.Value
        DRT_NvBlockSwComponentTypeRunnable_SiWalaExpState_0xA00049_Value: data=SiWalaExpState_0xA00049.Value
        DRT_NvBlockSwComponentTypeRunnable_SiWalaId_0xA00049_Value: data=SiWalaId_0xA00049.Value
        DRT_NvBlockSwComponentTypeRunnable_SlewRate_Value: data=SlewRate.Value
        DRT_NvBlockSwComponentTypeRunnable_SpeedFastReading_X_Value: data=SpeedFastReading_X.Value
        DRT_NvBlockSwComponentTypeRunnable_SpeedFastReading_Y_Value: data=SpeedFastReading_Y.Value
        DRT_NvBlockSwComponentTypeRunnable_SpeedThreshold_Value: data=SpeedThreshold.Value
        DRT_NvBlockSwComponentTypeRunnable_Speedo_Gauge_Hysteresis_Angle_Value: data=Speedo_Gauge_Hysteresis_Angle.Value
        DRT_NvBlockSwComponentTypeRunnable_Speedo_Gauge_Magnetic_Offset_Value: data=Speedo_Gauge_Magnetic_Offset.Value
        DRT_NvBlockSwComponentTypeRunnable_SupplyVoltage_N1_Value: data=SupplyVoltage_N1.Value
        DRT_NvBlockSwComponentTypeRunnable_SupplyVoltage_N2_Value: data=SupplyVoltage_N2.Value
        DRT_NvBlockSwComponentTypeRunnable_SupplyVoltage_V1_Value: data=SupplyVoltage_V1.Value
        DRT_NvBlockSwComponentTypeRunnable_SupplyVoltage_V2_Value: data=SupplyVoltage_V2.Value
        DRT_NvBlockSwComponentTypeRunnable_SynchronizationTime_DriversDoor_Value: data=SynchronizationTime_DriversDoor.Value
        DRT_NvBlockSwComponentTypeRunnable_TCO_Available_Value: data=TCO_Available.Value
        DRT_NvBlockSwComponentTypeRunnable_TFT_RGB_Gain_Value: data=TFT_RGB_Gain.Value
        DRT_NvBlockSwComponentTypeRunnable_TFT_Safety_Offset_Value: data=TFT_Safety_Offset.Value
        DRT_NvBlockSwComponentTypeRunnable_TFT_Threshold1_Value: data=TFT_Threshold1.Value
        DRT_NvBlockSwComponentTypeRunnable_TFT_Threshold2_Value: data=TFT_Threshold2.Value
        DRT_NvBlockSwComponentTypeRunnable_TT_Green_Luminosity_Calibration_PWM_Value: data=TT_Green_Luminosity_Calibration_PWM.Value
        DRT_NvBlockSwComponentTypeRunnable_TT_Red_Luminosity_Calibration_PWM_Value: data=TT_Red_Luminosity_Calibration_PWM.Value
        DRT_NvBlockSwComponentTypeRunnable_TT_Yellow_Luminosity_Calibration_PWM_Value: data=TT_Yellow_Luminosity_Calibration_PWM.Value
        DRT_NvBlockSwComponentTypeRunnable_T_Mode_Active_Value: data=T_Mode_Active.Value
        DRT_NvBlockSwComponentTypeRunnable_Tank_Gauge_Magnetic_Offset_Value: data=Tank_Gauge_Magnetic_Offset.Value
        DRT_NvBlockSwComponentTypeRunnable_TaskListEntry{1..5}_Value: data=TaskListEntry{1..5}.Value
        DRT_NvBlockSwComponentTypeRunnable_Temp_Threshold_Max_QuartzTemp_Value: data=Temp_Threshold_Max_QuartzTemp.Value
        DRT_NvBlockSwComponentTypeRunnable_Thermal_Timer{1..3}_Value: data=Thermal_Timer{1..3}.Value
        DRT_NvBlockSwComponentTypeRunnable_TimeConstant_Value: data=TimeConstant.Value
        DRT_NvBlockSwComponentTypeRunnable_Time_TimeSource_Value: data=Time_TimeSource.Value
        DRT_NvBlockSwComponentTypeRunnable_TrGW_Function_Enable_Value: data=TrGW_Function_Enable.Value
        DRT_NvBlockSwComponentTypeRunnable_TrendTime_Value: data=TrendTime.Value
        DRT_NvBlockSwComponentTypeRunnable_Trend_Threshold_Value: data=Trend_Threshold.Value
        DRT_NvBlockSwComponentTypeRunnable_USER_PROFILE{0..7}_Value: data=USER_PROFILE{0..7}.Value
        DRT_NvBlockSwComponentTypeRunnable_UnintendedMovement_Value: data=UnintendedMovement.Value
        DRT_NvBlockSwComponentTypeRunnable_Unit_KWh_per_mile_available_Value: data=Unit_KWh_per_mile_available.Value
        DRT_NvBlockSwComponentTypeRunnable_Unit_SpeedoScale_Value: data=Unit_SpeedoScale.Value
        DRT_NvBlockSwComponentTypeRunnable_Unit_mpge_us_available_Value: data=Unit_mpge_us_available.Value
        DRT_NvBlockSwComponentTypeRunnable_VCOM_Adjustment_Value: data=VCOM_Adjustment.Value
        DRT_NvBlockSwComponentTypeRunnable_VKMS_InitalKey_IS_Value: data=VKMS_InitalKey_IS.Value
        DRT_NvBlockSwComponentTypeRunnable_VKM_Range_Distance_Unclass_Value: data=VKM_Range_Distance_Unclass.Value
        DRT_NvBlockSwComponentTypeRunnable_VKM_Range_RangeAvgConsumptiom_Default_Value: data=VKM_Range_RangeAvgConsumptiom_Default.Value
        DRT_NvBlockSwComponentTypeRunnable_VWLogicalSoftwareBlockVersion_EEP_Value: data=VWLogicalSoftwareBlockVersion_EEP.Value
        DRT_NvBlockSwComponentTypeRunnable_VWSoftwareVersionNumber_Value: data=VWSoftwareVersionNumber.Value
        DRT_NvBlockSwComponentTypeRunnable_VW_Data_Set_Number_Value: data=VW_Data_Set_Number.Value
        DRT_NvBlockSwComponentTypeRunnable_VW_Data_Set_Version_Value: data=VW_Data_Set_Version.Value
        DRT_NvBlockSwComponentTypeRunnable_VW_Workshop_System_Name_Value: data=VW_Workshop_System_Name.Value
        DRT_NvBlockSwComponentTypeRunnable_V_Config_WarningThreshold1_Indien_Value: data=V_Config_WarningThreshold1_Indien.Value
        DRT_NvBlockSwComponentTypeRunnable_V_Customer_Active_Value: data=V_Customer_Active.Value
        DRT_NvBlockSwComponentTypeRunnable_V_Customer_SpeedThreshold_Value: data=V_Customer_SpeedThreshold.Value
        DRT_NvBlockSwComponentTypeRunnable_V_Warning_Legal_India_Value: data=V_Warning_Legal_India.Value
        DRT_NvBlockSwComponentTypeRunnable_Vehicle_Equipment_Code_Value: data=Vehicle_Equipment_Code.Value
        DRT_NvBlockSwComponentTypeRunnable_Vehicle_Network_Value: data=Vehicle_Network.Value
        DRT_NvBlockSwComponentTypeRunnable_VersionListEntry{1..5}_Value: data=VersionListEntry{1..5}.Value
        DRT_NvBlockSwComponentTypeRunnable_VersionListFlash_Counter_Value: data=VersionListFlash_Counter.Value
        DRT_NvBlockSwComponentTypeRunnable_VersionListIndex_Value: data=VersionListIndex.Value
        DRT_NvBlockSwComponentTypeRunnable_WLTP_Concept_Value: data=WLTP_Concept.Value
        DRT_NvBlockSwComponentTypeRunnable_Whisper_Mode_Loudness_Value: data=Whisper_Mode_Loudness.Value
        DRT_NvBlockSwComponentTypeRunnable_Whisper_Mode_Value: data=Whisper_Mode.Value
        DRT_NvBlockSwComponentTypeRunnable_WhitePointCorrectionMethod_Value: data=WhitePointCorrectionMethod.Value
        DRT_NvBlockSwComponentTypeRunnable_Write_Delay_Speed_Value: data=Write_Delay_Speed.Value
        DRT_NvBlockSwComponentTypeRunnable_Write_Delay_Time_Value: data=Write_Delay_Time.Value
        DRT_NvBlockSwComponentTypeRunnable_Write_Distance_Value: data=Write_Distance.Value
        DRT_NvBlockSwComponentTypeRunnable_Zero_Potential_Display_Active_Value: data=Zero_Potential_Display_Active.Value
        DRT_NvBlockSwComponentTypeRunnable_Zreserved_Bargraph_VAR_Value: data=Zreserved_Bargraph_VAR.Value
        DRT_NvBlockSwComponentTypeRunnable_bap_bc_mfa_SpeedWarning_Speed_Unit_Value: data=bap_bc_mfa_SpeedWarning_Speed_Unit.Value
        DRT_NvBlockSwComponentTypeRunnable_bap_bc_mfa_SpeedWarning_Speed_Value_Value: data=bap_bc_mfa_SpeedWarning_Speed_Value.Value
        DRT_NvBlockSwComponentTypeRunnable_bap_bc_mfa_SpeedWarning_State_Value: data=bap_bc_mfa_SpeedWarning_State.Value
        DRT_NvBlockSwComponentTypeRunnable_bcme_consumer_available_Value: data=bcme_consumer_available.Value
        DRT_NvBlockSwComponentTypeRunnable_bcme_consumption_unit_Value: data=bcme_consumption_unit.Value
        DRT_NvBlockSwComponentTypeRunnable_consum_correction_electro_Value: data=consum_correction_electro.Value
        DRT_NvBlockSwComponentTypeRunnable_counter_lost_communication_Distance_Value: data=counter_lost_communication_Distance.Value
        DRT_NvBlockSwComponentTypeRunnable_counter_lost_communication_EdgeCount_Value: data=counter_lost_communication_EdgeCount.Value
        DRT_NvBlockSwComponentTypeRunnable_counter_lost_communication_clamp15_Value: data=counter_lost_communication_clamp15.Value
        DRT_NvBlockSwComponentTypeRunnable_counter_lost_communication_time_Value: data=counter_lost_communication_time.Value
        DRT_NvBlockSwComponentTypeRunnable_da_3D_Geschw_verwenden_Value: data=da_3D_Geschw_verwenden.Value
        DRT_NvBlockSwComponentTypeRunnable_da_anzahl_tueren_Value: data=da_anzahl_tueren.Value
        DRT_NvBlockSwComponentTypeRunnable_da_gap_reset_tage_Value: data=da_gap_reset_tage.Value
        DRT_NvBlockSwComponentTypeRunnable_da_gap_tage_Value: data=da_gap_tage.Value
        DRT_NvBlockSwComponentTypeRunnable_da_schalter_genaue_geschw_Value: data=da_schalter_genaue_geschw.Value
        DRT_NvBlockSwComponentTypeRunnable_da_total_distance_pass_jump_Value: data=da_total_distance_pass_jump.Value
        DRT_NvBlockSwComponentTypeRunnable_distance_unit_default_Value: data=distance_unit_default.Value
        DRT_NvBlockSwComponentTypeRunnable_dm_Balance_sheet_jumps_distance_pulse_Value: data=dm_Balance_sheet_jumps_distance_pulse.Value
        DRT_NvBlockSwComponentTypeRunnable_dm_Biggest_negative_jump_distance_pulse_Value: data=dm_Biggest_negative_jump_distance_pulse.Value
        DRT_NvBlockSwComponentTypeRunnable_dm_Biggest_positive_jump_distance_pulse_Value: data=dm_Biggest_positive_jump_distance_pulse.Value
        DRT_NvBlockSwComponentTypeRunnable_dm_Esc_distance_pulse_Value: data=dm_Esc_distance_pulse.Value
        DRT_NvBlockSwComponentTypeRunnable_dm_Longest_communication_failures_ESC_Value: data=dm_Longest_communication_failures_ESC.Value
        DRT_NvBlockSwComponentTypeRunnable_dm_Number_of_communication_failures_ESC_Value: data=dm_Number_of_communication_failures_ESC.Value
        DRT_NvBlockSwComponentTypeRunnable_dm_Number_of_jumps_distance_pulse_Value: data=dm_Number_of_jumps_distance_pulse.Value
        DRT_NvBlockSwComponentTypeRunnable_dm_Sum_jumps_distance_pulse_Value: data=dm_Sum_jumps_distance_pulse.Value
        DRT_NvBlockSwComponentTypeRunnable_dm_TimeStampDay_Value: data=dm_TimeStampDay.Value
        DRT_NvBlockSwComponentTypeRunnable_dm_TimeStampHour_Value: data=dm_TimeStampHour.Value
        DRT_NvBlockSwComponentTypeRunnable_dm_TimeStampMinute_Value: data=dm_TimeStampMinute.Value
        DRT_NvBlockSwComponentTypeRunnable_dm_TimeStampMonth_Value: data=dm_TimeStampMonth.Value
        DRT_NvBlockSwComponentTypeRunnable_dm_TimeStampSecond_Value: data=dm_TimeStampSecond.Value
        DRT_NvBlockSwComponentTypeRunnable_dm_TimeStampYear_Value: data=dm_TimeStampYear.Value
        DRT_NvBlockSwComponentTypeRunnable_dm_Total_duration_communication_failures_ESC_Value: data=dm_Total_duration_communication_failures_ESC.Value
        DRT_NvBlockSwComponentTypeRunnable_dm_error_calculation_dates_Value: data=dm_error_calculation_dates.Value
        DRT_NvBlockSwComponentTypeRunnable_dm_error_secure_storage_AR_Value: data=dm_error_secure_storage_AR.Value
        DRT_NvBlockSwComponentTypeRunnable_dm_total_distance_Value: data=dm_total_distance.Value
        DRT_NvBlockSwComponentTypeRunnable_edv_charge_suppress_Value: data=edv_charge_suppress.Value
        DRT_NvBlockSwComponentTypeRunnable_ego_fahrzeug_Value: data=ego_fahrzeug.Value
        DRT_NvBlockSwComponentTypeRunnable_gap_FIFO_Day_Value: data=gap_FIFO_Day.Value
        DRT_NvBlockSwComponentTypeRunnable_gap_FIFO_Distance_Value: data=gap_FIFO_Distance.Value
        DRT_NvBlockSwComponentTypeRunnable_gap_FIFO_Month_Value: data=gap_FIFO_Month.Value
        DRT_NvBlockSwComponentTypeRunnable_gap_FIFO_NumberResets_Value: data=gap_FIFO_NumberResets.Value
        DRT_NvBlockSwComponentTypeRunnable_gap_FIFO_TimeLastGAP_Value: data=gap_FIFO_TimeLastGAP.Value
        DRT_NvBlockSwComponentTypeRunnable_gap_FIFO_Year_Value: data=gap_FIFO_Year.Value
        DRT_NvBlockSwComponentTypeRunnable_gap_mfa_max_Value: data=gap_mfa_max.Value
        DRT_NvBlockSwComponentTypeRunnable_gap_mfa_min_Value: data=gap_mfa_min.Value
        DRT_NvBlockSwComponentTypeRunnable_gap_tage_default_Value: data=gap_tage_default.Value
        DRT_NvBlockSwComponentTypeRunnable_gap_vorhanden_Value: data=gap_vorhanden.Value
        DRT_NvBlockSwComponentTypeRunnable_gastank_warnung_cng_LED_Value: data=gastank_warnung_cng_LED.Value
        DRT_NvBlockSwComponentTypeRunnable_glaettungsfaktor_g_Value: data=glaettungsfaktor_g.Value
        DRT_NvBlockSwComponentTypeRunnable_hmi_anteil_gas_aktiv_Value: data=hmi_anteil_gas_aktiv.Value
        DRT_NvBlockSwComponentTypeRunnable_hmi_t_RearBelt_Value: data=hmi_t_RearBelt.Value
        DRT_NvBlockSwComponentTypeRunnable_kombi_variante_e_traktion_Value: data=kombi_variante_e_traktion.Value
        DRT_NvBlockSwComponentTypeRunnable_lautstaerke_offset_Value: data=lautstaerke_offset.Value
        DRT_NvBlockSwComponentTypeRunnable_negative_calculations_allowed_Value: data=negative_calculations_allowed.Value
        DRT_NvBlockSwComponentTypeRunnable_offroad_Value: data=offroad.Value
        DRT_NvBlockSwComponentTypeRunnable_p_BR_Systemart_Value: data=p_BR_Systemart.Value
        DRT_NvBlockSwComponentTypeRunnable_p_Bargraph_Luminosity_Calibration_PWM_Value: data=p_Bargraph_Luminosity_Calibration_PWM.Value
        DRT_NvBlockSwComponentTypeRunnable_p_Hmi_TripDistance_Max_Km_Value: data=p_Hmi_TripDistance_Max_Km.Value
        DRT_NvBlockSwComponentTypeRunnable_p_Hmi_TripDistance_Max_Miles_Value: data=p_Hmi_TripDistance_Max_Miles.Value
        DRT_NvBlockSwComponentTypeRunnable_p_Oil_Exceeded_Days_Value: data=p_Oil_Exceeded_Days.Value
        DRT_NvBlockSwComponentTypeRunnable_p_Oil_Exceeded_Km_Value: data=p_Oil_Exceeded_Km.Value
        DRT_NvBlockSwComponentTypeRunnable_p_PWM_DampingCurve_Value: data=p_PWM_DampingCurve.Value
        DRT_NvBlockSwComponentTypeRunnable_p_Perso_NumberOfUserProfiles_Value: data=p_Perso_NumberOfUserProfiles.Value
        DRT_NvBlockSwComponentTypeRunnable_p_canrw_initzeit_Value: data=p_canrw_initzeit.Value
        DRT_NvBlockSwComponentTypeRunnable_p_kilometerstand_last_value_Value: data=p_kilometerstand_last_value.Value
        DRT_NvBlockSwComponentTypeRunnable_p_kilometerstand_last_value_obsolete_Value: data=p_kilometerstand_last_value_obsolete.Value
        DRT_NvBlockSwComponentTypeRunnable_p_mute_delay_Value: data=p_mute_delay.Value
        DRT_NvBlockSwComponentTypeRunnable_personalisation_2x_active_Value: data=personalisation_2x_active.Value
        DRT_NvBlockSwComponentTypeRunnable_primary_engine_type_Value: data=primary_engine_type.Value
        DRT_NvBlockSwComponentTypeRunnable_rawVIN_lastmode_Value: data=rawVIN_lastmode.Value
        DRT_NvBlockSwComponentTypeRunnable_rawVin_change_in_clamp15_lastmode_Value: data=rawVin_change_in_clamp15_lastmode.Value
        DRT_NvBlockSwComponentTypeRunnable_rw_calc_time_Value: data=rw_calc_time.Value
        DRT_NvBlockSwComponentTypeRunnable_rw_fahrzg_faehrt_Value: data=rw_fahrzg_faehrt.Value
        DRT_NvBlockSwComponentTypeRunnable_rw_fahrzg_steht_Value: data=rw_fahrzg_steht.Value
        DRT_NvBlockSwComponentTypeRunnable_secondary_engine_type_Value: data=secondary_engine_type.Value
        DRT_NvBlockSwComponentTypeRunnable_size_n_Value: data=size_n.Value
        DRT_NvBlockSwComponentTypeRunnable_skinning_Value: data=skinning.Value
        DRT_NvBlockSwComponentTypeRunnable_sperrung_AnzahlListeneintraege_Value: data=sperrung_AnzahlListeneintraege.Value
        DRT_NvBlockSwComponentTypeRunnable_sperrung_CarDecorator_Value: data=sperrung_CarDecorator.Value
        DRT_NvBlockSwComponentTypeRunnable_sperrung_Karte_Value: data=sperrung_Karte.Value
        DRT_NvBlockSwComponentTypeRunnable_sperrung_NPSCoverIntensitaet_Value: data=sperrung_NPSCoverIntensitaet.Value
        DRT_NvBlockSwComponentTypeRunnable_sperrung_PiloFahrt_Value: data=sperrung_PiloFahrt.Value
        DRT_NvBlockSwComponentTypeRunnable_sperrung_bedienunterstuetzende_animationen_Value: data=sperrung_bedienunterstuetzende_animationen.Value
        DRT_NvBlockSwComponentTypeRunnable_sperrung_dynamische_bilder_Value: data=sperrung_dynamische_bilder.Value
        DRT_NvBlockSwComponentTypeRunnable_sperrung_funktionale_animationen_Value: data=sperrung_funktionale_animationen.Value
        DRT_NvBlockSwComponentTypeRunnable_sperrung_funktionslisten_Value: data=sperrung_funktionslisten.Value
        DRT_NvBlockSwComponentTypeRunnable_sperrung_infotainmentlisten_Value: data=sperrung_infotainmentlisten.Value
        DRT_NvBlockSwComponentTypeRunnable_sperrung_listentimeout_Value: data=sperrung_listentimeout.Value
        DRT_NvBlockSwComponentTypeRunnable_sperrung_mfa_anzeigen_Value: data=sperrung_mfa_anzeigen.Value
        DRT_NvBlockSwComponentTypeRunnable_sperrung_schmuckanimationen_Value: data=sperrung_schmuckanimationen.Value
        DRT_NvBlockSwComponentTypeRunnable_sperrung_systemzustandsanimationen_Value: data=sperrung_systemzustandsanimationen.Value
        DRT_NvBlockSwComponentTypeRunnable_sport_Value: data=sport.Value
        DRT_NvBlockSwComponentTypeRunnable_t_Celeb_Pause_Until_EndDim_Scale_Value: data=t_Celeb_Pause_Until_EndDim_Scale.Value
        DRT_NvBlockSwComponentTypeRunnable_t_DisplayDelay_KL15Off_Value: data=t_DisplayDelay_KL15Off.Value
        DRT_NvBlockSwComponentTypeRunnable_t_DisplayDelay_KL15On_Value: data=t_DisplayDelay_KL15On.Value
        DRT_NvBlockSwComponentTypeRunnable_t_Max_Delay_CLWError_Value: data=t_Max_Delay_CLWError.Value
        DRT_NvBlockSwComponentTypeRunnable_tachoendwert_Value: data=tachoendwert.Value
        DRT_NvBlockSwComponentTypeRunnable_total_distance_jump_is_valid_Value: data=total_distance_jump_is_valid.Value
        DRT_NvBlockSwComponentTypeRunnable_total_distance_pass_jump_Value: data=total_distance_pass_jump.Value
        DRT_NvBlockSwComponentTypeRunnable_total_distance_pass_jump_lastmode_Value: data=total_distance_pass_jump_lastmode.Value
        DRT_NvBlockSwComponentTypeRunnable_total_distance_sum_implaus_jump_high_ESP_Value: data=total_distance_sum_implaus_jump_high_ESP.Value
        DRT_NvBlockSwComponentTypeRunnable_total_distance_sum_implaus_jump_low_ESP_Value: data=total_distance_sum_implaus_jump_low_ESP.Value
        DRT_NvBlockSwComponentTypeRunnable_tuben_darstellung_Value: data=tuben_darstellung.Value
        DRT_NvBlockSwComponentTypeRunnable_vehicle_type_Value: data=vehicle_type.Value
        DRT_NvBlockSwComponentTypeRunnable_verlassenswarnung_VWN_Value: data=verlassenswarnung_VWN.Value
        DRT_NvBlockSwComponentTypeRunnable_vkmrw_Verbrauchsaequivalent_Value: data=vkmrw_Verbrauchsaequivalent.Value
        DRT_NvBlockSwComponentTypeRunnable_vkmrw_Verbrauchsaequivalent_ein_Value: data=vkmrw_Verbrauchsaequivalent_ein.Value
        DRT_NvBlockSwComponentTypeRunnable_vkmrw_gesamtreichweite_vorhanden_Value: data=vkmrw_gesamtreichweite_vorhanden.Value
        DRT_NvBlockSwComponentTypeRunnable_vkmrw_rwdv_cng_default_Value: data=vkmrw_rwdv_cng_default.Value
        DRT_NvBlockSwComponentTypeRunnable_vkmrw_rwdv_lpg_default_Value: data=vkmrw_rwdv_lpg_default.Value
        DRT_NvBlockSwComponentTypeRunnable_vkmrw_verbrauchsfaktor_kombi_Value: data=vkmrw_verbrauchsfaktor_kombi.Value
        DRT_NvBlockSwComponentTypeRunnable_wheel_circumference_lastmode_Value: data=wheel_circumference_lastmode.Value
        DRT_NvBlockSwComponentTypeRunnable_zIniSwVer_COMPONENTS_Cfg_CONST_Value: data=zIniSwVer_COMPONENTS_Cfg_CONST.Value
        DRT_NvBlockSwComponentTypeRunnable_zIniSwVer_DIAG_VariantCoding_CONST_Value: data=zIniSwVer_DIAG_VariantCoding_CONST.Value
        DRT_NvBlockSwComponentTypeRunnable_zIniSwVer_Value: data=zIniSwVer.Value
        DRT_NvBlockSwComponentTypeRunnable_zReservedAligmnet_DIAG_EOL_HWCalib_CONST_Value: data=zReservedAligmnet_DIAG_EOL_HWCalib_CONST.Value
        DRT_NvBlockSwComponentTypeRunnable_zReserved_1_COMPONENTS_Cfg_CONST_Value: data=zReserved_1_COMPONENTS_Cfg_CONST.Value
        DRT_NvBlockSwComponentTypeRunnable_zReserved_1_COMPONENTS_Cfg_VAR_Value: data=zReserved_1_COMPONENTS_Cfg_VAR.Value
        DRT_NvBlockSwComponentTypeRunnable_zReserved_1_Com_Cfg_VAR_Value: data=zReserved_1_Com_Cfg_VAR.Value
        DRT_NvBlockSwComponentTypeRunnable_zReserved_1_DIAG_EOL_DiagCfg_CONST_Value: data=zReserved_1_DIAG_EOL_DiagCfg_CONST.Value
        DRT_NvBlockSwComponentTypeRunnable_zReserved_1_DIAG_VariantCodingCheck_CONST_Value: data=zReserved_1_DIAG_VariantCodingCheck_CONST.Value
        DRT_NvBlockSwComponentTypeRunnable_zReserved_1_DIAG_VariantCoding_CONST_Value: data=zReserved_1_DIAG_VariantCoding_CONST.Value
        DRT_NvBlockSwComponentTypeRunnable_zReserved_2_DIAG_VariantCodingCheck_CONST_Value: data=zReserved_2_DIAG_VariantCodingCheck_CONST.Value
        DRT_NvBlockSwComponentTypeRunnable_zReserved_2_TANK_Variant_CONST_Value: data=zReserved_2_TANK_Variant_CONST.Value
        DRT_NvBlockSwComponentTypeRunnable_zReserved_3_TANK_Variant_CONST_Value: data=zReserved_3_TANK_Variant_CONST.Value
        DRT_NvBlockSwComponentTypeRunnable_zReserved_Bcct_Cfg_VAR_1_Value: data=zReserved_Bcct_Cfg_VAR_1.Value
        DRT_NvBlockSwComponentTypeRunnable_zReserved_CAN_VAR_Value: data=zReserved_CAN_VAR.Value
        DRT_NvBlockSwComponentTypeRunnable_zReserved_COMPONENTS_Cfg_CONST_Value: data=zReserved_COMPONENTS_Cfg_CONST.Value
        DRT_NvBlockSwComponentTypeRunnable_zReserved_COMPONENTS_Cfg_VAR_Value: data=zReserved_COMPONENTS_Cfg_VAR.Value
        DRT_NvBlockSwComponentTypeRunnable_zReserved_Cluster_Settings_Value: data=zReserved_Cluster_Settings.Value
        DRT_NvBlockSwComponentTypeRunnable_zReserved_Com_Cfg_VAR_Value: data=zReserved_Com_Cfg_VAR.Value
        DRT_NvBlockSwComponentTypeRunnable_zReserved_DEV_Messages_Value: data=zReserved_DEV_Messages.Value
        DRT_NvBlockSwComponentTypeRunnable_zReserved_DIAG_AC_IlluminationCfg_1_VAR_Value: data=zReserved_DIAG_AC_IlluminationCfg_1_VAR.Value
        DRT_NvBlockSwComponentTypeRunnable_zReserved_DIAG_AC_ServiceCfg_VAR_Value: data=zReserved_DIAG_AC_ServiceCfg_VAR.Value
        DRT_NvBlockSwComponentTypeRunnable_zReserved_DIAG_AdaptationChannel_VAR_2_Value: data=zReserved_DIAG_AdaptationChannel_VAR_2.Value
        DRT_NvBlockSwComponentTypeRunnable_zReserved_DIAG_EOL_DiagCfg_CONST_Value: data=zReserved_DIAG_EOL_DiagCfg_CONST.Value
        DRT_NvBlockSwComponentTypeRunnable_zReserved_DIAG_EOL_HWCalib_CONST_1_Value: data=zReserved_DIAG_EOL_HWCalib_CONST_1.Value
        DRT_NvBlockSwComponentTypeRunnable_zReserved_DIAG_EOL_HWCalib_CONST_Value: data=zReserved_DIAG_EOL_HWCalib_CONST.Value
        DRT_NvBlockSwComponentTypeRunnable_zReserved_DIAG_EOL_VAR_Value: data=zReserved_DIAG_EOL_VAR.Value
        DRT_NvBlockSwComponentTypeRunnable_zReserved_DIAG_VariantCodingCheck_CONST_Value: data=zReserved_DIAG_VariantCodingCheck_CONST.Value
        DRT_NvBlockSwComponentTypeRunnable_zReserved_DIAG_VariantCoding_CONST_Handle_Value: data=zReserved_DIAG_VariantCoding_CONST_Handle.Value
        DRT_NvBlockSwComponentTypeRunnable_zReserved_Diag_Adjustment_VAR_Value: data=zReserved_Diag_Adjustment_VAR.Value
        DRT_NvBlockSwComponentTypeRunnable_zReserved_Gamma_Adjustment_VAR_Value: data=zReserved_Gamma_Adjustment_VAR.Value
        DRT_NvBlockSwComponentTypeRunnable_zReserved_Nvm_Block_Reserved_1_Value: data=zReserved_Nvm_Block_Reserved_1.Value
        DRT_NvBlockSwComponentTypeRunnable_zReserved_Nvm_Block_Reserved_4_Value: data=zReserved_Nvm_Block_Reserved_4.Value
        DRT_NvBlockSwComponentTypeRunnable_zReserved_OperatingTime_VAR_Value: data=zReserved_OperatingTime_VAR.Value
        DRT_NvBlockSwComponentTypeRunnable_zReserved_REFUEL_Logger_VAR_Value: data=zReserved_REFUEL_Logger_VAR.Value
        DRT_NvBlockSwComponentTypeRunnable_zReserved_RGB_Calibration_VAR_Value: data=zReserved_RGB_Calibration_VAR.Value
        DRT_NvBlockSwComponentTypeRunnable_zReserved_Recorder_VAR_2_Value: data=zReserved_Recorder_VAR_2.Value
        DRT_NvBlockSwComponentTypeRunnable_zReserved_Recorder_VAR_Value: data=zReserved_Recorder_VAR.Value
        DRT_NvBlockSwComponentTypeRunnable_zReserved_SAFETY_RECORD_VAR_Value: data=zReserved_SAFETY_RECORD_VAR.Value
        DRT_NvBlockSwComponentTypeRunnable_zReserved_SecDiag_Value: data=zReserved_SecDiag.Value
        DRT_NvBlockSwComponentTypeRunnable_zReserved_ServiceKey_VAR_Value: data=zReserved_ServiceKey_VAR.Value
        DRT_NvBlockSwComponentTypeRunnable_zReserved_WLTP_Odo_Value: data=zReserved_WLTP_Odo.Value
        DRT_NvBlockSwComponentTypeRunnable_zReserveed_Bcct_Cfg_VAR_2_Value: data=zReserveed_Bcct_Cfg_VAR_2.Value
        DRT_NvBlockSwComponentTypeRunnable_zweitgeschwindigkeit_einheitenwechsel_Value: data=zweitgeschwindigkeit_einheitenwechsel.Value
      runnable NvBlockSwComponentTypeRunnable
    94 x nv block descriptor, all with support-dirty-flag=true:
      NVBlockDescriptor_Bargraph_Hysteresis_Coolant: client-server-ports=role-based-port-assignment={port-prototype=Bargraph_Hysteresis_Coolant_NvM_JobFinished, role=Bargraph_Hysteresis_Coolant_NvM_JobFinished}, nv-block-data-mapping{nv-ram-block-element=autosar-variable-in-impl-datatype=Bargraph_Hysteresis_Coolant, written-read-nv-data=Bargraph_Hysteresis_Coolant.Value}
        nv block needs NVNeed_NVBlockDescriptor: n-data-sets=2, ram-block-status-control=API, reliability=NO-PROTECTION, restore-at-start=true, store-at-shutdown=false, store-immediate=true, write-verification=false
        ram block RAM_NVBlockDescriptor_Bargraph_Hysteresis_Coolant: type=NV_Data_Bargraph_Hysteresis_Coolant, init-value=fields=Bargraph_Hysteresis_Coolant:15 x 1
        rom block ROM_NVBlockDescriptor_Bargraph_Hysteresis_Coolant: sw-calibration-access=READ-WRITE, type=NV_Data_Bargraph_Hysteresis_Coolant, init-value=fields=Bargraph_Hysteresis_Coolant:15 x 1
      NVBlockDescriptor_Bargraph_Treshold_Switch_Coolant: client-server-ports=role-based-port-assignment={port-prototype=Bargraph_Treshold_Switch_Coolant_NvM_JobFinished, role=Bargraph_Treshold_Switch_Coolant_NvM_JobFinished}, nv-block-data-mapping{nv-ram-block-element=autosar-variable-in-impl-datatype=Bargraph_Treshold_Switch_Coolant, written-read-nv-data=Bargraph_Treshold_Switch_Coolant.Value}
        nv block needs NVNeed_NVBlockDescriptor: n-data-sets=2, ram-block-status-control=API, reliability=NO-PROTECTION, restore-at-start=true, store-at-shutdown=false, store-immediate=true, write-verification=false
        ram block RAM_NVBlockDescriptor_Bargraph_Treshold_Switch_Coolant: type=NV_Data_Bargraph_Treshold_Switch_Coolant, init-value=fields=Bargraph_Treshold_Switch_Coolant:[66, 66, 89, 89, 101, 101, 113, 113, 125, 125, 137, 137, 149, 149, 161]
        rom block ROM_NVBlockDescriptor_Bargraph_Treshold_Switch_Coolant: sw-calibration-access=READ-WRITE, type=NV_Data_Bargraph_Treshold_Switch_Coolant, init-value=fields=Bargraph_Treshold_Switch_Coolant:[66, 66, 89, 89, 101, 101, 113, 113, 125, 125, 137, 137, 149, 149, 161]
      NVBlockDescriptor_Bargraph_VAR: client-server-ports=role-based-port-assignment={port-prototype=Bargraph_VAR_NvM_JobFinished, role=Bargraph_VAR_NvM_JobFinished}
        nv-block-data-mappings:
          nv-ram-block-element=autosar-variable-in-impl-datatype=DisplayDamping_On_Bargraph_Tank, written-read-nv-data=DisplayDamping_On_Bargraph_Tank.Value
          nv-ram-block-element=autosar-variable-in-impl-datatype=DisplayDamping_Off_Bargraph_Tank, written-read-nv-data=DisplayDamping_Off_Bargraph_Tank.Value
          nv-ram-block-element=autosar-variable-in-impl-datatype=Reserved_1_Bargraph_VAR, written-read-nv-data=Reserved_1_Bargraph_VAR.Value
          nv-ram-block-element=autosar-variable-in-impl-datatype=Old_Tank_Warning_Other_State_do_not_use, written-read-nv-data=Old_Tank_Warning_Other_State_do_not_use.Value
          nv-ram-block-element=autosar-variable-in-impl-datatype=Bargraph_Primary_Engine_Type, written-read-nv-data=Bargraph_Primary_Engine_Type.Value
          nv-ram-block-element=autosar-variable-in-impl-datatype=Bargraph_Secondary_Engine_Type, written-read-nv-data=Bargraph_Secondary_Engine_Type.Value
          nv-ram-block-element=autosar-variable-in-impl-datatype=Damping_Indic_Coolnt_Bargrph_ON, written-read-nv-data=Damping_Indic_Coolnt_Bargrph_ON.Value
          nv-ram-block-element=autosar-variable-in-impl-datatype=Damping_Indic_Coolnt_Bargrph_OFF, written-read-nv-data=Damping_Indic_Coolnt_Bargrph_OFF.Value
          nv-ram-block-element=autosar-variable-in-impl-datatype=Zreserved_Bargraph_VAR, written-read-nv-data=Zreserved_Bargraph_VAR.Value
        nv block needs NVNeed_NVBlockDescriptor: n-data-sets=2, ram-block-status-control=API, reliability=NO-PROTECTION, restore-at-start=true, store-at-shutdown=false, store-immediate=true, write-verification=false
        ram block RAM_NVBlockDescriptor_Bargraph_VAR: type=NV_Data_Bargraph_VAR, init-value=fields=[DisplayDamping_On_Bargraph_Tank:4, DisplayDamping_Off_Bargraph_Tank:4, Reserved_1_Bargraph_VAR:0, Old_Tank_Warning_Other_State_do_not_use:1, Bargraph_Primary_Engine_Type:1, Bargraph_Secondary_Engine_Type:0, Damping_Indic_Coolnt_Bargrph_ON:4, Damping_Indic_Coolnt_Bargrph_OFF:4, Zreserved_Bargraph_VAR:12 x 255]
        rom block ROM_NVBlockDescriptor_Bargraph_VAR: sw-calibration-access=READ-WRITE, type=NV_Data_Bargraph_VAR, init-value=fields=[DisplayDamping_On_Bargraph_Tank:4, DisplayDamping_Off_Bargraph_Tank:4, Reserved_1_Bargraph_VAR:0, Old_Tank_Warning_Other_State_do_not_use:1, Bargraph_Primary_Engine_Type:1, Bargraph_Secondary_Engine_Type:0, Damping_Indic_Coolnt_Bargrph_ON:4, Damping_Indic_Coolnt_Bargrph_OFF:4, Zreserved_Bargraph_VAR:12 x 255]
      NVBlockDescriptor_Bcct_Cfg_VAR_1: client-server-ports=role-based-port-assignment={port-prototype=Bcct_Cfg_VAR_1_NvM_JobFinished, role=Bcct_Cfg_VAR_1_NvM_JobFinished}
        nv-block-data-mappings:
          nv-ram-block-element=autosar-variable-in-impl-datatype=RGB_Color_Calibration_PWM_AmbientLight_X, written-read-nv-data=RGB_Color_Calibration_PWM_AmbientLight_X.Value
          nv-ram-block-element=autosar-variable-in-impl-datatype=zReserved_Bcct_Cfg_VAR_1, written-read-nv-data=zReserved_Bcct_Cfg_VAR_1.Value
        nv block needs NVNeed_NVBlockDescriptor: n-data-sets=2, ram-block-status-control=API, reliability=NO-PROTECTION, restore-at-start=true, store-at-shutdown=false, store-immediate=true, write-verification=false
        ram block RAM_NVBlockDescriptor_Bcct_Cfg_VAR_1: type=NV_Data_Bcct_Cfg_VAR_1, init-value=fields=[RGB_Color_Calibration_PWM_AmbientLight_X:[11534144, 16448170, 15073280, 15098910, 15114270, 16760320, 15132160, 13823499, 13827840, 11206420, 3997470, 60190, 60270, 3342220, 57760, 57800, 51455, 41215, 30975, 678655, 1976575, 4267775, 7872255, 12787455, 14418175, 16711935, 16711795, 16722010, 16734790, 15756900], zReserved_Bcct_Cfg_VAR_1:[255, 255, 255, 255]]
        rom block ROM_NVBlockDescriptor_Bcct_Cfg_VAR_1:
          sw-calibration-access=READ-WRITE
          type=NV_Data_Bcct_Cfg_VAR_1
          init-value=fields=[RGB_Color_Calibration_PWM_AmbientLight_X:[11534144, 16448170, 15073280, 15098910, 15114270, 16760320, 15132160, 13823499, 13827840, 11206420, 3997470, 60190, 60270, 3342220, 57760, 57800, 51455, 41215, 30975, 678655, 1976575, 4267775, 7872255, 12787455, 14418175, 16711935, 16711795, 16722010, 16734790, 15756900], zReserved_Bcct_Cfg_VAR_1:[255, 255, 255, 255]]
      NVBlockDescriptor_Bcct_Cfg_VAR_2: client-server-ports=role-based-port-assignment={port-prototype=Bcct_Cfg_VAR_2_NvM_JobFinished, role=Bcct_Cfg_VAR_2_NvM_JobFinished}
        nv-block-data-mappings:
          nv-ram-block-element=autosar-variable-in-impl-datatype=BCCT_Lookup_Curve_AmbientLight_Dimming_Coef_X, written-read-nv-data=BCCT_Lookup_Curve_AmbientLight_Dimming_Coef_X.Value
          nv-ram-block-element=autosar-variable-in-impl-datatype=BCCT_Lookup_Curve_AmbientLight_Dimming_Coef_Y, written-read-nv-data=BCCT_Lookup_Curve_AmbientLight_Dimming_Coef_Y.Value
          nv-ram-block-element=autosar-variable-in-impl-datatype=BCCT_Lookup_Curve_AmbientLight_Left_Temp_Coef_X, written-read-nv-data=BCCT_Lookup_Curve_AmbientLight_Left_Temp_Coef_X.Value
          nv-ram-block-element=autosar-variable-in-impl-datatype=BCCT_Lookup_Curve_AmbientLight_Left_Temp_Coef_Y, written-read-nv-data=BCCT_Lookup_Curve_AmbientLight_Left_Temp_Coef_Y.Value
          nv-ram-block-element=autosar-variable-in-impl-datatype=BCCT_Lookup_Curve_AmbientLight_Right_Temp_Coef_X, written-read-nv-data=BCCT_Lookup_Curve_AmbientLight_Right_Temp_Coef_X.Value
          nv-ram-block-element=autosar-variable-in-impl-datatype=BCCT_Lookup_Curve_AmbientLight_Right_Temp_Coef_Y, written-read-nv-data=BCCT_Lookup_Curve_AmbientLight_Right_Temp_Coef_Y.Value
          nv-ram-block-element=autosar-variable-in-impl-datatype=BCCT_Temperature_Sensor_AmbientLight_Conv_X, written-read-nv-data=BCCT_Temperature_Sensor_AmbientLight_Conv_X.Value
          nv-ram-block-element=autosar-variable-in-impl-datatype=BCCT_Temperature_Sensor_AmbientLight_Conv_Y, written-read-nv-data=BCCT_Temperature_Sensor_AmbientLight_Conv_Y.Value
          nv-ram-block-element=autosar-variable-in-impl-datatype=zReserveed_Bcct_Cfg_VAR_2, written-read-nv-data=zReserveed_Bcct_Cfg_VAR_2.Value
        nv block needs NVNeed_NVBlockDescriptor: n-data-sets=2, ram-block-status-control=API, reliability=NO-PROTECTION, restore-at-start=true, store-at-shutdown=false, store-immediate=true, write-verification=false
        ram block RAM_NVBlockDescriptor_Bcct_Cfg_VAR_2: type=NV_Data_Bcct_Cfg_VAR_2, init-value=fields=[BCCT_Lookup_Curve_AmbientLight_Dimming_Coef_X:[0, 10, 50, 100, 150, 253], BCCT_Lookup_Curve_AmbientLight_Dimming_Coef_Y:[1, 1, 7, 14, 30, 100], BCCT_Lookup_Curve_AmbientLight_Left_Temp_Coef_X:[216, 0, 32, 64, 96, 125], BCCT_Lookup_Curve_AmbientLight_Left_Temp_Coef_Y:6 x 100, BCCT_Lookup_Curve_AmbientLight_Right_Temp_Coef_X:[216, 0, 32, 64, 96, 125], BCCT_Lookup_Curve_AmbientLight_Right_Temp_Coef_Y:6 x 100, BCCT_Temperature_Sensor_AmbientLight_Conv_X:[1624, 1663, 1702, 1741, 1780, 1820, 1859, 1899, 1938, 1977, 2016, 2049, 2081, 2112, 2144, 2175, 2206, 2237, 2267, 2297, 2327, 2356, 2385, 2414, 2442, 2470, 2498, 2525, 2552, 2579, 2605, 2631], BCCT_Temperature_Sensor_AmbientLight_Conv_Y:[216, 222, 228, 234, 240, 246, 252, 2, 8, 14, 20, 25, 30, 35, 40, 45, 50, 55, 60, 65, 70, 75, 80, 85, 90, 95, 100, 105, 110, 115, 120, 125], zReserveed_Bcct_Cfg_VAR_2:8 x 255]
        rom block ROM_NVBlockDescriptor_Bcct_Cfg_VAR_2:
          sw-calibration-access=READ-WRITE
          type=NV_Data_Bcct_Cfg_VAR_2
          init-value=fields=[BCCT_Lookup_Curve_AmbientLight_Dimming_Coef_X:[0, 10, 50, 100, 150, 253], BCCT_Lookup_Curve_AmbientLight_Dimming_Coef_Y:[1, 1, 7, 14, 30, 100], BCCT_Lookup_Curve_AmbientLight_Left_Temp_Coef_X:[216, 0, 32, 64, 96, 125], BCCT_Lookup_Curve_AmbientLight_Left_Temp_Coef_Y:6 x 100, BCCT_Lookup_Curve_AmbientLight_Right_Temp_Coef_X:[216, 0, 32, 64, 96, 125], BCCT_Lookup_Curve_AmbientLight_Right_Temp_Coef_Y:6 x 100, BCCT_Temperature_Sensor_AmbientLight_Conv_X:[1624, 1663, 1702, 1741, 1780, 1820, 1859, 1899, 1938, 1977, 2016, 2049, 2081, 2112, 2144, 2175, 2206, 2237, 2267, 2297, 2327, 2356, 2385, 2414, 2442, 2470, 2498, 2525, 2552, 2579, 2605, 2631], BCCT_Temperature_Sensor_AmbientLight_Conv_Y:[216, 222, 228, 234, 240, 246, 252, 2, 8, 14, 20, 25, 30, 35, 40, 45, 50, 55, 60, 65, 70, 75, 80, 85, 90, 95, 100, 105, 110, 115, 120, 125], zReserveed_Bcct_Cfg_VAR_2:8 x 255]
      NVBlockDescriptor_Bcct_Cfg_VAR_3: client-server-ports=role-based-port-assignment={port-prototype=Bcct_Cfg_VAR_3_NvM_JobFinished, role=Bcct_Cfg_VAR_3_NvM_JobFinished}, nv-block-data-mapping{nv-ram-block-element=autosar-variable-in-impl-datatype=RGB_Color_Calibration_PWM_AmbientLight_Y_Display, written-read-nv-data=RGB_Color_Calibration_PWM_AmbientLight_Y_Display.Value}
        nv block needs NVNeed_NVBlockDescriptor: n-data-sets=2, ram-block-status-control=API, reliability=NO-PROTECTION, restore-at-start=true, store-at-shutdown=false, store-immediate=true, write-verification=false
        ram block RAM_NVBlockDescriptor_Bcct_Cfg_VAR_3: type=NV_Data_Bcct_Cfg_VAR_3, init-value=fields=RGB_Color_Calibration_PWM_AmbientLight_Y_Display:[1976575, 16448170, 15073280, 15098910, 15114270, 16760320, 15132160, 13823499, 13827840, 11206420, 3997470, 60190, 60270, 3342220, 57760, 57800, 51455, 41215, 30975, 678655, 1976575, 4267775, 7872255, 12787455, 14418175, 16711935, 16711795, 16722010, 16734790, 15756900]
        rom block ROM_NVBlockDescriptor_Bcct_Cfg_VAR_3: sw-calibration-access=READ-WRITE, type=NV_Data_Bcct_Cfg_VAR_3, init-value=fields=RGB_Color_Calibration_PWM_AmbientLight_Y_Display:[1976575, 16448170, 15073280, 15098910, 15114270, 16760320, 15132160, 13823499, 13827840, 11206420, 3997470, 60190, 60270, 3342220, 57760, 57800, 51455, 41215, 30975, 678655, 1976575, 4267775, 7872255, 12787455, 14418175, 16711935, 16711795, 16722010, 16734790, 15756900]
      NVBlockDescriptor_CAN_VAR: client-server-ports=role-based-port-assignment={port-prototype=CAN_VAR_NvM_JobFinished, role=CAN_VAR_NvM_JobFinished}
        nv-block-data-mappings:
          nv-ram-block-element=autosar-variable-in-impl-datatype=CanBusActive, written-read-nv-data=CanBusActive.Value
          nv-ram-block-element=autosar-variable-in-impl-datatype=zReserved_CAN_VAR, written-read-nv-data=zReserved_CAN_VAR.Value
        nv block needs NVNeed_NVBlockDescriptor: n-data-sets=2, ram-block-status-control=API, reliability=NO-PROTECTION, restore-at-start=true, store-at-shutdown=false, store-immediate=true, write-verification=false
        ram block RAM_NVBlockDescriptor_CAN_VAR: type=NV_Data_CAN_VAR, init-value=fields=[CanBusActive:0, zReserved_CAN_VAR:[255, 255, 255]]
        rom block ROM_NVBlockDescriptor_CAN_VAR: sw-calibration-access=READ-WRITE, type=NV_Data_CAN_VAR, init-value=fields=[CanBusActive:0, zReserved_CAN_VAR:[255, 255, 255]]
      NVBlockDescriptor_COMPONENTS_Cfg_CONST: client-server-ports=role-based-port-assignment={port-prototype=COMPONENTS_Cfg_CONST_NvM_JobFinished, role=COMPONENTS_Cfg_CONST_NvM_JobFinished}
        nv-block-data-mappings:
          nv-ram-block-element=autosar-variable-in-impl-datatype=Brightness_Photosensor_Cal_Init, written-read-nv-data=Brightness_Photosensor_Cal_Init.Value
          nv-ram-block-element=autosar-variable-in-impl-datatype=Cluster_Variant_Canada, written-read-nv-data=Cluster_Variant_Canada.Value
          nv-ram-block-element=autosar-variable-in-impl-datatype=Brightness_Photosensor_Damp_Dimm_Down, written-read-nv-data=Brightness_Photosensor_Damp_Dimm_Down.Value
          nv-ram-block-element=autosar-variable-in-impl-datatype=Brightness_Photosensor_Damp_Dimm_Up, written-read-nv-data=Brightness_Photosensor_Damp_Dimm_Up.Value
          nv-ram-block-element=autosar-variable-in-impl-datatype=COMPONENTS_Cfg_CONST_Safety_CRC, written-read-nv-data=COMPONENTS_Cfg_CONST_Safety_CRC.Value
          nv-ram-block-element=autosar-variable-in-impl-datatype=RunIn_FinalPointerPositions, written-read-nv-data=RunIn_FinalPointerPositions.Value
          nv-ram-block-element=autosar-variable-in-impl-datatype=SpeedFastReading_X, written-read-nv-data=SpeedFastReading_X.Value
          nv-ram-block-element=autosar-variable-in-impl-datatype=SpeedFastReading_Y, written-read-nv-data=SpeedFastReading_Y.Value
          nv-ram-block-element=autosar-variable-in-impl-datatype=BAP_BC_MFA_FSG_Setup_Status_PrimaryEngineType, written-read-nv-data=BAP_BC_MFA_FSG_Setup_Status_PrimaryEngineType.Value
          nv-ram-block-element=autosar-variable-in-impl-datatype=Brand_Info, written-read-nv-data=Brand_Info.Value
          nv-ram-block-element=autosar-variable-in-impl-datatype=Cluster_Variant, written-read-nv-data=Cluster_Variant.Value
          nv-ram-block-element=autosar-variable-in-impl-datatype=Cluster_Variant_ASIA, written-read-nv-data=Cluster_Variant_ASIA.Value
          nv-ram-block-element=autosar-variable-in-impl-datatype=Cluster_Variant_CHINA, written-read-nv-data=Cluster_Variant_CHINA.Value
          nv-ram-block-element=autosar-variable-in-impl-datatype=Cluster_Variant_USA, written-read-nv-data=Cluster_Variant_USA.Value
          nv-ram-block-element=autosar-variable-in-impl-datatype=Display_Type, written-read-nv-data=Display_Type.Value
          nv-ram-block-element=autosar-variable-in-impl-datatype=ego_fahrzeug, written-read-nv-data=ego_fahrzeug.Value
          nv-ram-block-element=autosar-variable-in-impl-datatype=Fuel_Consumption_Min, written-read-nv-data=Fuel_Consumption_Min.Value
          nv-ram-block-element=autosar-variable-in-impl-datatype=zReserved_COMPONENTS_Cfg_CONST, written-read-nv-data=zReserved_COMPONENTS_Cfg_CONST.Value
          nv-ram-block-element=autosar-variable-in-impl-datatype=Photosensor_available, written-read-nv-data=Photosensor_available.Value
          nv-ram-block-element=autosar-variable-in-impl-datatype=RunIn_FuelADC_Max, written-read-nv-data=RunIn_FuelADC_Max.Value
          nv-ram-block-element=autosar-variable-in-impl-datatype=RunIn_FuelADC_Min, written-read-nv-data=RunIn_FuelADC_Min.Value
          nv-ram-block-element=autosar-variable-in-impl-datatype=Service_Early_Warning_Prediction, written-read-nv-data=Service_Early_Warning_Prediction.Value
          nv-ram-block-element=autosar-variable-in-impl-datatype=t_Max_Delay_CLWError, written-read-nv-data=t_Max_Delay_CLWError.Value
          nv-ram-block-element=autosar-variable-in-impl-datatype=Analog_CoolantTemperature_Available, written-read-nv-data=Analog_CoolantTemperature_Available.Value
          nv-ram-block-element=autosar-variable-in-impl-datatype=Cluster_Variant_FBU, written-read-nv-data=Cluster_Variant_FBU.Value
          nv-ram-block-element=autosar-variable-in-impl-datatype=Immo_Individual_Schluessel_Fahrberecht, written-read-nv-data=Immo_Individual_Schluessel_Fahrberecht.Value
          nv-ram-block-element=autosar-variable-in-impl-datatype=LIM_Display_Available, written-read-nv-data=LIM_Display_Available.Value
          nv-ram-block-element=autosar-variable-in-impl-datatype=OutsideTemperature_Exclusive_DisplayArea, written-read-nv-data=OutsideTemperature_Exclusive_DisplayArea.Value
          nv-ram-block-element=autosar-variable-in-impl-datatype=SWA_Telltales_Installed, written-read-nv-data=SWA_Telltales_Installed.Value
          nv-ram-block-element=autosar-variable-in-impl-datatype=UnintendedMovement, written-read-nv-data=UnintendedMovement.Value
          nv-ram-block-element=autosar-variable-in-impl-datatype=Unit_SpeedoScale, written-read-nv-data=Unit_SpeedoScale.Value
          nv-ram-block-element=autosar-variable-in-impl-datatype=p_canrw_initzeit, written-read-nv-data=p_canrw_initzeit.Value
          nv-ram-block-element=autosar-variable-in-impl-datatype=p_Perso_NumberOfUserProfiles, written-read-nv-data=p_Perso_NumberOfUserProfiles.Value
          nv-ram-block-element=autosar-variable-in-impl-datatype=total_distance_pass_jump, written-read-nv-data=total_distance_pass_jump.Value
          nv-ram-block-element=autosar-variable-in-impl-datatype=WLTP_Concept, written-read-nv-data=WLTP_Concept.Value
          nv-ram-block-element=autosar-variable-in-impl-datatype=da_anzahl_tueren, written-read-nv-data=da_anzahl_tueren.Value
          nv-ram-block-element=autosar-variable-in-impl-datatype=zReserved_1_COMPONENTS_Cfg_CONST, written-read-nv-data=zReserved_1_COMPONENTS_Cfg_CONST.Value
          nv-ram-block-element=autosar-variable-in-impl-datatype=zIniSwVer_COMPONENTS_Cfg_CONST, written-read-nv-data=zIniSwVer_COMPONENTS_Cfg_CONST.Value
          nv-ram-block-element=autosar-variable-in-impl-datatype=p_Hmi_TripDistance_Max_Km, written-read-nv-data=p_Hmi_TripDistance_Max_Km.Value
          nv-ram-block-element=autosar-variable-in-impl-datatype=p_Hmi_TripDistance_Max_Miles, written-read-nv-data=p_Hmi_TripDistance_Max_Miles.Value
        nv block needs NVNeed_NVBlockDescriptor: n-data-sets=2, ram-block-status-control=API, reliability=NO-PROTECTION, restore-at-start=true, store-at-shutdown=false, store-immediate=true, write-verification=false
        ram block RAM_NVBlockDescriptor_COMPONENTS_Cfg_CONST: type=NV_Data_COMPONENTS_Cfg_CONST, init-value=fields=[254, Cluster_Variant_Canada:0, Brightness_Photosensor_Damp_Dimm_Down:1200, Brightness_Photosensor_Damp_Dimm_Up:480, COMPONENTS_Cfg_CONST_Safety_CRC:33078, RunIn_FinalPointerPositions:[13000, 13000, 13000, 13000], SpeedFastReading_X:[0, 50, 100, 150, 190, 1300, 1800, 2534, 2600, 3250], SpeedFastReading_Y:[0, 51, 103, 154, 195, 1305, 1829, 2600, 2670, 3350], BAP_BC_MFA_FSG_Setup_Status_PrimaryEngineType:6, Brand_Info:0, Cluster_Variant:6, Cluster_Variant_ASIA:0, Cluster_Variant_CHINA:0, Cluster_Variant_USA:0, Display_Type:255, ego_fahrzeug:[15, 185, 0, 0, 0, 0, 0, 0, 0, 0, 0, 0, 0, 0, 0, 0], Fuel_Consumption_Min:0, zReserved_COMPONENTS_Cfg_CONST:8 x 255, Photosensor_available:1, RunIn_FuelADC_Max:175, RunIn_FuelADC_Min:50, Service_Early_Warning_Prediction:30, t_Max_Delay_CLWError:8, Analog_CoolantTemperature_Available:1, Cluster_Variant_FBU:0, Immo_Individual_Schluessel_Fahrberecht:0, LIM_Display_Available:1, OutsideTemperature_Exclusive_DisplayArea:0, SWA_Telltales_Installed:0, UnintendedMovement:1, Unit_SpeedoScale:0, 50, p_Perso_NumberOfUserProfiles:7, total_distance_pass_jump:0, WLTP_Concept:0, da_anzahl_tueren:0, zReserved_1_COMPONENTS_Cfg_CONST:255, zIniSwVer_COMPONENTS_Cfg_CONST:1, p_Hmi_TripDistance_Max_Km:99999, p_Hmi_TripDistance_Max_Miles:99999]
        rom block ROM_NVBlockDescriptor_COMPONENTS_Cfg_CONST:
          sw-calibration-access=READ-WRITE
          type=NV_Data_COMPONENTS_Cfg_CONST
          init-value=fields=[254, Cluster_Variant_Canada:0, Brightness_Photosensor_Damp_Dimm_Down:1200, Brightness_Photosensor_Damp_Dimm_Up:480, COMPONENTS_Cfg_CONST_Safety_CRC:33078, RunIn_FinalPointerPositions:[13000, 13000, 13000, 13000], SpeedFastReading_X:[0, 50, 100, 150, 190, 1300, 1800, 2534, 2600, 3250], SpeedFastReading_Y:[0, 51, 103, 154, 195, 1305, 1829, 2600, 2670, 3350], BAP_BC_MFA_FSG_Setup_Status_PrimaryEngineType:6, Brand_Info:0, Cluster_Variant:6, Cluster_Variant_ASIA:0, Cluster_Variant_CHINA:0, Cluster_Variant_USA:0, Display_Type:255, ego_fahrzeug:[15, 185, 0, 0, 0, 0, 0, 0, 0, 0, 0, 0, 0, 0, 0, 0], Fuel_Consumption_Min:0, zReserved_COMPONENTS_Cfg_CONST:8 x 255, Photosensor_available:1, RunIn_FuelADC_Max:175, RunIn_FuelADC_Min:50, Service_Early_Warning_Prediction:30, t_Max_Delay_CLWError:8, Analog_CoolantTemperature_Available:1, Cluster_Variant_FBU:0, Immo_Individual_Schluessel_Fahrberecht:0, LIM_Display_Available:1, OutsideTemperature_Exclusive_DisplayArea:0, SWA_Telltales_Installed:0, UnintendedMovement:1, Unit_SpeedoScale:0, 50, p_Perso_NumberOfUserProfiles:7, total_distance_pass_jump:0, WLTP_Concept:0, da_anzahl_tueren:0, zReserved_1_COMPONENTS_Cfg_CONST:255, zIniSwVer_COMPONENTS_Cfg_CONST:1, p_Hmi_TripDistance_Max_Km:99999, p_Hmi_TripDistance_Max_Miles:99999]
      NVBlockDescriptor_COMPONENTS_Cfg_VAR: client-server-ports=role-based-port-assignment={port-prototype=COMPONENTS_Cfg_VAR_NvM_JobFinished, role=COMPONENTS_Cfg_VAR_NvM_JobFinished}
        nv-block-data-mappings:
          nv-ram-block-element=autosar-variable-in-impl-datatype=BAP_BC_MFA_ExternalFunctionControl_Set_Controlcode, written-read-nv-data=BAP_BC_MFA_ExternalFunctionControl_Set_Controlcode.Value
          nv-ram-block-element=autosar-variable-in-impl-datatype=BAP_BC_MFA_ExternalFunctionControl_Status_Installation, written-read-nv-data=BAP_BC_MFA_ExternalFunctionControl_Status_Installation.Value
          nv-ram-block-element=autosar-variable-in-impl-datatype=COMPONENTS_Cfg_VAR_Safety_CRC, written-read-nv-data=COMPONENTS_Cfg_VAR_Safety_CRC.Value
          nv-ram-block-element=autosar-variable-in-impl-datatype=Immo_DtcLastTestResult, written-read-nv-data=Immo_DtcLastTestResult.Value
          nv-ram-block-element=autosar-variable-in-impl-datatype=V_Customer_SpeedThreshold, written-read-nv-data=V_Customer_SpeedThreshold.Value
          nv-ram-block-element=autosar-variable-in-impl-datatype=BAP_BC_MFA_FSG_Setup_Status_Installation1, written-read-nv-data=BAP_BC_MFA_FSG_Setup_Status_Installation1.Value
          nv-ram-block-element=autosar-variable-in-impl-datatype=BAP_BC_MFA_FSG_Setup_Status_Installation2, written-read-nv-data=BAP_BC_MFA_FSG_Setup_Status_Installation2.Value
          nv-ram-block-element=autosar-variable-in-impl-datatype=BAP_BC_MFA_FSG_Setup_Status_SecondaryEngineType, written-read-nv-data=BAP_BC_MFA_FSG_Setup_Status_SecondaryEngineType.Value
          nv-ram-block-element=autosar-variable-in-impl-datatype=BAP_BC_MFA_MenueSetup_Status_Menue1_1, written-read-nv-data=BAP_BC_MFA_MenueSetup_Status_Menue1_1.Value
          nv-ram-block-element=autosar-variable-in-impl-datatype=BAP_BC_MFA_MenueSetup_Status_Menue1_2, written-read-nv-data=BAP_BC_MFA_MenueSetup_Status_Menue1_2.Value
          nv-ram-block-element=autosar-variable-in-impl-datatype=BAP_BC_MFA_MenueSetup_Status_Menue2_1, written-read-nv-data=BAP_BC_MFA_MenueSetup_Status_Menue2_1.Value
          nv-ram-block-element=autosar-variable-in-impl-datatype=BAP_BC_MFA_MenueSetup_Status_Menue2_2, written-read-nv-data=BAP_BC_MFA_MenueSetup_Status_Menue2_2.Value
          nv-ram-block-element=autosar-variable-in-impl-datatype=BAP_BC_MFA_MenueSetup_Status_Menue3_1, written-read-nv-data=BAP_BC_MFA_MenueSetup_Status_Menue3_1.Value
          nv-ram-block-element=autosar-variable-in-impl-datatype=BAP_BC_MFA_MenueSetup_Status_Menue3_2, written-read-nv-data=BAP_BC_MFA_MenueSetup_Status_Menue3_2.Value
          nv-ram-block-element=autosar-variable-in-impl-datatype=BAP_BC_MFA_MenueSetup_Status_Special, written-read-nv-data=BAP_BC_MFA_MenueSetup_Status_Special.Value
          nv-ram-block-element=autosar-variable-in-impl-datatype=bcme_consumption_unit, written-read-nv-data=bcme_consumption_unit.Value
          nv-ram-block-element=autosar-variable-in-impl-datatype=DLS_Auto_Day, written-read-nv-data=DLS_Auto_Day.Value
          nv-ram-block-element=autosar-variable-in-impl-datatype=DLS_Auto_Hour, written-read-nv-data=DLS_Auto_Hour.Value
          nv-ram-block-element=autosar-variable-in-impl-datatype=DLS_Auto_Minute, written-read-nv-data=DLS_Auto_Minute.Value
          nv-ram-block-element=autosar-variable-in-impl-datatype=DLS_Auto_Month, written-read-nv-data=DLS_Auto_Month.Value
          nv-ram-block-element=autosar-variable-in-impl-datatype=DLS_Auto_State, written-read-nv-data=DLS_Auto_State.Value
          nv-ram-block-element=autosar-variable-in-impl-datatype=EMSG_Mode_Active, written-read-nv-data=EMSG_Mode_Active.Value
          nv-ram-block-element=autosar-variable-in-impl-datatype=p_BR_Systemart, written-read-nv-data=p_BR_Systemart.Value
          nv-ram-block-element=autosar-variable-in-impl-datatype=primary_engine_type, written-read-nv-data=primary_engine_type.Value
          nv-ram-block-element=autosar-variable-in-impl-datatype=ROE_Config, written-read-nv-data=ROE_Config.Value
          nv-ram-block-element=autosar-variable-in-impl-datatype=secondary_engine_type, written-read-nv-data=secondary_engine_type.Value
          nv-ram-block-element=autosar-variable-in-impl-datatype=Time_TimeSource, written-read-nv-data=Time_TimeSource.Value
          nv-ram-block-element=autosar-variable-in-impl-datatype=vehicle_type, written-read-nv-data=vehicle_type.Value
          nv-ram-block-element=autosar-variable-in-impl-datatype=bcme_consumer_available, written-read-nv-data=bcme_consumer_available.Value
          nv-ram-block-element=autosar-variable-in-impl-datatype=Hmi_Variant, written-read-nv-data=Hmi_Variant.Value
          nv-ram-block-element=autosar-variable-in-impl-datatype=MFL_Valid, written-read-nv-data=MFL_Valid.Value
          nv-ram-block-element=autosar-variable-in-impl-datatype=QRS_Mode_Active, written-read-nv-data=QRS_Mode_Active.Value
          nv-ram-block-element=autosar-variable-in-impl-datatype=T_Mode_Active, written-read-nv-data=T_Mode_Active.Value
          nv-ram-block-element=autosar-variable-in-impl-datatype=V_Customer_Active, written-read-nv-data=V_Customer_Active.Value
          nv-ram-block-element=autosar-variable-in-impl-datatype=Unit_KWh_per_mile_available, written-read-nv-data=Unit_KWh_per_mile_available.Value
          nv-ram-block-element=autosar-variable-in-impl-datatype=Unit_mpge_us_available, written-read-nv-data=Unit_mpge_us_available.Value
          nv-ram-block-element=autosar-variable-in-impl-datatype=zReserved_COMPONENTS_Cfg_VAR, written-read-nv-data=zReserved_COMPONENTS_Cfg_VAR.Value
          nv-ram-block-element=autosar-variable-in-impl-datatype=p_kilometerstand_last_value, written-read-nv-data=p_kilometerstand_last_value.Value
          nv-ram-block-element=autosar-variable-in-impl-datatype=zReserved_1_COMPONENTS_Cfg_VAR, written-read-nv-data=zReserved_1_COMPONENTS_Cfg_VAR.Value
        nv block needs NVNeed_NVBlockDescriptor: n-data-sets=2, ram-block-status-control=API, reliability=NO-PROTECTION, restore-at-start=true, store-at-shutdown=false, store-immediate=true, write-verification=false
        ram block RAM_NVBlockDescriptor_COMPONENTS_Cfg_VAR: type=NV_Data_COMPONENTS_Cfg_VAR, init-value=fields=[BAP_BC_MFA_ExternalFunctionControl_Set_Controlcode:3, BAP_BC_MFA_ExternalFunctionControl_Status_Installation:2, COMPONENTS_Cfg_VAR_Safety_CRC:12589, Immo_DtcLastTestResult:0, V_Customer_SpeedThreshold:130, BAP_BC_MFA_FSG_Setup_Status_Installation1:0, BAP_BC_MFA_FSG_Setup_Status_Installation2:0, BAP_BC_MFA_FSG_Setup_Status_SecondaryEngineType:0, BAP_BC_MFA_MenueSetup_Status_Menue1_1:0, BAP_BC_MFA_MenueSetup_Status_Menue1_2:0, BAP_BC_MFA_MenueSetup_Status_Menue2_1:0, BAP_BC_MFA_MenueSetup_Status_Menue2_2:0, BAP_BC_MFA_MenueSetup_Status_Menue3_1:0, BAP_BC_MFA_MenueSetup_Status_Menue3_2:0, BAP_BC_MFA_MenueSetup_Status_Special:10, bcme_consumption_unit:2, DLS_Auto_Day:1, DLS_Auto_Hour:0, DLS_Auto_Minute:0, DLS_Auto_Month:1, DLS_Auto_State:2, EMSG_Mode_Active:0, p_BR_Systemart:0, primary_engine_type:1, ROE_Config:[0, 0, 0], secondary_engine_type:0, Time_TimeSource:1, vehicle_type:2, bcme_consumer_available:0, Hmi_Variant:1, MFL_Valid:0, QRS_Mode_Active:0, T_Mode_Active:0, V_Customer_Active:0, Unit_KWh_per_mile_available:1, Unit_mpge_us_available:1, zReserved_COMPONENTS_Cfg_VAR:255, p_kilometerstand_last_value:1048573, zReserved_1_COMPONENTS_Cfg_VAR:[255, 255, 255, 255]]
        rom block ROM_NVBlockDescriptor_COMPONENTS_Cfg_VAR:
          sw-calibration-access=READ-WRITE
          type=NV_Data_COMPONENTS_Cfg_VAR
          init-value=fields=[BAP_BC_MFA_ExternalFunctionControl_Set_Controlcode:3, BAP_BC_MFA_ExternalFunctionControl_Status_Installation:2, COMPONENTS_Cfg_VAR_Safety_CRC:12589, Immo_DtcLastTestResult:0, V_Customer_SpeedThreshold:130, BAP_BC_MFA_FSG_Setup_Status_Installation1:0, BAP_BC_MFA_FSG_Setup_Status_Installation2:0, BAP_BC_MFA_FSG_Setup_Status_SecondaryEngineType:0, BAP_BC_MFA_MenueSetup_Status_Menue1_1:0, BAP_BC_MFA_MenueSetup_Status_Menue1_2:0, BAP_BC_MFA_MenueSetup_Status_Menue2_1:0, BAP_BC_MFA_MenueSetup_Status_Menue2_2:0, BAP_BC_MFA_MenueSetup_Status_Menue3_1:0, BAP_BC_MFA_MenueSetup_Status_Menue3_2:0, BAP_BC_MFA_MenueSetup_Status_Special:10, bcme_consumption_unit:2, DLS_Auto_Day:1, DLS_Auto_Hour:0, DLS_Auto_Minute:0, DLS_Auto_Month:1, DLS_Auto_State:2, EMSG_Mode_Active:0, p_BR_Systemart:0, primary_engine_type:1, ROE_Config:[0, 0, 0], secondary_engine_type:0, Time_TimeSource:1, vehicle_type:2, bcme_consumer_available:0, Hmi_Variant:1, MFL_Valid:0, QRS_Mode_Active:0, T_Mode_Active:0, V_Customer_Active:0, Unit_KWh_per_mile_available:1, Unit_mpge_us_available:1, zReserved_COMPONENTS_Cfg_VAR:255, p_kilometerstand_last_value:1048573, zReserved_1_COMPONENTS_Cfg_VAR:[255, 255, 255, 255]]
      NVBlockDescriptor_Cluster_Settings: client-server-ports=role-based-port-assignment={port-prototype=Cluster_Settings_NvM_JobFinished, role=Cluster_Settings_NvM_JobFinished}
        nv-block-data-mappings:
          nv-ram-block-element=autosar-variable-in-impl-datatype=Actual_Language, written-read-nv-data=Actual_Language.Value
          nv-ram-block-element=autosar-variable-in-impl-datatype=Celeb_DimOffset_Scale, written-read-nv-data=Celeb_DimOffset_Scale.Value
          nv-ram-block-element=autosar-variable-in-impl-datatype=t_Celeb_Pause_Until_EndDim_Scale, written-read-nv-data=t_Celeb_Pause_Until_EndDim_Scale.Value
          nv-ram-block-element=autosar-variable-in-impl-datatype=Celeb_EndDim_Scale_Curve_X, written-read-nv-data=Celeb_EndDim_Scale_Curve_X.Value
          nv-ram-block-element=autosar-variable-in-impl-datatype=Celeb_EndDim_Scale_Curve_Y, written-read-nv-data=Celeb_EndDim_Scale_Curve_Y.Value
          nv-ram-block-element=autosar-variable-in-impl-datatype=Celeb_PreStart_Scale_Curve_X, written-read-nv-data=Celeb_PreStart_Scale_Curve_X.Value
          nv-ram-block-element=autosar-variable-in-impl-datatype=Celeb_PreStart_Scale_Curve_Y, written-read-nv-data=Celeb_PreStart_Scale_Curve_Y.Value
          nv-ram-block-element=autosar-variable-in-impl-datatype=Celeb_StartDim_Scale_Curve_X, written-read-nv-data=Celeb_StartDim_Scale_Curve_X.Value
          nv-ram-block-element=autosar-variable-in-impl-datatype=Celeb_StartDim_Scale_Curve_Y, written-read-nv-data=Celeb_StartDim_Scale_Curve_Y.Value
          nv-ram-block-element=autosar-variable-in-impl-datatype=da_3D_Geschw_verwenden, written-read-nv-data=da_3D_Geschw_verwenden.Value
          nv-ram-block-element=autosar-variable-in-impl-datatype=da_schalter_genaue_geschw, written-read-nv-data=da_schalter_genaue_geschw.Value
          nv-ram-block-element=autosar-variable-in-impl-datatype=BlockInfo_EEP_Units, written-read-nv-data=BlockInfo_EEP_Units.Value
          nv-ram-block-element=autosar-variable-in-impl-datatype=BlockInfo_EEP_Engine, written-read-nv-data=BlockInfo_EEP_Engine.Value
          nv-ram-block-element=autosar-variable-in-impl-datatype=BlockInfo_EEP_Platform, written-read-nv-data=BlockInfo_EEP_Platform.Value
          nv-ram-block-element=autosar-variable-in-impl-datatype=BlockInfo_EEP_Market, written-read-nv-data=BlockInfo_EEP_Market.Value
          nv-ram-block-element=autosar-variable-in-impl-datatype=zReserved_Cluster_Settings, written-read-nv-data=zReserved_Cluster_Settings.Value
        nv block needs NVNeed_NVBlockDescriptor: n-data-sets=2, ram-block-status-control=API, reliability=NO-PROTECTION, restore-at-start=true, store-at-shutdown=false, store-immediate=true, write-verification=false
        ram block RAM_NVBlockDescriptor_Cluster_Settings: type=NV_Data_Cluster_Settings, init-value=fields=[Actual_Language:0, Celeb_DimOffset_Scale:0, t_Celeb_Pause_Until_EndDim_Scale:0, Celeb_EndDim_Scale_Curve_X:[0, 10, 15, 25, 30, 36, 43, 50], Celeb_EndDim_Scale_Curve_Y:[100, 85, 65, 20, 10, 5, 2, 0], Celeb_PreStart_Scale_Curve_X:6 x 0, Celeb_PreStart_Scale_Curve_Y:6 x 0, Celeb_StartDim_Scale_Curve_X:[0, 4, 8, 25, 50, 85, 90, 100], Celeb_StartDim_Scale_Curve_Y:[0, 2, 6, 28, 75, 92, 97, 100], da_3D_Geschw_verwenden:0, da_schalter_genaue_geschw:0, BlockInfo_EEP_Units:1, BlockInfo_EEP_Engine:1, BlockInfo_EEP_Platform:1, BlockInfo_EEP_Market:1, zReserved_Cluster_Settings:5 x 255]
        rom block ROM_NVBlockDescriptor_Cluster_Settings:
          sw-calibration-access=READ-WRITE
          type=NV_Data_Cluster_Settings
          init-value=fields=[Actual_Language:0, Celeb_DimOffset_Scale:0, t_Celeb_Pause_Until_EndDim_Scale:0, Celeb_EndDim_Scale_Curve_X:[0, 10, 15, 25, 30, 36, 43, 50], Celeb_EndDim_Scale_Curve_Y:[100, 85, 65, 20, 10, 5, 2, 0], Celeb_PreStart_Scale_Curve_X:6 x 0, Celeb_PreStart_Scale_Curve_Y:6 x 0, Celeb_StartDim_Scale_Curve_X:[0, 4, 8, 25, 50, 85, 90, 100], Celeb_StartDim_Scale_Curve_Y:[0, 2, 6, 28, 75, 92, 97, 100], da_3D_Geschw_verwenden:0, da_schalter_genaue_geschw:0, BlockInfo_EEP_Units:1, BlockInfo_EEP_Engine:1, BlockInfo_EEP_Platform:1, BlockInfo_EEP_Market:1, zReserved_Cluster_Settings:5 x 255]
      NVBlockDescriptor_Com_Cfg_VAR: client-server-ports=role-based-port-assignment={port-prototype=Com_Cfg_VAR_NvM_JobFinished, role=Com_Cfg_VAR_NvM_JobFinished}
        nv-block-data-mappings:
          nv-ram-block-element=autosar-variable-in-impl-datatype=zIniSwVer, written-read-nv-data=zIniSwVer.Value
          nv-ram-block-element=autosar-variable-in-impl-datatype=verlassenswarnung_VWN, written-read-nv-data=verlassenswarnung_VWN.Value
          nv-ram-block-element=autosar-variable-in-impl-datatype=ConfigWarning_Schwelle1_Indien, written-read-nv-data=ConfigWarning_Schwelle1_Indien.Value
          nv-ram-block-element=autosar-variable-in-impl-datatype=Compensation_Line_Slope_m, written-read-nv-data=Compensation_Line_Slope_m.Value
          nv-ram-block-element=autosar-variable-in-impl-datatype=Compensation_Line_Shift_b, written-read-nv-data=Compensation_Line_Shift_b.Value
          nv-ram-block-element=autosar-variable-in-impl-datatype=Brightness_Photosensor_Cal_Error, written-read-nv-data=Brightness_Photosensor_Cal_Error.Value
          nv-ram-block-element=autosar-variable-in-impl-datatype=Zero_Potential_Display_Active, written-read-nv-data=Zero_Potential_Display_Active.Value
          nv-ram-block-element=autosar-variable-in-impl-datatype=Knockout_Ctr, written-read-nv-data=Knockout_Ctr.Value
          nv-ram-block-element=autosar-variable-in-impl-datatype=SG_BusKnockout_Ctr, written-read-nv-data=SG_BusKnockout_Ctr.Value
          nv-ram-block-element=autosar-variable-in-impl-datatype=MO_StartStop_Coded, written-read-nv-data=MO_StartStop_Coded.Value
          nv-ram-block-element=autosar-variable-in-impl-datatype=tuben_darstellung, written-read-nv-data=tuben_darstellung.Value
          nv-ram-block-element=autosar-variable-in-impl-datatype=Display_FPA, written-read-nv-data=Display_FPA.Value
          nv-ram-block-element=autosar-variable-in-impl-datatype=zweitgeschwindigkeit_einheitenwechsel, written-read-nv-data=zweitgeschwindigkeit_einheitenwechsel.Value
          nv-ram-block-element=autosar-variable-in-impl-datatype=offroad, written-read-nv-data=offroad.Value
          nv-ram-block-element=autosar-variable-in-impl-datatype=sperrung_infotainmentlisten, written-read-nv-data=sperrung_infotainmentlisten.Value
          nv-ram-block-element=autosar-variable-in-impl-datatype=sperrung_funktionslisten, written-read-nv-data=sperrung_funktionslisten.Value
          nv-ram-block-element=autosar-variable-in-impl-datatype=sperrung_mfa_anzeigen, written-read-nv-data=sperrung_mfa_anzeigen.Value
          nv-ram-block-element=autosar-variable-in-impl-datatype=sperrung_dynamische_bilder, written-read-nv-data=sperrung_dynamische_bilder.Value
          nv-ram-block-element=autosar-variable-in-impl-datatype=sperrung_funktionale_animationen, written-read-nv-data=sperrung_funktionale_animationen.Value
          nv-ram-block-element=autosar-variable-in-impl-datatype=sperrung_schmuckanimationen, written-read-nv-data=sperrung_schmuckanimationen.Value
          nv-ram-block-element=autosar-variable-in-impl-datatype=sperrung_systemzustandsanimationen, written-read-nv-data=sperrung_systemzustandsanimationen.Value
          nv-ram-block-element=autosar-variable-in-impl-datatype=sperrung_bedienunterstuetzende_animationen, written-read-nv-data=sperrung_bedienunterstuetzende_animationen.Value
          nv-ram-block-element=autosar-variable-in-impl-datatype=sperrung_listentimeout, written-read-nv-data=sperrung_listentimeout.Value
          nv-ram-block-element=autosar-variable-in-impl-datatype=sperrung_Karte, written-read-nv-data=sperrung_Karte.Value
          nv-ram-block-element=autosar-variable-in-impl-datatype=sperrung_CarDecorator, written-read-nv-data=sperrung_CarDecorator.Value
          nv-ram-block-element=autosar-variable-in-impl-datatype=sperrung_PiloFahrt, written-read-nv-data=sperrung_PiloFahrt.Value
          nv-ram-block-element=autosar-variable-in-impl-datatype=sperrung_NPSCoverIntensitaet, written-read-nv-data=sperrung_NPSCoverIntensitaet.Value
          nv-ram-block-element=autosar-variable-in-impl-datatype=sperrung_AnzahlListeneintraege, written-read-nv-data=sperrung_AnzahlListeneintraege.Value
          nv-ram-block-element=autosar-variable-in-impl-datatype=sport, written-read-nv-data=sport.Value
          nv-ram-block-element=autosar-variable-in-impl-datatype=glaettungsfaktor_g, written-read-nv-data=glaettungsfaktor_g.Value
          nv-ram-block-element=autosar-variable-in-impl-datatype=size_n, written-read-nv-data=size_n.Value
          nv-ram-block-element=autosar-variable-in-impl-datatype=TCO_Available, written-read-nv-data=TCO_Available.Value
          nv-ram-block-element=autosar-variable-in-impl-datatype=PHEV_Statistic_Cycle, written-read-nv-data=PHEV_Statistic_Cycle.Value
          nv-ram-block-element=autosar-variable-in-impl-datatype=PHEV_Statistic_Distance, written-read-nv-data=PHEV_Statistic_Distance.Value
          nv-ram-block-element=autosar-variable-in-impl-datatype=kombi_variante_e_traktion, written-read-nv-data=kombi_variante_e_traktion.Value
          nv-ram-block-element=autosar-variable-in-impl-datatype=Knockout_Tmr, written-read-nv-data=Knockout_Tmr.Value
          nv-ram-block-element=autosar-variable-in-impl-datatype=SG_BusKnockout_Tmr, written-read-nv-data=SG_BusKnockout_Tmr.Value
          nv-ram-block-element=autosar-variable-in-impl-datatype=PCB_Hot_Spot_Threshold, written-read-nv-data=PCB_Hot_Spot_Threshold.Value
          nv-ram-block-element=autosar-variable-in-impl-datatype=Hot_Spot_Temp_Dimm_Time, written-read-nv-data=Hot_Spot_Temp_Dimm_Time.Value
          nv-ram-block-element=autosar-variable-in-impl-datatype=PCB_Timer_Temp_Too_Hot, written-read-nv-data=PCB_Timer_Temp_Too_Hot.Value
          nv-ram-block-element=autosar-variable-in-impl-datatype=p_mute_delay, written-read-nv-data=p_mute_delay.Value
          nv-ram-block-element=autosar-variable-in-impl-datatype=TFT_RGB_Gain, written-read-nv-data=TFT_RGB_Gain.Value
          nv-ram-block-element=autosar-variable-in-impl-datatype=BootloaderTPBlocksize, written-read-nv-data=BootloaderTPBlocksize.Value
          nv-ram-block-element=autosar-variable-in-impl-datatype=Security_InvalidKeyCounter, written-read-nv-data=Security_InvalidKeyCounter.Value
          nv-ram-block-element=autosar-variable-in-impl-datatype=Default_AmbientLight_Color_index, written-read-nv-data=Default_AmbientLight_Color_index.Value
          nv-ram-block-element=autosar-variable-in-impl-datatype=BAP_BC_MFA_Statistics_distance_ZE, written-read-nv-data=BAP_BC_MFA_Statistics_distance_ZE.Value
          nv-ram-block-element=autosar-variable-in-impl-datatype=BAP_BC_MFA_Statistics_distance_currentInterval_ZE, written-read-nv-data=BAP_BC_MFA_Statistics_distance_currentInterval_ZE.Value
          nv-ram-block-element=autosar-variable-in-impl-datatype=RangeAvgConsumption_High_CNG, written-read-nv-data=RangeAvgConsumption_High_CNG.Value
          nv-ram-block-element=autosar-variable-in-impl-datatype=zReserved_1_Com_Cfg_VAR, written-read-nv-data=zReserved_1_Com_Cfg_VAR.Value
          nv-ram-block-element=autosar-variable-in-impl-datatype=FAZIT_Number, written-read-nv-data=FAZIT_Number.Value
          nv-ram-block-element=autosar-variable-in-impl-datatype=consum_correction_electro, written-read-nv-data=consum_correction_electro.Value
          nv-ram-block-element=autosar-variable-in-impl-datatype=edv_charge_suppress, written-read-nv-data=edv_charge_suppress.Value
          nv-ram-block-element=autosar-variable-in-impl-datatype=negative_calculations_allowed, written-read-nv-data=negative_calculations_allowed.Value
          nv-ram-block-element=autosar-variable-in-impl-datatype=Default_AmbientLight_Color_CHINA_index, written-read-nv-data=Default_AmbientLight_Color_CHINA_index.Value
          nv-ram-block-element=autosar-variable-in-impl-datatype=zReserved_Com_Cfg_VAR, written-read-nv-data=zReserved_Com_Cfg_VAR.Value
        nv block needs NVNeed_NVBlockDescriptor: n-data-sets=2, ram-block-status-control=API, reliability=NO-PROTECTION, restore-at-start=true, store-at-shutdown=false, store-immediate=true, write-verification=false
        ram block RAM_NVBlockDescriptor_Com_Cfg_VAR: type=NV_Data_Com_Cfg_VAR, init-value=fields=[zIniSwVer:1, verlassenswarnung_VWN:0, ConfigWarning_Schwelle1_Indien:60, Compensation_Line_Slope_m:44433, Compensation_Line_Shift_b:11, Brightness_Photosensor_Cal_Error:255, Zero_Potential_Display_Active:2, Knockout_Ctr:0, SG_BusKnockout_Ctr:0, MO_StartStop_Coded:1, tuben_darstellung:0, Display_FPA:1, zweitgeschwindigkeit_einheitenwechsel:1, offroad:0, sperrung_infotainmentlisten:0, sperrung_funktionslisten:0, sperrung_mfa_anzeigen:0, sperrung_dynamische_bilder:0, sperrung_funktionale_animationen:0, sperrung_schmuckanimationen:0, sperrung_systemzustandsanimationen:0, sperrung_bedienunterstuetzende_animationen:0, sperrung_listentimeout:72000, sperrung_Karte:0, sperrung_CarDecorator:0, sperrung_PiloFahrt:0, sperrung_NPSCoverIntensitaet:100, sperrung_AnzahlListeneintraege:0, sport:0, glaettungsfaktor_g:10, size_n:15, TCO_Available:0, PHEV_Statistic_Cycle:0, PHEV_Statistic_Distance:5, kombi_variante_e_traktion:0, Knockout_Tmr:20, SG_BusKnockout_Tmr:30, PCB_Hot_Spot_Threshold:100, Hot_Spot_Temp_Dimm_Time:60, PCB_Timer_Temp_Too_Hot:2, p_mute_delay:20, TFT_RGB_Gain:[255, 255, 255], BootloaderTPBlocksize:15, Security_InvalidKeyCounter:0, Default_AmbientLight_Color_index:1, BAP_BC_MFA_Statistics_distance_ZE:0, BAP_BC_MFA_Statistics_distance_currentInterval_ZE:0, RangeAvgConsumption_High_CNG:1023, zReserved_1_Com_Cfg_VAR:8 x 255, FAZIT_Number:23 x 255, consum_correction_electro:100, edv_charge_suppress:0, negative_calculations_allowed:1, Default_AmbientLight_Color_CHINA_index:6, zReserved_Com_Cfg_VAR:5 x 255]
        rom block ROM_NVBlockDescriptor_Com_Cfg_VAR:
          sw-calibration-access=READ-WRITE
          type=NV_Data_Com_Cfg_VAR
          init-value=fields=[zIniSwVer:1, verlassenswarnung_VWN:0, ConfigWarning_Schwelle1_Indien:60, Compensation_Line_Slope_m:44433, Compensation_Line_Shift_b:11, Brightness_Photosensor_Cal_Error:255, Zero_Potential_Display_Active:2, Knockout_Ctr:0, SG_BusKnockout_Ctr:0, MO_StartStop_Coded:1, tuben_darstellung:0, Display_FPA:1, zweitgeschwindigkeit_einheitenwechsel:1, offroad:0, sperrung_infotainmentlisten:0, sperrung_funktionslisten:0, sperrung_mfa_anzeigen:0, sperrung_dynamische_bilder:0, sperrung_funktionale_animationen:0, sperrung_schmuckanimationen:0, sperrung_systemzustandsanimationen:0, sperrung_bedienunterstuetzende_animationen:0, sperrung_listentimeout:72000, sperrung_Karte:0, sperrung_CarDecorator:0, sperrung_PiloFahrt:0, sperrung_NPSCoverIntensitaet:100, sperrung_AnzahlListeneintraege:0, sport:0, glaettungsfaktor_g:10, size_n:15, TCO_Available:0, PHEV_Statistic_Cycle:0, PHEV_Statistic_Distance:5, kombi_variante_e_traktion:0, Knockout_Tmr:20, SG_BusKnockout_Tmr:30, PCB_Hot_Spot_Threshold:100, Hot_Spot_Temp_Dimm_Time:60, PCB_Timer_Temp_Too_Hot:2, p_mute_delay:20, TFT_RGB_Gain:[255, 255, 255], BootloaderTPBlocksize:15, Security_InvalidKeyCounter:0, Default_AmbientLight_Color_index:1, BAP_BC_MFA_Statistics_distance_ZE:0, BAP_BC_MFA_Statistics_distance_currentInterval_ZE:0, RangeAvgConsumption_High_CNG:1023, zReserved_1_Com_Cfg_VAR:8 x 255, FAZIT_Number:23 x 255, consum_correction_electro:100, edv_charge_suppress:0, negative_calculations_allowed:1, Default_AmbientLight_Color_CHINA_index:6, zReserved_Com_Cfg_VAR:5 x 255]
      NVBlockDescriptor_DATE_VAR: client-server-ports=role-based-port-assignment={port-prototype=DATE_VAR_NvM_JobFinished, role=DATE_VAR_NvM_JobFinished}
        nv-block-data-mappings:
          nv-ram-block-element=autosar-variable-in-impl-datatype=Date_Year, written-read-nv-data=Date_Year.Value
          nv-ram-block-element=autosar-variable-in-impl-datatype=Date_Day, written-read-nv-data=Date_Day.Value
          nv-ram-block-element=autosar-variable-in-impl-datatype=Date_Month, written-read-nv-data=Date_Month.Value
        nv block needs NVNeed_NVBlockDescriptor: n-data-sets=2, ram-block-status-control=API, reliability=NO-PROTECTION, restore-at-start=true, store-at-shutdown=false, store-immediate=true, write-verification=false
        ram block RAM_NVBlockDescriptor_DATE_VAR: type=NV_Data_DATE_VAR, init-value=fields=[Date_Year:2020, Date_Day:1, Date_Month:1]
        rom block ROM_NVBlockDescriptor_DATE_VAR: sw-calibration-access=READ-WRITE, type=NV_Data_DATE_VAR, init-value=fields=[Date_Year:2020, Date_Day:1, Date_Month:1]
      NVBlockDescriptor_DIAG_AC_Curve_Scales_VAR: client-server-ports=role-based-port-assignment={port-prototype=DIAG_AC_Curve_Scales_VAR_NvM_JobFinished, role=DIAG_AC_Curve_Scales_VAR_NvM_JobFinished}
        nv-block-data-mappings:
          nv-ram-block-element=autosar-variable-in-impl-datatype=Scales_Day_X, written-read-nv-data=Scales_Day_X.Value
          nv-ram-block-element=autosar-variable-in-impl-datatype=Scales_Day_Y, written-read-nv-data=Scales_Day_Y.Value
          nv-ram-block-element=autosar-variable-in-impl-datatype=Scales_Night_X, written-read-nv-data=Scales_Night_X.Value
          nv-ram-block-element=autosar-variable-in-impl-datatype=Scales_Night_Y, written-read-nv-data=Scales_Night_Y.Value
          nv-ram-block-element=autosar-variable-in-impl-datatype=Scale_Luminosity_Calibration_PWM, written-read-nv-data=Scale_Luminosity_Calibration_PWM.Value
          nv-ram-block-element=autosar-variable-in-impl-datatype=FPK_zeigerdaempfung_drehzahl, written-read-nv-data=FPK_zeigerdaempfung_drehzahl.Value
          nv-ram-block-element=autosar-variable-in-impl-datatype=Reserved_DIAG_AC_Curve_Scales_VAR, written-read-nv-data=Reserved_DIAG_AC_Curve_Scales_VAR.Value
        nv block needs NVNeed_NVBlockDescriptor: n-data-sets=2, ram-block-status-control=API, reliability=NO-PROTECTION, restore-at-start=true, store-at-shutdown=false, store-immediate=true, write-verification=false
        ram block RAM_NVBlockDescriptor_DIAG_AC_Curve_Scales_VAR: type=NV_Data_DIAG_AC_Curve_Scales_VAR, init-value=fields=[Scales_Day_X:[0, 100, 500, 1000, 1500, 2530], Scales_Day_Y:[40, 40, 120, 200, 800, 1000], Scales_Night_X:[0, 100, 500, 1000, 1500, 2530], Scales_Night_Y:[40, 40, 120, 200, 800, 1000], Scale_Luminosity_Calibration_PWM:10000, FPK_zeigerdaempfung_drehzahl:0, Reserved_DIAG_AC_Curve_Scales_VAR:9 x 255]
        rom block ROM_NVBlockDescriptor_DIAG_AC_Curve_Scales_VAR: sw-calibration-access=READ-WRITE, type=NV_Data_DIAG_AC_Curve_Scales_VAR, init-value=fields=[Scales_Day_X:[0, 100, 500, 1000, 1500, 2530], Scales_Day_Y:[40, 40, 120, 200, 800, 1000], Scales_Night_X:[0, 100, 500, 1000, 1500, 2530], Scales_Night_Y:[40, 40, 120, 200, 800, 1000], Scale_Luminosity_Calibration_PWM:10000, FPK_zeigerdaempfung_drehzahl:0, Reserved_DIAG_AC_Curve_Scales_VAR:9 x 255]
      NVBlockDescriptor_DIAG_AC_IlluminationCfg_VAR_0: client-server-ports=role-based-port-assignment={port-prototype=DIAG_AC_IlluminationCfg_VAR_0_NvM_JobFinished, role=DIAG_AC_IlluminationCfg_VAR_0_NvM_JobFinished}
        nv-block-data-mappings:
          nv-ram-block-element=autosar-variable-in-impl-datatype=PWM_Display_X, written-read-nv-data=PWM_Display_X.Value
          nv-ram-block-element=autosar-variable-in-impl-datatype=PWM_Display_Y, written-read-nv-data=PWM_Display_Y.Value
          nv-ram-block-element=autosar-variable-in-impl-datatype=PWM_Pointer_xd_X, written-read-nv-data=PWM_Pointer_xd_X.Value
          nv-ram-block-element=autosar-variable-in-impl-datatype=PWM_Pointer_xd_Y, written-read-nv-data=PWM_Pointer_xd_Y.Value
          nv-ram-block-element=autosar-variable-in-impl-datatype=TT_Red_Luminosity_Calibration_PWM, written-read-nv-data=TT_Red_Luminosity_Calibration_PWM.Value
          nv-ram-block-element=autosar-variable-in-impl-datatype=TT_Green_Luminosity_Calibration_PWM, written-read-nv-data=TT_Green_Luminosity_Calibration_PWM.Value
          nv-ram-block-element=autosar-variable-in-impl-datatype=TT_Yellow_Luminosity_Calibration_PWM, written-read-nv-data=TT_Yellow_Luminosity_Calibration_PWM.Value
          nv-ram-block-element=autosar-variable-in-impl-datatype=Reserved_DIAG_AC_IlluminationCfg_VAR_0, written-read-nv-data=Reserved_DIAG_AC_IlluminationCfg_VAR_0.Value
        nv block needs NVNeed_NVBlockDescriptor: n-data-sets=2, ram-block-status-control=API, reliability=NO-PROTECTION, restore-at-start=true, store-at-shutdown=false, store-immediate=true, write-verification=false
        ram block RAM_NVBlockDescriptor_DIAG_AC_IlluminationCfg_VAR_0: type=NV_Data_DIAG_AC_IlluminationCfg_VAR_0, init-value=fields=[PWM_Display_X:[0, 100, 500, 1000, 1500, 2530], PWM_Display_Y:[20, 20, 40, 80, 610, 1000], PWM_Pointer_xd_X:[0, 100, 500, 1000, 2200, 2530], PWM_Pointer_xd_Y:[20, 20, 60, 160, 850, 1000], TT_Red_Luminosity_Calibration_PWM:10000, TT_Green_Luminosity_Calibration_PWM:10000, TT_Yellow_Luminosity_Calibration_PWM:10000, Reserved_DIAG_AC_IlluminationCfg_VAR_0:6 x 255]
        rom block ROM_NVBlockDescriptor_DIAG_AC_IlluminationCfg_VAR_0:
          sw-calibration-access=READ-WRITE
          type=NV_Data_DIAG_AC_IlluminationCfg_VAR_0
          init-value=fields=[PWM_Display_X:[0, 100, 500, 1000, 1500, 2530], PWM_Display_Y:[20, 20, 40, 80, 610, 1000], PWM_Pointer_xd_X:[0, 100, 500, 1000, 2200, 2530], PWM_Pointer_xd_Y:[20, 20, 60, 160, 850, 1000], TT_Red_Luminosity_Calibration_PWM:10000, TT_Green_Luminosity_Calibration_PWM:10000, TT_Yellow_Luminosity_Calibration_PWM:10000, Reserved_DIAG_AC_IlluminationCfg_VAR_0:6 x 255]
