[part 1 of 4: package /ComponentTypes]
AUTOSAR XML (schema 4-2-1)
package /ComponentTypes
  nv block sw component type NvBlockSwComponentType
    1028 x provide/require port:
      ACC_Darstellung: nv-provide-com-spec{ram-block-init-value=0, rom-block-init-value=0, variable=ACC_Darstellung/Value}, nv-require-com-spec=init-value=0, provided-required-interface=ACC_Darstellung
      AD_Value_Max_lx: nv-provide-com-spec{ram-block-init-value=300, rom-block-init-value=300, variable=AD_Value_Max_lx/Value}, nv-require-com-spec=init-value=300, provided-required-interface=AD_Value_Max_lx
      AD_Value_Min_lx: nv-provide-com-spec{ram-block-init-value=12, rom-block-init-value=12, variable=AD_Value_Min_lx/Value}, nv-require-com-spec=init-value=12, provided-required-interface=AD_Value_Min_lx
      ASAMFileIdentifier:
        nv-provide-com-spec{ram-block-init-value=[69, 86, 95, 68, 97, 115, 104, 66, 111, 97, 114, 100, 74, 67, 73, 77, 81, 66, 65, 66, 0, 0, 0, 0, 0, 0], rom-block-init-value=[69, 86, 95, 68, 97, 115, 104, 66, 111, 97, 114, 100, 74, 67, 73, 77, 81, 66, 65, 66, 0, 0, 0, 0, 0, 0], variable=ASAMFileIdentifier/Value}
        nv-require-com-spec=init-value=[69, 86, 95, 68, 97, 115, 104, 66, 111, 97, 114, 100, 74, 67, 73, 77, 81, 66, 65, 66, 0, 0, 0, 0, 0, 0]
        provided-required-interface=ASAMFileIdentifier
      ASAMFileVersion: nv-provide-com-spec{ram-block-init-value=[48, 49, 49, 48, 48, 49], rom-block-init-value=[48, 49, 49, 48, 48, 49], variable=ASAMFileVersion/Value}, nv-require-com-spec=init-value=[48, 49, 49, 48, 48, 49], provided-required-interface=ASAMFileVersion
      AbsErrorCounter: nv-provide-com-spec{ram-block-init-value=0, rom-block-init-value=0, variable=AbsErrorCounter/Value}, nv-require-com-spec=init-value=0, provided-required-interface=AbsErrorCounter
      AbsErrorPath: nv-provide-com-spec{ram-block-init-value=0, rom-block-init-value=0, variable=AbsErrorPath/Value}, nv-require-com-spec=init-value=0, provided-required-interface=AbsErrorPath
      Acceleration_Display_Available: nv-provide-com-spec{ram-block-init-value=0, rom-block-init-value=0, variable=Acceleration_Display_Available/Value}, nv-require-com-spec=init-value=0, provided-required-interface=Acceleration_Display_Available
      Actual_Language: nv-provide-com-spec{ram-block-init-value=0, rom-block-init-value=0, variable=Actual_Language/Value}, nv-require-com-spec=init-value=0, provided-required-interface=Actual_Language
      AcuRequest_0xA00044: nv-provide-com-spec{ram-block-init-value=0, rom-block-init-value=0, variable=AcuRequest_0xA00044/Value}, nv-require-com-spec=init-value=0, provided-required-interface=AcuRequest_0xA00044
      AcuStatus_0xA00044: nv-provide-com-spec{ram-block-init-value=0, rom-block-init-value=0, variable=AcuStatus_0xA00044/Value}, nv-require-com-spec=init-value=0, provided-required-interface=AcuStatus_0xA00044
      Adaption_SeatbeltWarning: nv-provide-com-spec{ram-block-init-value=0, rom-block-init-value=0, variable=Adaption_SeatbeltWarning/Value}, nv-require-com-spec=init-value=0, provided-required-interface=Adaption_SeatbeltWarning
      AdcTicks_0xA00044: nv-provide-com-spec{ram-block-init-value=0, rom-block-init-value=0, variable=AdcTicks_0xA00044/Value}, nv-require-com-spec=init-value=0, provided-required-interface=AdcTicks_0xA00044
      AdcTicks_0xA00049: nv-provide-com-spec{ram-block-init-value=0, rom-block-init-value=0, variable=AdcTicks_0xA00049/Value}, nv-require-com-spec=init-value=0, provided-required-interface=AdcTicks_0xA00049
      AirbagErrorCounter: nv-provide-com-spec{ram-block-init-value=0, rom-block-init-value=0, variable=AirbagErrorCounter/Value}, nv-require-com-spec=init-value=0, provided-required-interface=AirbagErrorCounter
      AirbagErrorPath: nv-provide-com-spec{ram-block-init-value=0, rom-block-init-value=0, variable=AirbagErrorPath/Value}, nv-require-com-spec=init-value=0, provided-required-interface=AirbagErrorPath
      AmbientLight_Left_Blue_LED_Coef: nv-provide-com-spec{ram-block-init-value=32767, rom-block-init-value=32767, variable=AmbientLight_Left_Blue_LED_Coef/Value}, nv-require-com-spec=init-value=32767, provided-required-interface=AmbientLight_Left_Blue_LED_Coef
      AmbientLight_Left_Green_LED_Coef: nv-provide-com-spec{ram-block-init-value=32767, rom-block-init-value=32767, variable=AmbientLight_Left_Green_LED_Coef/Value}, nv-require-com-spec=init-value=32767, provided-required-interface=AmbientLight_Left_Green_LED_Coef
      AmbientLight_Left_Red_LED_Coef: nv-provide-com-spec{ram-block-init-value=32767, rom-block-init-value=32767, variable=AmbientLight_Left_Red_LED_Coef/Value}, nv-require-com-spec=init-value=32767, provided-required-interface=AmbientLight_Left_Red_LED_Coef
      AmbientLight_Right_Blue_LED_Coef: nv-provide-com-spec{ram-block-init-value=32767, rom-block-init-value=32767, variable=AmbientLight_Right_Blue_LED_Coef/Value}, nv-require-com-spec=init-value=32767, provided-required-interface=AmbientLight_Right_Blue_LED_Coef
      AmbientLight_Right_Green_LED_Coef: nv-provide-com-spec{ram-block-init-value=32767, rom-block-init-value=32767, variable=AmbientLight_Right_Green_LED_Coef/Value}, nv-require-com-spec=init-value=32767, provided-required-interface=AmbientLight_Right_Green_LED_Coef
      AmbientLight_Right_Red_LED_Coef: nv-provide-com-spec{ram-block-init-value=32767, rom-block-init-value=32767, variable=AmbientLight_Right_Red_LED_Coef/Value}, nv-require-com-spec=init-value=32767, provided-required-interface=AmbientLight_Right_Red_LED_Coef
      Analog_CoolantTemperature_Available: nv-provide-com-spec{ram-block-init-value=1, rom-block-init-value=1, variable=Analog_CoolantTemperature_Available/Value}, nv-require-com-spec=init-value=1, provided-required-interface=Analog_CoolantTemperature_Available
      ApplValidity: nv-provide-com-spec{ram-block-init-value=209, rom-block-init-value=209, variable=ApplValidity/Value}, nv-require-com-spec=init-value=209, provided-required-interface=ApplValidity
      BAP_BC_MFA_ExternalFunctionControl_Set_Controlcode: nv-provide-com-spec{ram-block-init-value=3, rom-block-init-value=3, variable=BAP_BC_MFA_ExternalFunctionControl_Set_Controlcode/Value}, nv-require-com-spec=init-value=3, provided-required-interface=BAP_BC_MFA_ExternalFunctionControl_Set_Controlcode
      BAP_BC_MFA_ExternalFunctionControl_Status_Installation: nv-provide-com-spec{ram-block-init-value=2, rom-block-init-value=2, variable=BAP_BC_MFA_ExternalFunctionControl_Status_Installation/Value}, nv-require-com-spec=init-value=2, provided-required-interface=BAP_BC_MFA_ExternalFunctionControl_Status_Installation
      BAP_BC_MFA_FSG_Setup_Status_Installation1: nv-provide-com-spec{ram-block-init-value=0, rom-block-init-value=0, variable=BAP_BC_MFA_FSG_Setup_Status_Installation1/Value}, nv-require-com-spec=init-value=0, provided-required-interface=BAP_BC_MFA_FSG_Setup_Status_Installation1
      BAP_BC_MFA_FSG_Setup_Status_Installation2: nv-provide-com-spec{ram-block-init-value=0, rom-block-init-value=0, variable=BAP_BC_MFA_FSG_Setup_Status_Installation2/Value}, nv-require-com-spec=init-value=0, provided-required-interface=BAP_BC_MFA_FSG_Setup_Status_Installation2
      BAP_BC_MFA_FSG_Setup_Status_PrimaryEngineType: nv-provide-com-spec{ram-block-init-value=6, rom-block-init-value=6, variable=BAP_BC_MFA_FSG_Setup_Status_PrimaryEngineType/Value}, nv-require-com-spec=init-value=6, provided-required-interface=BAP_BC_MFA_FSG_Setup_Status_PrimaryEngineType
      BAP_BC_MFA_FSG_Setup_Status_SecondaryEngineType: nv-provide-com-spec{ram-block-init-value=0, rom-block-init-value=0, variable=BAP_BC_MFA_FSG_Setup_Status_SecondaryEngineType/Value}, nv-require-com-spec=init-value=0, provided-required-interface=BAP_BC_MFA_FSG_Setup_Status_SecondaryEngineType
      BAP_BC_MFA_MenueSetup_Status_Menue1_1: nv-provide-com-spec{ram-block-init-value=0, rom-block-init-value=0, variable=BAP_BC_MFA_MenueSetup_Status_Menue1_1/Value}, nv-require-com-spec=init-value=0, provided-required-interface=BAP_BC_MFA_MenueSetup_Status_Menue1_1
      BAP_BC_MFA_MenueSetup_Status_Menue1_2: nv-provide-com-spec{ram-block-init-value=0, rom-block-init-value=0, variable=BAP_BC_MFA_MenueSetup_Status_Menue1_2/Value}, nv-require-com-spec=init-value=0, provided-required-interface=BAP_BC_MFA_MenueSetup_Status_Menue1_2
      BAP_BC_MFA_MenueSetup_Status_Menue2_1: nv-provide-com-spec{ram-block-init-value=0, rom-block-init-value=0, variable=BAP_BC_MFA_MenueSetup_Status_Menue2_1/Value}, nv-require-com-spec=init-value=0, provided-required-interface=BAP_BC_MFA_MenueSetup_Status_Menue2_1
      BAP_BC_MFA_MenueSetup_Status_Menue2_2: nv-provide-com-spec{ram-block-init-value=0, rom-block-init-value=0, variable=BAP_BC_MFA_MenueSetup_Status_Menue2_2/Value}, nv-require-com-spec=init-value=0, provided-required-interface=BAP_BC_MFA_MenueSetup_Status_Menue2_2
      BAP_BC_MFA_MenueSetup_Status_Menue3_1: nv-provide-com-spec{ram-block-init-value=0, rom-block-init-value=0, variable=BAP_BC_MFA_MenueSetup_Status_Menue3_1/Value}, nv-require-com-spec=init-value=0, provided-required-interface=BAP_BC_MFA_MenueSetup_Status_Menue3_1
      BAP_BC_MFA_MenueSetup_Status_Menue3_2: nv-provide-com-spec{ram-block-init-value=0, rom-block-init-value=0, variable=BAP_BC_MFA_MenueSetup_Status_Menue3_2/Value}, nv-require-com-spec=init-value=0, provided-required-interface=BAP_BC_MFA_MenueSetup_Status_Menue3_2
      BAP_BC_MFA_MenueSetup_Status_Special: nv-provide-com-spec{ram-block-init-value=10, rom-block-init-value=10, variable=BAP_BC_MFA_MenueSetup_Status_Special/Value}, nv-require-com-spec=init-value=10, provided-required-interface=BAP_BC_MFA_MenueSetup_Status_Special
      BAP_BC_MFA_Statistics_distance_ZE: nv-provide-com-spec{ram-block-init-value=0, rom-block-init-value=0, variable=BAP_BC_MFA_Statistics_distance_ZE/Value}, nv-require-com-spec=init-value=0, provided-required-interface=BAP_BC_MFA_Statistics_distance_ZE
      BAP_BC_MFA_Statistics_distance_currentInterval_ZE: nv-provide-com-spec{ram-block-init-value=0, rom-block-init-value=0, variable=BAP_BC_MFA_Statistics_distance_currentInterval_ZE/Value}, nv-require-com-spec=init-value=0, provided-required-interface=BAP_BC_MFA_Statistics_distance_currentInterval_ZE
      BAP_Debug_Mode_enabled: nv-provide-com-spec{ram-block-init-value=0, rom-block-init-value=0, variable=BAP_Debug_Mode_enabled/Value}, nv-require-com-spec=init-value=0, provided-required-interface=BAP_Debug_Mode_enabled
      BCCT_Lookup_Curve_AmbientLight_Dimming_Coef_X: nv-provide-com-spec{ram-block-init-value=[0, 10, 50, 100, 150, 253], rom-block-init-value=[0, 10, 50, 100, 150, 253], variable=BCCT_Lookup_Curve_AmbientLight_Dimming_Coef_X/Value}, nv-require-com-spec=init-value=[0, 10, 50, 100, 150, 253], provided-required-interface=BCCT_Lookup_Curve_AmbientLight_Dimming_Coef_X
      BCCT_Lookup_Curve_AmbientLight_Dimming_Coef_Y: nv-provide-com-spec{ram-block-init-value=[1, 1, 7, 14, 30, 100], rom-block-init-value=[1, 1, 7, 14, 30, 100], variable=BCCT_Lookup_Curve_AmbientLight_Dimming_Coef_Y/Value}, nv-require-com-spec=init-value=[1, 1, 7, 14, 30, 100], provided-required-interface=BCCT_Lookup_Curve_AmbientLight_Dimming_Coef_Y
      BCCT_Lookup_Curve_AmbientLight_Left_Temp_Coef_X: nv-provide-com-spec{ram-block-init-value=[216, 0, 32, 64, 96, 125], rom-block-init-value=[216, 0, 32, 64, 96, 125], variable=BCCT_Lookup_Curve_AmbientLight_Left_Temp_Coef_X/Value}, nv-require-com-spec=init-value=[216, 0, 32, 64, 96, 125], provided-required-interface=BCCT_Lookup_Curve_AmbientLight_Left_Temp_Coef_X
      BCCT_Lookup_Curve_AmbientLight_Left_Temp_Coef_Y: nv-provide-com-spec{ram-block-init-value=6 x 100, rom-block-init-value=6 x 100, variable=BCCT_Lookup_Curve_AmbientLight_Left_Temp_Coef_Y/Value}, nv-require-com-spec=init-value=6 x 100, provided-required-interface=BCCT_Lookup_Curve_AmbientLight_Left_Temp_Coef_Y
      BCCT_Lookup_Curve_AmbientLight_Right_Temp_Coef_X: nv-provide-com-spec{ram-block-init-value=[216, 0, 32, 64, 96, 125], rom-block-init-value=[216, 0, 32, 64, 96, 125], variable=BCCT_Lookup_Curve_AmbientLight_Right_Temp_Coef_X/Value}, nv-require-com-spec=init-value=[216, 0, 32, 64, 96, 125], provided-required-interface=BCCT_Lookup_Curve_AmbientLight_Right_Temp_Coef_X
      BCCT_Lookup_Curve_AmbientLight_Right_Temp_Coef_Y: nv-provide-com-spec{ram-block-init-value=6 x 100, rom-block-init-value=6 x 100, variable=BCCT_Lookup_Curve_AmbientLight_Right_Temp_Coef_Y/Value}, nv-require-com-spec=init-value=6 x 100, provided-required-interface=BCCT_Lookup_Curve_AmbientLight_Right_Temp_Coef_Y
      BCCT_Temperature_Sensor_AmbientLight_Conv_X:
        nv-provide-com-spec{ram-block-init-value=[1624, 1663, 1702, 1741, 1780, 1820, 1859, 1899, 1938, 1977, 2016, 2049, 2081, 2112, 2144, 2175, 2206, 2237, 2267, 2297, 2327, 2356, 2385, 2414, 2442, 2470, 2498, 2525, 2552, 2579, 2605, 2631], rom-block-init-value=[1624, 1663, 1702, 1741, 1780, 1820, 1859, 1899, 1938, 1977, 2016, 2049, 2081, 2112, 2144, 2175, 2206, 2237, 2267, 2297, 2327, 2356, 2385, 2414, 2442, 2470, 2498, 2525, 2552, 2579, 2605, 2631], variable=BCCT_Temperature_Sensor_AmbientLight_Conv_X/Value}
        nv-require-com-spec=init-value=[1624, 1663, 1702, 1741, 1780, 1820, 1859, 1899, 1938, 1977, 2016, 2049, 2081, 2112, 2144, 2175, 2206, 2237, 2267, 2297, 2327, 2356, 2385, 2414, 2442, 2470, 2498, 2525, 2552, 2579, 2605, 2631]
        provided-required-interface=BCCT_Temperature_Sensor_AmbientLight_Conv_X
      BCCT_Temperature_Sensor_AmbientLight_Conv_Y:
        nv-provide-com-spec{ram-block-init-value=[216, 222, 228, 234, 240, 246, 252, 2, 8, 14, 20, 25, 30, 35, 40, 45, 50, 55, 60, 65, 70, 75, 80, 85, 90, 95, 100, 105, 110, 115, 120, 125], rom-block-init-value=[216, 222, 228, 234, 240, 246, 252, 2, 8, 14, 20, 25, 30, 35, 40, 45, 50, 55, 60, 65, 70, 75, 80, 85, 90, 95, 100, 105, 110, 115, 120, 125], variable=BCCT_Temperature_Sensor_AmbientLight_Conv_Y/Value}
        nv-require-com-spec=init-value=[216, 222, 228, 234, 240, 246, 252, 2, 8, 14, 20, 25, 30, 35, 40, 45, 50, 55, 60, 65, 70, 75, 80, 85, 90, 95, 100, 105, 110, 115, 120, 125]
        provided-required-interface=BCCT_Temperature_Sensor_AmbientLight_Conv_Y
      BSBlockSize: nv-provide-com-spec{ram-block-init-value=255, rom-block-init-value=255, variable=BSBlockSize/Value}, nv-require-com-spec=init-value=255, provided-required-interface=BSBlockSize
      BSBlockSizeActive: nv-provide-com-spec{ram-block-init-value=255, rom-block-init-value=255, variable=BSBlockSizeActive/Value}, nv-require-com-spec=init-value=255, provided-required-interface=BSBlockSizeActive
      Bargraph_Color_Calibration: nv-provide-com-spec{ram-block-init-value=[3, 232, 3, 232, 3, 232, 3, 232], rom-block-init-value=[3, 232, 3, 232, 3, 232, 3, 232], variable=Bargraph_Color_Calibration/Value}, nv-require-com-spec=init-value=[3, 232, 3, 232, 3, 232, 3, 232], provided-required-interface=Bargraph_Color_Calibration
      Bargraph_Hysteresis_Coolant: nv-provide-com-spec{ram-block-init-value=15 x 1, rom-block-init-value=15 x 1, variable=Bargraph_Hysteresis_Coolant/Value}, nv-require-com-spec=init-value=15 x 1, provided-required-interface=Bargraph_Hysteresis_Coolant
      Bargraph_Primary_Engine_Type: nv-provide-com-spec{ram-block-init-value=1, rom-block-init-value=1, variable=Bargraph_Primary_Engine_Type/Value}, nv-require-com-spec=init-value=1, provided-required-interface=Bargraph_Primary_Engine_Type
      Bargraph_Secondary_Engine_Type: nv-provide-com-spec{ram-block-init-value=0, rom-block-init-value=0, variable=Bargraph_Secondary_Engine_Type/Value}, nv-require-com-spec=init-value=0, provided-required-interface=Bargraph_Secondary_Engine_Type
      Bargraph_Treshold_Switch_Coolant:
        nv-provide-com-spec{ram-block-init-value=[66, 66, 89, 89, 101, 101, 113, 113, 125, 125, 137, 137, 149, 149, 161], rom-block-init-value=[66, 66, 89, 89, 101, 101, 113, 113, 125, 125, 137, 137, 149, 149, 161], variable=Bargraph_Treshold_Switch_Coolant/Value}
        nv-require-com-spec=init-value=[66, 66, 89, 89, 101, 101, 113, 113, 125, 125, 137, 137, 149, 149, 161]
        provided-required-interface=Bargraph_Treshold_Switch_Coolant
      Bargraphs_X: nv-provide-com-spec{ram-block-init-value=[0, 100, 500, 1000, 1500, 2530], rom-block-init-value=[0, 100, 500, 1000, 1500, 2530], variable=Bargraphs_X/Value}, nv-require-com-spec=init-value=[0, 100, 500, 1000, 1500, 2530], provided-required-interface=Bargraphs_X
      Bargraphs_Y: nv-provide-com-spec{ram-block-init-value=[20, 20, 50, 80, 500, 1000], rom-block-init-value=[20, 20, 50, 80, 500, 1000], variable=Bargraphs_Y/Value}, nv-require-com-spec=init-value=[20, 20, 50, 80, 500, 1000], provided-required-interface=Bargraphs_Y
      BattVoltage_0xA00000: nv-provide-com-spec{ram-block-init-value=0, rom-block-init-value=0, variable=BattVoltage_0xA00000/Value}, nv-require-com-spec=init-value=0, provided-required-interface=BattVoltage_0xA00000
      BattVoltage_0xA{00040..00044}: nv-provide-com-spec{ram-block-init-value=0, rom-block-init-value=0, variable=BattVoltage_0xA{00040..00044}/Value}, nv-require-com-spec=init-value=0, provided-required-interface=BattVoltage_0xA{00040..00044}
      BattVoltage_0xA00049: nv-provide-com-spec{ram-block-init-value=0, rom-block-init-value=0, variable=BattVoltage_0xA00049/Value}, nv-require-com-spec=init-value=0, provided-required-interface=BattVoltage_0xA00049
      Bc_Display_Available: nv-provide-com-spec{ram-block-init-value=1, rom-block-init-value=1, variable=Bc_Display_Available/Value}, nv-require-com-spec=init-value=1, provided-required-interface=Bc_Display_Available
      Bc_Layer3_Auto_Reset: nv-provide-com-spec{ram-block-init-value=1, rom-block-init-value=1, variable=Bc_Layer3_Auto_Reset/Value}, nv-require-com-spec=init-value=1, provided-required-interface=Bc_Layer3_Auto_Reset
      Bc_Layer3_Auto_Reset_EV: nv-provide-com-spec{ram-block-init-value=1, rom-block-init-value=1, variable=Bc_Layer3_Auto_Reset_EV/Value}, nv-require-com-spec=init-value=1, provided-required-interface=Bc_Layer3_Auto_Reset_EV
      Bc_Layer3_Auto_Reset_Gas: nv-provide-com-spec{ram-block-init-value=1, rom-block-init-value=1, variable=Bc_Layer3_Auto_Reset_Gas/Value}, nv-require-com-spec=init-value=1, provided-required-interface=Bc_Layer3_Auto_Reset_Gas
      Bc_Layer3_Manual_Reset: nv-provide-com-spec{ram-block-init-value=0, rom-block-init-value=0, variable=Bc_Layer3_Manual_Reset/Value}, nv-require-com-spec=init-value=0, provided-required-interface=Bc_Layer3_Manual_Reset
      BlackIceThresholdHighTemp: nv-provide-com-spec{ram-block-init-value=6, rom-block-init-value=6, variable=BlackIceThresholdHighTemp/Value}, nv-require-com-spec=init-value=6, provided-required-interface=BlackIceThresholdHighTemp
      BlackIceThresholdLowTemp: nv-provide-com-spec{ram-block-init-value=4, rom-block-init-value=4, variable=BlackIceThresholdLowTemp/Value}, nv-require-com-spec=init-value=4, provided-required-interface=BlackIceThresholdLowTemp
      BlackScreen_Reason: nv-provide-com-spec{ram-block-init-value=0, rom-block-init-value=0, variable=BlackScreen_Reason/Value}, nv-require-com-spec=init-value=0, provided-required-interface=BlackScreen_Reason
      BlockInfo_EEP_Engine: nv-provide-com-spec{ram-block-init-value=1, rom-block-init-value=1, variable=BlockInfo_EEP_Engine/Value}, nv-require-com-spec=init-value=1, provided-required-interface=BlockInfo_EEP_Engine
      BlockInfo_EEP_Market: nv-provide-com-spec{ram-block-init-value=1, rom-block-init-value=1, variable=BlockInfo_EEP_Market/Value}, nv-require-com-spec=init-value=1, provided-required-interface=BlockInfo_EEP_Market
      BlockInfo_EEP_Platform: nv-provide-com-spec{ram-block-init-value=1, rom-block-init-value=1, variable=BlockInfo_EEP_Platform/Value}, nv-require-com-spec=init-value=1, provided-required-interface=BlockInfo_EEP_Platform
      BlockInfo_EEP_Units: nv-provide-com-spec{ram-block-init-value=1, rom-block-init-value=1, variable=BlockInfo_EEP_Units/Value}, nv-require-com-spec=init-value=1, provided-required-interface=BlockInfo_EEP_Units
      BlockingDistanceVehicleMoving: nv-provide-com-spec{ram-block-init-value=50, rom-block-init-value=50, variable=BlockingDistanceVehicleMoving/Value}, nv-require-com-spec=init-value=50, provided-required-interface=BlockingDistanceVehicleMoving
      BlockingTimeVehicleMoving: nv-provide-com-spec{ram-block-init-value=15, rom-block-init-value=15, variable=BlockingTimeVehicleMoving/Value}, nv-require-com-spec=init-value=15, provided-required-interface=BlockingTimeVehicleMoving
      Blue_Gamma_Adjustment_Display1:
        nv-provide-com-spec{ram-block-init-value=[0, 64, 128, 192, 0, 64, 128, 192, 0, 64, 128, 192, 0, 64, 128, 192, 255, 0, 85, 170, 255, 3, 0, 0, 0, 0, 0], rom-block-init-value=[0, 64, 128, 192, 0, 64, 128, 192, 0, 64, 128, 192, 0, 64, 128, 192, 255, 0, 85, 170, 255, 3, 0, 0, 0, 0, 0], variable=Blue_Gamma_Adjustment_Display1/Value}
        nv-require-com-spec=init-value=[0, 64, 128, 192, 0, 64, 128, 192, 0, 64, 128, 192, 0, 64, 128, 192, 255, 0, 85, 170, 255, 3, 0, 0, 0, 0, 0]
        provided-required-interface=Blue_Gamma_Adjustment_Display1
      Blue_Gamma_Adjustment_Display2:
        nv-provide-com-spec{ram-block-init-value=[96, 140, 178, 210, 238, 56, 102, 146, 202, 2, 52, 122, 168, 220, 46, 72, 111, 144, 208, 0, 84, 169, 250, 63, 96, 140, 178, 210, 238, 56, 102, 146, 202, 2, 52, 122, 168, 220, 46, 72, 111, 144, 208, 0, 84, 169, 250, 63], rom-block-init-value=[96, 140, 178, 210, 238, 56, 102, 146, 202, 2, 52, 122, 168, 220, 46, 72, 111, 144, 208, 0, 84, 169, 250, 63, 96, 140, 178, 210, 238, 56, 102, 146, 202, 2, 52, 122, 168, 220, 46, 72, 111, 144, 208, 0, 84, 169, 250, 63], variable=Blue_Gamma_Adjustment_Display2/Value}
        nv-require-com-spec=init-value=[96, 140, 178, 210, 238, 56, 102, 146, 202, 2, 52, 122, 168, 220, 46, 72, 111, 144, 208, 0, 84, 169, 250, 63, 96, 140, 178, 210, 238, 56, 102, 146, 202, 2, 52, 122, 168, 220, 46, 72, 111, 144, 208, 0, 84, 169, 250, 63]
        provided-required-interface=Blue_Gamma_Adjustment_Display2
      BootloaderTPBlocksize: nv-provide-com-spec{ram-block-init-value=15, rom-block-init-value=15, variable=BootloaderTPBlocksize/Value}, nv-require-com-spec=init-value=15, provided-required-interface=BootloaderTPBlocksize
      Brand_Info: nv-provide-com-spec{ram-block-init-value=0, rom-block-init-value=0, variable=Brand_Info/Value}, nv-require-com-spec=init-value=0, provided-required-interface=Brand_Info
      Brightness_Photosensor_Cal_Error: nv-provide-com-spec{ram-block-init-value=255, rom-block-init-value=255, variable=Brightness_Photosensor_Cal_Error/Value}, nv-require-com-spec=init-value=255, provided-required-interface=Brightness_Photosensor_Cal_Error
      Brightness_Photosensor_Cal_Init: nv-provide-com-spec{ram-block-init-value=254, rom-block-init-value=254, variable=Brightness_Photosensor_Cal_Init/Value}, nv-require-com-spec=init-value=254, provided-required-interface=Brightness_Photosensor_Cal_Init
      Brightness_Photosensor_Damp_Dimm_Down: nv-provide-com-spec{ram-block-init-value=1200, rom-block-init-value=1200, variable=Brightness_Photosensor_Damp_Dimm_Down/Value}, nv-require-com-spec=init-value=1200, provided-required-interface=Brightness_Photosensor_Damp_Dimm_Down
      Brightness_Photosensor_Damp_Dimm_Up: nv-provide-com-spec{ram-block-init-value=480, rom-block-init-value=480, variable=Brightness_Photosensor_Damp_Dimm_Up/Value}, nv-require-com-spec=init-value=480, provided-required-interface=Brightness_Photosensor_Damp_Dimm_Up
      CAN_DEV_Monitoring_Blocks: nv-provide-com-spec{ram-block-init-value=20 x 0, rom-block-init-value=20 x 0, variable=CAN_DEV_Monitoring_Blocks/Value}, nv-require-com-spec=init-value=20 x 0, provided-required-interface=CAN_DEV_Monitoring_Blocks
      CAN_DEV_Monitoring_Status: nv-provide-com-spec{ram-block-init-value=0, rom-block-init-value=0, variable=CAN_DEV_Monitoring_Status/Value}, nv-require-com-spec=init-value=0, provided-required-interface=CAN_DEV_Monitoring_Status
      COMPONENTS_Cfg_CONST_Safety_CRC: nv-provide-com-spec{ram-block-init-value=33078, rom-block-init-value=33078, variable=COMPONENTS_Cfg_CONST_Safety_CRC/Value}, nv-require-com-spec=init-value=33078, provided-required-interface=COMPONENTS_Cfg_CONST_Safety_CRC
      COMPONENTS_Cfg_VAR_Safety_CRC: nv-provide-com-spec{ram-block-init-value=12589, rom-block-init-value=12589, variable=COMPONENTS_Cfg_VAR_Safety_CRC/Value}, nv-require-com-spec=init-value=12589, provided-required-interface=COMPONENTS_Cfg_VAR_Safety_CRC
      CRCLength_Block{1..6}: nv-provide-com-spec{ram-block-init-value=[255, 255, 255, 255], rom-block-init-value=[255, 255, 255, 255], variable=CRCLength_Block{1..6}/Value}, nv-require-com-spec=init-value=[255, 255, 255, 255], provided-required-interface=CRCLength_Block{1..6}
      CRCStart_Block{1..6}: nv-provide-com-spec{ram-block-init-value=[255, 255, 255, 255], rom-block-init-value=[255, 255, 255, 255], variable=CRCStart_Block{1..6}/Value}, nv-require-com-spec=init-value=[255, 255, 255, 255], provided-required-interface=CRCStart_Block{1..6}
      CRCValue_Block{1..6}: nv-provide-com-spec{ram-block-init-value=[255, 255, 255, 255], rom-block-init-value=[255, 255, 255, 255], variable=CRCValue_Block{1..6}/Value}, nv-require-com-spec=init-value=[255, 255, 255, 255], provided-required-interface=CRCValue_Block{1..6}
      Calibrated_RGB_Font_Colour_Triple: nv-provide-com-spec{ram-block-init-value=[255, 255, 255], rom-block-init-value=[255, 255, 255], variable=Calibrated_RGB_Font_Colour_Triple/Value}, nv-require-com-spec=init-value=[255, 255, 255], provided-required-interface=Calibrated_RGB_Font_Colour_Triple
      Calibration_Date: nv-provide-com-spec{ram-block-init-value=[0, 1, 1], rom-block-init-value=[0, 1, 1], variable=Calibration_Date/Value}, nv-require-com-spec=init-value=[0, 1, 1], provided-required-interface=Calibration_Date
      Calibration_Shop_Code: nv-provide-com-spec{ram-block-init-value=6 x 0, rom-block-init-value=6 x 0, variable=Calibration_Shop_Code/Value}, nv-require-com-spec=init-value=6 x 0, provided-required-interface=Calibration_Shop_Code
      CanBusActive: nv-provide-com-spec{ram-block-init-value=0, rom-block-init-value=0, variable=CanBusActive/Value}, nv-require-com-spec=init-value=0, provided-required-interface=CanBusActive
      Celeb_DimOffset_Scale: nv-provide-com-spec{ram-block-init-value=0, rom-block-init-value=0, variable=Celeb_DimOffset_Scale/Value}, nv-require-com-spec=init-value=0, provided-required-interface=Celeb_DimOffset_Scale
      Celeb_EndDim_Scale_Curve_X: nv-provide-com-spec{ram-block-init-value=[0, 10, 15, 25, 30, 36, 43, 50], rom-block-init-value=[0, 10, 15, 25, 30, 36, 43, 50], variable=Celeb_EndDim_Scale_Curve_X/Value}, nv-require-com-spec=init-value=[0, 10, 15, 25, 30, 36, 43, 50], provided-required-interface=Celeb_EndDim_Scale_Curve_X
      Celeb_EndDim_Scale_Curve_Y: nv-provide-com-spec{ram-block-init-value=[100, 85, 65, 20, 10, 5, 2, 0], rom-block-init-value=[100, 85, 65, 20, 10, 5, 2, 0], variable=Celeb_EndDim_Scale_Curve_Y/Value}, nv-require-com-spec=init-value=[100, 85, 65, 20, 10, 5, 2, 0], provided-required-interface=Celeb_EndDim_Scale_Curve_Y
      Celeb_PreStart_Scale_Curve_X: nv-provide-com-spec{ram-block-init-value=6 x 0, rom-block-init-value=6 x 0, variable=Celeb_PreStart_Scale_Curve_X/Value}, nv-require-com-spec=init-value=6 x 0, provided-required-interface=Celeb_PreStart_Scale_Curve_X
      Celeb_PreStart_Scale_Curve_Y: nv-provide-com-spec{ram-block-init-value=6 x 0, rom-block-init-value=6 x 0, variable=Celeb_PreStart_Scale_Curve_Y/Value}, nv-require-com-spec=init-value=6 x 0, provided-required-interface=Celeb_PreStart_Scale_Curve_Y
      Celeb_StartDim_Scale_Curve_X: nv-provide-com-spec{ram-block-init-value=[0, 4, 8, 25, 50, 85, 90, 100], rom-block-init-value=[0, 4, 8, 25, 50, 85, 90, 100], variable=Celeb_StartDim_Scale_Curve_X/Value}, nv-require-com-spec=init-value=[0, 4, 8, 25, 50, 85, 90, 100], provided-required-interface=Celeb_StartDim_Scale_Curve_X
      Celeb_StartDim_Scale_Curve_Y: nv-provide-com-spec{ram-block-init-value=[0, 2, 6, 28, 75, 92, 97, 100], rom-block-init-value=[0, 2, 6, 28, 75, 92, 97, 100], variable=Celeb_StartDim_Scale_Curve_Y/Value}, nv-require-com-spec=init-value=[0, 2, 6, 28, 75, 92, 97, 100], provided-required-interface=Celeb_StartDim_Scale_Curve_Y
      ClusterFunction_0xA00000: nv-provide-com-spec{ram-block-init-value=0, rom-block-init-value=0, variable=ClusterFunction_0xA00000/Value}, nv-require-com-spec=init-value=0, provided-required-interface=ClusterFunction_0xA00000
      ClusterFunction_0xA{00040..00044}: nv-provide-com-spec{ram-block-init-value=0, rom-block-init-value=0, variable=ClusterFunction_0xA{00040..00044}/Value}, nv-require-com-spec=init-value=0, provided-required-interface=ClusterFunction_0xA{00040..00044}
      ClusterFunction_0xA00049: nv-provide-com-spec{ram-block-init-value=0, rom-block-init-value=0, variable=ClusterFunction_0xA00049/Value}, nv-require-com-spec=init-value=0, provided-required-interface=ClusterFunction_0xA00049
      ClusterState_0xA00000: nv-provide-com-spec{ram-block-init-value=0, rom-block-init-value=0, variable=ClusterState_0xA00000/Value}, nv-require-com-spec=init-value=0, provided-required-interface=ClusterState_0xA00000
      ClusterState_0xA{00040..00044}: nv-provide-com-spec{ram-block-init-value=0, rom-block-init-value=0, variable=ClusterState_0xA{00040..00044}/Value}, nv-require-com-spec=init-value=0, provided-required-interface=ClusterState_0xA{00040..00044}
      ClusterState_0xA00049: nv-provide-com-spec{ram-block-init-value=0, rom-block-init-value=0, variable=ClusterState_0xA00049/Value}, nv-require-com-spec=init-value=0, provided-required-interface=ClusterState_0xA00049
      Cluster_Variant: nv-provide-com-spec{ram-block-init-value=6, rom-block-init-value=6, variable=Cluster_Variant/Value}, nv-require-com-spec=init-value=6, provided-required-interface=Cluster_Variant
      Cluster_Variant_ASIA: nv-provide-com-spec{ram-block-init-value=0, rom-block-init-value=0, variable=Cluster_Variant_ASIA/Value}, nv-require-com-spec=init-value=0, provided-required-interface=Cluster_Variant_ASIA
      Cluster_Variant_CHINA: nv-provide-com-spec{ram-block-init-value=0, rom-block-init-value=0, variable=Cluster_Variant_CHINA/Value}, nv-require-com-spec=init-value=0, provided-required-interface=Cluster_Variant_CHINA
      Cluster_Variant_Canada: nv-provide-com-spec{ram-block-init-value=0, rom-block-init-value=0, variable=Cluster_Variant_Canada/Value}, nv-require-com-spec=init-value=0, provided-required-interface=Cluster_Variant_Canada
      Cluster_Variant_FBU: nv-provide-com-spec{ram-block-init-value=0, rom-block-init-value=0, variable=Cluster_Variant_FBU/Value}, nv-require-com-spec=init-value=0, provided-required-interface=Cluster_Variant_FBU
      Cluster_Variant_USA: nv-provide-com-spec{ram-block-init-value=0, rom-block-init-value=0, variable=Cluster_Variant_USA/Value}, nv-require-com-spec=init-value=0, provided-required-interface=Cluster_Variant_USA
      CodingCheck_4WD_Installed: nv-provide-com-spec{ram-block-init-value=3, rom-block-init-value=3, variable=CodingCheck_4WD_Installed/Value}, nv-require-com-spec=init-value=3, provided-required-interface=CodingCheck_4WD_Installed
      CodingCheck_ACC_Installed: nv-provide-com-spec{ram-block-init-value=3, rom-block-init-value=3, variable=CodingCheck_ACC_Installed/Value}, nv-require-com-spec=init-value=3, provided-required-interface=CodingCheck_ACC_Installed
      CodingCheck_ADA_Installed: nv-provide-com-spec{ram-block-init-value=0, rom-block-init-value=0, variable=CodingCheck_ADA_Installed/Value}, nv-require-com-spec=init-value=0, provided-required-interface=CodingCheck_ADA_Installed
      CodingCheck_AFS_Installed: nv-provide-com-spec{ram-block-init-value=3, rom-block-init-value=3, variable=CodingCheck_AFS_Installed/Value}, nv-require-com-spec=init-value=3, provided-required-interface=CodingCheck_AFS_Installed
      CodingCheck_AGA_Installed: nv-provide-com-spec{ram-block-init-value=3, rom-block-init-value=3, variable=CodingCheck_AGA_Installed/Value}, nv-require-com-spec=init-value=3, provided-required-interface=CodingCheck_AGA_Installed
      CodingCheck_ARA_Installed: nv-provide-com-spec{ram-block-init-value=3, rom-block-init-value=3, variable=CodingCheck_ARA_Installed/Value}, nv-require-com-spec=init-value=3, provided-required-interface=CodingCheck_ARA_Installed
      CodingCheck_ASTA_Installed: nv-provide-com-spec{ram-block-init-value=3, rom-block-init-value=3, variable=CodingCheck_ASTA_Installed/Value}, nv-require-com-spec=init-value=3, provided-required-interface=CodingCheck_ASTA_Installed
      CodingCheck_AWV_BAP_Installed: nv-provide-com-spec{ram-block-init-value=3, rom-block-init-value=3, variable=CodingCheck_AWV_BAP_Installed/Value}, nv-require-com-spec=init-value=3, provided-required-interface=CodingCheck_AWV_BAP_Installed
      CodingCheck_AWV_Installed: nv-provide-com-spec{ram-block-init-value=3, rom-block-init-value=3, variable=CodingCheck_AWV_Installed/Value}, nv-require-com-spec=init-value=3, provided-required-interface=CodingCheck_AWV_Installed
      CodingCheck_Acceleration_Display_Available: nv-provide-com-spec{ram-block-init-value=3, rom-block-init-value=3, variable=CodingCheck_Acceleration_Display_Available/Value}, nv-require-com-spec=init-value=3, provided-required-interface=CodingCheck_Acceleration_Display_Available
      CodingCheck_Audio_Installed: nv-provide-com-spec{ram-block-init-value=3, rom-block-init-value=3, variable=CodingCheck_Audio_Installed/Value}, nv-require-com-spec=init-value=3, provided-required-interface=CodingCheck_Audio_Installed
      CodingCheck_BCmE_Installed: nv-provide-com-spec{ram-block-init-value=3, rom-block-init-value=3, variable=CodingCheck_BCmE_Installed/Value}, nv-require-com-spec=init-value=3, provided-required-interface=CodingCheck_BCmE_Installed
      CodingCheck_BVA_with_BKL: nv-provide-com-spec{ram-block-init-value=3, rom-block-init-value=3, variable=CodingCheck_BVA_with_BKL/Value}, nv-require-com-spec=init-value=3, provided-required-interface=CodingCheck_BVA_with_BKL
      CodingCheck_Bc_Display_Available: nv-provide-com-spec{ram-block-init-value=3, rom-block-init-value=3, variable=CodingCheck_Bc_Display_Available/Value}, nv-require-com-spec=init-value=3, provided-required-interface=CodingCheck_Bc_Display_Available
      CodingCheck_CarBody: nv-provide-com-spec{ram-block-init-value=3, rom-block-init-value=3, variable=CodingCheck_CarBody/Value}, nv-require-com-spec=init-value=3, provided-required-interface=CodingCheck_CarBody
      CodingCheck_Car_Leaving_Warning_Available: nv-provide-com-spec{ram-block-init-value=3, rom-block-init-value=3, variable=CodingCheck_Car_Leaving_Warning_Available/Value}, nv-require-com-spec=init-value=3, provided-required-interface=CodingCheck_Car_Leaving_Warning_Available
      CodingCheck_Compass_Position: nv-provide-com-spec{ram-block-init-value=3, rom-block-init-value=3, variable=CodingCheck_Compass_Position/Value}, nv-require-com-spec=init-value=3, provided-required-interface=CodingCheck_Compass_Position
      CodingCheck_Damper_Installed: nv-provide-com-spec{ram-block-init-value=3, rom-block-init-value=3, variable=CodingCheck_Damper_Installed/Value}, nv-require-com-spec=init-value=3, provided-required-interface=CodingCheck_Damper_Installed
      CodingCheck_DayIlluminationPointers: nv-provide-com-spec{ram-block-init-value=3, rom-block-init-value=3, variable=CodingCheck_DayIlluminationPointers/Value}, nv-require-com-spec=init-value=3, provided-required-interface=CodingCheck_DayIlluminationPointers
      CodingCheck_DayIlluminationScales: nv-provide-com-spec{ram-block-init-value=3, rom-block-init-value=3, variable=CodingCheck_DayIlluminationScales/Value}, nv-require-com-spec=init-value=3, provided-required-interface=CodingCheck_DayIlluminationScales
      CodingCheck_Dig_OilTemp_Display_Available: nv-provide-com-spec{ram-block-init-value=3, rom-block-init-value=3, variable=CodingCheck_Dig_OilTemp_Display_Available/Value}, nv-require-com-spec=init-value=3, provided-required-interface=CodingCheck_Dig_OilTemp_Display_Available
      CodingCheck_Digital_Key_Installed: nv-provide-com-spec{ram-block-init-value=3, rom-block-init-value=3, variable=CodingCheck_Digital_Key_Installed/Value}, nv-require-com-spec=init-value=3, provided-required-interface=CodingCheck_Digital_Key_Installed
      CodingCheck_EBKV_Installed: nv-provide-com-spec{ram-block-init-value=3, rom-block-init-value=3, variable=CodingCheck_EBKV_Installed/Value}, nv-require-com-spec=init-value=3, provided-required-interface=CodingCheck_EBKV_Installed
      CodingCheck_ELV_Installed: nv-provide-com-spec{ram-block-init-value=3, rom-block-init-value=3, variable=CodingCheck_ELV_Installed/Value}, nv-require-com-spec=init-value=3, provided-required-interface=CodingCheck_ELV_Installed
      CodingCheck_Epb_Installed: nv-provide-com-spec{ram-block-init-value=3, rom-block-init-value=3, variable=CodingCheck_Epb_Installed/Value}, nv-require-com-spec=init-value=3, provided-required-interface=CodingCheck_Epb_Installed
      CodingCheck_Eps_Installed: nv-provide-com-spec{ram-block-init-value=3, rom-block-init-value=3, variable=CodingCheck_Eps_Installed/Value}, nv-require-com-spec=init-value=3, provided-required-interface=CodingCheck_Eps_Installed
      CodingCheck_FCWP_Installed: nv-provide-com-spec{ram-block-init-value=3, rom-block-init-value=3, variable=CodingCheck_FCWP_Installed/Value}, nv-require-com-spec=init-value=3, provided-required-interface=CodingCheck_FCWP_Installed
      CodingCheck_Fuel_Variant: nv-provide-com-spec{ram-block-init-value=4027056127, rom-block-init-value=4027056127, variable=CodingCheck_Fuel_Variant/Value}, nv-require-com-spec=init-value=4027056127, provided-required-interface=CodingCheck_Fuel_Variant
      CodingCheck_GRA_High_Display: nv-provide-com-spec{ram-block-init-value=3, rom-block-init-value=3, variable=CodingCheck_GRA_High_Display/Value}, nv-require-com-spec=init-value=3, provided-required-interface=CodingCheck_GRA_High_Display
      CodingCheck_HRE_Installed: nv-provide-com-spec{ram-block-init-value=3, rom-block-init-value=3, variable=CodingCheck_HRE_Installed/Value}, nv-require-com-spec=init-value=3, provided-required-interface=CodingCheck_HRE_Installed
      CodingCheck_Hybrid_BAP_Installed: nv-provide-com-spec{ram-block-init-value=3, rom-block-init-value=3, variable=CodingCheck_Hybrid_BAP_Installed/Value}, nv-require-com-spec=init-value=3, provided-required-interface=CodingCheck_Hybrid_BAP_Installed
      CodingCheck_Hybrid_Installed: nv-provide-com-spec{ram-block-init-value=3, rom-block-init-value=3, variable=CodingCheck_Hybrid_Installed/Value}, nv-require-com-spec=init-value=3, provided-required-interface=CodingCheck_Hybrid_Installed
      CodingCheck_IAA_PSO_BAP_Installed: nv-provide-com-spec{ram-block-init-value=3, rom-block-init-value=3, variable=CodingCheck_IAA_PSO_BAP_Installed/Value}, nv-require-com-spec=init-value=3, provided-required-interface=CodingCheck_IAA_PSO_BAP_Installed
      CodingCheck_Ignition_EV_LowVoltage: nv-provide-com-spec{ram-block-init-value=3, rom-block-init-value=3, variable=CodingCheck_Ignition_EV_LowVoltage/Value}, nv-require-com-spec=init-value=3, provided-required-interface=CodingCheck_Ignition_EV_LowVoltage
      CodingCheck_Joker_Button_Installed: nv-provide-com-spec{ram-block-init-value=3, rom-block-init-value=3, variable=CodingCheck_Joker_Button_Installed/Value}, nv-require-com-spec=init-value=3, provided-required-interface=CodingCheck_Joker_Button_Installed
      CodingCheck_KFG_Installed: nv-provide-com-spec{ram-block-init-value=3, rom-block-init-value=3, variable=CodingCheck_KFG_Installed/Value}, nv-require-com-spec=init-value=3, provided-required-interface=CodingCheck_KFG_Installed
      CodingCheck_K_Number: nv-provide-com-spec{ram-block-init-value=5, rom-block-init-value=5, variable=CodingCheck_K_Number/Value}, nv-require-com-spec=init-value=5, provided-required-interface=CodingCheck_K_Number
      CodingCheck_Key_Warning: nv-provide-com-spec{ram-block-init-value=3, rom-block-init-value=3, variable=CodingCheck_Key_Warning/Value}, nv-require-com-spec=init-value=3, provided-required-interface=CodingCheck_Key_Warning
      CodingCheck_LDW_BAP_Installed: nv-provide-com-spec{ram-block-init-value=3, rom-block-init-value=3, variable=CodingCheck_LDW_BAP_Installed/Value}, nv-require-com-spec=init-value=3, provided-required-interface=CodingCheck_LDW_BAP_Installed
      CodingCheck_LDW_Installed: nv-provide-com-spec{ram-block-init-value=3, rom-block-init-value=3, variable=CodingCheck_LDW_Installed/Value}, nv-require-com-spec=init-value=3, provided-required-interface=CodingCheck_LDW_Installed
      CodingCheck_Laptimer: nv-provide-com-spec{ram-block-init-value=3, rom-block-init-value=3, variable=CodingCheck_Laptimer/Value}, nv-require-com-spec=init-value=3, provided-required-interface=CodingCheck_Laptimer
      CodingCheck_Navigation_Compass_Installed: nv-provide-com-spec{ram-block-init-value=3, rom-block-init-value=3, variable=CodingCheck_Navigation_Compass_Installed/Value}, nv-require-com-spec=init-value=3, provided-required-interface=CodingCheck_Navigation_Compass_Installed
      CodingCheck_OutsideTemperature_Indication: nv-provide-com-spec{ram-block-init-value=3, rom-block-init-value=3, variable=CodingCheck_OutsideTemperature_Indication/Value}, nv-require-com-spec=init-value=3, provided-required-interface=CodingCheck_OutsideTemperature_Indication
      CodingCheck_PEA_BAP_Installed: nv-provide-com-spec{ram-block-init-value=3, rom-block-init-value=3, variable=CodingCheck_PEA_BAP_Installed/Value}, nv-require-com-spec=init-value=3, provided-required-interface=CodingCheck_PEA_BAP_Installed
      CodingCheck_PLA3_Installed: nv-provide-com-spec{ram-block-init-value=3, rom-block-init-value=3, variable=CodingCheck_PLA3_Installed/Value}, nv-require-com-spec=init-value=3, provided-required-interface=CodingCheck_PLA3_Installed
      CodingCheck_PLA_Installed: nv-provide-com-spec{ram-block-init-value=3, rom-block-init-value=3, variable=CodingCheck_PLA_Installed/Value}, nv-require-com-spec=init-value=3, provided-required-interface=CodingCheck_PLA_Installed
      CodingCheck_PedestrianAssist_BAP_Installed: nv-provide-com-spec{ram-block-init-value=3, rom-block-init-value=3, variable=CodingCheck_PedestrianAssist_BAP_Installed/Value}, nv-require-com-spec=init-value=3, provided-required-interface=CodingCheck_PedestrianAssist_BAP_Installed
      CodingCheck_Personalization_Installed: nv-provide-com-spec{ram-block-init-value=3, rom-block-init-value=3, variable=CodingCheck_Personalization_Installed/Value}, nv-require-com-spec=init-value=3, provided-required-interface=CodingCheck_Personalization_Installed
      CodingCheck_Pointer_Kl_58: nv-provide-com-spec{ram-block-init-value=3, rom-block-init-value=3, variable=CodingCheck_Pointer_Kl_58/Value}, nv-require-com-spec=init-value=3, provided-required-interface=CodingCheck_Pointer_Kl_58
      CodingCheck_QSP_Installed: nv-provide-com-spec{ram-block-init-value=3, rom-block-init-value=3, variable=CodingCheck_QSP_Installed/Value}, nv-require-com-spec=init-value=3, provided-required-interface=CodingCheck_QSP_Installed
      CodingCheck_RDK_BAP_Installed: nv-provide-com-spec{ram-block-init-value=3, rom-block-init-value=3, variable=CodingCheck_RDK_BAP_Installed/Value}, nv-require-com-spec=init-value=3, provided-required-interface=CodingCheck_RDK_BAP_Installed
      CodingCheck_RDK_Installed: nv-provide-com-spec{ram-block-init-value=3, rom-block-init-value=3, variable=CodingCheck_RDK_Installed/Value}, nv-require-com-spec=init-value=3, provided-required-interface=CodingCheck_RDK_Installed
      CodingCheck_RKA_Installed: nv-provide-com-spec{ram-block-init-value=3, rom-block-init-value=3, variable=CodingCheck_RKA_Installed/Value}, nv-require-com-spec=init-value=3, provided-required-interface=CodingCheck_RKA_Installed
      CodingCheck_RefulledVolume_Available: nv-provide-com-spec{ram-block-init-value=3, rom-block-init-value=3, variable=CodingCheck_RefulledVolume_Available/Value}, nv-require-com-spec=init-value=3, provided-required-interface=CodingCheck_RefulledVolume_Available
      CodingCheck_Right_Drive: nv-provide-com-spec{ram-block-init-value=3, rom-block-init-value=3, variable=CodingCheck_Right_Drive/Value}, nv-require-com-spec=init-value=3, provided-required-interface=CodingCheck_Right_Drive
      CodingCheck_SDS_BAP_Installed: nv-provide-com-spec{ram-block-init-value=3, rom-block-init-value=3, variable=CodingCheck_SDS_BAP_Installed/Value}, nv-require-com-spec=init-value=3, provided-required-interface=CodingCheck_SDS_BAP_Installed
      CodingCheck_SWA_BAP_Installed: nv-provide-com-spec{ram-block-init-value=3, rom-block-init-value=3, variable=CodingCheck_SWA_BAP_Installed/Value}, nv-require-com-spec=init-value=3, provided-required-interface=CodingCheck_SWA_BAP_Installed
      CodingCheck_SWA_Installed: nv-provide-com-spec{ram-block-init-value=3, rom-block-init-value=3, variable=CodingCheck_SWA_Installed/Value}, nv-require-com-spec=init-value=3, provided-required-interface=CodingCheck_SWA_Installed
      CodingCheck_SeatbeltWarning: nv-provide-com-spec{ram-block-init-value=7, rom-block-init-value=7, variable=CodingCheck_SeatbeltWarning/Value}, nv-require-com-spec=init-value=7, provided-required-interface=CodingCheck_SeatbeltWarning
      CodingCheck_Staging: nv-provide-com-spec{ram-block-init-value=3, rom-block-init-value=3, variable=CodingCheck_Staging/Value}, nv-require-com-spec=init-value=3, provided-required-interface=CodingCheck_Staging
      CodingCheck_StartStopReasons_BAP_Installed: nv-provide-com-spec{ram-block-init-value=3, rom-block-init-value=3, variable=CodingCheck_StartStopReasons_BAP_Installed/Value}, nv-require-com-spec=init-value=3, provided-required-interface=CodingCheck_StartStopReasons_BAP_Installed
      CodingCheck_StartUp_Screen: nv-provide-com-spec{ram-block-init-value=9, rom-block-init-value=9, variable=CodingCheck_StartUp_Screen/Value}, nv-require-com-spec=init-value=9, provided-required-interface=CodingCheck_StartUp_Screen
      CodingCheck_Telephone2_Installed: nv-provide-com-spec{ram-block-init-value=3, rom-block-init-value=3, variable=CodingCheck_Telephone2_Installed/Value}, nv-require-com-spec=init-value=3, provided-required-interface=CodingCheck_Telephone2_Installed
      CodingCheck_Telephone2_Installed_Obsolete: nv-provide-com-spec{ram-block-init-value=9 x 3, rom-block-init-value=9 x 3, variable=CodingCheck_Telephone2_Installed_Obsolete/Value}, nv-require-com-spec=init-value=9 x 3, provided-required-interface=CodingCheck_Telephone2_Installed_Obsolete
      CodingCheck_Telephone_Installed: nv-provide-com-spec{ram-block-init-value=3, rom-block-init-value=3, variable=CodingCheck_Telephone_Installed/Value}, nv-require-com-spec=init-value=3, provided-required-interface=CodingCheck_Telephone_Installed
      CodingCheck_Two_Keys_Installed: nv-provide-com-spec{ram-block-init-value=3, rom-block-init-value=3, variable=CodingCheck_Two_Keys_Installed/Value}, nv-require-com-spec=init-value=3, provided-required-interface=CodingCheck_Two_Keys_Installed
      CodingCheck_Unit_ClockFormat: nv-provide-com-spec{ram-block-init-value=3, rom-block-init-value=3, variable=CodingCheck_Unit_ClockFormat/Value}, nv-require-com-spec=init-value=3, provided-required-interface=CodingCheck_Unit_ClockFormat
      CodingCheck_Unit_Consumption_Electric: nv-provide-com-spec{ram-block-init-value=31, rom-block-init-value=31, variable=CodingCheck_Unit_Consumption_Electric/Value}, nv-require-com-spec=init-value=31, provided-required-interface=CodingCheck_Unit_Consumption_Electric
      CodingCheck_Unit_Consumption_Electric_Obsolete: nv-provide-com-spec{ram-block-init-value=9 x 3, rom-block-init-value=9 x 3, variable=CodingCheck_Unit_Consumption_Electric_Obsolete/Value}, nv-require-com-spec=init-value=9 x 3, provided-required-interface=CodingCheck_Unit_Consumption_Electric_Obsolete
      CodingCheck_Unit_DateFormat: nv-provide-com-spec{ram-block-init-value=7, rom-block-init-value=7, variable=CodingCheck_Unit_DateFormat/Value}, nv-require-com-spec=init-value=7, provided-required-interface=CodingCheck_Unit_DateFormat
      CodingCheck_Unit_FuelConsumption: nv-provide-com-spec{ram-block-init-value=15, rom-block-init-value=15, variable=CodingCheck_Unit_FuelConsumption/Value}, nv-require-com-spec=init-value=15, provided-required-interface=CodingCheck_Unit_FuelConsumption
      CodingCheck_Unit_FuelConsumption_Gas: nv-provide-com-spec{ram-block-init-value=511, rom-block-init-value=511, variable=CodingCheck_Unit_FuelConsumption_Gas/Value}, nv-require-com-spec=init-value=511, provided-required-interface=CodingCheck_Unit_FuelConsumption_Gas
      CodingCheck_Unit_Language: nv-provide-com-spec{ram-block-init-value=3890216959, rom-block-init-value=3890216959, variable=CodingCheck_Unit_Language/Value}, nv-require-com-spec=init-value=3890216959, provided-required-interface=CodingCheck_Unit_Language
      CodingCheck_Unit_Language_Ext: nv-provide-com-spec{ram-block-init-value=227, rom-block-init-value=227, variable=CodingCheck_Unit_Language_Ext/Value}, nv-require-com-spec=init-value=227, provided-required-interface=CodingCheck_Unit_Language_Ext
      CodingCheck_Unit_Language_Ext1: nv-provide-com-spec{ram-block-init-value=15, rom-block-init-value=15, variable=CodingCheck_Unit_Language_Ext1/Value}, nv-require-com-spec=init-value=15, provided-required-interface=CodingCheck_Unit_Language_Ext1
      CodingCheck_Unit_OdoTripDistance: nv-provide-com-spec{ram-block-init-value=3, rom-block-init-value=3, variable=CodingCheck_Unit_OdoTripDistance/Value}, nv-require-com-spec=init-value=3, provided-required-interface=CodingCheck_Unit_OdoTripDistance
      CodingCheck_Unit_Pressure: nv-provide-com-spec{ram-block-init-value=7, rom-block-init-value=7, variable=CodingCheck_Unit_Pressure/Value}, nv-require-com-spec=init-value=7, provided-required-interface=CodingCheck_Unit_Pressure
      CodingCheck_Unit_Speed: nv-provide-com-spec{ram-block-init-value=3, rom-block-init-value=3, variable=CodingCheck_Unit_Speed/Value}, nv-require-com-spec=init-value=3, provided-required-interface=CodingCheck_Unit_Speed
      CodingCheck_Unit_Temperature: nv-provide-com-spec{ram-block-init-value=3, rom-block-init-value=3, variable=CodingCheck_Unit_Temperature/Value}, nv-require-com-spec=init-value=3, provided-required-interface=CodingCheck_Unit_Temperature
      CodingCheck_Unit_Volume: nv-provide-com-spec{ram-block-init-value=7, rom-block-init-value=7, variable=CodingCheck_Unit_Volume/Value}, nv-require-com-spec=init-value=7, provided-required-interface=CodingCheck_Unit_Volume
      CodingCheck_Unit_Weight: nv-provide-com-spec{ram-block-init-value=3, rom-block-init-value=3, variable=CodingCheck_Unit_Weight/Value}, nv-require-com-spec=init-value=3, provided-required-interface=CodingCheck_Unit_Weight
      CodingCheck_VZA_Installed: nv-provide-com-spec{ram-block-init-value=3, rom-block-init-value=3, variable=CodingCheck_VZA_Installed/Value}, nv-require-com-spec=init-value=3, provided-required-interface=CodingCheck_VZA_Installed
      CodingCheck_V_Warning_Legal: nv-provide-com-spec{ram-block-init-value=3, rom-block-init-value=3, variable=CodingCheck_V_Warning_Legal/Value}, nv-require-com-spec=init-value=3, provided-required-interface=CodingCheck_V_Warning_Legal
      CodingCheck_WBA_Installed: nv-provide-com-spec{ram-block-init-value=3, rom-block-init-value=3, variable=CodingCheck_WBA_Installed/Value}, nv-require-com-spec=init-value=3, provided-required-interface=CodingCheck_WBA_Installed
      CodingCheck_eCall_Installed: nv-provide-com-spec{ram-block-init-value=3, rom-block-init-value=3, variable=CodingCheck_eCall_Installed/Value}, nv-require-com-spec=init-value=3, provided-required-interface=CodingCheck_eCall_Installed
      Coding_4WD_Installed: nv-provide-com-spec{ram-block-init-value=0, rom-block-init-value=0, variable=Coding_4WD_Installed/Value}, nv-require-com-spec=init-value=0, provided-required-interface=Coding_4WD_Installed
      Coding_ACC_Installed: nv-provide-com-spec{ram-block-init-value=0, rom-block-init-value=0, variable=Coding_ACC_Installed/Value}, nv-require-com-spec=init-value=0, provided-required-interface=Coding_ACC_Installed
      Coding_ADA_Installed: nv-provide-com-spec{ram-block-init-value=0, rom-block-init-value=0, variable=Coding_ADA_Installed/Value}, nv-require-com-spec=init-value=0, provided-required-interface=Coding_ADA_Installed
      Coding_AFS_Installed: nv-provide-com-spec{ram-block-init-value=0, rom-block-init-value=0, variable=Coding_AFS_Installed/Value}, nv-require-com-spec=init-value=0, provided-required-interface=Coding_AFS_Installed
      Coding_AGA_Installed: nv-provide-com-spec{ram-block-init-value=0, rom-block-init-value=0, variable=Coding_AGA_Installed/Value}, nv-require-com-spec=init-value=0, provided-required-interface=Coding_AGA_Installed
      Coding_ARA_Installed: nv-provide-com-spec{ram-block-init-value=0, rom-block-init-value=0, variable=Coding_ARA_Installed/Value}, nv-require-com-spec=init-value=0, provided-required-interface=Coding_ARA_Installed
      Coding_ASTA_Installed: nv-provide-com-spec{ram-block-init-value=0, rom-block-init-value=0, variable=Coding_ASTA_Installed/Value}, nv-require-com-spec=init-value=0, provided-required-interface=Coding_ASTA_Installed
      Coding_AWV_BAP_Installed: nv-provide-com-spec{ram-block-init-value=0, rom-block-init-value=0, variable=Coding_AWV_BAP_Installed/Value}, nv-require-com-spec=init-value=0, provided-required-interface=Coding_AWV_BAP_Installed
      Coding_AWV_Installed: nv-provide-com-spec{ram-block-init-value=0, rom-block-init-value=0, variable=Coding_AWV_Installed/Value}, nv-require-com-spec=init-value=0, provided-required-interface=Coding_AWV_Installed
      Coding_Audio_Installed: nv-provide-com-spec{ram-block-init-value=0, rom-block-init-value=0, variable=Coding_Audio_Installed/Value}, nv-require-com-spec=init-value=0, provided-required-interface=Coding_Audio_Installed
      Coding_BCmE_Installed: nv-provide-com-spec{ram-block-init-value=0, rom-block-init-value=0, variable=Coding_BCmE_Installed/Value}, nv-require-com-spec=init-value=0, provided-required-interface=Coding_BCmE_Installed
      Coding_BMS_Installed: nv-provide-com-spec{ram-block-init-value=1, rom-block-init-value=1, variable=Coding_BMS_Installed/Value}, nv-require-com-spec=init-value=1, provided-required-interface=Coding_BMS_Installed
      Coding_BVA_with_BKL: nv-provide-com-spec{ram-block-init-value=0, rom-block-init-value=0, variable=Coding_BVA_with_BKL/Value}, nv-require-com-spec=init-value=0, provided-required-interface=Coding_BVA_with_BKL
      Coding_CarBody: nv-provide-com-spec{ram-block-init-value=0, rom-block-init-value=0, variable=Coding_CarBody/Value}, nv-require-com-spec=init-value=0, provided-required-interface=Coding_CarBody
      Coding_Car_Leaving_Warning_Active: nv-provide-com-spec{ram-block-init-value=0, rom-block-init-value=0, variable=Coding_Car_Leaving_Warning_Active/Value}, nv-require-com-spec=init-value=0, provided-required-interface=Coding_Car_Leaving_Warning_Active
      Coding_Compass_Position: nv-provide-com-spec{ram-block-init-value=1, rom-block-init-value=1, variable=Coding_Compass_Position/Value}, nv-require-com-spec=init-value=1, provided-required-interface=Coding_Compass_Position
      Coding_Damper_Installed: nv-provide-com-spec{ram-block-init-value=0, rom-block-init-value=0, variable=Coding_Damper_Installed/Value}, nv-require-com-spec=init-value=0, provided-required-interface=Coding_Damper_Installed
      Coding_Date: nv-provide-com-spec{ram-block-init-value=[0, 1, 1], rom-block-init-value=[0, 1, 1], variable=Coding_Date/Value}, nv-require-com-spec=init-value=[0, 1, 1], provided-required-interface=Coding_Date
      Coding_DayIlluminationPointers: nv-provide-com-spec{ram-block-init-value=1, rom-block-init-value=1, variable=Coding_DayIlluminationPointers/Value}, nv-require-com-spec=init-value=1, provided-required-interface=Coding_DayIlluminationPointers
      Coding_DayIlluminationScales: nv-provide-com-spec{ram-block-init-value=1, rom-block-init-value=1, variable=Coding_DayIlluminationScales/Value}, nv-require-com-spec=init-value=1, provided-required-interface=Coding_DayIlluminationScales
      Coding_Digital_Key_Installed: nv-provide-com-spec{ram-block-init-value=0, rom-block-init-value=0, variable=Coding_Digital_Key_Installed/Value}, nv-require-com-spec=init-value=0, provided-required-interface=Coding_Digital_Key_Installed
      Coding_EBKV_Installed: nv-provide-com-spec{ram-block-init-value=0, rom-block-init-value=0, variable=Coding_EBKV_Installed/Value}, nv-require-com-spec=init-value=0, provided-required-interface=Coding_EBKV_Installed
      Coding_ELV_Installed: nv-provide-com-spec{ram-block-init-value=0, rom-block-init-value=0, variable=Coding_ELV_Installed/Value}, nv-require-com-spec=init-value=0, provided-required-interface=Coding_ELV_Installed
      Coding_EPS_Installed: nv-provide-com-spec{ram-block-init-value=0, rom-block-init-value=0, variable=Coding_EPS_Installed/Value}, nv-require-com-spec=init-value=0, provided-required-interface=Coding_EPS_Installed
      Coding_Epb_Installed: nv-provide-com-spec{ram-block-init-value=0, rom-block-init-value=0, variable=Coding_Epb_Installed/Value}, nv-require-com-spec=init-value=0, provided-required-interface=Coding_Epb_Installed
      Coding_FCWP_Installed: nv-provide-com-spec{ram-block-init-value=0, rom-block-init-value=0, variable=Coding_FCWP_Installed/Value}, nv-require-com-spec=init-value=0, provided-required-interface=Coding_FCWP_Installed
      Coding_HRE_Installed: nv-provide-com-spec{ram-block-init-value=0, rom-block-init-value=0, variable=Coding_HRE_Installed/Value}, nv-require-com-spec=init-value=0, provided-required-interface=Coding_HRE_Installed
      Coding_Hybrid_BAP_Installed: nv-provide-com-spec{ram-block-init-value=0, rom-block-init-value=0, variable=Coding_Hybrid_BAP_Installed/Value}, nv-require-com-spec=init-value=0, provided-required-interface=Coding_Hybrid_BAP_Installed
      Coding_Hybrid_Installed: nv-provide-com-spec{ram-block-init-value=0, rom-block-init-value=0, variable=Coding_Hybrid_Installed/Value}, nv-require-com-spec=init-value=0, provided-required-interface=Coding_Hybrid_Installed
      Coding_IAA_PSO_BAP_Installed: nv-provide-com-spec{ram-block-init-value=0, rom-block-init-value=0, variable=Coding_IAA_PSO_BAP_Installed/Value}, nv-require-com-spec=init-value=0, provided-required-interface=Coding_IAA_PSO_BAP_Installed
      Coding_Ignition_EV_LowVoltage: nv-provide-com-spec{ram-block-init-value=0, rom-block-init-value=0, variable=Coding_Ignition_EV_LowVoltage/Value}, nv-require-com-spec=init-value=0, provided-required-interface=Coding_Ignition_EV_LowVoltage
      Coding_Joker_Button_Installed: nv-provide-com-spec{ram-block-init-value=0, rom-block-init-value=0, variable=Coding_Joker_Button_Installed/Value}, nv-require-com-spec=init-value=0, provided-required-interface=Coding_Joker_Button_Installed
      Coding_KFG_Installed: nv-provide-com-spec{ram-block-init-value=0, rom-block-init-value=0, variable=Coding_KFG_Installed/Value}, nv-require-com-spec=init-value=0, provided-required-interface=Coding_KFG_Installed
      Coding_KeyWarning: nv-provide-com-spec{ram-block-init-value=0, rom-block-init-value=0, variable=Coding_KeyWarning/Value}, nv-require-com-spec=init-value=0, provided-required-interface=Coding_KeyWarning
      Coding_LDW_BAP_Installed: nv-provide-com-spec{ram-block-init-value=0, rom-block-init-value=0, variable=Coding_LDW_BAP_Installed/Value}, nv-require-com-spec=init-value=0, provided-required-interface=Coding_LDW_BAP_Installed
      Coding_LDW_Installed: nv-provide-com-spec{ram-block-init-value=0, rom-block-init-value=0, variable=Coding_LDW_Installed/Value}, nv-require-com-spec=init-value=0, provided-required-interface=Coding_LDW_Installed
      Coding_Language: nv-provide-com-spec{ram-block-init-value=0, rom-block-init-value=0, variable=Coding_Language/Value}, nv-require-com-spec=init-value=0, provided-required-interface=Coding_Language
      Coding_Laptimer: nv-provide-com-spec{ram-block-init-value=0, rom-block-init-value=0, variable=Coding_Laptimer/Value}, nv-require-com-spec=init-value=0, provided-required-interface=Coding_Laptimer
      Coding_Navigation_Compass_Installed: nv-provide-com-spec{ram-block-init-value=0, rom-block-init-value=0, variable=Coding_Navigation_Compass_Installed/Value}, nv-require-com-spec=init-value=0, provided-required-interface=Coding_Navigation_Compass_Installed
      Coding_PEA_BAP_Installed: nv-provide-com-spec{ram-block-init-value=0, rom-block-init-value=0, variable=Coding_PEA_BAP_Installed/Value}, nv-require-com-spec=init-value=0, provided-required-interface=Coding_PEA_BAP_Installed
      Coding_PLA3_Installed: nv-provide-com-spec{ram-block-init-value=0, rom-block-init-value=0, variable=Coding_PLA3_Installed/Value}, nv-require-com-spec=init-value=0, provided-required-interface=Coding_PLA3_Installed
      Coding_PLA_Installed: nv-provide-com-spec{ram-block-init-value=0, rom-block-init-value=0, variable=Coding_PLA_Installed/Value}, nv-require-com-spec=init-value=0, provided-required-interface=Coding_PLA_Installed
      Coding_PedestrianAssist_BAP_Installed: nv-provide-com-spec{ram-block-init-value=0, rom-block-init-value=0, variable=Coding_PedestrianAssist_BAP_Installed/Value}, nv-require-com-spec=init-value=0, provided-required-interface=Coding_PedestrianAssist_BAP_Installed
      Coding_Personalization_Installed: nv-provide-com-spec{ram-block-init-value=1, rom-block-init-value=1, variable=Coding_Personalization_Installed/Value}, nv-require-com-spec=init-value=1, provided-required-interface=Coding_Personalization_Installed
      Coding_Pointer_Kl_58: nv-provide-com-spec{ram-block-init-value=1, rom-block-init-value=1, variable=Coding_Pointer_Kl_58/Value}, nv-require-com-spec=init-value=1, provided-required-interface=Coding_Pointer_Kl_58
      Coding_Production_Mode_Acoustic: nv-provide-com-spec{ram-block-init-value=0, rom-block-init-value=0, variable=Coding_Production_Mode_Acoustic/Value}, nv-require-com-spec=init-value=0, provided-required-interface=Coding_Production_Mode_Acoustic
      Coding_Production_Mode_Key_Lock: nv-provide-com-spec{ram-block-init-value=0, rom-block-init-value=0, variable=Coding_Production_Mode_Key_Lock/Value}, nv-require-com-spec=init-value=0, provided-required-interface=Coding_Production_Mode_Key_Lock
      Coding_QSP_Installed: nv-provide-com-spec{ram-block-init-value=0, rom-block-init-value=0, variable=Coding_QSP_Installed/Value}, nv-require-com-spec=init-value=0, provided-required-interface=Coding_QSP_Installed
      Coding_RDK_BAP_Installed: nv-provide-com-spec{ram-block-init-value=0, rom-block-init-value=0, variable=Coding_RDK_BAP_Installed/Value}, nv-require-com-spec=init-value=0, provided-required-interface=Coding_RDK_BAP_Installed
      Coding_RDK_Installed: nv-provide-com-spec{ram-block-init-value=0, rom-block-init-value=0, variable=Coding_RDK_Installed/Value}, nv-require-com-spec=init-value=0, provided-required-interface=Coding_RDK_Installed
      Coding_RKA_Installed: nv-provide-com-spec{ram-block-init-value=0, rom-block-init-value=0, variable=Coding_RKA_Installed/Value}, nv-require-com-spec=init-value=0, provided-required-interface=Coding_RKA_Installed
      Coding_Right_Drive: nv-provide-com-spec{ram-block-init-value=0, rom-block-init-value=0, variable=Coding_Right_Drive/Value}, nv-require-com-spec=init-value=0, provided-required-interface=Coding_Right_Drive
      Coding_SDS_BAP_Installed: nv-provide-com-spec{ram-block-init-value=0, rom-block-init-value=0, variable=Coding_SDS_BAP_Installed/Value}, nv-require-com-spec=init-value=0, provided-required-interface=Coding_SDS_BAP_Installed
      Coding_SWA_BAP_Installed: nv-provide-com-spec{ram-block-init-value=0, rom-block-init-value=0, variable=Coding_SWA_BAP_Installed/Value}, nv-require-com-spec=init-value=0, provided-required-interface=Coding_SWA_BAP_Installed
      Coding_SWA_Installed: nv-provide-com-spec{ram-block-init-value=0, rom-block-init-value=0, variable=Coding_SWA_Installed/Value}, nv-require-com-spec=init-value=0, provided-required-interface=Coding_SWA_Installed
      Coding_SeatbeltWarning: nv-provide-com-spec{ram-block-init-value=1, rom-block-init-value=1, variable=Coding_SeatbeltWarning/Value}, nv-require-com-spec=init-value=1, provided-required-interface=Coding_SeatbeltWarning
      Coding_Shop_Code: nv-provide-com-spec{ram-block-init-value=6 x 0, rom-block-init-value=6 x 0, variable=Coding_Shop_Code/Value}, nv-require-com-spec=init-value=6 x 0, provided-required-interface=Coding_Shop_Code
      Coding_Staging: nv-provide-com-spec{ram-block-init-value=0, rom-block-init-value=0, variable=Coding_Staging/Value}, nv-require-com-spec=init-value=0, provided-required-interface=Coding_Staging
      Coding_StartStopReasons_BAP_Installed: nv-provide-com-spec{ram-block-init-value=0, rom-block-init-value=0, variable=Coding_StartStopReasons_BAP_Installed/Value}, nv-require-com-spec=init-value=0, provided-required-interface=Coding_StartStopReasons_BAP_Installed
      Coding_StartUp_Screen: nv-provide-com-spec{ram-block-init-value=0, rom-block-init-value=0, variable=Coding_StartUp_Screen/Value}, nv-require-com-spec=init-value=0, provided-required-interface=Coding_StartUp_Screen
      Coding_TCO_Installed: nv-provide-com-spec{ram-block-init-value=0, rom-block-init-value=0, variable=Coding_TCO_Installed/Value}, nv-require-com-spec=init-value=0, provided-required-interface=Coding_TCO_Installed
      Coding_Telephone2_Installed: nv-provide-com-spec{ram-block-init-value=0, rom-block-init-value=0, variable=Coding_Telephone2_Installed/Value}, nv-require-com-spec=init-value=0, provided-required-interface=Coding_Telephone2_Installed
      Coding_Telephone_Installed: nv-provide-com-spec{ram-block-init-value=0, rom-block-init-value=0, variable=Coding_Telephone_Installed/Value}, nv-require-com-spec=init-value=0, provided-required-interface=Coding_Telephone_Installed
      Coding_Unit_ClockFormat: nv-provide-com-spec{ram-block-init-value=0, rom-block-init-value=0, variable=Coding_Unit_ClockFormat/Value}, nv-require-com-spec=init-value=0, provided-required-interface=Coding_Unit_ClockFormat
      Coding_Unit_Consumption_Electrical: nv-provide-com-spec{ram-block-init-value=0, rom-block-init-value=0, variable=Coding_Unit_Consumption_Electrical/Value}, nv-require-com-spec=init-value=0, provided-required-interface=Coding_Unit_Consumption_Electrical
      Coding_Unit_DateFormat: nv-provide-com-spec{ram-block-init-value=0, rom-block-init-value=0, variable=Coding_Unit_DateFormat/Value}, nv-require-com-spec=init-value=0, provided-required-interface=Coding_Unit_DateFormat
      Coding_Unit_FuelConsumption: nv-provide-com-spec{ram-block-init-value=2, rom-block-init-value=2, variable=Coding_Unit_FuelConsumption/Value}, nv-require-com-spec=init-value=2, provided-required-interface=Coding_Unit_FuelConsumption
      Coding_Unit_FuelConsumption_Gas: nv-provide-com-spec{ram-block-init-value=0, rom-block-init-value=0, variable=Coding_Unit_FuelConsumption_Gas/Value}, nv-require-com-spec=init-value=0, provided-required-interface=Coding_Unit_FuelConsumption_Gas
      Coding_Unit_OdoTripDistance: nv-provide-com-spec{ram-block-init-value=0, rom-block-init-value=0, variable=Coding_Unit_OdoTripDistance/Value}, nv-require-com-spec=init-value=0, provided-required-interface=Coding_Unit_OdoTripDistance
      Coding_Unit_Pressure: nv-provide-com-spec{ram-block-init-value=0, rom-block-init-value=0, variable=Coding_Unit_Pressure/Value}, nv-require-com-spec=init-value=0, provided-required-interface=Coding_Unit_Pressure
      Coding_Unit_Speed: nv-provide-com-spec{ram-block-init-value=0, rom-block-init-value=0, variable=Coding_Unit_Speed/Value}, nv-require-com-spec=init-value=0, provided-required-interface=Coding_Unit_Speed
      Coding_Unit_Temperature: nv-provide-com-spec{ram-block-init-value=0, rom-block-init-value=0, variable=Coding_Unit_Temperature/Value}, nv-require-com-spec=init-value=0, provided-required-interface=Coding_Unit_Temperature
      Coding_Unit_Volume: nv-provide-com-spec{ram-block-init-value=0, rom-block-init-value=0, variable=Coding_Unit_Volume/Value}, nv-require-com-spec=init-value=0, provided-required-interface=Coding_Unit_Volume
      Coding_Unit_Weight: nv-provide-com-spec{ram-block-init-value=0, rom-block-init-value=0, variable=Coding_Unit_Weight/Value}, nv-require-com-spec=init-value=0, provided-required-interface=Coding_Unit_Weight
      Coding_VZA_Installed: nv-provide-com-spec{ram-block-init-value=0, rom-block-init-value=0, variable=Coding_VZA_Installed/Value}, nv-require-com-spec=init-value=0, provided-required-interface=Coding_VZA_Installed
      Coding_V_Warning_Legal: nv-provide-com-spec{ram-block-init-value=0, rom-block-init-value=0, variable=Coding_V_Warning_Legal/Value}, nv-require-com-spec=init-value=0, provided-required-interface=Coding_V_Warning_Legal
      Coding_WBA_Installed: nv-provide-com-spec{ram-block-init-value=0, rom-block-init-value=0, variable=Coding_WBA_Installed/Value}, nv-require-com-spec=init-value=0, provided-required-interface=Coding_WBA_Installed
      Coding_eCall_Installed: nv-provide-com-spec{ram-block-init-value=0, rom-block-init-value=0, variable=Coding_eCall_Installed/Value}, nv-require-com-spec=init-value=0, provided-required-interface=Coding_eCall_Installed
      Coding_two_keys: nv-provide-com-spec{ram-block-init-value=0, rom-block-init-value=0, variable=Coding_two_keys/Value}, nv-require-com-spec=init-value=0, provided-required-interface=Coding_two_keys
      Compensation_Line_Shift_b: nv-provide-com-spec{ram-block-init-value=11, rom-block-init-value=11, variable=Compensation_Line_Shift_b/Value}, nv-require-com-spec=init-value=11, provided-required-interface=Compensation_Line_Shift_b
      Compensation_Line_Shift_b_Left: nv-provide-com-spec{ram-block-init-value=11, rom-block-init-value=11, variable=Compensation_Line_Shift_b_Left/Value}, nv-require-com-spec=init-value=11, provided-required-interface=Compensation_Line_Shift_b_Left
      Compensation_Line_Shift_b_Right: nv-provide-com-spec{ram-block-init-value=11, rom-block-init-value=11, variable=Compensation_Line_Shift_b_Right/Value}, nv-require-com-spec=init-value=11, provided-required-interface=Compensation_Line_Shift_b_Right
      Compensation_Line_Slope_m: nv-provide-com-spec{ram-block-init-value=44433, rom-block-init-value=44433, variable=Compensation_Line_Slope_m/Value}, nv-require-com-spec=init-value=44433, provided-required-interface=Compensation_Line_Slope_m
      Compensation_Line_Slope_m_Left: nv-provide-com-spec{ram-block-init-value=113570, rom-block-init-value=113570, variable=Compensation_Line_Slope_m_Left/Value}, nv-require-com-spec=init-value=113570, provided-required-interface=Compensation_Line_Slope_m_Left
      Compensation_Line_Slope_m_Right: nv-provide-com-spec{ram-block-init-value=113570, rom-block-init-value=113570, variable=Compensation_Line_Slope_m_Right/Value}, nv-require-com-spec=init-value=113570, provided-required-interface=Compensation_Line_Slope_m_Right
      ConfigWarning_Schwelle1_Indien: nv-provide-com-spec{ram-block-init-value=60, rom-block-init-value=60, variable=ConfigWarning_Schwelle1_Indien/Value}, nv-require-com-spec=init-value=60, provided-required-interface=ConfigWarning_Schwelle1_Indien
      ConsumptionCorrection: nv-provide-com-spec{ram-block-init-value=100, rom-block-init-value=100, variable=ConsumptionCorrection/Value}, nv-require-com-spec=init-value=100, provided-required-interface=ConsumptionCorrection
      ConsumptionCorrection_Cng: nv-provide-com-spec{ram-block-init-value=100, rom-block-init-value=100, variable=ConsumptionCorrection_Cng/Value}, nv-require-com-spec=init-value=100, provided-required-interface=ConsumptionCorrection_Cng
      CoolantTemp_Gauge_Hysteresis_Angle: nv-provide-com-spec{ram-block-init-value=0, rom-block-init-value=0, variable=CoolantTemp_Gauge_Hysteresis_Angle/Value}, nv-require-com-spec=init-value=0, provided-required-interface=CoolantTemp_Gauge_Hysteresis_Angle
      CoolantTemperatureDelta: nv-provide-com-spec{ram-block-init-value=70, rom-block-init-value=70, variable=CoolantTemperatureDelta/Value}, nv-require-com-spec=init-value=70, provided-required-interface=CoolantTemperatureDelta
      Coolant_Cold_Indication_Present: nv-provide-com-spec{ram-block-init-value=0, rom-block-init-value=0, variable=Coolant_Cold_Indication_Present/Value}, nv-require-com-spec=init-value=0, provided-required-interface=Coolant_Cold_Indication_Present
      CorrectionCoefficient_k1: nv-provide-com-spec{ram-block-init-value=9920, rom-block-init-value=9920, variable=CorrectionCoefficient_k1/Value}, nv-require-com-spec=init-value=9920, provided-required-interface=CorrectionCoefficient_k1
      CorrectionCoefficient_k2: nv-provide-com-spec{ram-block-init-value=20, rom-block-init-value=20, variable=CorrectionCoefficient_k2/Value}, nv-require-com-spec=init-value=20, provided-required-interface=CorrectionCoefficient_k2
      Counter_RamError: nv-provide-com-spec{ram-block-init-value=0, rom-block-init-value=0, variable=Counter_RamError/Value}, nv-require-com-spec=init-value=0, provided-required-interface=Counter_RamError
      Customer_Request_Flag: nv-provide-com-spec{ram-block-init-value=0, rom-block-init-value=0, variable=Customer_Request_Flag/Value}, nv-require-com-spec=init-value=0, provided-required-interface=Customer_Request_Flag
      CwlErrorCounter: nv-provide-com-spec{ram-block-init-value=0, rom-block-init-value=0, variable=CwlErrorCounter/Value}, nv-require-com-spec=init-value=0, provided-required-interface=CwlErrorCounter
      CwlErrorPath: nv-provide-com-spec{ram-block-init-value=0, rom-block-init-value=0, variable=CwlErrorPath/Value}, nv-require-com-spec=init-value=0, provided-required-interface=CwlErrorPath
      CylinderDeactivation_Active: nv-provide-com-spec{ram-block-init-value=1, rom-block-init-value=1, variable=CylinderDeactivation_Active/Value}, nv-require-com-spec=init-value=1, provided-required-interface=CylinderDeactivation_Active
      DIAG_AdaptationChannel_VAR_0_Safety_CRC: nv-provide-com-spec{ram-block-init-value=39665, rom-block-init-value=39665, variable=DIAG_AdaptationChannel_VAR_0_Safety_CRC/Value}, nv-require-com-spec=init-value=39665, provided-required-interface=DIAG_AdaptationChannel_VAR_0_Safety_CRC
      DIAG_EOL_DiagCfg_CONST_Safety_CRC: nv-provide-com-spec{ram-block-init-value=57840, rom-block-init-value=57840, variable=DIAG_EOL_DiagCfg_CONST_Safety_CRC/Value}, nv-require-com-spec=init-value=57840, provided-required-interface=DIAG_EOL_DiagCfg_CONST_Safety_CRC
      DIAG_EOL_HWCalib_CONST_Safety_CRC: nv-provide-com-spec{ram-block-init-value=8701, rom-block-init-value=8701, variable=DIAG_EOL_HWCalib_CONST_Safety_CRC/Value}, nv-require-com-spec=init-value=8701, provided-required-interface=DIAG_EOL_HWCalib_CONST_Safety_CRC
      DIAG_VariantCoding_CONST_Safety_CRC: nv-provide-com-spec{ram-block-init-value=52380, rom-block-init-value=52380, variable=DIAG_VariantCoding_CONST_Safety_CRC/Value}, nv-require-com-spec=init-value=52380, provided-required-interface=DIAG_VariantCoding_CONST_Safety_CRC
      DLS_Auto_Day: nv-provide-com-spec{ram-block-init-value=1, rom-block-init-value=1, variable=DLS_Auto_Day/Value}, nv-require-com-spec=init-value=1, provided-required-interface=DLS_Auto_Day
      DLS_Auto_Hour: nv-provide-com-spec{ram-block-init-value=0, rom-block-init-value=0, variable=DLS_Auto_Hour/Value}, nv-require-com-spec=init-value=0, provided-required-interface=DLS_Auto_Hour
      DLS_Auto_Minute: nv-provide-com-spec{ram-block-init-value=0, rom-block-init-value=0, variable=DLS_Auto_Minute/Value}, nv-require-com-spec=init-value=0, provided-required-interface=DLS_Auto_Minute
      DLS_Auto_Month: nv-provide-com-spec{ram-block-init-value=1, rom-block-init-value=1, variable=DLS_Auto_Month/Value}, nv-require-com-spec=init-value=1, provided-required-interface=DLS_Auto_Month
      DLS_Auto_State: nv-provide-com-spec{ram-block-init-value=2, rom-block-init-value=2, variable=DLS_Auto_State/Value}, nv-require-com-spec=init-value=2, provided-required-interface=DLS_Auto_State
      DTC_ECU_not_coded: nv-provide-com-spec{ram-block-init-value=1, rom-block-init-value=1, variable=DTC_ECU_not_coded/Value}, nv-require-com-spec=init-value=1, provided-required-interface=DTC_ECU_not_coded
      DURMW: nv-provide-com-spec{ram-block-init-value=999936, rom-block-init-value=999936, variable=DURMW/Value}, nv-require-com-spec=init-value=999936, provided-required-interface=DURMW
      DailyMileage: nv-provide-com-spec{ram-block-init-value=100, rom-block-init-value=100, variable=DailyMileage/Value}, nv-require-com-spec=init-value=100, provided-required-interface=DailyMileage
      Damping_Indic_Coolnt_Bargrph_OFF: nv-provide-com-spec{ram-block-init-value=4, rom-block-init-value=4, variable=Damping_Indic_Coolnt_Bargrph_OFF/Value}, nv-require-com-spec=init-value=4, provided-required-interface=Damping_Indic_Coolnt_Bargrph_OFF
      Damping_Indic_Coolnt_Bargrph_ON: nv-provide-com-spec{ram-block-init-value=4, rom-block-init-value=4, variable=Damping_Indic_Coolnt_Bargrph_ON/Value}, nv-require-com-spec=init-value=4, provided-required-interface=Damping_Indic_Coolnt_Bargrph_ON
      Date_Day: nv-provide-com-spec{ram-block-init-value=1, rom-block-init-value=1, variable=Date_Day/Value}, nv-require-com-spec=init-value=1, provided-required-interface=Date_Day
      Date_Month: nv-provide-com-spec{ram-block-init-value=1, rom-block-init-value=1, variable=Date_Month/Value}, nv-require-com-spec=init-value=1, provided-required-interface=Date_Month
      Date_Year: nv-provide-com-spec{ram-block-init-value=2020, rom-block-init-value=2020, variable=Date_Year/Value}, nv-require-com-spec=init-value=2020, provided-required-interface=Date_Year
      DcmDslRxTesterSourceAddr: nv-provide-com-spec{ram-block-init-value=65535, rom-block-init-value=65535, variable=DcmDslRxTesterSourceAddr/Value}, nv-require-com-spec=init-value=65535, provided-required-interface=DcmDslRxTesterSourceAddr
      Deactivate_SK_Function: nv-provide-com-spec{ram-block-init-value=1, rom-block-init-value=1, variable=Deactivate_SK_Function/Value}, nv-require-com-spec=init-value=1, provided-required-interface=Deactivate_SK_Function
      Debouncing_AutomaticDrivingLight: nv-provide-com-spec{ram-block-init-value=2, rom-block-init-value=2, variable=Debouncing_AutomaticDrivingLight/Value}, nv-require-com-spec=init-value=2, provided-required-interface=Debouncing_AutomaticDrivingLight
      Debouncing_FogLight: nv-provide-com-spec{ram-block-init-value=2, rom-block-init-value=2, variable=Debouncing_FogLight/Value}, nv-require-com-spec=init-value=2, provided-required-interface=Debouncing_FogLight
      Debouncing_LowBeam: nv-provide-com-spec{ram-block-init-value=2, rom-block-init-value=2, variable=Debouncing_LowBeam/Value}, nv-require-com-spec=init-value=2, provided-required-interface=Debouncing_LowBeam
      Debouncing_Sidelight: nv-provide-com-spec{ram-block-init-value=2, rom-block-init-value=2, variable=Debouncing_Sidelight/Value}, nv-require-com-spec=init-value=2, provided-required-interface=Debouncing_Sidelight
      Default_AmbientLight_Color_Blue: nv-provide-com-spec{ram-block-init-value=64, rom-block-init-value=64, variable=Default_AmbientLight_Color_Blue/Value}, nv-require-com-spec=init-value=64, provided-required-interface=Default_AmbientLight_Color_Blue
      Default_AmbientLight_Color_CHINA_index: nv-provide-com-spec{ram-block-init-value=6, rom-block-init-value=6, variable=Default_AmbientLight_Color_CHINA_index/Value}, nv-require-com-spec=init-value=6, provided-required-interface=Default_AmbientLight_Color_CHINA_index
      Default_AmbientLight_Color_Green: nv-provide-com-spec{ram-block-init-value=175, rom-block-init-value=175, variable=Default_AmbientLight_Color_Green/Value}, nv-require-com-spec=init-value=175, provided-required-interface=Default_AmbientLight_Color_Green
      Default_AmbientLight_Color_Red: nv-provide-com-spec{ram-block-init-value=255, rom-block-init-value=255, variable=Default_AmbientLight_Color_Red/Value}, nv-require-com-spec=init-value=255, provided-required-interface=Default_AmbientLight_Color_Red
      Default_AmbientLight_Color_index: nv-provide-com-spec{ram-block-init-value=1, rom-block-init-value=1, variable=Default_AmbientLight_Color_index/Value}, nv-require-com-spec=init-value=1, provided-required-interface=Default_AmbientLight_Color_index
      Diag_Blue_Gamma_Adjustment: nv-provide-com-spec{ram-block-init-value=[192, 12, 0], rom-block-init-value=[192, 12, 0], variable=Diag_Blue_Gamma_Adjustment/Value}, nv-require-com-spec=init-value=[192, 12, 0], provided-required-interface=Diag_Blue_Gamma_Adjustment
      Diag_Blue_Gamma_Neg_Adjustment:
        nv-provide-com-spec{ram-block-init-value=[23, 24, 42, 56, 67, 76, 84, 92, 93, 204, 206, 225, 231, 227, 218, 220, 212, 217, 231, 0, 5, 138, 145, 153, 162, 171, 183, 198, 218, 235], rom-block-init-value=[23, 24, 42, 56, 67, 76, 84, 92, 93, 204, 206, 225, 231, 227, 218, 220, 212, 217, 231, 0, 5, 138, 145, 153, 162, 171, 183, 198, 218, 235], variable=Diag_Blue_Gamma_Neg_Adjustment/Value}
        nv-require-com-spec=init-value=[23, 24, 42, 56, 67, 76, 84, 92, 93, 204, 206, 225, 231, 227, 218, 220, 212, 217, 231, 0, 5, 138, 145, 153, 162, 171, 183, 198, 218, 235]
        provided-required-interface=Diag_Blue_Gamma_Neg_Adjustment
      Diag_Blue_Gamma_Pos_Adjustment:
        nv-provide-com-spec{ram-block-init-value=[23, 24, 42, 56, 67, 76, 84, 92, 103, 214, 214, 233, 239, 231, 218, 220, 212, 219, 233, 4, 9, 142, 149, 157, 166, 175, 189, 204, 224, 241], rom-block-init-value=[23, 24, 42, 56, 67, 76, 84, 92, 103, 214, 214, 233, 239, 231, 218, 220, 212, 219, 233, 4, 9, 142, 149, 157, 166, 175, 189, 204, 224, 241], variable=Diag_Blue_Gamma_Pos_Adjustment/Value}
        nv-require-com-spec=init-value=[23, 24, 42, 56, 67, 76, 84, 92, 103, 214, 214, 233, 239, 231, 218, 220, 212, 219, 233, 4, 9, 142, 149, 157, 166, 175, 189, 204, 224, 241]
        provided-required-interface=Diag_Blue_Gamma_Pos_Adjustment
      Diag_Compensation_Line_Shift_b: nv-provide-com-spec{ram-block-init-value=[0, 0, 11], rom-block-init-value=[0, 0, 11], variable=Diag_Compensation_Line_Shift_b/Value}, nv-require-com-spec=init-value=[0, 0, 11], provided-required-interface=Diag_Compensation_Line_Shift_b
      Diag_Compensation_Line_Slope_m: nv-provide-com-spec{ram-block-init-value=[0, 173, 145], rom-block-init-value=[0, 173, 145], variable=Diag_Compensation_Line_Slope_m/Value}, nv-require-com-spec=init-value=[0, 173, 145], provided-required-interface=Diag_Compensation_Line_Slope_m
      Diag_Gain_Adjustment: nv-provide-com-spec{ram-block-init-value=[255, 255, 255], rom-block-init-value=[255, 255, 255], variable=Diag_Gain_Adjustment/Value}, nv-require-com-spec=init-value=[255, 255, 255], provided-required-interface=Diag_Gain_Adjustment
      Diag_Green_Gamma_Adjustment: nv-provide-com-spec{ram-block-init-value=[192, 12, 0], rom-block-init-value=[192, 12, 0], variable=Diag_Green_Gamma_Adjustment/Value}, nv-require-com-spec=init-value=[192, 12, 0], provided-required-interface=Diag_Green_Gamma_Adjustment
      Diag_Green_Gamma_Neg_Adjustment:
        nv-provide-com-spec{ram-block-init-value=[23, 24, 42, 56, 67, 76, 84, 92, 93, 204, 206, 225, 231, 227, 218, 220, 212, 217, 231, 0, 5, 138, 145, 153, 162, 171, 183, 198, 218, 235], rom-block-init-value=[23, 24, 42, 56, 67, 76, 84, 92, 93, 204, 206, 225, 231, 227, 218, 220, 212, 217, 231, 0, 5, 138, 145, 153, 162, 171, 183, 198, 218, 235], variable=Diag_Green_Gamma_Neg_Adjustment/Value}
        nv-require-com-spec=init-value=[23, 24, 42, 56, 67, 76, 84, 92, 93, 204, 206, 225, 231, 227, 218, 220, 212, 217, 231, 0, 5, 138, 145, 153, 162, 171, 183, 198, 218, 235]
        provided-required-interface=Diag_Green_Gamma_Neg_Adjustment
      Diag_Green_Gamma_Pos_Adjustment:
        nv-provide-com-spec{ram-block-init-value=[23, 24, 42, 56, 67, 76, 84, 92, 103, 214, 214, 233, 239, 231, 218, 220, 212, 219, 233, 4, 9, 142, 149, 157, 166, 175, 189, 204, 224, 241], rom-block-init-value=[23, 24, 42, 56, 67, 76, 84, 92, 103, 214, 214, 233, 239, 231, 218, 220, 212, 219, 233, 4, 9, 142, 149, 157, 166, 175, 189, 204, 224, 241], variable=Diag_Green_Gamma_Pos_Adjustment/Value}
        nv-require-com-spec=init-value=[23, 24, 42, 56, 67, 76, 84, 92, 103, 214, 214, 233, 239, 231, 218, 220, 212, 219, 233, 4, 9, 142, 149, 157, 166, 175, 189, 204, 224, 241]
        provided-required-interface=Diag_Green_Gamma_Pos_Adjustment
      Diag_Red_Gamma_Adjustment: nv-provide-com-spec{ram-block-init-value=[192, 12, 0], rom-block-init-value=[192, 12, 0], variable=Diag_Red_Gamma_Adjustment/Value}, nv-require-com-spec=init-value=[192, 12, 0], provided-required-interface=Diag_Red_Gamma_Adjustment
      Diag_Red_Gamma_Neg_Adjustment:
        nv-provide-com-spec{ram-block-init-value=[23, 24, 42, 56, 67, 76, 84, 92, 93, 204, 206, 225, 231, 227, 218, 220, 212, 217, 231, 0, 5, 138, 145, 153, 162, 171, 183, 198, 218, 235], rom-block-init-value=[23, 24, 42, 56, 67, 76, 84, 92, 93, 204, 206, 225, 231, 227, 218, 220, 212, 217, 231, 0, 5, 138, 145, 153, 162, 171, 183, 198, 218, 235], variable=Diag_Red_Gamma_Neg_Adjustment/Value}
        nv-require-com-spec=init-value=[23, 24, 42, 56, 67, 76, 84, 92, 93, 204, 206, 225, 231, 227, 218, 220, 212, 217, 231, 0, 5, 138, 145, 153, 162, 171, 183, 198, 218, 235]
        provided-required-interface=Diag_Red_Gamma_Neg_Adjustment
      Diag_Red_Gamma_Pos_Adjustment:
        nv-provide-com-spec{ram-block-init-value=[23, 24, 42, 56, 67, 76, 84, 92, 103, 214, 214, 233, 239, 231, 218, 220, 212, 219, 233, 4, 9, 142, 149, 157, 166, 175, 189, 204, 224, 241], rom-block-init-value=[23, 24, 42, 56, 67, 76, 84, 92, 103, 214, 214, 233, 239, 231, 218, 220, 212, 219, 233, 4, 9, 142, 149, 157, 166, 175, 189, 204, 224, 241], variable=Diag_Red_Gamma_Pos_Adjustment/Value}
        nv-require-com-spec=init-value=[23, 24, 42, 56, 67, 76, 84, 92, 103, 214, 214, 233, 239, 231, 218, 220, 212, 219, 233, 4, 9, 142, 149, 157, 166, 175, 189, 204, 224, 241]
        provided-required-interface=Diag_Red_Gamma_Pos_Adjustment
      Dig_OilTemp_Display_Available: nv-provide-com-spec{ram-block-init-value=0, rom-block-init-value=0, variable=Dig_OilTemp_Display_Available/Value}, nv-require-com-spec=init-value=0, provided-required-interface=Dig_OilTemp_Display_Available
      DisplayDamping_Off_Bargraph_Tank: nv-provide-com-spec{ram-block-init-value=4, rom-block-init-value=4, variable=DisplayDamping_Off_Bargraph_Tank/Value}, nv-require-com-spec=init-value=4, provided-required-interface=DisplayDamping_Off_Bargraph_Tank
      DisplayDamping_On_Bargraph_Tank: nv-provide-com-spec{ram-block-init-value=4, rom-block-init-value=4, variable=DisplayDamping_On_Bargraph_Tank/Value}, nv-require-com-spec=init-value=4, provided-required-interface=DisplayDamping_On_Bargraph_Tank
      Display_FPA: nv-provide-com-spec{ram-block-init-value=1, rom-block-init-value=1, variable=Display_FPA/Value}, nv-require-com-spec=init-value=1, provided-required-interface=Display_FPA
      Display_Illum_Max_Level: nv-provide-com-spec{ram-block-init-value=10000, rom-block-init-value=10000, variable=Display_Illum_Max_Level/Value}, nv-require-com-spec=init-value=10000, provided-required-interface=Display_Illum_Max_Level
      Display_Save_CP: nv-provide-com-spec{ram-block-init-value=1, rom-block-init-value=1, variable=Display_Save_CP/Value}, nv-require-com-spec=init-value=1, provided-required-interface=Display_Save_CP
      Display_Type: nv-provide-com-spec{ram-block-init-value=255, rom-block-init-value=255, variable=Display_Type/Value}, nv-require-com-spec=init-value=255, provided-required-interface=Display_Type
      DtcAging: nv-provide-com-spec{ram-block-init-value=[0, 0, 0, 0], rom-block-init-value=[0, 0, 0, 0], variable=DtcAging/Value}, nv-require-com-spec=init-value=[0, 0, 0, 0], provided-required-interface=DtcAging
      ECT_Gauge_Magnetic_Offset: nv-provide-com-spec{ram-block-init-value=0, rom-block-init-value=0, variable=ECT_Gauge_Magnetic_Offset/Value}, nv-require-com-spec=init-value=0, provided-required-interface=ECT_Gauge_Magnetic_Offset
      EMSG_Mode_Active: nv-provide-com-spec{ram-block-init-value=0, rom-block-init-value=0, variable=EMSG_Mode_Active/Value}, nv-require-com-spec=init-value=0, provided-required-interface=EMSG_Mode_Active
      ESP_number_of_teeth_lastmode: nv-provide-com-spec{ram-block-init-value=0, rom-block-init-value=0, variable=ESP_number_of_teeth_lastmode/Value}, nv-require-com-spec=init-value=0, provided-required-interface=ESP_number_of_teeth_lastmode
      EpbErrorCounter: nv-provide-com-spec{ram-block-init-value=0, rom-block-init-value=0, variable=EpbErrorCounter/Value}, nv-require-com-spec=init-value=0, provided-required-interface=EpbErrorCounter
      EpbErrorPath: nv-provide-com-spec{ram-block-init-value=0, rom-block-init-value=0, variable=EpbErrorPath/Value}, nv-require-com-spec=init-value=0, provided-required-interface=EpbErrorPath
      EraseState_Block{1..6}: nv-provide-com-spec{ram-block-init-value=255, rom-block-init-value=255, variable=EraseState_Block{1..6}/Value}, nv-require-com-spec=init-value=255, provided-required-interface=EraseState_Block{1..6}
      ErrorType_0xA00041: nv-provide-com-spec{ram-block-init-value=0, rom-block-init-value=0, variable=ErrorType_0xA00041/Value}, nv-require-com-spec=init-value=0, provided-required-interface=ErrorType_0xA00041
      ErrorType_0xA00042: nv-provide-com-spec{ram-block-init-value=0, rom-block-init-value=0, variable=ErrorType_0xA00042/Value}, nv-require-com-spec=init-value=0, provided-required-interface=ErrorType_0xA00042
      ErrorType_0xA00044: nv-provide-com-spec{ram-block-init-value=0, rom-block-init-value=0, variable=ErrorType_0xA00044/Value}, nv-require-com-spec=init-value=0, provided-required-interface=ErrorType_0xA00044
      EspErrorCounter: nv-provide-com-spec{ram-block-init-value=0, rom-block-init-value=0, variable=EspErrorCounter/Value}, nv-require-com-spec=init-value=0, provided-required-interface=EspErrorCounter
      EspErrorPath: nv-provide-com-spec{ram-block-init-value=0, rom-block-init-value=0, variable=EspErrorPath/Value}, nv-require-com-spec=init-value=0, provided-required-interface=EspErrorPath
      FAS_menu_ACC: nv-provide-com-spec{ram-block-init-value=0, rom-block-init-value=0, variable=FAS_menu_ACC/Value}, nv-require-com-spec=init-value=0, provided-required-interface=FAS_menu_ACC
      FAS_menu_GRA: nv-provide-com-spec{ram-block-init-value=0, rom-block-init-value=0, variable=FAS_menu_GRA/Value}, nv-require-com-spec=init-value=0, provided-required-interface=FAS_menu_GRA
      FAS_menu_LIM: nv-provide-com-spec{ram-block-init-value=0, rom-block-init-value=0, variable=FAS_menu_LIM/Value}, nv-require-com-spec=init-value=0, provided-required-interface=FAS_menu_LIM
      FAZIT_Number: nv-provide-com-spec{ram-block-init-value=23 x 255, rom-block-init-value=23 x 255, variable=FAZIT_Number/Value}, nv-require-com-spec=init-value=23 x 255, provided-required-interface=FAZIT_Number
      FPK_zeigerdaempfung_drehzahl: nv-provide-com-spec{ram-block-init-value=0, rom-block-init-value=0, variable=FPK_zeigerdaempfung_drehzahl/Value}, nv-require-com-spec=init-value=0, provided-required-interface=FPK_zeigerdaempfung_drehzahl
      FblShareDataPartOneReserved: nv-provide-com-spec{ram-block-init-value=72 x 255, rom-block-init-value=72 x 255, variable=FblShareDataPartOneReserved/Value}, nv-require-com-spec=init-value=72 x 255, provided-required-interface=FblShareDataPartOneReserved
      FblShareDataPartOneReserved1: nv-provide-com-spec{ram-block-init-value=[3, 232, 3, 232, 3, 232, 255, 255, 255, 255], rom-block-init-value=[3, 232, 3, 232, 3, 232, 255, 255, 255, 255], variable=FblShareDataPartOneReserved1/Value}, nv-require-com-spec=init-value=[3, 232, 3, 232, 3, 232, 255, 255, 255, 255], provided-required-interface=FblShareDataPartOneReserved1
      FblShareDataPartOneReserved2: nv-provide-com-spec{ram-block-init-value=11 x 255, rom-block-init-value=11 x 255, variable=FblShareDataPartOneReserved2/Value}, nv-require-com-spec=init-value=11 x 255, provided-required-interface=FblShareDataPartOneReserved2
      FblShareDataPartThreeReserved: nv-provide-com-spec{ram-block-init-value=50 x 255, rom-block-init-value=50 x 255, variable=FblShareDataPartThreeReserved/Value}, nv-require-com-spec=init-value=50 x 255, provided-required-interface=FblShareDataPartThreeReserved
      FblShareDataPartTwoReserved1: nv-provide-com-spec{ram-block-init-value=8 x 255, rom-block-init-value=8 x 255, variable=FblShareDataPartTwoReserved1/Value}, nv-require-com-spec=init-value=8 x 255, provided-required-interface=FblShareDataPartTwoReserved1
      Forcewrite_Qual_Time: nv-provide-com-spec{ram-block-init-value=10, rom-block-init-value=10, variable=Forcewrite_Qual_Time/Value}, nv-require-com-spec=init-value=10, provided-required-interface=Forcewrite_Qual_Time
      FuelLevel_Gauge_Hysteresis_Angle: nv-provide-com-spec{ram-block-init-value=0, rom-block-init-value=0, variable=FuelLevel_Gauge_Hysteresis_Angle/Value}, nv-require-com-spec=init-value=0, provided-required-interface=FuelLevel_Gauge_Hysteresis_Angle
      Fuel_AuxHeater_Consumption_Active: nv-provide-com-spec{ram-block-init-value=0, rom-block-init-value=0, variable=Fuel_AuxHeater_Consumption_Active/Value}, nv-require-com-spec=init-value=0, provided-required-interface=Fuel_AuxHeater_Consumption_Active
      Fuel_Calib_DryCalibration: nv-provide-com-spec{ram-block-init-value=0, rom-block-init-value=0, variable=Fuel_Calib_DryCalibration/Value}, nv-require-com-spec=init-value=0, provided-required-interface=Fuel_Calib_DryCalibration
      Fuel_Calib_Dry_Max: nv-provide-com-spec{ram-block-init-value=32, rom-block-init-value=32, variable=Fuel_Calib_Dry_Max/Value}, nv-require-com-spec=init-value=32, provided-required-interface=Fuel_Calib_Dry_Max
      Fuel_Calib_FullCalibration: nv-provide-com-spec{ram-block-init-value=1, rom-block-init-value=1, variable=Fuel_Calib_FullCalibration/Value}, nv-require-com-spec=init-value=1, provided-required-interface=Fuel_Calib_FullCalibration
      Fuel_Calib_Full_Max: nv-provide-com-spec{ram-block-init-value=16, rom-block-init-value=16, variable=Fuel_Calib_Full_Max/Value}, nv-require-com-spec=init-value=16, provided-required-interface=Fuel_Calib_Full_Max
      Fuel_Calib_Full_Offset: nv-provide-com-spec{ram-block-init-value=-128, rom-block-init-value=-128, variable=Fuel_Calib_Full_Offset/Value}, nv-require-com-spec=init-value=-128, provided-required-interface=Fuel_Calib_Full_Offset
      Fuel_Calib_Vol_Dead: nv-provide-com-spec{ram-block-init-value=0, rom-block-init-value=0, variable=Fuel_Calib_Vol_Dead/Value}, nv-require-com-spec=init-value=0, provided-required-interface=Fuel_Calib_Vol_Dead
      Fuel_Calib_Vol_Filled: nv-provide-com-spec{ram-block-init-value=0, rom-block-init-value=0, variable=Fuel_Calib_Vol_Filled/Value}, nv-require-com-spec=init-value=0, provided-required-interface=Fuel_Calib_Vol_Filled
      Fuel_Calib_WetCalibration: nv-provide-com-spec{ram-block-init-value=1, rom-block-init-value=1, variable=Fuel_Calib_WetCalibration/Value}, nv-require-com-spec=init-value=1, provided-required-interface=Fuel_Calib_WetCalibration
      Fuel_Calib_Wet_Max: nv-provide-com-spec{ram-block-init-value=32, rom-block-init-value=32, variable=Fuel_Calib_Wet_Max/Value}, nv-require-com-spec=init-value=32, provided-required-interface=Fuel_Calib_Wet_Max
      Fuel_Consumption_Min: nv-provide-com-spec{ram-block-init-value=0, rom-block-init-value=0, variable=Fuel_Consumption_Min/Value}, nv-require-com-spec=init-value=0, provided-required-interface=Fuel_Consumption_Min
      Fuel_Odometer_Log_n: nv-provide-com-spec{ram-block-init-value=0, rom-block-init-value=0, variable=Fuel_Odometer_Log_n/Value}, nv-require-com-spec=init-value=0, provided-required-interface=Fuel_Odometer_Log_n
      Fuel_Odometer_Log_n{1..3}: nv-provide-com-spec{ram-block-init-value=0, rom-block-init-value=0, variable=Fuel_Odometer_Log_n{1..3}/Value}, nv-require-com-spec=init-value=0, provided-required-interface=Fuel_Odometer_Log_n{1..3}
      Fuel_Offset_Sensor_1: nv-provide-com-spec{ram-block-init-value=-128, rom-block-init-value=-128, variable=Fuel_Offset_Sensor_1/Value}, nv-require-com-spec=init-value=-128, provided-required-interface=Fuel_Offset_Sensor_1
      Fuel_Offset_Sensor_2: nv-provide-com-spec{ram-block-init-value=-128, rom-block-init-value=-128, variable=Fuel_Offset_Sensor_2/Value}, nv-require-com-spec=init-value=-128, provided-required-interface=Fuel_Offset_Sensor_2
      Fuel_Offset_Sensor_3: nv-provide-com-spec{ram-block-init-value=127, rom-block-init-value=127, variable=Fuel_Offset_Sensor_3/Value}, nv-require-com-spec=init-value=127, provided-required-interface=Fuel_Offset_Sensor_3
      Fuel_Offset_Sensor_4: nv-provide-com-spec{ram-block-init-value=127, rom-block-init-value=127, variable=Fuel_Offset_Sensor_4/Value}, nv-require-com-spec=init-value=127, provided-required-interface=Fuel_Offset_Sensor_4
      Fuel_RefuelDetect_Log_Error_n: nv-provide-com-spec{ram-block-init-value=0, rom-block-init-value=0, variable=Fuel_RefuelDetect_Log_Error_n/Value}, nv-require-com-spec=init-value=0, provided-required-interface=Fuel_RefuelDetect_Log_Error_n
      Fuel_RefuelDetect_Log_Error_n{1..3}: nv-provide-com-spec{ram-block-init-value=0, rom-block-init-value=0, variable=Fuel_RefuelDetect_Log_Error_n{1..3}/Value}, nv-require-com-spec=init-value=0, provided-required-interface=Fuel_RefuelDetect_Log_Error_n{1..3}
      Fuel_Variant: nv-provide-com-spec{ram-block-init-value=0, rom-block-init-value=0, variable=Fuel_Variant/Value}, nv-require-com-spec=init-value=0, provided-required-interface=Fuel_Variant
      Fuel_Vol_Display_Old_Log_n: nv-provide-com-spec{ram-block-init-value=0, rom-block-init-value=0, variable=Fuel_Vol_Display_Old_Log_n/Value}, nv-require-com-spec=init-value=0, provided-required-interface=Fuel_Vol_Display_Old_Log_n
      Fuel_Vol_Display_Old_Log_n{1..3}: nv-provide-com-spec{ram-block-init-value=0, rom-block-init-value=0, variable=Fuel_Vol_Display_Old_Log_n{1..3}/Value}, nv-require-com-spec=init-value=0, provided-required-interface=Fuel_Vol_Display_Old_Log_n{1..3}
      Fuel_Vol_Ref_Log_n: nv-provide-com-spec{ram-block-init-value=0, rom-block-init-value=0, variable=Fuel_Vol_Ref_Log_n/Value}, nv-require-com-spec=init-value=0, provided-required-interface=Fuel_Vol_Ref_Log_n
      Fuel_Vol_Ref_Log_n{1..3}: nv-provide-com-spec{ram-block-init-value=0, rom-block-init-value=0, variable=Fuel_Vol_Ref_Log_n{1..3}/Value}, nv-require-com-spec=init-value=0, provided-required-interface=Fuel_Vol_Ref_Log_n{1..3}
      Fuel_Vol_RefuelHandling_Log_n: nv-provide-com-spec{ram-block-init-value=0, rom-block-init-value=0, variable=Fuel_Vol_RefuelHandling_Log_n/Value}, nv-require-com-spec=init-value=0, provided-required-interface=Fuel_Vol_RefuelHandling_Log_n
      Fuel_Vol_RefuelHandling_Log_n{1..3}: nv-provide-com-spec{ram-block-init-value=0, rom-block-init-value=0, variable=Fuel_Vol_RefuelHandling_Log_n{1..3}/Value}, nv-require-com-spec=init-value=0, provided-required-interface=Fuel_Vol_RefuelHandling_Log_n{1..3}
      Fuel_Vol_Refueling_Drainage_1: nv-provide-com-spec{ram-block-init-value=9, rom-block-init-value=9, variable=Fuel_Vol_Refueling_Drainage_1/Value}, nv-require-com-spec=init-value=9, provided-required-interface=Fuel_Vol_Refueling_Drainage_1
      Fuel_Vol_Refueling_Drainage_10: nv-provide-com-spec{ram-block-init-value=9, rom-block-init-value=9, variable=Fuel_Vol_Refueling_Drainage_10/Value}, nv-require-com-spec=init-value=9, provided-required-interface=Fuel_Vol_Refueling_Drainage_10
      Fuel_Vol_Refueling_Drainage_11: nv-provide-com-spec{ram-block-init-value=9, rom-block-init-value=9, variable=Fuel_Vol_Refueling_Drainage_11/Value}, nv-require-com-spec=init-value=9, provided-required-interface=Fuel_Vol_Refueling_Drainage_11
      Fuel_Vol_Refueling_Drainage_12: nv-provide-com-spec{ram-block-init-value=5, rom-block-init-value=5, variable=Fuel_Vol_Refueling_Drainage_12/Value}, nv-require-com-spec=init-value=5, provided-required-interface=Fuel_Vol_Refueling_Drainage_12
      Fuel_Vol_Refueling_Drainage_{13..19}: nv-provide-com-spec{ram-block-init-value=9, rom-block-init-value=9, variable=Fuel_Vol_Refueling_Drainage_{13..19}/Value}, nv-require-com-spec=init-value=9, provided-required-interface=Fuel_Vol_Refueling_Drainage_{13..19}
      Fuel_Vol_Refueling_Drainage_2: nv-provide-com-spec{ram-block-init-value=9, rom-block-init-value=9, variable=Fuel_Vol_Refueling_Drainage_2/Value}, nv-require-com-spec=init-value=9, provided-required-interface=Fuel_Vol_Refueling_Drainage_2
      Fuel_Vol_Refueling_Drainage_{20..29}: nv-provide-com-spec{ram-block-init-value=9, rom-block-init-value=9, variable=Fuel_Vol_Refueling_Drainage_{20..29}/Value}, nv-require-com-spec=init-value=9, provided-required-interface=Fuel_Vol_Refueling_Drainage_{20..29}
      Fuel_Vol_Refueling_Drainage_3: nv-provide-com-spec{ram-block-init-value=9, rom-block-init-value=9, variable=Fuel_Vol_Refueling_Drainage_3/Value}, nv-require-com-spec=init-value=9, provided-required-interface=Fuel_Vol_Refueling_Drainage_3
      Fuel_Vol_Refueling_Drainage_{30..32}: nv-provide-com-spec{ram-block-init-value=9, rom-block-init-value=9, variable=Fuel_Vol_Refueling_Drainage_{30..32}/Value}, nv-require-com-spec=init-value=9, provided-required-interface=Fuel_Vol_Refueling_Drainage_{30..32}
      Fuel_Vol_Refueling_Drainage_4: nv-provide-com-spec{ram-block-init-value=9, rom-block-init-value=9, variable=Fuel_Vol_Refueling_Drainage_4/Value}, nv-require-com-spec=init-value=9, provided-required-interface=Fuel_Vol_Refueling_Drainage_4
      Fuel_Vol_Refueling_Drainage_5: nv-provide-com-spec{ram-block-init-value=8, rom-block-init-value=8, variable=Fuel_Vol_Refueling_Drainage_5/Value}, nv-require-com-spec=init-value=8, provided-required-interface=Fuel_Vol_Refueling_Drainage_5
      Fuel_Vol_Refueling_Drainage_6: nv-provide-com-spec{ram-block-init-value=8, rom-block-init-value=8, variable=Fuel_Vol_Refueling_Drainage_6/Value}, nv-require-com-spec=init-value=8, provided-required-interface=Fuel_Vol_Refueling_Drainage_6
      Fuel_Vol_Refueling_Drainage_7: nv-provide-com-spec{ram-block-init-value=5, rom-block-init-value=5, variable=Fuel_Vol_Refueling_Drainage_7/Value}, nv-require-com-spec=init-value=5, provided-required-interface=Fuel_Vol_Refueling_Drainage_7
      Fuel_Vol_Refueling_Drainage_8: nv-provide-com-spec{ram-block-init-value=9, rom-block-init-value=9, variable=Fuel_Vol_Refueling_Drainage_8/Value}, nv-require-com-spec=init-value=9, provided-required-interface=Fuel_Vol_Refueling_Drainage_8
      Fuel_Vol_Refueling_Drainage_9: nv-provide-com-spec{ram-block-init-value=9, rom-block-init-value=9, variable=Fuel_Vol_Refueling_Drainage_9/Value}, nv-require-com-spec=init-value=9, provided-required-interface=Fuel_Vol_Refueling_Drainage_9
      Fuel_Vol_Sensor_Avrg_RefuelHandling_Log_n: nv-provide-com-spec{ram-block-init-value=0, rom-block-init-value=0, variable=Fuel_Vol_Sensor_Avrg_RefuelHandling_Log_n/Value}, nv-require-com-spec=init-value=0, provided-required-interface=Fuel_Vol_Sensor_Avrg_RefuelHandling_Log_n
      Fuel_Vol_Sensor_Avrg_RefuelHandling_Log_n{1..3}: nv-provide-com-spec{ram-block-init-value=0, rom-block-init-value=0, variable=Fuel_Vol_Sensor_Avrg_RefuelHandling_Log_n{1..3}/Value}, nv-require-com-spec=init-value=0, provided-required-interface=Fuel_Vol_Sensor_Avrg_RefuelHandling_Log_n{1..3}
      GRA_High_Display_Available: nv-provide-com-spec{ram-block-init-value=0, rom-block-init-value=0, variable=GRA_High_Display_Available/Value}, nv-require-com-spec=init-value=0, provided-required-interface=GRA_High_Display_Available
      Gamma_Adjustment_VAR_CRC: nv-provide-com-spec{ram-block-init-value=55471, rom-block-init-value=55471, variable=Gamma_Adjustment_VAR_CRC/Value}, nv-require-com-spec=init-value=55471, provided-required-interface=Gamma_Adjustment_VAR_CRC
      GasTank_Display_Attenuation_Off: nv-provide-com-spec{ram-block-init-value=4, rom-block-init-value=4, variable=GasTank_Display_Attenuation_Off/Value}, nv-require-com-spec=init-value=4, provided-required-interface=GasTank_Display_Attenuation_Off
      GasTank_Display_Attenuation_On: nv-provide-com-spec{ram-block-init-value=4, rom-block-init-value=4, variable=GasTank_Display_Attenuation_On/Value}, nv-require-com-spec=init-value=4, provided-required-interface=GasTank_Display_Attenuation_On
      GasTank_Duration_Red_LED_Flashing: nv-provide-com-spec{ram-block-init-value=0, rom-block-init-value=0, variable=GasTank_Duration_Red_LED_Flashing/Value}, nv-require-com-spec=init-value=0, provided-required-interface=GasTank_Duration_Red_LED_Flashing
      GasTank_Warning_Special_State: nv-provide-com-spec{ram-block-init-value=1, rom-block-init-value=1, variable=GasTank_Warning_Special_State/Value}, nv-require-com-spec=init-value=1, provided-required-interface=GasTank_Warning_Special_State
      GeneralBrakeErrorCounter: nv-provide-com-spec{ram-block-init-value=0, rom-block-init-value=0, variable=GeneralBrakeErrorCounter/Value}, nv-require-com-spec=init-value=0, provided-required-interface=GeneralBrakeErrorCounter
      GeneralBrakeErrorPath: nv-provide-com-spec{ram-block-init-value=0, rom-block-init-value=0, variable=GeneralBrakeErrorPath/Value}, nv-require-com-spec=init-value=0, provided-required-interface=GeneralBrakeErrorPath
      Green_Gamma_Adjustment_Display1:
        nv-provide-com-spec{ram-block-init-value=[0, 64, 128, 192, 0, 64, 128, 192, 0, 64, 128, 192, 0, 64, 128, 192, 255, 0, 85, 170, 255, 3, 0, 0, 0, 0, 0], rom-block-init-value=[0, 64, 128, 192, 0, 64, 128, 192, 0, 64, 128, 192, 0, 64, 128, 192, 255, 0, 85, 170, 255, 3, 0, 0, 0, 0, 0], variable=Green_Gamma_Adjustment_Display1/Value}
        nv-require-com-spec=init-value=[0, 64, 128, 192, 0, 64, 128, 192, 0, 64, 128, 192, 0, 64, 128, 192, 255, 0, 85, 170, 255, 3, 0, 0, 0, 0, 0]
        provided-required-interface=Green_Gamma_Adjustment_Display1
      Green_Gamma_Adjustment_Display2:
        nv-provide-com-spec{ram-block-init-value=[96, 140, 178, 210, 238, 56, 102, 146, 202, 2, 52, 122, 168, 220, 46, 72, 111, 144, 208, 0, 84, 169, 250, 63, 96, 140, 178, 210, 238, 56, 102, 146, 202, 2, 52, 122, 168, 220, 46, 72, 111, 144, 208, 0, 84, 169, 250, 63], rom-block-init-value=[96, 140, 178, 210, 238, 56, 102, 146, 202, 2, 52, 122, 168, 220, 46, 72, 111, 144, 208, 0, 84, 169, 250, 63, 96, 140, 178, 210, 238, 56, 102, 146, 202, 2, 52, 122, 168, 220, 46, 72, 111, 144, 208, 0, 84, 169, 250, 63], variable=Green_Gamma_Adjustment_Display2/Value}
        nv-require-com-spec=init-value=[96, 140, 178, 210, 238, 56, 102, 146, 202, 2, 52, 122, 168, 220, 46, 72, 111, 144, 208, 0, 84, 169, 250, 63, 96, 140, 178, 210, 238, 56, 102, 146, 202, 2, 52, 122, 168, 220, 46, 72, 111, 144, 208, 0, 84, 169, 250, 63]
        provided-required-interface=Green_Gamma_Adjustment_Display2
      HmiZpm_0xA00044: nv-provide-com-spec{ram-block-init-value=0, rom-block-init-value=0, variable=HmiZpm_0xA00044/Value}, nv-require-com-spec=init-value=0, provided-required-interface=HmiZpm_0xA00044
      Hmi_Skinning: nv-provide-com-spec{ram-block-init-value=0, rom-block-init-value=0, variable=Hmi_Skinning/Value}, nv-require-com-spec=init-value=0, provided-required-interface=Hmi_Skinning
      Hmi_Variant: nv-provide-com-spec{ram-block-init-value=1, rom-block-init-value=1, variable=Hmi_Variant/Value}, nv-require-com-spec=init-value=1, provided-required-interface=Hmi_Variant
      HookInfo_ApiId_Det_ErrorHook: nv-provide-com-spec{ram-block-init-value=0, rom-block-init-value=0, variable=HookInfo_ApiId_Det_ErrorHook/Value}, nv-require-com-spec=init-value=0, provided-required-interface=HookInfo_ApiId_Det_ErrorHook
      HookInfo_BswModuleId_EcuM_BswErrorHook: nv-provide-com-spec{ram-block-init-value=0, rom-block-init-value=0, variable=HookInfo_BswModuleId_EcuM_BswErrorHook/Value}, nv-require-com-spec=init-value=0, provided-required-interface=HookInfo_BswModuleId_EcuM_BswErrorHook
      HookInfo_EcuM_ErrorHook: nv-provide-com-spec{ram-block-init-value=0, rom-block-init-value=0, variable=HookInfo_EcuM_ErrorHook/Value}, nv-require-com-spec=init-value=0, provided-required-interface=HookInfo_EcuM_ErrorHook
      HookInfo_ErrorHook: nv-provide-com-spec{ram-block-init-value=0, rom-block-init-value=0, variable=HookInfo_ErrorHook/Value}, nv-require-com-spec=init-value=0, provided-required-interface=HookInfo_ErrorHook
      HookInfo_ErrorId_Det_ErrorHook: nv-provide-com-spec{ram-block-init-value=0, rom-block-init-value=0, variable=HookInfo_ErrorId_Det_ErrorHook/Value}, nv-require-com-spec=init-value=0, provided-required-interface=HookInfo_ErrorId_Det_ErrorHook
      HookInfo_ErrorId_EcuM_BswErrorHook: nv-provide-com-spec{ram-block-init-value=0, rom-block-init-value=0, variable=HookInfo_ErrorId_EcuM_BswErrorHook/Value}, nv-require-com-spec=init-value=0, provided-required-interface=HookInfo_ErrorId_EcuM_BswErrorHook
      HookInfo_InstanceId_Det_ErrorHook: nv-provide-com-spec{ram-block-init-value=0, rom-block-init-value=0, variable=HookInfo_InstanceId_Det_ErrorHook/Value}, nv-require-com-spec=init-value=0, provided-required-interface=HookInfo_InstanceId_Det_ErrorHook
      HookInfo_ModuleId_Det_ErrorHook: nv-provide-com-spec{ram-block-init-value=0, rom-block-init-value=0, variable=HookInfo_ModuleId_Det_ErrorHook/Value}, nv-require-com-spec=init-value=0, provided-required-interface=HookInfo_ModuleId_Det_ErrorHook
      HookInfo_ProtectionHook: nv-provide-com-spec{ram-block-init-value=0, rom-block-init-value=0, variable=HookInfo_ProtectionHook/Value}, nv-require-com-spec=init-value=0, provided-required-interface=HookInfo_ProtectionHook
      HookInfo_ShutdownHook: nv-provide-com-spec{ram-block-init-value=0, rom-block-init-value=0, variable=HookInfo_ShutdownHook/Value}, nv-require-com-spec=init-value=0, provided-required-interface=HookInfo_ShutdownHook
      Hot_Spot_Temp_Dimm_Time: nv-provide-com-spec{ram-block-init-value=60, rom-block-init-value=60, variable=Hot_Spot_Temp_Dimm_Time/Value}, nv-require-com-spec=init-value=60, provided-required-interface=Hot_Spot_Temp_Dimm_Time
      I5CM_ID_NVM_BlockDET: nv-provide-com-spec{ram-block-init-value=64 x 0, rom-block-init-value=64 x 0, variable=I5CM_ID_NVM_BlockDET/Value}, nv-require-com-spec=init-value=64 x 0, provided-required-interface=I5CM_ID_NVM_BlockDET
      I5CM_ID_NVM_BlockDL: nv-provide-com-spec{ram-block-init-value=176 x 0, rom-block-init-value=176 x 0, variable=I5CM_ID_NVM_BlockDL/Value}, nv-require-com-spec=init-value=176 x 0, provided-required-interface=I5CM_ID_NVM_BlockDL
      I5CM_ID_NVM_BlockKEYLC: nv-provide-com-spec{ram-block-init-value=128 x 0, rom-block-init-value=128 x 0, variable=I5CM_ID_NVM_BlockKEYLC/Value}, nv-require-com-spec=init-value=128 x 0, provided-required-interface=I5CM_ID_NVM_BlockKEYLC
      I5CM_ID_NVM_BlockKEY_{0..2}: nv-provide-com-spec{ram-block-init-value=64 x 0, rom-block-init-value=64 x 0, variable=I5CM_ID_NVM_BlockKEY_{0..2}/Value}, nv-require-com-spec=init-value=64 x 0, provided-required-interface=I5CM_ID_NVM_BlockKEY_{0..2}
      I5CM_ID_NVM_BlockLEARN_{0..2}: nv-provide-com-spec{ram-block-init-value=80 x 0, rom-block-init-value=80 x 0, variable=I5CM_ID_NVM_BlockLEARN_{0..2}/Value}, nv-require-com-spec=init-value=80 x 0, provided-required-interface=I5CM_ID_NVM_BlockLEARN_{0..2}
      I5CM_ID_NVM_BlockPARAM_{0..2}: nv-provide-com-spec{ram-block-init-value=32 x 0, rom-block-init-value=32 x 0, variable=I5CM_ID_NVM_BlockPARAM_{0..2}/Value}, nv-require-com-spec=init-value=32 x 0, provided-required-interface=I5CM_ID_NVM_BlockPARAM_{0..2}
      I5CM_ID_NVM_BlockSRM_{0..2}: nv-provide-com-spec{ram-block-init-value=32 x 0, rom-block-init-value=32 x 0, variable=I5CM_ID_NVM_BlockSRM_{0..2}/Value}, nv-require-com-spec=init-value=32 x 0, provided-required-interface=I5CM_ID_NVM_BlockSRM_{0..2}
      I5CM_ID_NVM_BlockSTATE_{0..2}: nv-provide-com-spec{ram-block-init-value=16 x 0, rom-block-init-value=16 x 0, variable=I5CM_ID_NVM_BlockSTATE_{0..2}/Value}, nv-require-com-spec=init-value=16 x 0, provided-required-interface=I5CM_ID_NVM_BlockSTATE_{0..2}
      I5CM_ID_NVM_BlockSTS_{0..2}: nv-provide-com-spec{ram-block-init-value=16 x 0, rom-block-init-value=16 x 0, variable=I5CM_ID_NVM_BlockSTS_{0..2}/Value}, nv-require-com-spec=init-value=16 x 0, provided-required-interface=I5CM_ID_NVM_BlockSTS_{0..2}
      Ignition_Active_Message: nv-provide-com-spec{ram-block-init-value=1, rom-block-init-value=1, variable=Ignition_Active_Message/Value}, nv-require-com-spec=init-value=1, provided-required-interface=Ignition_Active_Message
      IllumThreshold_CRC: nv-provide-com-spec{ram-block-init-value=42880, rom-block-init-value=42880, variable=IllumThreshold_CRC/Value}, nv-require-com-spec=init-value=42880, provided-required-interface=IllumThreshold_CRC
      Immo_DtcLastTestResult: nv-provide-com-spec{ram-block-init-value=0, rom-block-init-value=0, variable=Immo_DtcLastTestResult/Value}, nv-require-com-spec=init-value=0, provided-required-interface=Immo_DtcLastTestResult
      Immo_Individual_Schluessel_Fahrberecht: nv-provide-com-spec{ram-block-init-value=0, rom-block-init-value=0, variable=Immo_Individual_Schluessel_Fahrberecht/Value}, nv-require-com-spec=init-value=0, provided-required-interface=Immo_Individual_Schluessel_Fahrberecht
      Inspection_Elapsed_Days: nv-provide-com-spec{ram-block-init-value=0, rom-block-init-value=0, variable=Inspection_Elapsed_Days/Value}, nv-require-com-spec=init-value=0, provided-required-interface=Inspection_Elapsed_Days
      Inspection_Elapsed_Km: nv-provide-com-spec{ram-block-init-value=0, rom-block-init-value=0, variable=Inspection_Elapsed_Km/Value}, nv-require-com-spec=init-value=0, provided-required-interface=Inspection_Elapsed_Km
      Inspection_MaxNext_Days: nv-provide-com-spec{ram-block-init-value=1095, rom-block-init-value=1095, variable=Inspection_MaxNext_Days/Value}, nv-require-com-spec=init-value=1095, provided-required-interface=Inspection_MaxNext_Days
      Inspection_MaxNext_Km: nv-provide-com-spec{ram-block-init-value=300, rom-block-init-value=300, variable=Inspection_MaxNext_Km/Value}, nv-require-com-spec=init-value=300, provided-required-interface=Inspection_MaxNext_Km
      Inspection_ResetValue_Days: nv-provide-com-spec{ram-block-init-value=365, rom-block-init-value=365, variable=Inspection_ResetValue_Days/Value}, nv-require-com-spec=init-value=365, provided-required-interface=Inspection_ResetValue_Days
      Inspection_ResetValue_Km: nv-provide-com-spec{ram-block-init-value=300, rom-block-init-value=300, variable=Inspection_ResetValue_Km/Value}, nv-require-com-spec=init-value=300, provided-required-interface=Inspection_ResetValue_Km
      InternalLogicalSoftwareBlockVersion_EEP: nv-provide-com-spec{ram-block-init-value=[36, 9, 17, 17], rom-block-init-value=[36, 9, 17, 17], variable=InternalLogicalSoftwareBlockVersion_EEP/Value}, nv-require-com-spec=init-value=[36, 9, 17, 17], provided-required-interface=InternalLogicalSoftwareBlockVersion_EEP
      K_Number: nv-provide-com-spec{ram-block-init-value=0, rom-block-init-value=0, variable=K_Number/Value}, nv-require-com-spec=init-value=0, provided-required-interface=K_Number
      Knockout_Ctr: nv-provide-com-spec{ram-block-init-value=0, rom-block-init-value=0, variable=Knockout_Ctr/Value}, nv-require-com-spec=init-value=0, provided-required-interface=Knockout_Ctr
      Knockout_Tmr: nv-provide-com-spec{ram-block-init-value=20, rom-block-init-value=20, variable=Knockout_Tmr/Value}, nv-require-com-spec=init-value=20, provided-required-interface=Knockout_Tmr
      KsNvmBlockGfaKey_0: nv-provide-com-spec{ram-block-init-value=64 x 255, rom-block-init-value=64 x 255, variable=KsNvmBlockGfaKey_0/Value}, nv-require-com-spec=init-value=64 x 255, provided-required-interface=KsNvmBlockGfaKey_0
      KsNvmBlockGfaKey_1: nv-provide-com-spec{ram-block-init-value=64 x 255, rom-block-init-value=64 x 255, variable=KsNvmBlockGfaKey_1/Value}, nv-require-com-spec=init-value=64 x 255, provided-required-interface=KsNvmBlockGfaKey_1
      KsNvmBlockMisc_0: nv-provide-com-spec{ram-block-init-value=[233, 127, 244, 170, 47, 39, 100, 114, 168, 247, 8, 100, 216, 21, 109, 47], rom-block-init-value=[233, 127, 244, 170, 47, 39, 100, 114, 168, 247, 8, 100, 216, 21, 109, 47], variable=KsNvmBlockMisc_0/Value}, nv-require-com-spec=init-value=[233, 127, 244, 170, 47, 39, 100, 114, 168, 247, 8, 100, 216, 21, 109, 47], provided-required-interface=KsNvmBlockMisc_0
      KsNvmBlockMisc_1: nv-provide-com-spec{ram-block-init-value=[233, 127, 244, 170, 47, 39, 100, 114, 168, 247, 8, 100, 216, 21, 109, 47], rom-block-init-value=[233, 127, 244, 170, 47, 39, 100, 114, 168, 247, 8, 100, 216, 21, 109, 47], variable=KsNvmBlockMisc_1/Value}, nv-require-com-spec=init-value=[233, 127, 244, 170, 47, 39, 100, 114, 168, 247, 8, 100, 216, 21, 109, 47], provided-required-interface=KsNvmBlockMisc_1
      LIM_Display_Available: nv-provide-com-spec{ram-block-init-value=1, rom-block-init-value=1, variable=LIM_Display_Available/Value}, nv-require-com-spec=init-value=1, provided-required-interface=LIM_Display_Available
      LeftIndicatorErrorCounter: nv-provide-com-spec{ram-block-init-value=0, rom-block-init-value=0, variable=LeftIndicatorErrorCounter/Value}, nv-require-com-spec=init-value=0, provided-required-interface=LeftIndicatorErrorCounter
      LeftIndicatorErrorPath: nv-provide-com-spec{ram-block-init-value=0, rom-block-init-value=0, variable=LeftIndicatorErrorPath/Value}, nv-require-com-spec=init-value=0, provided-required-interface=LeftIndicatorErrorPath
      Lookup_Compression_Curve_Photosensor_Bus_Coef_X: nv-provide-com-spec{ram-block-init-value=[0, 50, 100, 250, 500], rom-block-init-value=[0, 50, 100, 250, 500], variable=Lookup_Compression_Curve_Photosensor_Bus_Coef_X/Value}, nv-require-com-spec=init-value=[0, 50, 100, 250, 500], provided-required-interface=Lookup_Compression_Curve_Photosensor_Bus_Coef_X
      Lookup_Compression_Curve_Photosensor_Bus_Coef_Y: nv-provide-com-spec{ram-block-init-value=[0, 40, 80, 150, 253], rom-block-init-value=[0, 40, 80, 150, 253], variable=Lookup_Compression_Curve_Photosensor_Bus_Coef_Y/Value}, nv-require-com-spec=init-value=[0, 40, 80, 150, 253], provided-required-interface=Lookup_Compression_Curve_Photosensor_Bus_Coef_Y
      Lookup_Curve_Bargraphs_Red_Coef_X: nv-provide-com-spec{ram-block-init-value=[0, 100, 500, 1000, 1500, 2530], rom-block-init-value=[0, 100, 500, 1000, 1500, 2530], variable=Lookup_Curve_Bargraphs_Red_Coef_X/Value}, nv-require-com-spec=init-value=[0, 100, 500, 1000, 1500, 2530], provided-required-interface=Lookup_Curve_Bargraphs_Red_Coef_X
      Lookup_Curve_Bargraphs_Red_Coef_Y: nv-provide-com-spec{ram-block-init-value=[20, 20, 50, 80, 500, 1000], rom-block-init-value=[20, 20, 50, 80, 500, 1000], variable=Lookup_Curve_Bargraphs_Red_Coef_Y/Value}, nv-require-com-spec=init-value=[20, 20, 50, 80, 500, 1000], provided-required-interface=Lookup_Curve_Bargraphs_Red_Coef_Y
      MDO_EN_0xA00049: nv-provide-com-spec{ram-block-init-value=0, rom-block-init-value=0, variable=MDO_EN_0xA00049/Value}, nv-require-com-spec=init-value=0, provided-required-interface=MDO_EN_0xA00049
      MFL_Valid: nv-provide-com-spec{ram-block-init-value=0, rom-block-init-value=0, variable=MFL_Valid/Value}, nv-require-com-spec=init-value=0, provided-required-interface=MFL_Valid
      MO_StartStop_Coded: nv-provide-com-spec{ram-block-init-value=1, rom-block-init-value=1, variable=MO_StartStop_Coded/Value}, nv-require-com-spec=init-value=1, provided-required-interface=MO_StartStop_Coded
      Main_Switch_Basis: nv-provide-com-spec{ram-block-init-value=1, rom-block-init-value=1, variable=Main_Switch_Basis/Value}, nv-require-com-spec=init-value=1, provided-required-interface=Main_Switch_Basis
      Main_Switch_Keyless: nv-provide-com-spec{ram-block-init-value=1, rom-block-init-value=1, variable=Main_Switch_Keyless/Value}, nv-require-com-spec=init-value=1, provided-required-interface=Main_Switch_Keyless
      Manuf_Assembly_Plant_Number: nv-provide-com-spec{ram-block-init-value=[255, 255, 255], rom-block-init-value=[255, 255, 255], variable=Manuf_Assembly_Plant_Number/Value}, nv-require-com-spec=init-value=[255, 255, 255], provided-required-interface=Manuf_Assembly_Plant_Number
      Manuf_Equiped_PCB_Reference: nv-provide-com-spec{ram-block-init-value=5 x 255, rom-block-init-value=5 x 255, variable=Manuf_Equiped_PCB_Reference/Value}, nv-require-com-spec=init-value=5 x 255, provided-required-interface=Manuf_Equiped_PCB_Reference
      Manuf_Equiped_PCB_Revision: nv-provide-com-spec{ram-block-init-value=[255, 255], rom-block-init-value=[255, 255], variable=Manuf_Equiped_PCB_Revision/Value}, nv-require-com-spec=init-value=[255, 255], provided-required-interface=Manuf_Equiped_PCB_Revision
      Manuf_Equipped_PCB_Partnumber: nv-provide-com-spec{ram-block-init-value=18 x 255, rom-block-init-value=18 x 255, variable=Manuf_Equipped_PCB_Partnumber/Value}, nv-require-com-spec=init-value=18 x 255, provided-required-interface=Manuf_Equipped_PCB_Partnumber
      Manuf_PCB_Serial_Number: nv-provide-com-spec{ram-block-init-value=[255, 255, 255, 255], rom-block-init-value=[255, 255, 255, 255], variable=Manuf_PCB_Serial_Number/Value}, nv-require-com-spec=init-value=[255, 255, 255, 255], provided-required-interface=Manuf_PCB_Serial_Number
      Manuf_Product_Partnumber:
        nv-provide-com-spec{ram-block-init-value=[86, 80, 76, 86, 65, 70, 45, 49, 48, 56, 52, 57, 32, 45, 73, 71, 32, 32], rom-block-init-value=[86, 80, 76, 86, 65, 70, 45, 49, 48, 56, 52, 57, 32, 45, 73, 71, 32, 32], variable=Manuf_Product_Partnumber/Value}
        nv-require-com-spec=init-value=[86, 80, 76, 86, 65, 70, 45, 49, 48, 56, 52, 57, 32, 45, 73, 71, 32, 32]
        provided-required-interface=Manuf_Product_Partnumber
      Manuf_Product_Reference: nv-provide-com-spec{ram-block-init-value=5 x 255, rom-block-init-value=5 x 255, variable=Manuf_Product_Reference/Value}, nv-require-com-spec=init-value=5 x 255, provided-required-interface=Manuf_Product_Reference
      Manuf_Product_Revision: nv-provide-com-spec{ram-block-init-value=[255, 255], rom-block-init-value=[255, 255], variable=Manuf_Product_Revision/Value}, nv-require-com-spec=init-value=[255, 255], provided-required-interface=Manuf_Product_Revision
      Manuf_SMD_Manufacturing_Date: nv-provide-com-spec{ram-block-init-value=[48, 49, 46, 48, 49, 46, 48, 48], rom-block-init-value=[48, 49, 46, 48, 49, 46, 48, 48], variable=Manuf_SMD_Manufacturing_Date/Value}, nv-require-com-spec=init-value=[48, 49, 46, 48, 49, 46, 48, 48], provided-required-interface=Manuf_SMD_Manufacturing_Date
      Manuf_SMD_Plant_Number: nv-provide-com-spec{ram-block-init-value=[255, 255, 255], rom-block-init-value=[255, 255, 255], variable=Manuf_SMD_Plant_Number/Value}, nv-require-com-spec=init-value=[255, 255, 255], provided-required-interface=Manuf_SMD_Plant_Number
      Manuf_Traceability_PIM: nv-provide-com-spec{ram-block-init-value=0, rom-block-init-value=0, variable=Manuf_Traceability_PIM/Value}, nv-require-com-spec=init-value=0, provided-required-interface=Manuf_Traceability_PIM
      Manuf_Traceability_Station_Nr: nv-provide-com-spec{ram-block-init-value=8 x 0, rom-block-init-value=8 x 0, variable=Manuf_Traceability_Station_Nr/Value}, nv-require-com-spec=init-value=8 x 0, provided-required-interface=Manuf_Traceability_Station_Nr
      Manufacturing_Mode: nv-provide-com-spec{ram-block-init-value=0, rom-block-init-value=0, variable=Manufacturing_Mode/Value}, nv-require-com-spec=init-value=0, provided-required-interface=Manufacturing_Mode
      Manufacturing_PublicKey:
        nv-provide-com-spec{ram-block-init-value=[120, 246, 45, 214, 163, 103, 90, 74, 236, 136, 192, 27, 70, 132, 175, 37, 223, 89, 189, 187, 201, 85, 212, 53, 8, 163, 78, 193, 193, 80, 122, 146], rom-block-init-value=[120, 246, 45, 214, 163, 103, 90, 74, 236, 136, 192, 27, 70, 132, 175, 37, 223, 89, 189, 187, 201, 85, 212, 53, 8, 163, 78, 193, 193, 80, 122, 146], variable=Manufacturing_PublicKey/Value}
        nv-require-com-spec=init-value=[120, 246, 45, 214, 163, 103, 90, 74, 236, 136, 192, 27, 70, 132, 175, 37, 223, 89, 189, 187, 201, 85, 212, 53, 8, 163, 78, 193, 193, 80, 122, 146]
        provided-required-interface=Manufacturing_PublicKey
      Manufacturing_SID: nv-provide-com-spec{ram-block-init-value=32 x 255, rom-block-init-value=32 x 255, variable=Manufacturing_SID/Value}, nv-require-com-spec=init-value=32 x 255, provided-required-interface=Manufacturing_SID
      Measured_Value_Max_Range_lx: nv-provide-com-spec{ram-block-init-value=50000, rom-block-init-value=50000, variable=Measured_Value_Max_Range_lx/Value}, nv-require-com-spec=init-value=50000, provided-required-interface=Measured_Value_Max_Range_lx
      Measured_Value_Max_lx: nv-provide-com-spec{ram-block-init-value=30000, rom-block-init-value=30000, variable=Measured_Value_Max_lx/Value}, nv-require-com-spec=init-value=30000, provided-required-interface=Measured_Value_Max_lx
      Measured_Value_Min_Range_lx: nv-provide-com-spec{ram-block-init-value=0, rom-block-init-value=0, variable=Measured_Value_Min_Range_lx/Value}, nv-require-com-spec=init-value=0, provided-required-interface=Measured_Value_Min_Range_lx
      Measured_Value_Min_lx: nv-provide-com-spec{ram-block-init-value=1200, rom-block-init-value=1200, variable=Measured_Value_Min_lx/Value}, nv-require-com-spec=init-value=1200, provided-required-interface=Measured_Value_Min_lx
      NTC_TFT_Derating_step: nv-provide-com-spec{ram-block-init-value=5, rom-block-init-value=5, variable=NTC_TFT_Derating_step/Value}, nv-require-com-spec=init-value=5, provided-required-interface=NTC_TFT_Derating_step
      NVM_BLOCK_IVD_0X0250: nv-provide-com-spec{ram-block-init-value=202 x 255, rom-block-init-value=202 x 255, variable=NVM_BLOCK_IVD_0X0250/Value}, nv-require-com-spec=init-value=202 x 255, provided-required-interface=NVM_BLOCK_IVD_0X0250
      NVM_BLOCK_SFD_ConfigurationFingerprint_Data: nv-provide-com-spec{ram-block-init-value=514 x 255, rom-block-init-value=514 x 255, variable=NVM_BLOCK_SFD_ConfigurationFingerprint_Data/Value}, nv-require-com-spec=init-value=514 x 255, provided-required-interface=NVM_BLOCK_SFD_ConfigurationFingerprint_Data
      NVM_BLOCK_SFD_PersistentData: nv-provide-com-spec{ram-block-init-value=30 x 255, rom-block-init-value=30 x 255, variable=NVM_BLOCK_SFD_PersistentData/Value}, nv-require-com-spec=init-value=30 x 255, provided-required-interface=NVM_BLOCK_SFD_PersistentData
      NVM_BLOCK_SFD_PublicKey:
        nv-provide-com-spec{ram-block-init-value=[162, 116, 6, 241, 69, 185, 82, 238, 112, 6, 178, 61, 208, 120, 250, 208, 102, 39, 182, 71, 203, 44, 209, 32, 61, 199, 205, 206, 30, 35, 252, 141, 194, 124, 221, 37, 43, 38, 106, 96, 191, 198, 122, 159, 219, 202, 200, 63, 9, 158, 170, 34, 31, 205, 75, 92, 104, 255, 207, 83, 154, 147, 199, 4], rom-block-init-value=[162, 116, 6, 241, 69, 185, 82, 238, 112, 6, 178, 61, 208, 120, 250, 208, 102, 39, 182, 71, 203, 44, 209, 32, 61, 199, 205, 206, 30, 35, 252, 141, 194, 124, 221, 37, 43, 38, 106, 96, 191, 198, 122, 159, 219, 202, 200, 63, 9, 158, 170, 34, 31, 205, 75, 92, 104, 255, 207, 83, 154, 147, 199, 4], variable=NVM_BLOCK_SFD_PublicKey/Value}
        nv-require-com-spec=init-value=[162, 116, 6, 241, 69, 185, 82, 238, 112, 6, 178, 61, 208, 120, 250, 208, 102, 39, 182, 71, 203, 44, 209, 32, 61, 199, 205, 206, 30, 35, 252, 141, 194, 124, 221, 37, 43, 38, 106, 96, 191, 198, 122, 159, 219, 202, 200, 63, 9, 158, 170, 34, 31, 205, 75, 92, 104, 255, 207, 83, 154, 147, 199, 4]
        provided-required-interface=NVM_BLOCK_SFD_PublicKey
      NvM_VKMS: nv-provide-com-spec{ram-block-init-value=[0, 0], rom-block-init-value=[0, 0], variable=NvM_VKMS/Value}, nv-require-com-spec=init-value=[0, 0], provided-required-interface=NvM_VKMS
      Odometer_{0..2}: nv-provide-com-spec{ram-block-init-value=16 x 0, rom-block-init-value=16 x 0, variable=Odometer_{0..2}/Value}, nv-require-com-spec=init-value=16 x 0, provided-required-interface=Odometer_{0..2}
      Offset_Color_Blue: nv-provide-com-spec{ram-block-init-value=0, rom-block-init-value=0, variable=Offset_Color_Blue/Value}, nv-require-com-spec=init-value=0, provided-required-interface=Offset_Color_Blue
      Offset_Color_Green: nv-provide-com-spec{ram-block-init-value=0, rom-block-init-value=0, variable=Offset_Color_Green/Value}, nv-require-com-spec=init-value=0, provided-required-interface=Offset_Color_Green
      Offset_Color_Red: nv-provide-com-spec{ram-block-init-value=0, rom-block-init-value=0, variable=Offset_Color_Red/Value}, nv-require-com-spec=init-value=0, provided-required-interface=Offset_Color_Red
      Oil_Elapsed_Days: nv-provide-com-spec{ram-block-init-value=0, rom-block-init-value=0, variable=Oil_Elapsed_Days/Value}, nv-require-com-spec=init-value=0, provided-required-interface=Oil_Elapsed_Days
      Oil_Elapsed_Km: nv-provide-com-spec{ram-block-init-value=0, rom-block-init-value=0, variable=Oil_Elapsed_Km/Value}, nv-require-com-spec=init-value=0, provided-required-interface=Oil_Elapsed_Km
      Oil_FixedNext_Days: nv-provide-com-spec{ram-block-init-value=365, rom-block-init-value=365, variable=Oil_FixedNext_Days/Value}, nv-require-com-spec=init-value=365, provided-required-interface=Oil_FixedNext_Days
      Oil_FixedNext_Km: nv-provide-com-spec{ram-block-init-value=150, rom-block-init-value=150, variable=Oil_FixedNext_Km/Value}, nv-require-com-spec=init-value=150, provided-required-interface=Oil_FixedNext_Km
      Oil_Quality: nv-provide-com-spec{ram-block-init-value=1, rom-block-init-value=1, variable=Oil_Quality/Value}, nv-require-com-spec=init-value=1, provided-required-interface=Oil_Quality
      Oil_Reset: nv-provide-com-spec{ram-block-init-value=0, rom-block-init-value=0, variable=Oil_Reset/Value}, nv-require-com-spec=init-value=0, provided-required-interface=Oil_Reset
      Oil_SootContamination_Sum: nv-provide-com-spec{ram-block-init-value=0, rom-block-init-value=0, variable=Oil_SootContamination_Sum/Value}, nv-require-com-spec=init-value=0, provided-required-interface=Oil_SootContamination_Sum
      Oil_Theoretic_Km: nv-provide-com-spec{ram-block-init-value=150, rom-block-init-value=150, variable=Oil_Theoretic_Km/Value}, nv-require-com-spec=init-value=150, provided-required-interface=Oil_Theoretic_Km
      Oil_ThermalWear_Sum: nv-provide-com-spec{ram-block-init-value=0, rom-block-init-value=0, variable=Oil_ThermalWear_Sum/Value}, nv-require-com-spec=init-value=0, provided-required-interface=Oil_ThermalWear_Sum
      Oil_VariableMaxNext_Days: nv-provide-com-spec{ram-block-init-value=730, rom-block-init-value=730, variable=Oil_VariableMaxNext_Days/Value}, nv-require-com-spec=init-value=730, provided-required-interface=Oil_VariableMaxNext_Days
      Oil_VariableMaxNext_Km: nv-provide-com-spec{ram-block-init-value=300, rom-block-init-value=300, variable=Oil_VariableMaxNext_Km/Value}, nv-require-com-spec=init-value=300, provided-required-interface=Oil_VariableMaxNext_Km
      Oil_VariableMinNext_Days: nv-provide-com-spec{ram-block-init-value=365, rom-block-init-value=365, variable=Oil_VariableMinNext_Days/Value}, nv-require-com-spec=init-value=365, provided-required-interface=Oil_VariableMinNext_Days
      Oil_VariableMinNext_Km: nv-provide-com-spec{ram-block-init-value=150, rom-block-init-value=150, variable=Oil_VariableMinNext_Km/Value}, nv-require-com-spec=init-value=150, provided-required-interface=Oil_VariableMinNext_Km
      Old_Tank_Warning_Other_State_do_not_use: nv-provide-com-spec{ram-block-init-value=1, rom-block-init-value=1, variable=Old_Tank_Warning_Other_State_do_not_use/Value}, nv-require-com-spec=init-value=1, provided-required-interface=Old_Tank_Warning_Other_State_do_not_use
      OperatingTimeStoredLSB: nv-provide-com-spec{ram-block-init-value=0, rom-block-init-value=0, variable=OperatingTimeStoredLSB/Value}, nv-require-com-spec=init-value=0, provided-required-interface=OperatingTimeStoredLSB
      OperatingTimeStoredMSB: nv-provide-com-spec{ram-block-init-value=0, rom-block-init-value=0, variable=OperatingTimeStoredMSB/Value}, nv-require-com-spec=init-value=0, provided-required-interface=OperatingTimeStoredMSB
      OutsideTemperature_Exclusive_DisplayArea: nv-provide-com-spec{ram-block-init-value=0, rom-block-init-value=0, variable=OutsideTemperature_Exclusive_DisplayArea/Value}, nv-require-com-spec=init-value=0, provided-required-interface=OutsideTemperature_Exclusive_DisplayArea
      OutsideTemperature_Indication: nv-provide-com-spec{ram-block-init-value=1, rom-block-init-value=1, variable=OutsideTemperature_Indication/Value}, nv-require-com-spec=init-value=1, provided-required-interface=OutsideTemperature_Indication
      Overheat_DIMM_primary: nv-provide-com-spec{ram-block-init-value=0, rom-block-init-value=0, variable=Overheat_DIMM_primary/Value}, nv-require-com-spec=init-value=0, provided-required-interface=Overheat_DIMM_primary
      Overheat_DIMM_secondary: nv-provide-com-spec{ram-block-init-value=0, rom-block-init-value=0, variable=Overheat_DIMM_secondary/Value}, nv-require-com-spec=init-value=0, provided-required-interface=Overheat_DIMM_secondary
      PCB_Hot_Spot_Threshold: nv-provide-com-spec{ram-block-init-value=100, rom-block-init-value=100, variable=PCB_Hot_Spot_Threshold/Value}, nv-require-com-spec=init-value=100, provided-required-interface=PCB_Hot_Spot_Threshold
      PCB_Threshold1: nv-provide-com-spec{ram-block-init-value=2379, rom-block-init-value=2379, variable=PCB_Threshold1/Value}, nv-require-com-spec=init-value=2379, provided-required-interface=PCB_Threshold1
      PCB_Threshold2: nv-provide-com-spec{ram-block-init-value=2453, rom-block-init-value=2453, variable=PCB_Threshold2/Value}, nv-require-com-spec=init-value=2453, provided-required-interface=PCB_Threshold2
      PCB_Timer_Temp_Too_Hot: nv-provide-com-spec{ram-block-init-value=2, rom-block-init-value=2, variable=PCB_Timer_Temp_Too_Hot/Value}, nv-require-com-spec=init-value=2, provided-required-interface=PCB_Timer_Temp_Too_Hot
      PCB_TrackResistance: nv-provide-com-spec{ram-block-init-value=0, rom-block-init-value=0, variable=PCB_TrackResistance/Value}, nv-require-com-spec=init-value=0, provided-required-interface=PCB_TrackResistance
      PHEV_Statistic_Cycle: nv-provide-com-spec{ram-block-init-value=0, rom-block-init-value=0, variable=PHEV_Statistic_Cycle/Value}, nv-require-com-spec=init-value=0, provided-required-interface=PHEV_Statistic_Cycle
      PHEV_Statistic_Distance: nv-provide-com-spec{ram-block-init-value=5, rom-block-init-value=5, variable=PHEV_Statistic_Distance/Value}, nv-require-com-spec=init-value=5, provided-required-interface=PHEV_Statistic_Distance
      PSO_DataTag_USER_{0..7}: nv-provide-com-spec{ram-block-init-value=7 x 255, rom-block-init-value=7 x 255, variable=PSO_DataTag_USER_{0..7}/Value}, nv-require-com-spec=init-value=7 x 255, provided-required-interface=PSO_DataTag_USER_{0..7}
      PTC_PCB_Derating_step: nv-provide-com-spec{ram-block-init-value=2, rom-block-init-value=2, variable=PTC_PCB_Derating_step/Value}, nv-require-com-spec=init-value=2, provided-required-interface=PTC_PCB_Derating_step
      PWM_Damping_CurveSwitch: nv-provide-com-spec{ram-block-init-value=0, rom-block-init-value=0, variable=PWM_Damping_CurveSwitch/Value}, nv-require-com-spec=init-value=0, provided-required-interface=PWM_Damping_CurveSwitch
      PWM_Display_X: nv-provide-com-spec{ram-block-init-value=[0, 100, 500, 1000, 1500, 2530], rom-block-init-value=[0, 100, 500, 1000, 1500, 2530], variable=PWM_Display_X/Value}, nv-require-com-spec=init-value=[0, 100, 500, 1000, 1500, 2530], provided-required-interface=PWM_Display_X
      PWM_Display_Y: nv-provide-com-spec{ram-block-init-value=[20, 20, 40, 80, 610, 1000], rom-block-init-value=[20, 20, 40, 80, 610, 1000], variable=PWM_Display_Y/Value}, nv-require-com-spec=init-value=[20, 20, 40, 80, 610, 1000], provided-required-interface=PWM_Display_Y
      PWM_Pointer_xd_X: nv-provide-com-spec{ram-block-init-value=[0, 100, 500, 1000, 2200, 2530], rom-block-init-value=[0, 100, 500, 1000, 2200, 2530], variable=PWM_Pointer_xd_X/Value}, nv-require-com-spec=init-value=[0, 100, 500, 1000, 2200, 2530], provided-required-interface=PWM_Pointer_xd_X
      PWM_Pointer_xd_Y: nv-provide-com-spec{ram-block-init-value=[20, 20, 60, 160, 850, 1000], rom-block-init-value=[20, 20, 60, 160, 850, 1000], variable=PWM_Pointer_xd_Y/Value}, nv-require-com-spec=init-value=[20, 20, 60, 160, 850, 1000], provided-required-interface=PWM_Pointer_xd_Y
      PWM_Pointer_xt_X: nv-provide-com-spec{ram-block-init-value=[0, 200, 300, 500, 700, 1000], rom-block-init-value=[0, 200, 300, 500, 700, 1000], variable=PWM_Pointer_xt_X/Value}, nv-require-com-spec=init-value=[0, 200, 300, 500, 700, 1000], provided-required-interface=PWM_Pointer_xt_X
      PWM_Pointer_xt_Y: nv-provide-com-spec{ram-block-init-value=[0, 200, 300, 500, 700, 1000], rom-block-init-value=[0, 200, 300, 500, 700, 1000], variable=PWM_Pointer_xt_Y/Value}, nv-require-com-spec=init-value=[0, 200, 300, 500, 700, 1000], provided-required-interface=PWM_Pointer_xt_Y
      Photosensor_Calib_Max_Lx: nv-provide-com-spec{ram-block-init-value=500, rom-block-init-value=500, variable=Photosensor_Calib_Max_Lx/Value}, nv-require-com-spec=init-value=500, provided-required-interface=Photosensor_Calib_Max_Lx
      Photosensor_Calib_Max_Range_Lx: nv-provide-com-spec{ram-block-init-value=50000, rom-block-init-value=50000, variable=Photosensor_Calib_Max_Range_Lx/Value}, nv-require-com-spec=init-value=50000, provided-required-interface=Photosensor_Calib_Max_Range_Lx
      Photosensor_Calib_Min_Lx: nv-provide-com-spec{ram-block-init-value=20, rom-block-init-value=20, variable=Photosensor_Calib_Min_Lx/Value}, nv-require-com-spec=init-value=20, provided-required-interface=Photosensor_Calib_Min_Lx
      Photosensor_Calib_Min_Range_Lx: nv-provide-com-spec{ram-block-init-value=0, rom-block-init-value=0, variable=Photosensor_Calib_Min_Range_Lx/Value}, nv-require-com-spec=init-value=0, provided-required-interface=Photosensor_Calib_Min_Range_Lx
      Photosensor_Plausi_Threshold: nv-provide-com-spec{ram-block-init-value=5000, rom-block-init-value=5000, variable=Photosensor_Plausi_Threshold/Value}, nv-require-com-spec=init-value=5000, provided-required-interface=Photosensor_Plausi_Threshold
      Photosensor_available: nv-provide-com-spec{ram-block-init-value=1, rom-block-init-value=1, variable=Photosensor_available/Value}, nv-require-com-spec=init-value=1, provided-required-interface=Photosensor_available
      Photosensor_enabled: nv-provide-com-spec{ram-block-init-value=0, rom-block-init-value=0, variable=Photosensor_enabled/Value}, nv-require-com-spec=init-value=0, provided-required-interface=Photosensor_enabled
      Picture_Upload_Download: nv-provide-com-spec{ram-block-init-value=0, rom-block-init-value=0, variable=Picture_Upload_Download/Value}, nv-require-com-spec=init-value=0, provided-required-interface=Picture_Upload_Download
      PointerType: nv-provide-com-spec{ram-block-init-value=0, rom-block-init-value=0, variable=PointerType/Value}, nv-require-com-spec=init-value=0, provided-required-interface=PointerType
      Pointer_Kl_58xt_Kl_58xd: nv-provide-com-spec{ram-block-init-value=1, rom-block-init-value=1, variable=Pointer_Kl_58xt_Kl_58xd/Value}, nv-require-com-spec=init-value=1, provided-required-interface=Pointer_Kl_58xt_Kl_58xd
      ProductionMode: nv-provide-com-spec{ram-block-init-value=0, rom-block-init-value=0, variable=ProductionMode/Value}, nv-require-com-spec=init-value=0, provided-required-interface=ProductionMode
      ProgMarker: nv-provide-com-spec{ram-block-init-value=255, rom-block-init-value=255, variable=ProgMarker/Value}, nv-require-com-spec=init-value=255, provided-required-interface=ProgMarker
      ProgReqFlag: nv-provide-com-spec{ram-block-init-value=255, rom-block-init-value=255, variable=ProgReqFlag/Value}, nv-require-com-spec=init-value=255, provided-required-interface=ProgReqFlag
      QRS_Mode_Active: nv-provide-com-spec{ram-block-init-value=0, rom-block-init-value=0, variable=QRS_Mode_Active/Value}, nv-require-com-spec=init-value=0, provided-required-interface=QRS_Mode_Active
      QuartzFrequencyOffset: nv-provide-com-spec{ram-block-init-value=0, rom-block-init-value=0, variable=QuartzFrequencyOffset/Value}, nv-require-com-spec=init-value=0, provided-required-interface=QuartzFrequencyOffset
      RCC_IZ: nv-provide-com-spec{ram-block-init-value=4660, rom-block-init-value=4660, variable=RCC_IZ/Value}, nv-require-com-spec=init-value=4660, provided-required-interface=RCC_IZ
      RGB_Color_Calibration_PWM_AmbientLight_X:
        nv-provide-com-spec{ram-block-init-value=[11534144, 16448170, 15073280, 15098910, 15114270, 16760320, 15132160, 13823499, 13827840, 11206420, 3997470, 60190, 60270, 3342220, 57760, 57800, 51455, 41215, 30975, 678655, 1976575, 4267775, 7872255, 12787455, 14418175, 16711935, 16711795, 16722010, 16734790, 15756900], rom-block-init-value=[11534144, 16448170, 15073280, 15098910, 15114270, 16760320, 15132160, 13823499, 13827840, 11206420, 3997470, 60190, 60270, 3342220, 57760, 57800, 51455, 41215, 30975, 678655, 1976575, 4267775, 7872255, 12787455, 14418175, 16711935, 16711795, 16722010, 16734790, 15756900], variable=RGB_Color_Calibration_PWM_AmbientLight_X/Value}
        nv-require-com-spec=init-value=[11534144, 16448170, 15073280, 15098910, 15114270, 16760320, 15132160, 13823499, 13827840, 11206420, 3997470, 60190, 60270, 3342220, 57760, 57800, 51455, 41215, 30975, 678655, 1976575, 4267775, 7872255, 12787455, 14418175, 16711935, 16711795, 16722010, 16734790, 15756900]
        provided-required-interface=RGB_Color_Calibration_PWM_AmbientLight_X
      RGB_Color_Calibration_PWM_AmbientLight_Y_Display:
        nv-provide-com-spec{ram-block-init-value=[1976575, 16448170, 15073280, 15098910, 15114270, 16760320, 15132160, 13823499, 13827840, 11206420, 3997470, 60190, 60270, 3342220, 57760, 57800, 51455, 41215, 30975, 678655, 1976575, 4267775, 7872255, 12787455, 14418175, 16711935, 16711795, 16722010, 16734790, 15756900], rom-block-init-value=[1976575, 16448170, 15073280, 15098910, 15114270, 16760320, 15132160, 13823499, 13827840, 11206420, 3997470, 60190, 60270, 3342220, 57760, 57800, 51455, 41215, 30975, 678655, 1976575, 4267775, 7872255, 12787455, 14418175, 16711935, 16711795, 16722010, 16734790, 15756900], variable=RGB_Color_Calibration_PWM_AmbientLight_Y_Display/Value}
        nv-require-com-spec=init-value=[1976575, 16448170, 15073280, 15098910, 15114270, 16760320, 15132160, 13823499, 13827840, 11206420, 3997470, 60190, 60270, 3342220, 57760, 57800, 51455, 41215, 30975, 678655, 1976575, 4267775, 7872255, 12787455, 14418175, 16711935, 16711795, 16722010, 16734790, 15756900]
        provided-required-interface=RGB_Color_Calibration_PWM_AmbientLight_Y_Display
      RGB_Color_Calibration_PWM_AmbientLight_Y_Left:
        nv-provide-com-spec{ram-block-init-value=[15, 15, 20, 20, 127, 255, 125, 125, 125, 125, 85, 85, 115, 115, 0, 0, 0, 0, 115, 115, 50, 50, 15, 15, 115, 115, 80, 80, 15, 15, 127, 255, 95, 95, 0, 0, 115, 115, 115, 115, 0, 0, 105, 105, 119, 119, 5, 133, 105, 105, 127, 255, 0, 0, 85, 85, 127, 255, 10, 10, 30, 30, 127, 255, 15, 15, 0, 0, 117, 245, 15, 15, 0, 0, 117, 245, 55, 55, 25, 25, 127, 255, 70, 70, 0, 0, 112, 240, 80, 80, 0, 0, 112, 240, 100, 100, 0, 0, 100, 100, 127, 255, 0, 0, 80, 80, 127, 255, 0, 0, 60, 60, 127, 255, 5, 5, 45, 45, 127, 255, 15, 15, 20, 20, 127, 255, 32, 160, 15, 15, 127, 255, 60, 60, 15, 15, 127, 255, 97, 225, 15, 15, 127, 255, 110, 110, 0, 0, 127, 255, 127, 255, 0, 0, 127, 255, 127, 255, 0, 0, 57, 185, 127, 255, 20, 20, 45, 45, 127, 255, 45, 45, 35, 35, 120, 120, 55, 55, 50, 50], rom-block-init-value=[15, 15, 20, 20, 127, 255, 125, 125, 125, 125, 85, 85, 115, 115, 0, 0, 0, 0, 115, 115, 50, 50, 15, 15, 115, 115, 80, 80, 15, 15, 127, 255, 95, 95, 0, 0, 115, 115, 115, 115, 0, 0, 105, 105, 119, 119, 5, 133, 105, 105, 127, 255, 0, 0, 85, 85, 127, 255, 10, 10, 30, 30, 127, 255, 15, 15, 0, 0, 117, 245, 15, 15, 0, 0, 117, 245, 55, 55, 25, 25, 127, 255, 70, 70, 0, 0, 112, 240, 80, 80, 0, 0, 112, 240, 100, 100, 0, 0, 100, 100, 127, 255, 0, 0, 80, 80, 127, 255, 0, 0, 60, 60, 127, 255, 5, 5, 45, 45, 127, 255, 15, 15, 20, 20, 127, 255, 32, 160, 15, 15, 127, 255, 60, 60, 15, 15, 127, 255, 97, 225, 15, 15, 127, 255, 110, 110, 0, 0, 127, 255, 127, 255, 0, 0, 127, 255, 127, 255, 0, 0, 57, 185, 127, 255, 20, 20, 45, 45, 127, 255, 45, 45, 35, 35, 120, 120, 55, 55, 50, 50], variable=RGB_Color_Calibration_PWM_AmbientLight_Y_Left/Value}
        nv-require-com-spec=init-value=[15, 15, 20, 20, 127, 255, 125, 125, 125, 125, 85, 85, 115, 115, 0, 0, 0, 0, 115, 115, 50, 50, 15, 15, 115, 115, 80, 80, 15, 15, 127, 255, 95, 95, 0, 0, 115, 115, 115, 115, 0, 0, 105, 105, 119, 119, 5, 133, 105, 105, 127, 255, 0, 0, 85, 85, 127, 255, 10, 10, 30, 30, 127, 255, 15, 15, 0, 0, 117, 245, 15, 15, 0, 0, 117, 245, 55, 55, 25, 25, 127, 255, 70, 70, 0, 0, 112, 240, 80, 80, 0, 0, 112, 240, 100, 100, 0, 0, 100, 100, 127, 255, 0, 0, 80, 80, 127, 255, 0, 0, 60, 60, 127, 255, 5, 5, 45, 45, 127, 255, 15, 15, 20, 20, 127, 255, 32, 160, 15, 15, 127, 255, 60, 60, 15, 15, 127, 255, 97, 225, 15, 15, 127, 255, 110, 110, 0, 0, 127, 255, 127, 255, 0, 0, 127, 255, 127, 255, 0, 0, 57, 185, 127, 255, 20, 20, 45, 45, 127, 255, 45, 45, 35, 35, 120, 120, 55, 55, 50, 50]
        provided-required-interface=RGB_Color_Calibration_PWM_AmbientLight_Y_Left
      RGB_Color_Calibration_PWM_AmbientLight_Y_Right:
        nv-provide-com-spec{ram-block-init-value=[15, 15, 20, 20, 127, 255, 125, 125, 125, 125, 85, 85, 115, 115, 0, 0, 0, 0, 115, 115, 50, 50, 15, 15, 115, 115, 80, 80, 15, 15, 127, 255, 95, 95, 0, 0, 115, 115, 115, 115, 0, 0, 105, 105, 119, 119, 5, 133, 105, 105, 127, 255, 0, 0, 85, 85, 127, 255, 10, 10, 30, 30, 127, 255, 15, 15, 0, 0, 117, 245, 15, 15, 0, 0, 117, 245, 55, 55, 25, 25, 127, 255, 70, 70, 0, 0, 112, 240, 80, 80, 0, 0, 112, 240, 100, 100, 0, 0, 100, 100, 127, 255, 0, 0, 80, 80, 127, 255, 0, 0, 60, 60, 127, 255, 5, 5, 45, 45, 127, 255, 15, 15, 20, 20, 127, 255, 32, 160, 15, 15, 127, 255, 60, 60, 15, 15, 127, 255, 97, 225, 15, 15, 127, 255, 110, 110, 0, 0, 127, 255, 127, 255, 0, 0, 127, 255, 127, 255, 0, 0, 57, 185, 127, 255, 20, 20, 45, 45, 127, 255, 45, 45, 35, 35, 120, 120, 55, 55, 50, 50], rom-block-init-value=[15, 15, 20, 20, 127, 255, 125, 125, 125, 125, 85, 85, 115, 115, 0, 0, 0, 0, 115, 115, 50, 50, 15, 15, 115, 115, 80, 80, 15, 15, 127, 255, 95, 95, 0, 0, 115, 115, 115, 115, 0, 0, 105, 105, 119, 119, 5, 133, 105, 105, 127, 255, 0, 0, 85, 85, 127, 255, 10, 10, 30, 30, 127, 255, 15, 15, 0, 0, 117, 245, 15, 15, 0, 0, 117, 245, 55, 55, 25, 25, 127, 255, 70, 70, 0, 0, 112, 240, 80, 80, 0, 0, 112, 240, 100, 100, 0, 0, 100, 100, 127, 255, 0, 0, 80, 80, 127, 255, 0, 0, 60, 60, 127, 255, 5, 5, 45, 45, 127, 255, 15, 15, 20, 20, 127, 255, 32, 160, 15, 15, 127, 255, 60, 60, 15, 15, 127, 255, 97, 225, 15, 15, 127, 255, 110, 110, 0, 0, 127, 255, 127, 255, 0, 0, 127, 255, 127, 255, 0, 0, 57, 185, 127, 255, 20, 20, 45, 45, 127, 255, 45, 45, 35, 35, 120, 120, 55, 55, 50, 50], variable=RGB_Color_Calibration_PWM_AmbientLight_Y_Right/Value}
        nv-require-com-spec=init-value=[15, 15, 20, 20, 127, 255, 125, 125, 125, 125, 85, 85, 115, 115, 0, 0, 0, 0, 115, 115, 50, 50, 15, 15, 115, 115, 80, 80, 15, 15, 127, 255, 95, 95, 0, 0, 115, 115, 115, 115, 0, 0, 105, 105, 119, 119, 5, 133, 105, 105, 127, 255, 0, 0, 85, 85, 127, 255, 10, 10, 30, 30, 127, 255, 15, 15, 0, 0, 117, 245, 15, 15, 0, 0, 117, 245, 55, 55, 25, 25, 127, 255, 70, 70, 0, 0, 112, 240, 80, 80, 0, 0, 112, 240, 100, 100, 0, 0, 100, 100, 127, 255, 0, 0, 80, 80, 127, 255, 0, 0, 60, 60, 127, 255, 5, 5, 45, 45, 127, 255, 15, 15, 20, 20, 127, 255, 32, 160, 15, 15, 127, 255, 60, 60, 15, 15, 127, 255, 97, 225, 15, 15, 127, 255, 110, 110, 0, 0, 127, 255, 127, 255, 0, 0, 127, 255, 127, 255, 0, 0, 57, 185, 127, 255, 20, 20, 45, 45, 127, 255, 45, 45, 35, 35, 120, 120, 55, 55, 50, 50]
        provided-required-interface=RGB_Color_Calibration_PWM_AmbientLight_Y_Right
      ROE_Config: nv-provide-com-spec{ram-block-init-value=[0, 0, 0], rom-block-init-value=[0, 0, 0], variable=ROE_Config/Value}, nv-require-com-spec=init-value=[0, 0, 0], provided-required-interface=ROE_Config
      RPM_Gauge_FIR_Coefficients:
        nv-provide-com-spec{ram-block-init-value=[142, 56, 0, 0, 182, 171, 0, 0, 200, 213, 1, 0, 182, 22, 3, 0, 189, 160, 3, 0, 182, 22, 3, 0, 200, 213, 1, 0, 182, 171, 0, 0, 142, 56, 0, 0, 0, 0, 0, 0, 0, 0, 0, 0, 0, 0, 0, 0, 0, 0, 0, 0, 0, 0, 0, 0, 0, 0, 0, 0, 0, 0, 0, 0], rom-block-init-value=[142, 56, 0, 0, 182, 171, 0, 0, 200, 213, 1, 0, 182, 22, 3, 0, 189, 160, 3, 0, 182, 22, 3, 0, 200, 213, 1, 0, 182, 171, 0, 0, 142, 56, 0, 0, 0, 0, 0, 0, 0, 0, 0, 0, 0, 0, 0, 0, 0, 0, 0, 0, 0, 0, 0, 0, 0, 0, 0, 0, 0, 0, 0, 0], variable=RPM_Gauge_FIR_Coefficients/Value}
        nv-require-com-spec=init-value=[142, 56, 0, 0, 182, 171, 0, 0, 200, 213, 1, 0, 182, 22, 3, 0, 189, 160, 3, 0, 182, 22, 3, 0, 200, 213, 1, 0, 182, 171, 0, 0, 142, 56, 0, 0, 0, 0, 0, 0, 0, 0, 0, 0, 0, 0, 0, 0, 0, 0, 0, 0, 0, 0, 0, 0, 0, 0, 0, 0, 0, 0, 0, 0]
        provided-required-interface=RPM_Gauge_FIR_Coefficients
      RPM_Gauge_Hysteresis_Angle: nv-provide-com-spec{ram-block-init-value=0, rom-block-init-value=0, variable=RPM_Gauge_Hysteresis_Angle/Value}, nv-require-com-spec=init-value=0, provided-required-interface=RPM_Gauge_Hysteresis_Angle
      RPM_Gauge_Magnetic_Offset: nv-provide-com-spec{ram-block-init-value=0, rom-block-init-value=0, variable=RPM_Gauge_Magnetic_Offset/Value}, nv-require-com-spec=init-value=0, provided-required-interface=RPM_Gauge_Magnetic_Offset
      RangeAvgConsumption_High: nv-provide-com-spec{ram-block-init-value=1023, rom-block-init-value=1023, variable=RangeAvgConsumption_High/Value}, nv-require-com-spec=init-value=1023, provided-required-interface=RangeAvgConsumption_High
      RangeAvgConsumption_High_CNG: nv-provide-com-spec{ram-block-init-value=1023, rom-block-init-value=1023, variable=RangeAvgConsumption_High_CNG/Value}, nv-require-com-spec=init-value=1023, provided-required-interface=RangeAvgConsumption_High_CNG
      RangeAvgConsumption_High_LPG: nv-provide-com-spec{ram-block-init-value=1023, rom-block-init-value=1023, variable=RangeAvgConsumption_High_LPG/Value}, nv-require-com-spec=init-value=1023, provided-required-interface=RangeAvgConsumption_High_LPG
      Rate: nv-provide-com-spec{ram-block-init-value=100, rom-block-init-value=100, variable=Rate/Value}, nv-require-com-spec=init-value=100, provided-required-interface=Rate
      Red_Gamma_Adjustment_Display1:
        nv-provide-com-spec{ram-block-init-value=[0, 64, 128, 192, 0, 64, 128, 192, 0, 64, 128, 192, 0, 64, 128, 192, 255, 0, 85, 170, 255, 3, 0, 0, 0, 0, 0], rom-block-init-value=[0, 64, 128, 192, 0, 64, 128, 192, 0, 64, 128, 192, 0, 64, 128, 192, 255, 0, 85, 170, 255, 3, 0, 0, 0, 0, 0], variable=Red_Gamma_Adjustment_Display1/Value}
        nv-require-com-spec=init-value=[0, 64, 128, 192, 0, 64, 128, 192, 0, 64, 128, 192, 0, 64, 128, 192, 255, 0, 85, 170, 255, 3, 0, 0, 0, 0, 0]
        provided-required-interface=Red_Gamma_Adjustment_Display1
      Red_Gamma_Adjustment_Display2:
        nv-provide-com-spec{ram-block-init-value=[96, 140, 178, 210, 238, 56, 102, 146, 202, 2, 52, 122, 168, 220, 46, 72, 111, 144, 208, 0, 84, 169, 250, 63, 96, 140, 178, 210, 238, 56, 102, 146, 202, 2, 52, 122, 168, 220, 46, 72, 111, 144, 208, 0, 84, 169, 250, 63], rom-block-init-value=[96, 140, 178, 210, 238, 56, 102, 146, 202, 2, 52, 122, 168, 220, 46, 72, 111, 144, 208, 0, 84, 169, 250, 63, 96, 140, 178, 210, 238, 56, 102, 146, 202, 2, 52, 122, 168, 220, 46, 72, 111, 144, 208, 0, 84, 169, 250, 63], variable=Red_Gamma_Adjustment_Display2/Value}
        nv-require-com-spec=init-value=[96, 140, 178, 210, 238, 56, 102, 146, 202, 2, 52, 122, 168, 220, 46, 72, 111, 144, 208, 0, 84, 169, 250, 63, 96, 140, 178, 210, 238, 56, 102, 146, 202, 2, 52, 122, 168, 220, 46, 72, 111, 144, 208, 0, 84, 169, 250, 63]
        provided-required-interface=Red_Gamma_Adjustment_Display2
      RefulledVolume_Available: nv-provide-com-spec{ram-block-init-value=0, rom-block-init-value=0, variable=RefulledVolume_Available/Value}, nv-require-com-spec=init-value=0, provided-required-interface=RefulledVolume_Available
      Reserved_1: nv-provide-com-spec{ram-block-init-value=5, rom-block-init-value=5, variable=Reserved_1/Value}, nv-require-com-spec=init-value=5, provided-required-interface=Reserved_1
      Reserved_1_Bargraph_VAR: nv-provide-com-spec{ram-block-init-value=0, rom-block-init-value=0, variable=Reserved_1_Bargraph_VAR/Value}, nv-require-com-spec=init-value=0, provided-required-interface=Reserved_1_Bargraph_VAR
      Reserved_1_DIAG_AC_IlluminationCfg_VAR_3: nv-provide-com-spec{ram-block-init-value=6 x 255, rom-block-init-value=6 x 255, variable=Reserved_1_DIAG_AC_IlluminationCfg_VAR_3/Value}, nv-require-com-spec=init-value=6 x 255, provided-required-interface=Reserved_1_DIAG_AC_IlluminationCfg_VAR_3
      Reserved_DIAG_AC_Curve_Scales_VAR: nv-provide-com-spec{ram-block-init-value=9 x 255, rom-block-init-value=9 x 255, variable=Reserved_DIAG_AC_Curve_Scales_VAR/Value}, nv-require-com-spec=init-value=9 x 255, provided-required-interface=Reserved_DIAG_AC_Curve_Scales_VAR
      Reserved_DIAG_AC_IlluminationCfg_VAR_0: nv-provide-com-spec{ram-block-init-value=6 x 255, rom-block-init-value=6 x 255, variable=Reserved_DIAG_AC_IlluminationCfg_VAR_0/Value}, nv-require-com-spec=init-value=6 x 255, provided-required-interface=Reserved_DIAG_AC_IlluminationCfg_VAR_0
      Reserved_DIAG_AC_IlluminationCfg_VAR_3: nv-provide-com-spec{ram-block-init-value=16 x 255, rom-block-init-value=16 x 255, variable=Reserved_DIAG_AC_IlluminationCfg_VAR_3/Value}, nv-require-com-spec=init-value=16 x 255, provided-required-interface=Reserved_DIAG_AC_IlluminationCfg_VAR_3
      ResetCounter_BURAMMarkerInvalid: nv-provide-com-spec{ram-block-init-value=0, rom-block-init-value=0, variable=ResetCounter_BURAMMarkerInvalid/Value}, nv-require-com-spec=init-value=0, provided-required-interface=ResetCounter_BURAMMarkerInvalid
      ResetCounter_BuramChecksumError: nv-provide-com-spec{ram-block-init-value=0, rom-block-init-value=0, variable=ResetCounter_BuramChecksumError/Value}, nv-require-com-spec=init-value=0, provided-required-interface=ResetCounter_BuramChecksumError
      ResetCounter_CSV_Error: nv-provide-com-spec{ram-block-init-value=0, rom-block-init-value=0, variable=ResetCounter_CSV_Error/Value}, nv-require-com-spec=init-value=0, provided-required-interface=ResetCounter_CSV_Error
      ResetCounter_CTRL_App: nv-provide-com-spec{ram-block-init-value=0, rom-block-init-value=0, variable=ResetCounter_CTRL_App/Value}, nv-require-com-spec=init-value=0, provided-required-interface=ResetCounter_CTRL_App
      ResetCounter_CTRL_Warning: nv-provide-com-spec{ram-block-init-value=0, rom-block-init-value=0, variable=ResetCounter_CTRL_Warning/Value}, nv-require-com-spec=init-value=0, provided-required-interface=ResetCounter_CTRL_Warning
      ResetCounter_CXDR_ADC: nv-provide-com-spec{ram-block-init-value=0, rom-block-init-value=0, variable=ResetCounter_CXDR_ADC/Value}, nv-require-com-spec=init-value=0, provided-required-interface=ResetCounter_CXDR_ADC
      ResetCounter_CXDR_DisplayMonitor: nv-provide-com-spec{ram-block-init-value=0, rom-block-init-value=0, variable=ResetCounter_CXDR_DisplayMonitor/Value}, nv-require-com-spec=init-value=0, provided-required-interface=ResetCounter_CXDR_DisplayMonitor
      ResetCounter_CXDR_IOC: nv-provide-com-spec{ram-block-init-value=0, rom-block-init-value=0, variable=ResetCounter_CXDR_IOC/Value}, nv-require-com-spec=init-value=0, provided-required-interface=ResetCounter_CXDR_IOC
      ResetCounter_CXDR_Illum: nv-provide-com-spec{ram-block-init-value=0, rom-block-init-value=0, variable=ResetCounter_CXDR_Illum/Value}, nv-require-com-spec=init-value=0, provided-required-interface=ResetCounter_CXDR_Illum
      ResetCounter_CXDR_SafeTTMonitor: nv-provide-com-spec{ram-block-init-value=0, rom-block-init-value=0, variable=ResetCounter_CXDR_SafeTTMonitor/Value}, nv-require-com-spec=init-value=0, provided-required-interface=ResetCounter_CXDR_SafeTTMonitor
      ResetCounter_CXDR_Sensors: nv-provide-com-spec{ram-block-init-value=0, rom-block-init-value=0, variable=ResetCounter_CXDR_Sensors/Value}, nv-require-com-spec=init-value=0, provided-required-interface=ResetCounter_CXDR_Sensors
      ResetCounter_CXDR_Sound: nv-provide-com-spec{ram-block-init-value=0, rom-block-init-value=0, variable=ResetCounter_CXDR_Sound/Value}, nv-require-com-spec=init-value=0, provided-required-interface=ResetCounter_CXDR_Sound
      ResetCounter_ClockMon: nv-provide-com-spec{ram-block-init-value=0, rom-block-init-value=0, variable=ResetCounter_ClockMon/Value}, nv-require-com-spec=init-value=0, provided-required-interface=ResetCounter_ClockMon
      ResetCounter_DeepStopNotEntered: nv-provide-com-spec{ram-block-init-value=0, rom-block-init-value=0, variable=ResetCounter_DeepStopNotEntered/Value}, nv-require-com-spec=init-value=0, provided-required-interface=ResetCounter_DeepStopNotEntered
      ResetCounter_Det_ErrorHook: nv-provide-com-spec{ram-block-init-value=0, rom-block-init-value=0, variable=ResetCounter_Det_ErrorHook/Value}, nv-require-com-spec=init-value=0, provided-required-interface=ResetCounter_Det_ErrorHook
      ResetCounter_DpMainTaskError: nv-provide-com-spec{ram-block-init-value=0, rom-block-init-value=0, variable=ResetCounter_DpMainTaskError/Value}, nv-require-com-spec=init-value=0, provided-required-interface=ResetCounter_DpMainTaskError
      ResetCounter_DpQueueError: nv-provide-com-spec{ram-block-init-value=0, rom-block-init-value=0, variable=ResetCounter_DpQueueError/Value}, nv-require-com-spec=init-value=0, provided-required-interface=ResetCounter_DpQueueError
      ResetCounter_ECC_Error: nv-provide-com-spec{ram-block-init-value=0, rom-block-init-value=0, variable=ResetCounter_ECC_Error/Value}, nv-require-com-spec=init-value=0, provided-required-interface=ResetCounter_ECC_Error
      ResetCounter_EcuMErrorHook: nv-provide-com-spec{ram-block-init-value=0, rom-block-init-value=0, variable=ResetCounter_EcuMErrorHook/Value}, nv-require-com-spec=init-value=0, provided-required-interface=ResetCounter_EcuMErrorHook
      ResetCounter_EcuM_BswErrorHook: nv-provide-com-spec{ram-block-init-value=0, rom-block-init-value=0, variable=ResetCounter_EcuM_BswErrorHook/Value}, nv-require-com-spec=init-value=0, provided-required-interface=ResetCounter_EcuM_BswErrorHook
      ResetCounter_EcuReset: nv-provide-com-spec{ram-block-init-value=0, rom-block-init-value=0, variable=ResetCounter_EcuReset/Value}, nv-require-com-spec=init-value=0, provided-required-interface=ResetCounter_EcuReset
      ResetCounter_ErrorHook: nv-provide-com-spec{ram-block-init-value=0, rom-block-init-value=0, variable=ResetCounter_ErrorHook/Value}, nv-require-com-spec=init-value=0, provided-required-interface=ResetCounter_ErrorHook
      ResetCounter_EventQueueError: nv-provide-com-spec{ram-block-init-value=0, rom-block-init-value=0, variable=ResetCounter_EventQueueError/Value}, nv-require-com-spec=init-value=0, provided-required-interface=ResetCounter_EventQueueError
      ResetCounter_GuiQueueError: nv-provide-com-spec{ram-block-init-value=0, rom-block-init-value=0, variable=ResetCounter_GuiQueueError/Value}, nv-require-com-spec=init-value=0, provided-required-interface=ResetCounter_GuiQueueError
      ResetCounter_HMITaskError: nv-provide-com-spec{ram-block-init-value=0, rom-block-init-value=0, variable=ResetCounter_HMITaskError/Value}, nv-require-com-spec=init-value=0, provided-required-interface=ResetCounter_HMITaskError
      ResetCounter_IoHwAb: nv-provide-com-spec{ram-block-init-value=0, rom-block-init-value=0, variable=ResetCounter_IoHwAb/Value}, nv-require-com-spec=init-value=0, provided-required-interface=ResetCounter_IoHwAb
      ResetCounter_JumpToZero: nv-provide-com-spec{ram-block-init-value=0, rom-block-init-value=0, variable=ResetCounter_JumpToZero/Value}, nv-require-com-spec=init-value=0, provided-required-interface=ResetCounter_JumpToZero
      ResetCounter_LastResetReason: nv-provide-com-spec{ram-block-init-value=0, rom-block-init-value=0, variable=ResetCounter_LastResetReason/Value}, nv-require-com-spec=init-value=0, provided-required-interface=ResetCounter_LastResetReason
      ResetCounter_MDL_BCCT: nv-provide-com-spec{ram-block-init-value=0, rom-block-init-value=0, variable=ResetCounter_MDL_BCCT/Value}, nv-require-com-spec=init-value=0, provided-required-interface=ResetCounter_MDL_BCCT
      ResetCounter_MDL_CarModes: nv-provide-com-spec{ram-block-init-value=0, rom-block-init-value=0, variable=ResetCounter_MDL_CarModes/Value}, nv-require-com-spec=init-value=0, provided-required-interface=ResetCounter_MDL_CarModes
      ResetCounter_MDL_Immobilizer: nv-provide-com-spec{ram-block-init-value=0, rom-block-init-value=0, variable=ResetCounter_MDL_Immobilizer/Value}, nv-require-com-spec=init-value=0, provided-required-interface=ResetCounter_MDL_Immobilizer
      ResetCounter_MDL_SiWaLa: nv-provide-com-spec{ram-block-init-value=0, rom-block-init-value=0, variable=ResetCounter_MDL_SiWaLa/Value}, nv-require-com-spec=init-value=0, provided-required-interface=ResetCounter_MDL_SiWaLa
      ResetCounter_MPU_Error: nv-provide-com-spec{ram-block-init-value=0, rom-block-init-value=0, variable=ResetCounter_MPU_Error/Value}, nv-require-com-spec=init-value=0, provided-required-interface=ResetCounter_MPU_Error
      ResetCounter_POR: nv-provide-com-spec{ram-block-init-value=0, rom-block-init-value=0, variable=ResetCounter_POR/Value}, nv-require-com-spec=init-value=0, provided-required-interface=ResetCounter_POR
      ResetCounter_ProtectionHook: nv-provide-com-spec{ram-block-init-value=0, rom-block-init-value=0, variable=ResetCounter_ProtectionHook/Value}, nv-require-com-spec=init-value=0, provided-required-interface=ResetCounter_ProtectionHook
      ResetCounter_RamHashError: nv-provide-com-spec{ram-block-init-value=0, rom-block-init-value=0, variable=ResetCounter_RamHashError/Value}, nv-require-com-spec=init-value=0, provided-required-interface=ResetCounter_RamHashError
      ResetCounter_RendererTaskError: nv-provide-com-spec{ram-block-init-value=0, rom-block-init-value=0, variable=ResetCounter_RendererTaskError/Value}, nv-require-com-spec=init-value=0, provided-required-interface=ResetCounter_RendererTaskError
      ResetCounter_SRV_Cfg_Safety: nv-provide-com-spec{ram-block-init-value=0, rom-block-init-value=0, variable=ResetCounter_SRV_Cfg_Safety/Value}, nv-require-com-spec=init-value=0, provided-required-interface=ResetCounter_SRV_Cfg_Safety
      ResetCounter_SRV_ComExt_Task50: nv-provide-com-spec{ram-block-init-value=0, rom-block-init-value=0, variable=ResetCounter_SRV_ComExt_Task50/Value}, nv-require-com-spec=init-value=0, provided-required-interface=ResetCounter_SRV_ComExt_Task50
      ResetCounter_SRV_ComExt_TaskFast: nv-provide-com-spec{ram-block-init-value=0, rom-block-init-value=0, variable=ResetCounter_SRV_ComExt_TaskFast/Value}, nv-require-com-spec=init-value=0, provided-required-interface=ResetCounter_SRV_ComExt_TaskFast
      ResetCounter_SRV_MemTest: nv-provide-com-spec{ram-block-init-value=0, rom-block-init-value=0, variable=ResetCounter_SRV_MemTest/Value}, nv-require-com-spec=init-value=0, provided-required-interface=ResetCounter_SRV_MemTest
      ResetCounter_SRV_Monitor: nv-provide-com-spec{ram-block-init-value=0, rom-block-init-value=0, variable=ResetCounter_SRV_Monitor/Value}, nv-require-com-spec=init-value=0, provided-required-interface=ResetCounter_SRV_Monitor
      ResetCounter_SRV_Power: nv-provide-com-spec{ram-block-init-value=0, rom-block-init-value=0, variable=ResetCounter_SRV_Power/Value}, nv-require-com-spec=init-value=0, provided-required-interface=ResetCounter_SRV_Power
      ResetCounter_ShutdownHook: nv-provide-com-spec{ram-block-init-value=0, rom-block-init-value=0, variable=ResetCounter_ShutdownHook/Value}, nv-require-com-spec=init-value=0, provided-required-interface=ResetCounter_ShutdownHook
      ResetCounter_StackMonitor: nv-provide-com-spec{ram-block-init-value=0, rom-block-init-value=0, variable=ResetCounter_StackMonitor/Value}, nv-require-com-spec=init-value=0, provided-required-interface=ResetCounter_StackMonitor
      ResetCounter_TFT_alive: nv-provide-com-spec{ram-block-init-value=0, rom-block-init-value=0, variable=ResetCounter_TFT_alive/Value}, nv-require-com-spec=init-value=0, provided-required-interface=ResetCounter_TFT_alive
      ResetCounter_TimeoutModule: nv-provide-com-spec{ram-block-init-value=0, rom-block-init-value=0, variable=ResetCounter_TimeoutModule/Value}, nv-require-com-spec=init-value=0, provided-required-interface=ResetCounter_TimeoutModule
      ResetCounter_TmrFailure: nv-provide-com-spec{ram-block-init-value=0, rom-block-init-value=0, variable=ResetCounter_TmrFailure/Value}, nv-require-com-spec=init-value=0, provided-required-interface=ResetCounter_TmrFailure
      ResetCounter_Trap: nv-provide-com-spec{ram-block-init-value=0, rom-block-init-value=0, variable=ResetCounter_Trap/Value}, nv-require-com-spec=init-value=0, provided-required-interface=ResetCounter_Trap
      ResetCounter_Trap_GS: nv-provide-com-spec{ram-block-init-value=0, rom-block-init-value=0, variable=ResetCounter_Trap_GS/Value}, nv-require-com-spec=init-value=0, provided-required-interface=ResetCounter_Trap_GS
      ResetCounter_VIEW_Sound: nv-provide-com-spec{ram-block-init-value=0, rom-block-init-value=0, variable=ResetCounter_VIEW_Sound/Value}, nv-require-com-spec=init-value=0, provided-required-interface=ResetCounter_VIEW_Sound
      ResetCounter_WD: nv-provide-com-spec{ram-block-init-value=0, rom-block-init-value=0, variable=ResetCounter_WD/Value}, nv-require-com-spec=init-value=0, provided-required-interface=ResetCounter_WD
      ResetCounter_WD_GS: nv-provide-com-spec{ram-block-init-value=0, rom-block-init-value=0, variable=ResetCounter_WD_GS/Value}, nv-require-com-spec=init-value=0, provided-required-interface=ResetCounter_WD_GS
      ResetCounter_backlight: nv-provide-com-spec{ram-block-init-value=0, rom-block-init-value=0, variable=ResetCounter_backlight/Value}, nv-require-com-spec=init-value=0, provided-required-interface=ResetCounter_backlight
      ResetResponseFlag: nv-provide-com-spec{ram-block-init-value=255, rom-block-init-value=255, variable=ResetResponseFlag/Value}, nv-require-com-spec=init-value=255, provided-required-interface=ResetResponseFlag
      Rework_Param_1: nv-provide-com-spec{ram-block-init-value=0, rom-block-init-value=0, variable=Rework_Param_1/Value}, nv-require-com-spec=init-value=0, provided-required-interface=Rework_Param_1
      Rework_Param_2: nv-provide-com-spec{ram-block-init-value=0, rom-block-init-value=0, variable=Rework_Param_2/Value}, nv-require-com-spec=init-value=0, provided-required-interface=Rework_Param_2
      RightIndicatorErrorCounter: nv-provide-com-spec{ram-block-init-value=0, rom-block-init-value=0, variable=RightIndicatorErrorCounter/Value}, nv-require-com-spec=init-value=0, provided-required-interface=RightIndicatorErrorCounter
      RightIndicatorErrorPath: nv-provide-com-spec{ram-block-init-value=0, rom-block-init-value=0, variable=RightIndicatorErrorPath/Value}, nv-require-com-spec=init-value=0, provided-required-interface=RightIndicatorErrorPath
      RollTestStandMode: nv-provide-com-spec{ram-block-init-value=0, rom-block-init-value=0, variable=RollTestStandMode/Value}, nv-require-com-spec=init-value=0, provided-required-interface=RollTestStandMode
      RunInMode_Config: nv-provide-com-spec{ram-block-init-value=0, rom-block-init-value=0, variable=RunInMode_Config/Value}, nv-require-com-spec=init-value=0, provided-required-interface=RunInMode_Config
      RunInMode_Result: nv-provide-com-spec{ram-block-init-value=0, rom-block-init-value=0, variable=RunInMode_Result/Value}, nv-require-com-spec=init-value=0, provided-required-interface=RunInMode_Result
      RunIn_FinalPointerPositions: nv-provide-com-spec{ram-block-init-value=[13000, 13000, 13000, 13000], rom-block-init-value=[13000, 13000, 13000, 13000], variable=RunIn_FinalPointerPositions/Value}, nv-require-com-spec=init-value=[13000, 13000, 13000, 13000], provided-required-interface=RunIn_FinalPointerPositions
      RunIn_FuelADC_Max: nv-provide-com-spec{ram-block-init-value=175, rom-block-init-value=175, variable=RunIn_FuelADC_Max/Value}, nv-require-com-spec=init-value=175, provided-required-interface=RunIn_FuelADC_Max
      RunIn_FuelADC_Min: nv-provide-com-spec{ram-block-init-value=50, rom-block-init-value=50, variable=RunIn_FuelADC_Min/Value}, nv-require-com-spec=init-value=50, provided-required-interface=RunIn_FuelADC_Min
      SFD_Group_Attribute:
        nv-provide-com-spec{ram-block-init-value=[86, 52, 50, 48, 48, 50, 50, 49, 48, 55, 50, 54, 53, 78, 65, 46, 57, 50, 48, 46, 51, 49, 48], rom-block-init-value=[86, 52, 50, 48, 48, 50, 50, 49, 48, 55, 50, 54, 53, 78, 65, 46, 57, 50, 48, 46, 51, 49, 48], variable=SFD_Group_Attribute/Value}
        nv-require-com-spec=init-value=[86, 52, 50, 48, 48, 50, 50, 49, 48, 55, 50, 54, 53, 78, 65, 46, 57, 50, 48, 46, 51, 49, 48]
        provided-required-interface=SFD_Group_Attribute
      SFD_Project_ID: nv-provide-com-spec{ram-block-init-value=342, rom-block-init-value=342, variable=SFD_Project_ID/Value}, nv-require-com-spec=init-value=342, provided-required-interface=SFD_Project_ID
      SG_BusKnockout_Ctr: nv-provide-com-spec{ram-block-init-value=0, rom-block-init-value=0, variable=SG_BusKnockout_Ctr/Value}, nv-require-com-spec=init-value=0, provided-required-interface=SG_BusKnockout_Ctr
      SG_BusKnockout_Tmr: nv-provide-com-spec{ram-block-init-value=30, rom-block-init-value=30, variable=SG_BusKnockout_Tmr/Value}, nv-require-com-spec=init-value=30, provided-required-interface=SG_BusKnockout_Tmr
      SKey_Error_Counter: nv-provide-com-spec{ram-block-init-value=0, rom-block-init-value=0, variable=SKey_Error_Counter/Value}, nv-require-com-spec=init-value=0, provided-required-interface=SKey_Error_Counter
      SRV_TKM_ZvCrH_TKM_ZvCrHPimTkKeyInCarNeed: nv-provide-com-spec{ram-block-init-value=16 x 255, rom-block-init-value=16 x 255, variable=SRV_TKM_ZvCrH_TKM_ZvCrHPimTkKeyInCarNeed/Value}, nv-require-com-spec=init-value=16 x 255, provided-required-interface=SRV_TKM_ZvCrH_TKM_ZvCrHPimTkKeyInCarNeed
      SSO_EdgeCount_Sum_lastmode: nv-provide-com-spec{ram-block-init-value=0, rom-block-init-value=0, variable=SSO_EdgeCount_Sum_lastmode/Value}, nv-require-com-spec=init-value=0, provided-required-interface=SSO_EdgeCount_Sum_lastmode
      SWA_Telltales_Installed: nv-provide-com-spec{ram-block-init-value=0, rom-block-init-value=0, variable=SWA_Telltales_Installed/Value}, nv-require-com-spec=init-value=0, provided-required-interface=SWA_Telltales_Installed
      SaveTimeDisplayOff: nv-provide-com-spec{ram-block-init-value=10, rom-block-init-value=10, variable=SaveTimeDisplayOff/Value}, nv-require-com-spec=init-value=10, provided-required-interface=SaveTimeDisplayOff
      SaveTimeEngineOff: nv-provide-com-spec{ram-block-init-value=180, rom-block-init-value=180, variable=SaveTimeEngineOff/Value}, nv-require-com-spec=init-value=180, provided-required-interface=SaveTimeEngineOff
      Scale_Luminosity_Calibration_PWM: nv-provide-com-spec{ram-block-init-value=10000, rom-block-init-value=10000, variable=Scale_Luminosity_Calibration_PWM/Value}, nv-require-com-spec=init-value=10000, provided-required-interface=Scale_Luminosity_Calibration_PWM
      Scales_DayResponseCurve: nv-provide-com-spec{ram-block-init-value=2, rom-block-init-value=2, variable=Scales_DayResponseCurve/Value}, nv-require-com-spec=init-value=2, provided-required-interface=Scales_DayResponseCurve
      Scales_Day_X: nv-provide-com-spec{ram-block-init-value=[0, 100, 500, 1000, 1500, 2530], rom-block-init-value=[0, 100, 500, 1000, 1500, 2530], variable=Scales_Day_X/Value}, nv-require-com-spec=init-value=[0, 100, 500, 1000, 1500, 2530], provided-required-interface=Scales_Day_X
      Scales_Day_Y: nv-provide-com-spec{ram-block-init-value=[40, 40, 120, 200, 800, 1000], rom-block-init-value=[40, 40, 120, 200, 800, 1000], variable=Scales_Day_Y/Value}, nv-require-com-spec=init-value=[40, 40, 120, 200, 800, 1000], provided-required-interface=Scales_Day_Y
      Scales_Night_X: nv-provide-com-spec{ram-block-init-value=[0, 100, 500, 1000, 1500, 2530], rom-block-init-value=[0, 100, 500, 1000, 1500, 2530], variable=Scales_Night_X/Value}, nv-require-com-spec=init-value=[0, 100, 500, 1000, 1500, 2530], provided-required-interface=Scales_Night_X
      Scales_Night_Y: nv-provide-com-spec{ram-block-init-value=[40, 40, 120, 200, 800, 1000], rom-block-init-value=[40, 40, 120, 200, 800, 1000], variable=Scales_Night_Y/Value}, nv-require-com-spec=init-value=[40, 40, 120, 200, 800, 1000], provided-required-interface=Scales_Night_Y
      Seatbelt_Rear_Delaytime_acoustic: nv-provide-com-spec{ram-block-init-value=0, rom-block-init-value=0, variable=Seatbelt_Rear_Delaytime_acoustic/Value}, nv-require-com-spec=init-value=0, provided-required-interface=Seatbelt_Rear_Delaytime_acoustic
      Seatbelt_Rear_Displaytime_buckle: nv-provide-com-spec{ram-block-init-value=31, rom-block-init-value=31, variable=Seatbelt_Rear_Displaytime_buckle/Value}, nv-require-com-spec=init-value=31, provided-required-interface=Seatbelt_Rear_Displaytime_buckle
      Seatbelt_Rear_speed_blinking_off: nv-provide-com-spec{ram-block-init-value=5, rom-block-init-value=5, variable=Seatbelt_Rear_speed_blinking_off/Value}, nv-require-com-spec=init-value=5, provided-required-interface=Seatbelt_Rear_speed_blinking_off
      Seatbelt_Rear_speed_blinking_on: nv-provide-com-spec{ram-block-init-value=25, rom-block-init-value=25, variable=Seatbelt_Rear_speed_blinking_on/Value}, nv-require-com-spec=init-value=25, provided-required-interface=Seatbelt_Rear_speed_blinking_on
      Seatbelt_SBR_Installed: nv-provide-com-spec{ram-block-init-value=3, rom-block-init-value=3, variable=Seatbelt_SBR_Installed/Value}, nv-require-com-spec=init-value=3, provided-required-interface=Seatbelt_SBR_Installed
      SecAccessDelayFlag: nv-provide-com-spec{ram-block-init-value=255, rom-block-init-value=255, variable=SecAccessDelayFlag/Value}, nv-require-com-spec=init-value=255, provided-required-interface=SecAccessDelayFlag
      SecAccessInvalidCount: nv-provide-com-spec{ram-block-init-value=255, rom-block-init-value=255, variable=SecAccessInvalidCount/Value}, nv-require-com-spec=init-value=255, provided-required-interface=SecAccessInvalidCount
      Security_InvalidKeyCounter: nv-provide-com-spec{ram-block-init-value=0, rom-block-init-value=0, variable=Security_InvalidKeyCounter/Value}, nv-require-com-spec=init-value=0, provided-required-interface=Security_InvalidKeyCounter
      SegmentLengthList_Block{1..6}: nv-provide-com-spec{ram-block-init-value=[255, 255, 255, 255], rom-block-init-value=[255, 255, 255, 255], variable=SegmentLengthList_Block{1..6}/Value}, nv-require-com-spec=init-value=[255, 255, 255, 255], provided-required-interface=SegmentLengthList_Block{1..6}
      ServiceKey_Counter_Key_ID{1..8}: nv-provide-com-spec{ram-block-init-value=0, rom-block-init-value=0, variable=ServiceKey_Counter_Key_ID{1..8}/Value}, nv-require-com-spec=init-value=0, provided-required-interface=ServiceKey_Counter_Key_ID{1..8}
      ServiceKey_Counter_Key_ID_Kessy: nv-provide-com-spec{ram-block-init-value=0, rom-block-init-value=0, variable=ServiceKey_Counter_Key_ID_Kessy/Value}, nv-require-com-spec=init-value=0, provided-required-interface=ServiceKey_Counter_Key_ID_Kessy
      Service_Early_Warning_Prediction: nv-provide-com-spec{ram-block-init-value=30, rom-block-init-value=30, variable=Service_Early_Warning_Prediction/Value}, nv-require-com-spec=init-value=30, provided-required-interface=Service_Early_Warning_Prediction
      Service_History: nv-provide-com-spec{ram-block-init-value=64 x 4294967295, rom-block-init-value=64 x 4294967295, variable=Service_History/Value}, nv-require-com-spec=init-value=64 x 4294967295, provided-required-interface=Service_History
      Service_PreWarning_Days: nv-provide-com-spec{ram-block-init-value=30, rom-block-init-value=30, variable=Service_PreWarning_Days/Value}, nv-require-com-spec=init-value=30, provided-required-interface=Service_PreWarning_Days
      Share_ASAM_ODXFileIdentifier_Old: nv-provide-com-spec{ram-block-init-value=21 x 255, rom-block-init-value=21 x 255, variable=Share_ASAM_ODXFileIdentifier_Old/Value}, nv-require-com-spec=init-value=21 x 255, provided-required-interface=Share_ASAM_ODXFileIdentifier_Old
      Share_ASAM_ODXFileIdentifier_obsolate:
        nv-provide-com-spec{ram-block-init-value=[69, 86, 95, 68, 97, 115, 104, 66, 111, 97, 114, 100, 74, 67, 73, 77, 81, 66, 65, 66, 0], rom-block-init-value=[69, 86, 95, 68, 97, 115, 104, 66, 111, 97, 114, 100, 74, 67, 73, 77, 81, 66, 65, 66, 0], variable=Share_ASAM_ODXFileIdentifier_obsolate/Value}
        nv-require-com-spec=init-value=[69, 86, 95, 68, 97, 115, 104, 66, 111, 97, 114, 100, 74, 67, 73, 77, 81, 66, 65, 66, 0]
        provided-required-interface=Share_ASAM_ODXFileIdentifier_obsolate
      Share_ASAM_ODXFileVersion_Old: nv-provide-com-spec{ram-block-init-value=6 x 255, rom-block-init-value=6 x 255, variable=Share_ASAM_ODXFileVersion_Old/Value}, nv-require-com-spec=init-value=6 x 255, provided-required-interface=Share_ASAM_ODXFileVersion_Old
      Share_BootloaderTPBlocksize: nv-provide-com-spec{ram-block-init-value=15, rom-block-init-value=15, variable=Share_BootloaderTPBlocksize/Value}, nv-require-com-spec=init-value=15, provided-required-interface=Share_BootloaderTPBlocksize
      Share_ECUProgrammingInformation: nv-provide-com-spec{ram-block-init-value=64, rom-block-init-value=64, variable=Share_ECUProgrammingInformation/Value}, nv-require-com-spec=init-value=64, provided-required-interface=Share_ECUProgrammingInformation
      Share_FDSProjectData: nv-provide-com-spec{ram-block-init-value=8 x 255, rom-block-init-value=8 x 255, variable=Share_FDSProjectData/Value}, nv-require-com-spec=init-value=8 x 255, provided-required-interface=Share_FDSProjectData
      Share_FblShareDataPartTwoReserved: nv-provide-com-spec{ram-block-init-value=76 x 255, rom-block-init-value=76 x 255, variable=Share_FblShareDataPartTwoReserved/Value}, nv-require-com-spec=init-value=76 x 255, provided-required-interface=Share_FblShareDataPartTwoReserved
      Share_Fingerprint_Block{1..6}: nv-provide-com-spec{ram-block-init-value=[0, 1, 1, 0, 0, 0, 0, 0, 0], rom-block-init-value=[0, 1, 1, 0, 0, 0, 0, 0, 0], variable=Share_Fingerprint_Block{1..6}/Value}, nv-require-com-spec=init-value=[0, 1, 1, 0, 0, 0, 0, 0, 0], provided-required-interface=Share_Fingerprint_Block{1..6}
      Share_InvalidKeyCounter: nv-provide-com-spec{ram-block-init-value=0, rom-block-init-value=0, variable=Share_InvalidKeyCounter/Value}, nv-require-com-spec=init-value=0, provided-required-interface=Share_InvalidKeyCounter
      Share_ProgAttempts_Block{1..6}: nv-provide-com-spec{ram-block-init-value=[0, 0], rom-block-init-value=[0, 0], variable=Share_ProgAttempts_Block{1..6}/Value}, nv-require-com-spec=init-value=[0, 0], provided-required-interface=Share_ProgAttempts_Block{1..6}
      Share_VWECUHardwareNumber: nv-provide-com-spec{ram-block-init-value=[53, 78, 65, 57, 50, 48, 51, 49, 48, 32, 32], rom-block-init-value=[53, 78, 65, 57, 50, 48, 51, 49, 48, 32, 32], variable=Share_VWECUHardwareNumber/Value}, nv-require-com-spec=init-value=[53, 78, 65, 57, 50, 48, 51, 49, 48, 32, 32], provided-required-interface=Share_VWECUHardwareNumber
      Share_VWECUHardwareNumber_Old: nv-provide-com-spec{ram-block-init-value=11 x 255, rom-block-init-value=11 x 255, variable=Share_VWECUHardwareNumber_Old/Value}, nv-require-com-spec=init-value=11 x 255, provided-required-interface=Share_VWECUHardwareNumber_Old
      Share_VWECUHardwareVersionNumber: nv-provide-com-spec{ram-block-init-value=[48, 50, 48], rom-block-init-value=[48, 50, 48], variable=Share_VWECUHardwareVersionNumber/Value}, nv-require-com-spec=init-value=[48, 50, 48], provided-required-interface=Share_VWECUHardwareVersionNumber
      Share_VWECUHardwareVersionNumber_Old: nv-provide-com-spec{ram-block-init-value=[255, 255, 255], rom-block-init-value=[255, 255, 255], variable=Share_VWECUHardwareVersionNumber_Old/Value}, nv-require-com-spec=init-value=[255, 255, 255], provided-required-interface=Share_VWECUHardwareVersionNumber_Old
      Share_VWFAZITIdentificationString: nv-provide-com-spec{ram-block-init-value=23 x 255, rom-block-init-value=23 x 255, variable=Share_VWFAZITIdentificationString/Value}, nv-require-com-spec=init-value=23 x 255, provided-required-interface=Share_VWFAZITIdentificationString
      Share_VWSparePartNumber: nv-provide-com-spec{ram-block-init-value=[53, 78, 65, 57, 50, 48, 51, 49, 48, 32, 32], rom-block-init-value=[53, 78, 65, 57, 50, 48, 51, 49, 48, 32, 32], variable=Share_VWSparePartNumber/Value}, nv-require-com-spec=init-value=[53, 78, 65, 57, 50, 48, 51, 49, 48, 32, 32], provided-required-interface=Share_VWSparePartNumber
      Share_ValidityFlags: nv-provide-com-spec{ram-block-init-value=192, rom-block-init-value=192, variable=Share_ValidityFlags/Value}, nv-require-com-spec=init-value=192, provided-required-interface=Share_ValidityFlags
      SiWalaACT_0xA00049: nv-provide-com-spec{ram-block-init-value=0, rom-block-init-value=0, variable=SiWalaACT_0xA00049/Value}, nv-require-com-spec=init-value=0, provided-required-interface=SiWalaACT_0xA00049
      SiWalaActive_0xA00049: nv-provide-com-spec{ram-block-init-value=0, rom-block-init-value=0, variable=SiWalaActive_0xA00049/Value}, nv-require-com-spec=init-value=0, provided-required-interface=SiWalaActive_0xA00049
      SiWalaExpState_0xA00049: nv-provide-com-spec{ram-block-init-value=0, rom-block-init-value=0, variable=SiWalaExpState_0xA00049/Value}, nv-require-com-spec=init-value=0, provided-required-interface=SiWalaExpState_0xA00049
      SiWalaId_0xA00049: nv-provide-com-spec{ram-block-init-value=0, rom-block-init-value=0, variable=SiWalaId_0xA00049/Value}, nv-require-com-spec=init-value=0, provided-required-interface=SiWalaId_0xA00049
      SlewRate: nv-provide-com-spec{ram-block-init-value=20, rom-block-init-value=20, variable=SlewRate/Value}, nv-require-com-spec=init-value=20, provided-required-interface=SlewRate
      SpeedFastReading_X: nv-provide-com-spec{ram-block-init-value=[0, 50, 100, 150, 190, 1300, 1800, 2534, 2600, 3250], rom-block-init-value=[0, 50, 100, 150, 190, 1300, 1800, 2534, 2600, 3250], variable=SpeedFastReading_X/Value}, nv-require-com-spec=init-value=[0, 50, 100, 150, 190, 1300, 1800, 2534, 2600, 3250], provided-required-interface=SpeedFastReading_X
      SpeedFastReading_Y: nv-provide-com-spec{ram-block-init-value=[0, 51, 103, 154, 195, 1305, 1829, 2600, 2670, 3350], rom-block-init-value=[0, 51, 103, 154, 195, 1305, 1829, 2600, 2670, 3350], variable=SpeedFastReading_Y/Value}, nv-require-com-spec=init-value=[0, 51, 103, 154, 195, 1305, 1829, 2600, 2670, 3350], provided-required-interface=SpeedFastReading_Y
      SpeedThreshold: nv-provide-com-spec{ram-block-init-value=20, rom-block-init-value=20, variable=SpeedThreshold/Value}, nv-require-com-spec=init-value=20, provided-required-interface=SpeedThreshold
      Speedo_Gauge_Hysteresis_Angle: nv-provide-com-spec{ram-block-init-value=0, rom-block-init-value=0, variable=Speedo_Gauge_Hysteresis_Angle/Value}, nv-require-com-spec=init-value=0, provided-required-interface=Speedo_Gauge_Hysteresis_Angle
      Speedo_Gauge_Magnetic_Offset: nv-provide-com-spec{ram-block-init-value=0, rom-block-init-value=0, variable=Speedo_Gauge_Magnetic_Offset/Value}, nv-require-com-spec=init-value=0, provided-required-interface=Speedo_Gauge_Magnetic_Offset
      SupplyVoltage_N1: nv-provide-com-spec{ram-block-init-value=581, rom-block-init-value=581, variable=SupplyVoltage_N1/Value}, nv-require-com-spec=init-value=581, provided-required-interface=SupplyVoltage_N1
      SupplyVoltage_N2: nv-provide-com-spec{ram-block-init-value=1613, rom-block-init-value=1613, variable=SupplyVoltage_N2/Value}, nv-require-com-spec=init-value=1613, provided-required-interface=SupplyVoltage_N2
      SupplyVoltage_V1: nv-provide-com-spec{ram-block-init-value=630, rom-block-init-value=630, variable=SupplyVoltage_V1/Value}, nv-require-com-spec=init-value=630, provided-required-interface=SupplyVoltage_V1
      SupplyVoltage_V2: nv-provide-com-spec{ram-block-init-value=1750, rom-block-init-value=1750, variable=SupplyVoltage_V2/Value}, nv-require-com-spec=init-value=1750, provided-required-interface=SupplyVoltage_V2
      SynchronizationTime_DriversDoor: nv-provide-com-spec{ram-block-init-value=30, rom-block-init-value=30, variable=SynchronizationTime_DriversDoor/Value}, nv-require-com-spec=init-value=30, provided-required-interface=SynchronizationTime_DriversDoor
      TCO_Available: nv-provide-com-spec{ram-block-init-value=0, rom-block-init-value=0, variable=TCO_Available/Value}, nv-require-com-spec=init-value=0, provided-required-interface=TCO_Available
      TFT_RGB_Gain: nv-provide-com-spec{ram-block-init-value=[255, 255, 255], rom-block-init-value=[255, 255, 255], variable=TFT_RGB_Gain/Value}, nv-require-com-spec=init-value=[255, 255, 255], provided-required-interface=TFT_RGB_Gain
      TFT_Safety_Offset: nv-provide-com-spec{ram-block-init-value=21, rom-block-init-value=21, variable=TFT_Safety_Offset/Value}, nv-require-com-spec=init-value=21, provided-required-interface=TFT_Safety_Offset
      TFT_Threshold1: nv-provide-com-spec{ram-block-init-value=233, rom-block-init-value=233, variable=TFT_Threshold1/Value}, nv-require-com-spec=init-value=233, provided-required-interface=TFT_Threshold1
      TFT_Threshold2: nv-provide-com-spec{ram-block-init-value=269, rom-block-init-value=269, variable=TFT_Threshold2/Value}, nv-require-com-spec=init-value=269, provided-required-interface=TFT_Threshold2
      TT_Green_Luminosity_Calibration_PWM: nv-provide-com-spec{ram-block-init-value=10000, rom-block-init-value=10000, variable=TT_Green_Luminosity_Calibration_PWM/Value}, nv-require-com-spec=init-value=10000, provided-required-interface=TT_Green_Luminosity_Calibration_PWM
      TT_Red_Luminosity_Calibration_PWM: nv-provide-com-spec{ram-block-init-value=10000, rom-block-init-value=10000, variable=TT_Red_Luminosity_Calibration_PWM/Value}, nv-require-com-spec=init-value=10000, provided-required-interface=TT_Red_Luminosity_Calibration_PWM
      TT_Yellow_Luminosity_Calibration_PWM: nv-provide-com-spec{ram-block-init-value=10000, rom-block-init-value=10000, variable=TT_Yellow_Luminosity_Calibration_PWM/Value}, nv-require-com-spec=init-value=10000, provided-required-interface=TT_Yellow_Luminosity_Calibration_PWM
      T_Mode_Active: nv-provide-com-spec{ram-block-init-value=0, rom-block-init-value=0, variable=T_Mode_Active/Value}, nv-require-com-spec=init-value=0, provided-required-interface=T_Mode_Active
      Tank_Gauge_Magnetic_Offset: nv-provide-com-spec{ram-block-init-value=0, rom-block-init-value=0, variable=Tank_Gauge_Magnetic_Offset/Value}, nv-require-com-spec=init-value=0, provided-required-interface=Tank_Gauge_Magnetic_Offset
      TaskListEntry{1..5}: nv-provide-com-spec{ram-block-init-value=0, rom-block-init-value=0, variable=TaskListEntry{1..5}/Value}, nv-require-com-spec=init-value=0, provided-required-interface=TaskListEntry{1..5}
      Temp_Threshold_Max_QuartzTemp: nv-provide-com-spec{ram-block-init-value=100, rom-block-init-value=100, variable=Temp_Threshold_Max_QuartzTemp/Value}, nv-require-com-spec=init-value=100, provided-required-interface=Temp_Threshold_Max_QuartzTemp
      Thermal_Timer1: nv-provide-com-spec{ram-block-init-value=1000, rom-block-init-value=1000, variable=Thermal_Timer1/Value}, nv-require-com-spec=init-value=1000, provided-required-interface=Thermal_Timer1
      Thermal_Timer2: nv-provide-com-spec{ram-block-init-value=3500, rom-block-init-value=3500, variable=Thermal_Timer2/Value}, nv-require-com-spec=init-value=3500, provided-required-interface=Thermal_Timer2
      Thermal_Timer3: nv-provide-com-spec{ram-block-init-value=2000, rom-block-init-value=2000, variable=Thermal_Timer3/Value}, nv-require-com-spec=init-value=2000, provided-required-interface=Thermal_Timer3
      TimeConstant: nv-provide-com-spec{ram-block-init-value=40, rom-block-init-value=40, variable=TimeConstant/Value}, nv-require-com-spec=init-value=40, provided-required-interface=TimeConstant
      Time_TimeSource: nv-provide-com-spec{ram-block-init-value=1, rom-block-init-value=1, variable=Time_TimeSource/Value}, nv-require-com-spec=init-value=1, provided-required-interface=Time_TimeSource
      TrGW_Function_Enable: nv-provide-com-spec{ram-block-init-value=1, rom-block-init-value=1, variable=TrGW_Function_Enable/Value}, nv-require-com-spec=init-value=1, provided-required-interface=TrGW_Function_Enable
      TrendTime: nv-provide-com-spec{ram-block-init-value=15, rom-block-init-value=15, variable=TrendTime/Value}, nv-require-com-spec=init-value=15, provided-required-interface=TrendTime
      Trend_Threshold: nv-provide-com-spec{ram-block-init-value=10, rom-block-init-value=10, variable=Trend_Threshold/Value}, nv-require-com-spec=init-value=10, provided-required-interface=Trend_Threshold
      USER_PROFILE0:
        nv-provide-com-spec{ram-block-init-value=[207, 7, 175, 4, 51, 120, 16, 9, 255, 127, 191, 15, 2, 0, 0, 0, 0, 2, 0, 2, 0, 0, 0, 127, 0, 0, 0, 0, 0, 2, 161, 162, 211, 0, 0, 0, 0, 0, 0, 0, 0, 0, 3, 4, 1, 3, 0, 0, 0, 0, 0, 0, 0, 0, 0, 0, 0, 0, 0, 0], rom-block-init-value=[207, 7, 175, 4, 51, 120, 16, 9, 255, 127, 191, 15, 2, 0, 0, 0, 0, 2, 0, 2, 0, 0, 0, 127, 0, 0, 0, 0, 0, 2, 161, 162, 211, 0, 0, 0, 0, 0, 0, 0, 0, 0, 3, 4, 1, 3, 0, 0, 0, 0, 0, 0, 0, 0, 0, 0, 0, 0, 0, 0], variable=USER_PROFILE0/Value}
        nv-require-com-spec=init-value=[207, 7, 175, 4, 51, 120, 16, 9, 255, 127, 191, 15, 2, 0, 0, 0, 0, 2, 0, 2, 0, 0, 0, 127, 0, 0, 0, 0, 0, 2, 161, 162, 211, 0, 0, 0, 0, 0, 0, 0, 0, 0, 3, 4, 1, 3, 0, 0, 0, 0, 0, 0, 0, 0, 0, 0, 0, 0, 0, 0]
        provided-required-interface=USER_PROFILE0
      USER_PROFILE1:
        nv-provide-com-spec{ram-block-init-value=[207, 7, 175, 4, 51, 120, 16, 9, 255, 127, 191, 15, 2, 0, 0, 0, 0, 2, 0, 2, 0, 0, 0, 127, 0, 0, 0, 0, 0, 2, 161, 162, 211, 0, 0, 0, 0, 0, 0, 0, 0, 0, 3, 4, 1, 3, 0, 0, 0, 0, 0, 0, 0, 0, 0, 0, 0, 0, 0, 0], rom-block-init-value=[207, 7, 175, 4, 51, 120, 16, 9, 255, 127, 191, 15, 2, 0, 0, 0, 0, 2, 0, 2, 0, 0, 0, 127, 0, 0, 0, 0, 0, 2, 161, 162, 211, 0, 0, 0, 0, 0, 0, 0, 0, 0, 3, 4, 1, 3, 0, 0, 0, 0, 0, 0, 0, 0, 0, 0, 0, 0, 0, 0], variable=USER_PROFILE1/Value}
        nv-require-com-spec=init-value=[207, 7, 175, 4, 51, 120, 16, 9, 255, 127, 191, 15, 2, 0, 0, 0, 0, 2, 0, 2, 0, 0, 0, 127, 0, 0, 0, 0, 0, 2, 161, 162, 211, 0, 0, 0, 0, 0, 0, 0, 0, 0, 3, 4, 1, 3, 0, 0, 0, 0, 0, 0, 0, 0, 0, 0, 0, 0, 0, 0]
        provided-required-interface=USER_PROFILE1
      USER_PROFILE2:
        nv-provide-com-spec{ram-block-init-value=[207, 7, 175, 4, 51, 120, 16, 9, 255, 127, 191, 15, 2, 0, 0, 0, 0, 2, 0, 2, 0, 0, 0, 127, 0, 0, 0, 0, 0, 2, 161, 162, 211, 0, 0, 0, 0, 0, 0, 0, 0, 0, 3, 4, 1, 3, 0, 0, 0, 0, 0, 0, 0, 0, 0, 0, 0, 0, 0, 0], rom-block-init-value=[207, 7, 175, 4, 51, 120, 16, 9, 255, 127, 191, 15, 2, 0, 0, 0, 0, 2, 0, 2, 0, 0, 0, 127, 0, 0, 0, 0, 0, 2, 161, 162, 211, 0, 0, 0, 0, 0, 0, 0, 0, 0, 3, 4, 1, 3, 0, 0, 0, 0, 0, 0, 0, 0, 0, 0, 0, 0, 0, 0], variable=USER_PROFILE2/Value}
        nv-require-com-spec=init-value=[207, 7, 175, 4, 51, 120, 16, 9, 255, 127, 191, 15, 2, 0, 0, 0, 0, 2, 0, 2, 0, 0, 0, 127, 0, 0, 0, 0, 0, 2, 161, 162, 211, 0, 0, 0, 0, 0, 0, 0, 0, 0, 3, 4, 1, 3, 0, 0, 0, 0, 0, 0, 0, 0, 0, 0, 0, 0, 0, 0]
        provided-required-interface=USER_PROFILE2
      USER_PROFILE3:
        nv-provide-com-spec{ram-block-init-value=[207, 7, 175, 4, 51, 120, 16, 9, 255, 127, 191, 15, 2, 0, 0, 0, 0, 2, 0, 2, 0, 0, 0, 127, 0, 0, 0, 0, 0, 2, 161, 162, 211, 0, 0, 0, 0, 0, 0, 0, 0, 0, 3, 4, 1, 3, 0, 0, 0, 0, 0, 0, 0, 0, 0, 0, 0, 0, 0, 0], rom-block-init-value=[207, 7, 175, 4, 51, 120, 16, 9, 255, 127, 191, 15, 2, 0, 0, 0, 0, 2, 0, 2, 0, 0, 0, 127, 0, 0, 0, 0, 0, 2, 161, 162, 211, 0, 0, 0, 0, 0, 0, 0, 0, 0, 3, 4, 1, 3, 0, 0, 0, 0, 0, 0, 0, 0, 0, 0, 0, 0, 0, 0], variable=USER_PROFILE3/Value}
        nv-require-com-spec=init-value=[207, 7, 175, 4, 51, 120, 16, 9, 255, 127, 191, 15, 2, 0, 0, 0, 0, 2, 0, 2, 0, 0, 0, 127, 0, 0, 0, 0, 0, 2, 161, 162, 211, 0, 0, 0, 0, 0, 0, 0, 0, 0, 3, 4, 1, 3, 0, 0, 0, 0, 0, 0, 0, 0, 0, 0, 0, 0, 0, 0]
        provided-required-interface=USER_PROFILE3
      USER_PROFILE4:
        nv-provide-com-spec{ram-block-init-value=[207, 7, 175, 4, 51, 120, 16, 9, 255, 127, 191, 15, 2, 0, 0, 0, 0, 2, 0, 2, 0, 0, 0, 127, 0, 0, 0, 0, 0, 2, 161, 162, 211, 0, 0, 0, 0, 0, 0, 0, 0, 0, 3, 4, 1, 3, 0, 0, 0, 0, 0, 0, 0, 0, 0, 0, 0, 0, 0, 0], rom-block-init-value=[207, 7, 175, 4, 51, 120, 16, 9, 255, 127, 191, 15, 2, 0, 0, 0, 0, 2, 0, 2, 0, 0, 0, 127, 0, 0, 0, 0, 0, 2, 161, 162, 211, 0, 0, 0, 0, 0, 0, 0, 0, 0, 3, 4, 1, 3, 0, 0, 0, 0, 0, 0, 0, 0, 0, 0, 0, 0, 0, 0], variable=USER_PROFILE4/Value}
        nv-require-com-spec=init-value=[207, 7, 175, 4, 51, 120, 16, 9, 255, 127, 191, 15, 2, 0, 0, 0, 0, 2, 0, 2, 0, 0, 0, 127, 0, 0, 0, 0, 0, 2, 161, 162, 211, 0, 0, 0, 0, 0, 0, 0, 0, 0, 3, 4, 1, 3, 0, 0, 0, 0, 0, 0, 0, 0, 0, 0, 0, 0, 0, 0]
        provided-required-interface=USER_PROFILE4
      USER_PROFILE5:
        nv-provide-com-spec{ram-block-init-value=[207, 7, 175, 4, 51, 120, 16, 9, 255, 127, 191, 15, 2, 0, 0, 0, 0, 2, 0, 2, 0, 0, 0, 127, 0, 0, 0, 0, 0, 2, 161, 162, 211, 0, 0, 0, 0, 0, 0, 0, 0, 0, 3, 4, 1, 3, 0, 0, 0, 0, 0, 0, 0, 0, 0, 0, 0, 0, 0, 0], rom-block-init-value=[207, 7, 175, 4, 51, 120, 16, 9, 255, 127, 191, 15, 2, 0, 0, 0, 0, 2, 0, 2, 0, 0, 0, 127, 0, 0, 0, 0, 0, 2, 161, 162, 211, 0, 0, 0, 0, 0, 0, 0, 0, 0, 3, 4, 1, 3, 0, 0, 0, 0, 0, 0, 0, 0, 0, 0, 0, 0, 0, 0], variable=USER_PROFILE5/Value}
        nv-require-com-spec=init-value=[207, 7, 175, 4, 51, 120, 16, 9, 255, 127, 191, 15, 2, 0, 0, 0, 0, 2, 0, 2, 0, 0, 0, 127, 0, 0, 0, 0, 0, 2, 161, 162, 211, 0, 0, 0, 0, 0, 0, 0, 0, 0, 3, 4, 1, 3, 0, 0, 0, 0, 0, 0, 0, 0, 0, 0, 0, 0, 0, 0]
        provided-required-interface=USER_PROFILE5
      USER_PROFILE6:
        nv-provide-com-spec{ram-block-init-value=[207, 7, 175, 4, 51, 120, 16, 9, 255, 127, 191, 15, 2, 0, 0, 0, 0, 2, 0, 2, 0, 0, 0, 127, 0, 0, 0, 0, 0, 2, 161, 162, 211, 0, 0, 0, 0, 0, 0, 0, 0, 0, 3, 4, 1, 3, 0, 0, 0, 0, 0, 0, 0, 0, 0, 0, 0, 0, 0, 0], rom-block-init-value=[207, 7, 175, 4, 51, 120, 16, 9, 255, 127, 191, 15, 2, 0, 0, 0, 0, 2, 0, 2, 0, 0, 0, 127, 0, 0, 0, 0, 0, 2, 161, 162, 211, 0, 0, 0, 0, 0, 0, 0, 0, 0, 3, 4, 1, 3, 0, 0, 0, 0, 0, 0, 0, 0, 0, 0, 0, 0, 0, 0], variable=USER_PROFILE6/Value}
        nv-require-com-spec=init-value=[207, 7, 175, 4, 51, 120, 16, 9, 255, 127, 191, 15, 2, 0, 0, 0, 0, 2, 0, 2, 0, 0, 0, 127, 0, 0, 0, 0, 0, 2, 161, 162, 211, 0, 0, 0, 0, 0, 0, 0, 0, 0, 3, 4, 1, 3, 0, 0, 0, 0, 0, 0, 0, 0, 0, 0, 0, 0, 0, 0]
        provided-required-interface=USER_PROFILE6
      USER_PROFILE7:
        nv-provide-com-spec{ram-block-init-value=[207, 7, 175, 4, 51, 120, 16, 9, 255, 127, 191, 15, 2, 0, 0, 0, 0, 2, 0, 2, 0, 0, 0, 127, 0, 0, 0, 0, 0, 2, 161, 162, 211, 0, 0, 0, 0, 0, 0, 0, 0, 0, 3, 4, 1, 3, 0, 0, 0, 0, 0, 0, 0, 0, 0, 0, 0, 0, 0, 0], rom-block-init-value=[207, 7, 175, 4, 51, 120, 16, 9, 255, 127, 191, 15, 2, 0, 0, 0, 0, 2, 0, 2, 0, 0, 0, 127, 0, 0, 0, 0, 0, 2, 161, 162, 211, 0, 0, 0, 0, 0, 0, 0, 0, 0, 3, 4, 1, 3, 0, 0, 0, 0, 0, 0, 0, 0, 0, 0, 0, 0, 0, 0], variable=USER_PROFILE7/Value}
        nv-require-com-spec=init-value=[207, 7, 175, 4, 51, 120, 16, 9, 255, 127, 191, 15, 2, 0, 0, 0, 0, 2, 0, 2, 0, 0, 0, 127, 0, 0, 0, 0, 0, 2, 161, 162, 211, 0, 0, 0, 0, 0, 0, 0, 0, 0, 3, 4, 1, 3, 0, 0, 0, 0, 0, 0, 0, 0, 0, 0, 0, 0, 0, 0]
        provided-required-interface=USER_PROFILE7
      UnintendedMovement: nv-provide-com-spec{ram-block-init-value=1, rom-block-init-value=1, variable=UnintendedMovement/Value}, nv-require-com-spec=init-value=1, provided-required-interface=UnintendedMovement
      Unit_KWh_per_mile_available: nv-provide-com-spec{ram-block-init-value=1, rom-block-init-value=1, variable=Unit_KWh_per_mile_available/Value}, nv-require-com-spec=init-value=1, provided-required-interface=Unit_KWh_per_mile_available
      Unit_SpeedoScale: nv-provide-com-spec{ram-block-init-value=0, rom-block-init-value=0, variable=Unit_SpeedoScale/Value}, nv-require-com-spec=init-value=0, provided-required-interface=Unit_SpeedoScale
      Unit_mpge_us_available: nv-provide-com-spec{ram-block-init-value=1, rom-block-init-value=1, variable=Unit_mpge_us_available/Value}, nv-require-com-spec=init-value=1, provided-required-interface=Unit_mpge_us_available
      VCOM_Adjustment: nv-provide-com-spec{ram-block-init-value=105, rom-block-init-value=105, variable=VCOM_Adjustment/Value}, nv-require-com-spec=init-value=105, provided-required-interface=VCOM_Adjustment
      VKMS_InitalKey_IS: nv-provide-com-spec{ram-block-init-value=32 x 255, rom-block-init-value=32 x 255, variable=VKMS_InitalKey_IS/Value}, nv-require-com-spec=init-value=32 x 255, provided-required-interface=VKMS_InitalKey_IS
      VKM_Range_Distance_Unclass: nv-provide-com-spec{ram-block-init-value=100, rom-block-init-value=100, variable=VKM_Range_Distance_Unclass/Value}, nv-require-com-spec=init-value=100, provided-required-interface=VKM_Range_Distance_Unclass
