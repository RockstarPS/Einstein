[part 4 of 4: packages /ComponentTypes to /ARRoot/Types]
AUTOSAR XML (schema 4-2-1)
package /ComponentTypes  (continued)
  nv block sw component type NvBlockSwComponentType  (continued)
    94 x nv block descriptor, all with support-dirty-flag=true:  (continued)
      NVBlockDescriptor_SAFETY_RECORD_VAR: client-server-ports=role-based-port-assignment={port-prototype=SAFETY_RECORD_VAR_NvM_JobFinished, role=SAFETY_RECORD_VAR_NvM_JobFinished}
        nv-block-data-mappings:
          nv-ram-block-element=autosar-variable-in-impl-datatype=AbsErrorPath, written-read-nv-data=AbsErrorPath.Value
          nv-ram-block-element=autosar-variable-in-impl-datatype=AirbagErrorPath, written-read-nv-data=AirbagErrorPath.Value
          nv-ram-block-element=autosar-variable-in-impl-datatype=CwlErrorPath, written-read-nv-data=CwlErrorPath.Value
          nv-ram-block-element=autosar-variable-in-impl-datatype=EpbErrorPath, written-read-nv-data=EpbErrorPath.Value
          nv-ram-block-element=autosar-variable-in-impl-datatype=EspErrorPath, written-read-nv-data=EspErrorPath.Value
          nv-ram-block-element=autosar-variable-in-impl-datatype=GeneralBrakeErrorPath, written-read-nv-data=GeneralBrakeErrorPath.Value
          nv-ram-block-element=autosar-variable-in-impl-datatype=LeftIndicatorErrorPath, written-read-nv-data=LeftIndicatorErrorPath.Value
          nv-ram-block-element=autosar-variable-in-impl-datatype=RightIndicatorErrorPath, written-read-nv-data=RightIndicatorErrorPath.Value
          nv-ram-block-element=autosar-variable-in-impl-datatype=AbsErrorCounter, written-read-nv-data=AbsErrorCounter.Value
          nv-ram-block-element=autosar-variable-in-impl-datatype=AirbagErrorCounter, written-read-nv-data=AirbagErrorCounter.Value
          nv-ram-block-element=autosar-variable-in-impl-datatype=CwlErrorCounter, written-read-nv-data=CwlErrorCounter.Value
          nv-ram-block-element=autosar-variable-in-impl-datatype=EpbErrorCounter, written-read-nv-data=EpbErrorCounter.Value
          nv-ram-block-element=autosar-variable-in-impl-datatype=EspErrorCounter, written-read-nv-data=EspErrorCounter.Value
          nv-ram-block-element=autosar-variable-in-impl-datatype=GeneralBrakeErrorCounter, written-read-nv-data=GeneralBrakeErrorCounter.Value
          nv-ram-block-element=autosar-variable-in-impl-datatype=LeftIndicatorErrorCounter, written-read-nv-data=LeftIndicatorErrorCounter.Value
          nv-ram-block-element=autosar-variable-in-impl-datatype=RightIndicatorErrorCounter, written-read-nv-data=RightIndicatorErrorCounter.Value
          nv-ram-block-element=autosar-variable-in-impl-datatype=zReserved_SAFETY_RECORD_VAR, written-read-nv-data=zReserved_SAFETY_RECORD_VAR.Value
        nv block needs NVNeed_NVBlockDescriptor: n-data-sets=2, ram-block-status-control=API, reliability=NO-PROTECTION, restore-at-start=true, store-at-shutdown=false, store-immediate=true, write-verification=false
        ram block RAM_NVBlockDescriptor_SAFETY_RECORD_VAR: type=NV_Data_SAFETY_RECORD_VAR, init-value=fields=[AbsErrorPath:0, AirbagErrorPath:0, CwlErrorPath:0, EpbErrorPath:0, EspErrorPath:0, GeneralBrakeErrorPath:0, LeftIndicatorErrorPath:0, RightIndicatorErrorPath:0, AbsErrorCounter:0, AirbagErrorCounter:0, CwlErrorCounter:0, EpbErrorCounter:0, EspErrorCounter:0, GeneralBrakeErrorCounter:0, LeftIndicatorErrorCounter:0, RightIndicatorErrorCounter:0, zReserved_SAFETY_RECORD_VAR:[255, 255, 255, 255]]
        rom block ROM_NVBlockDescriptor_SAFETY_RECORD_VAR:
          sw-calibration-access=READ-WRITE
          type=NV_Data_SAFETY_RECORD_VAR
          init-value=fields=[AbsErrorPath:0, AirbagErrorPath:0, CwlErrorPath:0, EpbErrorPath:0, EspErrorPath:0, GeneralBrakeErrorPath:0, LeftIndicatorErrorPath:0, RightIndicatorErrorPath:0, AbsErrorCounter:0, AirbagErrorCounter:0, CwlErrorCounter:0, EpbErrorCounter:0, EspErrorCounter:0, GeneralBrakeErrorCounter:0, LeftIndicatorErrorCounter:0, RightIndicatorErrorCounter:0, zReserved_SAFETY_RECORD_VAR:[255, 255, 255, 255]]
      NVBlockDescriptor_SRV_TKM_ZvCrH_TKM_ZvCrHPimTkKeyInCarNeed: client-server-ports=role-based-port-assignment={port-prototype=SRV_TKM_ZvCrH_TKM_ZvCrHPimTkKeyInCarNeed_NvM_JobFinished, role=SRV_TKM_ZvCrH_TKM_ZvCrHPimTkKeyInCarNeed_NvM_JobFinished}, nv-block-data-mapping{nv-ram-block-element=autosar-variable-in-impl-datatype=SRV_TKM_ZvCrH_TKM_ZvCrHPimTkKeyInCarNeed, written-read-nv-data=SRV_TKM_ZvCrH_TKM_ZvCrHPimTkKeyInCarNeed.Value}
        nv block needs NVNeed_NVBlockDescriptor: n-data-sets=2, ram-block-status-control=API, reliability=NO-PROTECTION, restore-at-start=true, store-at-shutdown=false, store-immediate=true, write-verification=false
        ram block RAM_NVBlockDescriptor_SRV_TKM_ZvCrH_TKM_ZvCrHPimTkKeyInCarNeed: type=NV_Data_SRV_TKM_ZvCrH_TKM_ZvCrHPimTkKeyInCarNeed, init-value=fields=SRV_TKM_ZvCrH_TKM_ZvCrHPimTkKeyInCarNeed:16 x 255
        rom block ROM_NVBlockDescriptor_SRV_TKM_ZvCrH_TKM_ZvCrHPimTkKeyInCarNeed: sw-calibration-access=READ-WRITE, type=NV_Data_SRV_TKM_ZvCrH_TKM_ZvCrHPimTkKeyInCarNeed, init-value=fields=SRV_TKM_ZvCrH_TKM_ZvCrHPimTkKeyInCarNeed:16 x 255
      NVBlockDescriptor_SecDiag: client-server-ports=role-based-port-assignment={port-prototype=SecDiag_NvM_JobFinished, role=SecDiag_NvM_JobFinished}
        nv-block-data-mappings:
          nv-ram-block-element=autosar-variable-in-impl-datatype=Manufacturing_PublicKey, written-read-nv-data=Manufacturing_PublicKey.Value
          nv-ram-block-element=autosar-variable-in-impl-datatype=Manufacturing_SID, written-read-nv-data=Manufacturing_SID.Value
          nv-ram-block-element=autosar-variable-in-impl-datatype=SFD_Project_ID, written-read-nv-data=SFD_Project_ID.Value
          nv-ram-block-element=autosar-variable-in-impl-datatype=SFD_Group_Attribute, written-read-nv-data=SFD_Group_Attribute.Value
          nv-ram-block-element=autosar-variable-in-impl-datatype=VKMS_InitalKey_IS, written-read-nv-data=VKMS_InitalKey_IS.Value
          nv-ram-block-element=autosar-variable-in-impl-datatype=zReserved_SecDiag, written-read-nv-data=zReserved_SecDiag.Value
        nv block needs NVNeed_NVBlockDescriptor: n-data-sets=2, ram-block-status-control=API, reliability=NO-PROTECTION, restore-at-start=true, store-at-shutdown=false, store-immediate=true, write-verification=false
        ram block RAM_NVBlockDescriptor_SecDiag: type=NV_Data_SecDiag, init-value=fields=[Manufacturing_PublicKey:[120, 246, 45, 214, 163, 103, 90, 74, 236, 136, 192, 27, 70, 132, 175, 37, 223, 89, 189, 187, 201, 85, 212, 53, 8, 163, 78, 193, 193, 80, 122, 146], Manufacturing_SID:32 x 255, SFD_Project_ID:342, SFD_Group_Attribute:[86, 52, 50, 48, 48, 50, 50, 49, 48, 55, 50, 54, 53, 78, 65, 46, 57, 50, 48, 46, 51, 49, 48], 32 x 255, zReserved_SecDiag:27 x 255]
        rom block ROM_NVBlockDescriptor_SecDiag:
          sw-calibration-access=READ-WRITE
          type=NV_Data_SecDiag
          init-value=fields=[Manufacturing_PublicKey:[120, 246, 45, 214, 163, 103, 90, 74, 236, 136, 192, 27, 70, 132, 175, 37, 223, 89, 189, 187, 201, 85, 212, 53, 8, 163, 78, 193, 193, 80, 122, 146], Manufacturing_SID:32 x 255, SFD_Project_ID:342, SFD_Group_Attribute:[86, 52, 50, 48, 48, 50, 50, 49, 48, 55, 50, 54, 53, 78, 65, 46, 57, 50, 48, 46, 51, 49, 48], 32 x 255, zReserved_SecDiag:27 x 255]
      NVBlockDescriptor_ServiceKey_VAR: client-server-ports=role-based-port-assignment={port-prototype=ServiceKey_VAR_NvM_JobFinished, role=ServiceKey_VAR_NvM_JobFinished}
        nv-block-data-mappings:
          nv-ram-block-element=autosar-variable-in-impl-datatype=ServiceKey_Counter_Key_ID_Kessy, written-read-nv-data=ServiceKey_Counter_Key_ID_Kessy.Value
          nv-ram-block-element=autosar-variable-in-impl-datatype=ServiceKey_Counter_Key_ID{1..8}, written-read-nv-data=ServiceKey_Counter_Key_ID{1..8}.Value
          nv-ram-block-element=autosar-variable-in-impl-datatype=SKey_Error_Counter, written-read-nv-data=SKey_Error_Counter.Value
          nv-ram-block-element=autosar-variable-in-impl-datatype=zReserved_ServiceKey_VAR, written-read-nv-data=zReserved_ServiceKey_VAR.Value
        nv block needs NVNeed_NVBlockDescriptor: n-data-sets=2, ram-block-status-control=API, reliability=NO-PROTECTION, restore-at-start=true, store-at-shutdown=false, store-immediate=true, write-verification=false
        ram block RAM_NVBlockDescriptor_ServiceKey_VAR: type=NV_Data_ServiceKey_VAR, init-value=fields=[ServiceKey_Counter_Key_ID_Kessy:0, ServiceKey_Counter_Key_ID1:0, ServiceKey_Counter_Key_ID2:0, ServiceKey_Counter_Key_ID3:0, ServiceKey_Counter_Key_ID4:0, ServiceKey_Counter_Key_ID5:0, ServiceKey_Counter_Key_ID6:0, ServiceKey_Counter_Key_ID7:0, ServiceKey_Counter_Key_ID8:0, SKey_Error_Counter:0, zReserved_ServiceKey_VAR:8 x 255]
        rom block ROM_NVBlockDescriptor_ServiceKey_VAR:
          sw-calibration-access=READ-WRITE
          type=NV_Data_ServiceKey_VAR
          init-value=fields=[ServiceKey_Counter_Key_ID_Kessy:0, ServiceKey_Counter_Key_ID1:0, ServiceKey_Counter_Key_ID2:0, ServiceKey_Counter_Key_ID3:0, ServiceKey_Counter_Key_ID4:0, ServiceKey_Counter_Key_ID5:0, ServiceKey_Counter_Key_ID6:0, ServiceKey_Counter_Key_ID7:0, ServiceKey_Counter_Key_ID8:0, SKey_Error_Counter:0, zReserved_ServiceKey_VAR:8 x 255]
      NVBlockDescriptor_Service_History_Data: client-server-ports=role-based-port-assignment={port-prototype=Service_History_Data_NvM_JobFinished, role=Service_History_Data_NvM_JobFinished}, nv-block-data-mapping{nv-ram-block-element=autosar-variable-in-impl-datatype=Service_History, written-read-nv-data=Service_History.Value}
        nv block needs NVNeed_NVBlockDescriptor: n-data-sets=2, ram-block-status-control=API, reliability=NO-PROTECTION, restore-at-start=true, store-at-shutdown=false, store-immediate=true, write-verification=false
        ram block RAM_NVBlockDescriptor_Service_History_Data: type=NV_Data_Service_History_Data, init-value=fields=Service_History:64 x 4294967295
        rom block ROM_NVBlockDescriptor_Service_History_Data: sw-calibration-access=READ-WRITE, type=NV_Data_Service_History_Data, init-value=fields=Service_History:64 x 4294967295
      NVBlockDescriptor_TANK_Variant_CONST: client-server-ports=role-based-port-assignment={port-prototype=TANK_Variant_CONST_NvM_JobFinished, role=TANK_Variant_CONST_NvM_JobFinished}
        nv-block-data-mappings:
          nv-ram-block-element=autosar-variable-in-impl-datatype=rw_calc_time, written-read-nv-data=rw_calc_time.Value
          nv-ram-block-element=autosar-variable-in-impl-datatype=Fuel_Calib_Dry_Max, written-read-nv-data=Fuel_Calib_Dry_Max.Value
          nv-ram-block-element=autosar-variable-in-impl-datatype=Fuel_Calib_DryCalibration, written-read-nv-data=Fuel_Calib_DryCalibration.Value
          nv-ram-block-element=autosar-variable-in-impl-datatype=Fuel_Calib_Full_Max, written-read-nv-data=Fuel_Calib_Full_Max.Value
          nv-ram-block-element=autosar-variable-in-impl-datatype=Fuel_Calib_FullCalibration, written-read-nv-data=Fuel_Calib_FullCalibration.Value
          nv-ram-block-element=autosar-variable-in-impl-datatype=zReserved_2_TANK_Variant_CONST, written-read-nv-data=zReserved_2_TANK_Variant_CONST.Value
          nv-ram-block-element=autosar-variable-in-impl-datatype=Fuel_Calib_Wet_Max, written-read-nv-data=Fuel_Calib_Wet_Max.Value
          nv-ram-block-element=autosar-variable-in-impl-datatype=Fuel_Calib_WetCalibration, written-read-nv-data=Fuel_Calib_WetCalibration.Value
          nv-ram-block-element=autosar-variable-in-impl-datatype=zReserved_3_TANK_Variant_CONST, written-read-nv-data=zReserved_3_TANK_Variant_CONST.Value
        nv block needs NVNeed_NVBlockDescriptor: n-data-sets=2, ram-block-status-control=API, reliability=NO-PROTECTION, restore-at-start=true, store-at-shutdown=false, store-immediate=true, write-verification=false
        ram block RAM_NVBlockDescriptor_TANK_Variant_CONST: type=NV_Data_TANK_Variant_CONST, init-value=fields=[rw_calc_time:1, Fuel_Calib_Dry_Max:32, Fuel_Calib_DryCalibration:0, Fuel_Calib_Full_Max:16, Fuel_Calib_FullCalibration:1, zReserved_2_TANK_Variant_CONST:255, Fuel_Calib_Wet_Max:32, Fuel_Calib_WetCalibration:1, zReserved_3_TANK_Variant_CONST:10 x 255]
        rom block ROM_NVBlockDescriptor_TANK_Variant_CONST: sw-calibration-access=READ-WRITE, type=NV_Data_TANK_Variant_CONST, init-value=fields=[rw_calc_time:1, Fuel_Calib_Dry_Max:32, Fuel_Calib_DryCalibration:0, Fuel_Calib_Full_Max:16, Fuel_Calib_FullCalibration:1, zReserved_2_TANK_Variant_CONST:255, Fuel_Calib_Wet_Max:32, Fuel_Calib_WetCalibration:1, zReserved_3_TANK_Variant_CONST:10 x 255]
      NVBlockDescriptor_USER_PROFILE0: client-server-ports=role-based-port-assignment={port-prototype=USER_PROFILE0_NvM_JobFinished, role=USER_PROFILE0_NvM_JobFinished}, nv-block-data-mapping{nv-ram-block-element=autosar-variable-in-impl-datatype=USER_PROFILE0, written-read-nv-data=USER_PROFILE0.Value}
        nv block needs NVNeed_NVBlockDescriptor: n-data-sets=2, ram-block-status-control=API, reliability=NO-PROTECTION, restore-at-start=true, store-at-shutdown=false, store-immediate=true, write-verification=false
        ram block RAM_NVBlockDescriptor_USER_PROFILE0: type=NV_Data_USER_PROFILE0, init-value=fields=USER_PROFILE0:[207, 7, 175, 4, 51, 120, 16, 9, 255, 127, 191, 15, 2, 0, 0, 0, 0, 2, 0, 2, 0, 0, 0, 127, 0, 0, 0, 0, 0, 2, 161, 162, 211, 0, 0, 0, 0, 0, 0, 0, 0, 0, 3, 4, 1, 3, 0, 0, 0, 0, 0, 0, 0, 0, 0, 0, 0, 0, 0, 0]
        rom block ROM_NVBlockDescriptor_USER_PROFILE0: sw-calibration-access=READ-WRITE, type=NV_Data_USER_PROFILE0, init-value=fields=USER_PROFILE0:[207, 7, 175, 4, 51, 120, 16, 9, 255, 127, 191, 15, 2, 0, 0, 0, 0, 2, 0, 2, 0, 0, 0, 127, 0, 0, 0, 0, 0, 2, 161, 162, 211, 0, 0, 0, 0, 0, 0, 0, 0, 0, 3, 4, 1, 3, 0, 0, 0, 0, 0, 0, 0, 0, 0, 0, 0, 0, 0, 0]
      NVBlockDescriptor_USER_PROFILE1: client-server-ports=role-based-port-assignment={port-prototype=USER_PROFILE1_NvM_JobFinished, role=USER_PROFILE1_NvM_JobFinished}, nv-block-data-mapping{nv-ram-block-element=autosar-variable-in-impl-datatype=USER_PROFILE1, written-read-nv-data=USER_PROFILE1.Value}
        nv block needs NVNeed_NVBlockDescriptor: n-data-sets=2, ram-block-status-control=API, reliability=NO-PROTECTION, restore-at-start=true, store-at-shutdown=false, store-immediate=true, write-verification=false
        ram block RAM_NVBlockDescriptor_USER_PROFILE1: type=NV_Data_USER_PROFILE1, init-value=fields=USER_PROFILE1:[207, 7, 175, 4, 51, 120, 16, 9, 255, 127, 191, 15, 2, 0, 0, 0, 0, 2, 0, 2, 0, 0, 0, 127, 0, 0, 0, 0, 0, 2, 161, 162, 211, 0, 0, 0, 0, 0, 0, 0, 0, 0, 3, 4, 1, 3, 0, 0, 0, 0, 0, 0, 0, 0, 0, 0, 0, 0, 0, 0]
        rom block ROM_NVBlockDescriptor_USER_PROFILE1: sw-calibration-access=READ-WRITE, type=NV_Data_USER_PROFILE1, init-value=fields=USER_PROFILE1:[207, 7, 175, 4, 51, 120, 16, 9, 255, 127, 191, 15, 2, 0, 0, 0, 0, 2, 0, 2, 0, 0, 0, 127, 0, 0, 0, 0, 0, 2, 161, 162, 211, 0, 0, 0, 0, 0, 0, 0, 0, 0, 3, 4, 1, 3, 0, 0, 0, 0, 0, 0, 0, 0, 0, 0, 0, 0, 0, 0]
      NVBlockDescriptor_USER_PROFILE2: client-server-ports=role-based-port-assignment={port-prototype=USER_PROFILE2_NvM_JobFinished, role=USER_PROFILE2_NvM_JobFinished}, nv-block-data-mapping{nv-ram-block-element=autosar-variable-in-impl-datatype=USER_PROFILE2, written-read-nv-data=USER_PROFILE2.Value}
        nv block needs NVNeed_NVBlockDescriptor: n-data-sets=2, ram-block-status-control=API, reliability=NO-PROTECTION, restore-at-start=true, store-at-shutdown=false, store-immediate=true, write-verification=false
        ram block RAM_NVBlockDescriptor_USER_PROFILE2: type=NV_Data_USER_PROFILE2, init-value=fields=USER_PROFILE2:[207, 7, 175, 4, 51, 120, 16, 9, 255, 127, 191, 15, 2, 0, 0, 0, 0, 2, 0, 2, 0, 0, 0, 127, 0, 0, 0, 0, 0, 2, 161, 162, 211, 0, 0, 0, 0, 0, 0, 0, 0, 0, 3, 4, 1, 3, 0, 0, 0, 0, 0, 0, 0, 0, 0, 0, 0, 0, 0, 0]
        rom block ROM_NVBlockDescriptor_USER_PROFILE2: sw-calibration-access=READ-WRITE, type=NV_Data_USER_PROFILE2, init-value=fields=USER_PROFILE2:[207, 7, 175, 4, 51, 120, 16, 9, 255, 127, 191, 15, 2, 0, 0, 0, 0, 2, 0, 2, 0, 0, 0, 127, 0, 0, 0, 0, 0, 2, 161, 162, 211, 0, 0, 0, 0, 0, 0, 0, 0, 0, 3, 4, 1, 3, 0, 0, 0, 0, 0, 0, 0, 0, 0, 0, 0, 0, 0, 0]
      NVBlockDescriptor_USER_PROFILE3: client-server-ports=role-based-port-assignment={port-prototype=USER_PROFILE3_NvM_JobFinished, role=USER_PROFILE3_NvM_JobFinished}, nv-block-data-mapping{nv-ram-block-element=autosar-variable-in-impl-datatype=USER_PROFILE3, written-read-nv-data=USER_PROFILE3.Value}
        nv block needs NVNeed_NVBlockDescriptor: n-data-sets=2, ram-block-status-control=API, reliability=NO-PROTECTION, restore-at-start=true, store-at-shutdown=false, store-immediate=true, write-verification=false
        ram block RAM_NVBlockDescriptor_USER_PROFILE3: type=NV_Data_USER_PROFILE3, init-value=fields=USER_PROFILE3:[207, 7, 175, 4, 51, 120, 16, 9, 255, 127, 191, 15, 2, 0, 0, 0, 0, 2, 0, 2, 0, 0, 0, 127, 0, 0, 0, 0, 0, 2, 161, 162, 211, 0, 0, 0, 0, 0, 0, 0, 0, 0, 3, 4, 1, 3, 0, 0, 0, 0, 0, 0, 0, 0, 0, 0, 0, 0, 0, 0]
        rom block ROM_NVBlockDescriptor_USER_PROFILE3: sw-calibration-access=READ-WRITE, type=NV_Data_USER_PROFILE3, init-value=fields=USER_PROFILE3:[207, 7, 175, 4, 51, 120, 16, 9, 255, 127, 191, 15, 2, 0, 0, 0, 0, 2, 0, 2, 0, 0, 0, 127, 0, 0, 0, 0, 0, 2, 161, 162, 211, 0, 0, 0, 0, 0, 0, 0, 0, 0, 3, 4, 1, 3, 0, 0, 0, 0, 0, 0, 0, 0, 0, 0, 0, 0, 0, 0]
      NVBlockDescriptor_USER_PROFILE4: client-server-ports=role-based-port-assignment={port-prototype=USER_PROFILE4_NvM_JobFinished, role=USER_PROFILE4_NvM_JobFinished}, nv-block-data-mapping{nv-ram-block-element=autosar-variable-in-impl-datatype=USER_PROFILE4, written-read-nv-data=USER_PROFILE4.Value}
        nv block needs NVNeed_NVBlockDescriptor: n-data-sets=2, ram-block-status-control=API, reliability=NO-PROTECTION, restore-at-start=true, store-at-shutdown=false, store-immediate=true, write-verification=false
        ram block RAM_NVBlockDescriptor_USER_PROFILE4: type=NV_Data_USER_PROFILE4, init-value=fields=USER_PROFILE4:[207, 7, 175, 4, 51, 120, 16, 9, 255, 127, 191, 15, 2, 0, 0, 0, 0, 2, 0, 2, 0, 0, 0, 127, 0, 0, 0, 0, 0, 2, 161, 162, 211, 0, 0, 0, 0, 0, 0, 0, 0, 0, 3, 4, 1, 3, 0, 0, 0, 0, 0, 0, 0, 0, 0, 0, 0, 0, 0, 0]
        rom block ROM_NVBlockDescriptor_USER_PROFILE4: sw-calibration-access=READ-WRITE, type=NV_Data_USER_PROFILE4, init-value=fields=USER_PROFILE4:[207, 7, 175, 4, 51, 120, 16, 9, 255, 127, 191, 15, 2, 0, 0, 0, 0, 2, 0, 2, 0, 0, 0, 127, 0, 0, 0, 0, 0, 2, 161, 162, 211, 0, 0, 0, 0, 0, 0, 0, 0, 0, 3, 4, 1, 3, 0, 0, 0, 0, 0, 0, 0, 0, 0, 0, 0, 0, 0, 0]
      NVBlockDescriptor_USER_PROFILE5: client-server-ports=role-based-port-assignment={port-prototype=USER_PROFILE5_NvM_JobFinished, role=USER_PROFILE5_NvM_JobFinished}, nv-block-data-mapping{nv-ram-block-element=autosar-variable-in-impl-datatype=USER_PROFILE5, written-read-nv-data=USER_PROFILE5.Value}
        nv block needs NVNeed_NVBlockDescriptor: n-data-sets=2, ram-block-status-control=API, reliability=NO-PROTECTION, restore-at-start=true, store-at-shutdown=false, store-immediate=true, write-verification=false
        ram block RAM_NVBlockDescriptor_USER_PROFILE5: type=NV_Data_USER_PROFILE5, init-value=fields=USER_PROFILE5:[207, 7, 175, 4, 51, 120, 16, 9, 255, 127, 191, 15, 2, 0, 0, 0, 0, 2, 0, 2, 0, 0, 0, 127, 0, 0, 0, 0, 0, 2, 161, 162, 211, 0, 0, 0, 0, 0, 0, 0, 0, 0, 3, 4, 1, 3, 0, 0, 0, 0, 0, 0, 0, 0, 0, 0, 0, 0, 0, 0]
        rom block ROM_NVBlockDescriptor_USER_PROFILE5: sw-calibration-access=READ-WRITE, type=NV_Data_USER_PROFILE5, init-value=fields=USER_PROFILE5:[207, 7, 175, 4, 51, 120, 16, 9, 255, 127, 191, 15, 2, 0, 0, 0, 0, 2, 0, 2, 0, 0, 0, 127, 0, 0, 0, 0, 0, 2, 161, 162, 211, 0, 0, 0, 0, 0, 0, 0, 0, 0, 3, 4, 1, 3, 0, 0, 0, 0, 0, 0, 0, 0, 0, 0, 0, 0, 0, 0]
      NVBlockDescriptor_USER_PROFILE6: client-server-ports=role-based-port-assignment={port-prototype=USER_PROFILE6_NvM_JobFinished, role=USER_PROFILE6_NvM_JobFinished}, nv-block-data-mapping{nv-ram-block-element=autosar-variable-in-impl-datatype=USER_PROFILE6, written-read-nv-data=USER_PROFILE6.Value}
        nv block needs NVNeed_NVBlockDescriptor: n-data-sets=2, ram-block-status-control=API, reliability=NO-PROTECTION, restore-at-start=true, store-at-shutdown=false, store-immediate=true, write-verification=false
        ram block RAM_NVBlockDescriptor_USER_PROFILE6: type=NV_Data_USER_PROFILE6, init-value=fields=USER_PROFILE6:[207, 7, 175, 4, 51, 120, 16, 9, 255, 127, 191, 15, 2, 0, 0, 0, 0, 2, 0, 2, 0, 0, 0, 127, 0, 0, 0, 0, 0, 2, 161, 162, 211, 0, 0, 0, 0, 0, 0, 0, 0, 0, 3, 4, 1, 3, 0, 0, 0, 0, 0, 0, 0, 0, 0, 0, 0, 0, 0, 0]
        rom block ROM_NVBlockDescriptor_USER_PROFILE6: sw-calibration-access=READ-WRITE, type=NV_Data_USER_PROFILE6, init-value=fields=USER_PROFILE6:[207, 7, 175, 4, 51, 120, 16, 9, 255, 127, 191, 15, 2, 0, 0, 0, 0, 2, 0, 2, 0, 0, 0, 127, 0, 0, 0, 0, 0, 2, 161, 162, 211, 0, 0, 0, 0, 0, 0, 0, 0, 0, 3, 4, 1, 3, 0, 0, 0, 0, 0, 0, 0, 0, 0, 0, 0, 0, 0, 0]
      NVBlockDescriptor_USER_PROFILE7: client-server-ports=role-based-port-assignment={port-prototype=USER_PROFILE7_NvM_JobFinished, role=USER_PROFILE7_NvM_JobFinished}, nv-block-data-mapping{nv-ram-block-element=autosar-variable-in-impl-datatype=USER_PROFILE7, written-read-nv-data=USER_PROFILE7.Value}
        nv block needs NVNeed_NVBlockDescriptor: n-data-sets=2, ram-block-status-control=API, reliability=NO-PROTECTION, restore-at-start=true, store-at-shutdown=false, store-immediate=true, write-verification=false
        ram block RAM_NVBlockDescriptor_USER_PROFILE7: type=NV_Data_USER_PROFILE7, init-value=fields=USER_PROFILE7:[207, 7, 175, 4, 51, 120, 16, 9, 255, 127, 191, 15, 2, 0, 0, 0, 0, 2, 0, 2, 0, 0, 0, 127, 0, 0, 0, 0, 0, 2, 161, 162, 211, 0, 0, 0, 0, 0, 0, 0, 0, 0, 3, 4, 1, 3, 0, 0, 0, 0, 0, 0, 0, 0, 0, 0, 0, 0, 0, 0]
        rom block ROM_NVBlockDescriptor_USER_PROFILE7: sw-calibration-access=READ-WRITE, type=NV_Data_USER_PROFILE7, init-value=fields=USER_PROFILE7:[207, 7, 175, 4, 51, 120, 16, 9, 255, 127, 191, 15, 2, 0, 0, 0, 0, 2, 0, 2, 0, 0, 0, 127, 0, 0, 0, 0, 0, 2, 161, 162, 211, 0, 0, 0, 0, 0, 0, 0, 0, 0, 3, 4, 1, 3, 0, 0, 0, 0, 0, 0, 0, 0, 0, 0, 0, 0, 0, 0]
      NVBlockDescriptor_WLTP_Odo_VAR: client-server-ports=role-based-port-assignment={port-prototype=WLTP_Odo_VAR_NvM_JobFinished, role=WLTP_Odo_VAR_NvM_JobFinished}
        nv-block-data-mappings:
          nv-ram-block-element=autosar-variable-in-impl-datatype=dm_Esc_distance_pulse, written-read-nv-data=dm_Esc_distance_pulse.Value
          nv-ram-block-element=autosar-variable-in-impl-datatype=dm_Number_of_jumps_distance_pulse, written-read-nv-data=dm_Number_of_jumps_distance_pulse.Value
          nv-ram-block-element=autosar-variable-in-impl-datatype=dm_Biggest_negative_jump_distance_pulse, written-read-nv-data=dm_Biggest_negative_jump_distance_pulse.Value
          nv-ram-block-element=autosar-variable-in-impl-datatype=dm_Biggest_positive_jump_distance_pulse, written-read-nv-data=dm_Biggest_positive_jump_distance_pulse.Value
          nv-ram-block-element=autosar-variable-in-impl-datatype=dm_Sum_jumps_distance_pulse, written-read-nv-data=dm_Sum_jumps_distance_pulse.Value
          nv-ram-block-element=autosar-variable-in-impl-datatype=dm_Balance_sheet_jumps_distance_pulse, written-read-nv-data=dm_Balance_sheet_jumps_distance_pulse.Value
          nv-ram-block-element=autosar-variable-in-impl-datatype=dm_Number_of_communication_failures_ESC, written-read-nv-data=dm_Number_of_communication_failures_ESC.Value
          nv-ram-block-element=autosar-variable-in-impl-datatype=dm_Total_duration_communication_failures_ESC, written-read-nv-data=dm_Total_duration_communication_failures_ESC.Value
          nv-ram-block-element=autosar-variable-in-impl-datatype=dm_Longest_communication_failures_ESC, written-read-nv-data=dm_Longest_communication_failures_ESC.Value
          nv-ram-block-element=autosar-variable-in-impl-datatype=dm_error_secure_storage_AR, written-read-nv-data=dm_error_secure_storage_AR.Value
          nv-ram-block-element=autosar-variable-in-impl-datatype=dm_TimeStampYear, written-read-nv-data=dm_TimeStampYear.Value
          nv-ram-block-element=autosar-variable-in-impl-datatype=dm_TimeStampMonth, written-read-nv-data=dm_TimeStampMonth.Value
          nv-ram-block-element=autosar-variable-in-impl-datatype=dm_TimeStampDay, written-read-nv-data=dm_TimeStampDay.Value
          nv-ram-block-element=autosar-variable-in-impl-datatype=dm_TimeStampHour, written-read-nv-data=dm_TimeStampHour.Value
          nv-ram-block-element=autosar-variable-in-impl-datatype=dm_TimeStampMinute, written-read-nv-data=dm_TimeStampMinute.Value
          nv-ram-block-element=autosar-variable-in-impl-datatype=dm_TimeStampSecond, written-read-nv-data=dm_TimeStampSecond.Value
          nv-ram-block-element=autosar-variable-in-impl-datatype=total_distance_sum_implaus_jump_low_ESP, written-read-nv-data=total_distance_sum_implaus_jump_low_ESP.Value
          nv-ram-block-element=autosar-variable-in-impl-datatype=total_distance_sum_implaus_jump_high_ESP, written-read-nv-data=total_distance_sum_implaus_jump_high_ESP.Value
          nv-ram-block-element=autosar-variable-in-impl-datatype=counter_lost_communication_Distance, written-read-nv-data=counter_lost_communication_Distance.Value
          nv-ram-block-element=autosar-variable-in-impl-datatype=counter_lost_communication_EdgeCount, written-read-nv-data=counter_lost_communication_EdgeCount.Value
          nv-ram-block-element=autosar-variable-in-impl-datatype=counter_lost_communication_time, written-read-nv-data=counter_lost_communication_time.Value
          nv-ram-block-element=autosar-variable-in-impl-datatype=counter_lost_communication_clamp15, written-read-nv-data=counter_lost_communication_clamp15.Value
          nv-ram-block-element=autosar-variable-in-impl-datatype=dm_total_distance, written-read-nv-data=dm_total_distance.Value
          nv-ram-block-element=autosar-variable-in-impl-datatype=dm_error_calculation_dates, written-read-nv-data=dm_error_calculation_dates.Value
          nv-ram-block-element=autosar-variable-in-impl-datatype=ESP_number_of_teeth_lastmode, written-read-nv-data=ESP_number_of_teeth_lastmode.Value
          nv-ram-block-element=autosar-variable-in-impl-datatype=wheel_circumference_lastmode, written-read-nv-data=wheel_circumference_lastmode.Value
          nv-ram-block-element=autosar-variable-in-impl-datatype=rawVIN_lastmode, written-read-nv-data=rawVIN_lastmode.Value
          nv-ram-block-element=autosar-variable-in-impl-datatype=total_distance_pass_jump_lastmode, written-read-nv-data=total_distance_pass_jump_lastmode.Value
          nv-ram-block-element=autosar-variable-in-impl-datatype=rawVin_change_in_clamp15_lastmode, written-read-nv-data=rawVin_change_in_clamp15_lastmode.Value
          nv-ram-block-element=autosar-variable-in-impl-datatype=da_total_distance_pass_jump, written-read-nv-data=da_total_distance_pass_jump.Value
          nv-ram-block-element=autosar-variable-in-impl-datatype=SSO_EdgeCount_Sum_lastmode, written-read-nv-data=SSO_EdgeCount_Sum_lastmode.Value
          nv-ram-block-element=autosar-variable-in-impl-datatype=total_distance_jump_is_valid, written-read-nv-data=total_distance_jump_is_valid.Value
          nv-ram-block-element=autosar-variable-in-impl-datatype=distance_unit_default, written-read-nv-data=distance_unit_default.Value
          nv-ram-block-element=autosar-variable-in-impl-datatype=zReserved_WLTP_Odo, written-read-nv-data=zReserved_WLTP_Odo.Value
        nv block needs NVNeed_NVBlockDescriptor: n-data-sets=2, ram-block-status-control=API, reliability=NO-PROTECTION, restore-at-start=true, store-at-shutdown=false, store-immediate=true, write-verification=false
        ram block RAM_NVBlockDescriptor_WLTP_Odo_VAR: type=NV_Data_WLTP_Odo_VAR, init-value=fields=[dm_Esc_distance_pulse:0, dm_Number_of_jumps_distance_pulse:0, dm_Biggest_negative_jump_distance_pulse:0, dm_Biggest_positive_jump_distance_pulse:0, dm_Sum_jumps_distance_pulse:0, dm_Balance_sheet_jumps_distance_pulse:0, dm_Number_of_communication_failures_ESC:0, dm_Total_duration_communication_failures_ESC:0, dm_Longest_communication_failures_ESC:0, dm_error_secure_storage_AR:0, dm_TimeStampYear:0, dm_TimeStampMonth:0, dm_TimeStampDay:0, dm_TimeStampHour:0, dm_TimeStampMinute:0, dm_TimeStampSecond:0, total_distance_sum_implaus_jump_low_ESP:0, total_distance_sum_implaus_jump_high_ESP:0, counter_lost_communication_Distance:0, counter_lost_communication_EdgeCount:0, counter_lost_communication_time:0, counter_lost_communication_clamp15:0, dm_total_distance:0, dm_error_calculation_dates:0, ESP_number_of_teeth_lastmode:0, wheel_circumference_lastmode:0, rawVIN_lastmode:18 x 0, total_distance_pass_jump_lastmode:0, rawVin_change_in_clamp15_lastmode:0, da_total_distance_pass_jump:0, SSO_EdgeCount_Sum_lastmode:0, total_distance_jump_is_valid:0, distance_unit_default:0, zReserved_WLTP_Odo:15 x 0]
        rom block ROM_NVBlockDescriptor_WLTP_Odo_VAR:
          sw-calibration-access=READ-WRITE
          type=NV_Data_WLTP_Odo_VAR
          init-value=fields=[dm_Esc_distance_pulse:0, dm_Number_of_jumps_distance_pulse:0, dm_Biggest_negative_jump_distance_pulse:0, dm_Biggest_positive_jump_distance_pulse:0, dm_Sum_jumps_distance_pulse:0, dm_Balance_sheet_jumps_distance_pulse:0, dm_Number_of_communication_failures_ESC:0, dm_Total_duration_communication_failures_ESC:0, dm_Longest_communication_failures_ESC:0, dm_error_secure_storage_AR:0, dm_TimeStampYear:0, dm_TimeStampMonth:0, dm_TimeStampDay:0, dm_TimeStampHour:0, dm_TimeStampMinute:0, dm_TimeStampSecond:0, total_distance_sum_implaus_jump_low_ESP:0, total_distance_sum_implaus_jump_high_ESP:0, counter_lost_communication_Distance:0, counter_lost_communication_EdgeCount:0, counter_lost_communication_time:0, counter_lost_communication_clamp15:0, dm_total_distance:0, dm_error_calculation_dates:0, ESP_number_of_teeth_lastmode:0, wheel_circumference_lastmode:0, rawVIN_lastmode:18 x 0, total_distance_pass_jump_lastmode:0, rawVin_change_in_clamp15_lastmode:0, da_total_distance_pass_jump:0, SSO_EdgeCount_Sum_lastmode:0, total_distance_jump_is_valid:0, distance_unit_default:0, zReserved_WLTP_Odo:15 x 0]
  swc implementation NvBlockSwComponentType_Implementation: behavior=NvBlockSwComponentType_InternalBehavior
    code-descriptors:
      code Default: artifact-descriptors=autosar-engineering-object={short-label=Default, category=SWSRC}
package /ARRoot/If
  1028 x nv data interface:
    ACC_Darstellung
      nv-datas:
        data Value: type=boolean
    AD_Value_Max_lx
      nv-datas:
        data Value: type=uint16
    AD_Value_Min_lx
      nv-datas:
        data Value: type=uint16
    ASAMFileIdentifier
      nv-datas:
        data Value: type=Arr_u8_26
    ASAMFileVersion
      nv-datas:
        data Value: type=Arr_u8_6
    AbsErrorCounter
      nv-datas:
        data Value: type=uint8
    AbsErrorPath
      nv-datas:
        data Value: type=uint16
    Acceleration_Display_Available
      nv-datas:
        data Value: type=boolean
    Actual_Language
      nv-datas:
        data Value: type=uint8
    AcuRequest_0xA00044
      nv-datas:
        data Value: type=uint8
    AcuStatus_0xA00044
      nv-datas:
        data Value: type=uint8
    Adaption_SeatbeltWarning
      nv-datas:
        data Value: type=uint8
    AdcTicks_0xA00044
      nv-datas:
        data Value: type=uint16
    AdcTicks_0xA00049
      nv-datas:
        data Value: type=uint16
    AirbagErrorCounter
      nv-datas:
        data Value: type=uint8
    AirbagErrorPath
      nv-datas:
        data Value: type=uint16
    AmbientLight_Left_Blue_LED_Coef
      nv-datas:
        data Value: type=uint16
    AmbientLight_Left_Green_LED_Coef
      nv-datas:
        data Value: type=uint16
    AmbientLight_Left_Red_LED_Coef
      nv-datas:
        data Value: type=uint16
    AmbientLight_Right_Blue_LED_Coef
      nv-datas:
        data Value: type=uint16
    AmbientLight_Right_Green_LED_Coef
      nv-datas:
        data Value: type=uint16
    AmbientLight_Right_Red_LED_Coef
      nv-datas:
        data Value: type=uint16
    Analog_CoolantTemperature_Available
      nv-datas:
        data Value: type=boolean
    ApplValidity
      nv-datas:
        data Value: type=uint8
    BAP_BC_MFA_ExternalFunctionControl_Set_Controlcode
      nv-datas:
        data Value: type=uint16
    BAP_BC_MFA_ExternalFunctionControl_Status_Installation
      nv-datas:
        data Value: type=uint16
    BAP_BC_MFA_FSG_Setup_Status_Installation1
      nv-datas:
        data Value: type=uint8
    BAP_BC_MFA_FSG_Setup_Status_Installation2
      nv-datas:
        data Value: type=uint8
    BAP_BC_MFA_FSG_Setup_Status_PrimaryEngineType
      nv-datas:
        data Value: type=uint8
    BAP_BC_MFA_FSG_Setup_Status_SecondaryEngineType
      nv-datas:
        data Value: type=uint8
    BAP_BC_MFA_MenueSetup_Status_Menue1_1
      nv-datas:
        data Value: type=uint8
    BAP_BC_MFA_MenueSetup_Status_Menue1_2
      nv-datas:
        data Value: type=uint8
    BAP_BC_MFA_MenueSetup_Status_Menue2_1
      nv-datas:
        data Value: type=uint8
    BAP_BC_MFA_MenueSetup_Status_Menue2_2
      nv-datas:
        data Value: type=uint8
    BAP_BC_MFA_MenueSetup_Status_Menue3_1
      nv-datas:
        data Value: type=uint8
    BAP_BC_MFA_MenueSetup_Status_Menue3_2
      nv-datas:
        data Value: type=uint8
    BAP_BC_MFA_MenueSetup_Status_Special
      nv-datas:
        data Value: type=uint8
    BAP_BC_MFA_Statistics_distance_ZE
      nv-datas:
        data Value: type=boolean
    BAP_BC_MFA_Statistics_distance_currentInterval_ZE
      nv-datas:
        data Value: type=boolean
    BAP_Debug_Mode_enabled
      nv-datas:
        data Value: type=boolean
    BCCT_Lookup_Curve_AmbientLight_Dimming_Coef_X
      nv-datas:
        data Value: type=Arr_u8_6
    BCCT_Lookup_Curve_AmbientLight_Dimming_Coef_Y
      nv-datas:
        data Value: type=Arr_u8_6
    BCCT_Lookup_Curve_AmbientLight_Left_Temp_Coef_X
      nv-datas:
        data Value: type=Arr_u8_6
    BCCT_Lookup_Curve_AmbientLight_Left_Temp_Coef_Y
      nv-datas:
        data Value: type=Arr_u8_6
    BCCT_Lookup_Curve_AmbientLight_Right_Temp_Coef_X
      nv-datas:
        data Value: type=Arr_u8_6
    BCCT_Lookup_Curve_AmbientLight_Right_Temp_Coef_Y
      nv-datas:
        data Value: type=Arr_u8_6
    BCCT_Temperature_Sensor_AmbientLight_Conv_X
      nv-datas:
        data Value: type=Arr_u16_32
    BCCT_Temperature_Sensor_AmbientLight_Conv_Y
      nv-datas:
        data Value: type=Arr_u8_32
    BSBlockSize
      nv-datas:
        data Value: type=uint8
    BSBlockSizeActive
      nv-datas:
        data Value: type=uint8
    Bargraph_Color_Calibration
      nv-datas:
        data Value: type=Arr_u8_8
    Bargraph_Hysteresis_Coolant
      nv-datas:
        data Value: type=Arr_u8_15
    Bargraph_Primary_Engine_Type
      nv-datas:
        data Value: type=uint8
    Bargraph_Secondary_Engine_Type
      nv-datas:
        data Value: type=uint8
    Bargraph_Treshold_Switch_Coolant
      nv-datas:
        data Value: type=Arr_u8_15
    Bargraphs_X
      nv-datas:
        data Value: type=Arr_u16_6
    Bargraphs_Y
      nv-datas:
        data Value: type=Arr_u16_6
    BattVoltage_0xA00000
      nv-datas:
        data Value: type=uint8
    BattVoltage_0xA00040
      nv-datas:
        data Value: type=uint8
    BattVoltage_0xA00041
      nv-datas:
        data Value: type=uint8
    BattVoltage_0xA00042
      nv-datas:
        data Value: type=uint8
    BattVoltage_0xA00043
      nv-datas:
        data Value: type=uint8
    BattVoltage_0xA00044
      nv-datas:
        data Value: type=uint8
    BattVoltage_0xA00049
      nv-datas:
        data Value: type=uint8
    Bc_Display_Available
      nv-datas:
        data Value: type=boolean
    Bc_Layer3_Auto_Reset
      nv-datas:
        data Value: type=uint8
    Bc_Layer3_Auto_Reset_EV
      nv-datas:
        data Value: type=boolean
    Bc_Layer3_Auto_Reset_Gas
      nv-datas:
        data Value: type=uint8
    Bc_Layer3_Manual_Reset
      nv-datas:
        data Value: type=uint8
    BlackIceThresholdHighTemp
      nv-datas:
        data Value: type=sint8
    BlackIceThresholdLowTemp
      nv-datas:
        data Value: type=sint8
    BlackScreen_Reason
      nv-datas:
        data Value: type=uint8
    BlockInfo_EEP_Engine
      nv-datas:
        data Value: type=uint8
    BlockInfo_EEP_Market
      nv-datas:
        data Value: type=uint8
    BlockInfo_EEP_Platform
      nv-datas:
        data Value: type=uint16
    BlockInfo_EEP_Units
      nv-datas:
        data Value: type=uint8
    BlockingDistanceVehicleMoving
      nv-datas:
        data Value: type=uint16
    BlockingTimeVehicleMoving
      nv-datas:
        data Value: type=uint8
    Blue_Gamma_Adjustment_Display1
      nv-datas:
        data Value: type=Arr_u8_27
    Blue_Gamma_Adjustment_Display2
      nv-datas:
        data Value: type=Arr_u8_48
    BootloaderTPBlocksize
      nv-datas:
        data Value: type=uint8
    Brand_Info
      nv-datas:
        data Value: type=uint8
    Brightness_Photosensor_Cal_Error
      nv-datas:
        data Value: type=uint16
    Brightness_Photosensor_Cal_Init
      nv-datas:
        data Value: type=uint8
    Brightness_Photosensor_Damp_Dimm_Down
      nv-datas:
        data Value: type=uint16
    Brightness_Photosensor_Damp_Dimm_Up
      nv-datas:
        data Value: type=uint16
    CAN_DEV_Monitoring_Blocks
      nv-datas:
        data Value: type=Arr_u8_20
    CAN_DEV_Monitoring_Status
      nv-datas:
        data Value: type=uint8
    COMPONENTS_Cfg_CONST_Safety_CRC
      nv-datas:
        data Value: type=uint16
    COMPONENTS_Cfg_VAR_Safety_CRC
      nv-datas:
        data Value: type=uint16
    CRCLength_Block1
      nv-datas:
        data Value: type=Arr_u8_4
    CRCLength_Block2
      nv-datas:
        data Value: type=Arr_u8_4
    CRCLength_Block3
      nv-datas:
        data Value: type=Arr_u8_4
    CRCLength_Block4
      nv-datas:
        data Value: type=Arr_u8_4
    CRCLength_Block5
      nv-datas:
        data Value: type=Arr_u8_4
    CRCLength_Block6
      nv-datas:
        data Value: type=Arr_u8_4
    CRCStart_Block1
      nv-datas:
        data Value: type=Arr_u8_4
    CRCStart_Block2
      nv-datas:
        data Value: type=Arr_u8_4
    CRCStart_Block3
      nv-datas:
        data Value: type=Arr_u8_4
    CRCStart_Block4
      nv-datas:
        data Value: type=Arr_u8_4
    CRCStart_Block5
      nv-datas:
        data Value: type=Arr_u8_4
    CRCStart_Block6
      nv-datas:
        data Value: type=Arr_u8_4
    CRCValue_Block1
      nv-datas:
        data Value: type=Arr_u8_4
    CRCValue_Block2
      nv-datas:
        data Value: type=Arr_u8_4
    CRCValue_Block3
      nv-datas:
        data Value: type=Arr_u8_4
    CRCValue_Block4
      nv-datas:
        data Value: type=Arr_u8_4
    CRCValue_Block5
      nv-datas:
        data Value: type=Arr_u8_4
    CRCValue_Block6
      nv-datas:
        data Value: type=Arr_u8_4
    Calibrated_RGB_Font_Colour_Triple
      nv-datas:
        data Value: type=Arr_u8_3
    Calibration_Date
      nv-datas:
        data Value: type=Arr_u8_3
    Calibration_Shop_Code
      nv-datas:
        data Value: type=Arr_u8_6
    CanBusActive
      nv-datas:
        data Value: type=boolean
    Celeb_DimOffset_Scale
      nv-datas:
        data Value: type=uint8
    Celeb_EndDim_Scale_Curve_X
      nv-datas:
        data Value: type=Arr_u8_8
    Celeb_EndDim_Scale_Curve_Y
      nv-datas:
        data Value: type=Arr_u8_8
    Celeb_PreStart_Scale_Curve_X
      nv-datas:
        data Value: type=Arr_u8_6
    Celeb_PreStart_Scale_Curve_Y
      nv-datas:
        data Value: type=Arr_u8_6
    Celeb_StartDim_Scale_Curve_X
      nv-datas:
        data Value: type=Arr_u8_8
    Celeb_StartDim_Scale_Curve_Y
      nv-datas:
        data Value: type=Arr_u8_8
    ClusterFunction_0xA00000
      nv-datas:
        data Value: type=uint8
    ClusterFunction_0xA00040
      nv-datas:
        data Value: type=uint8
    ClusterFunction_0xA00041
      nv-datas:
        data Value: type=uint8
    ClusterFunction_0xA00042
      nv-datas:
        data Value: type=uint8
    ClusterFunction_0xA00043
      nv-datas:
        data Value: type=uint8
    ClusterFunction_0xA00044
      nv-datas:
        data Value: type=uint8
    ClusterFunction_0xA00049
      nv-datas:
        data Value: type=uint8
    ClusterState_0xA00000
      nv-datas:
        data Value: type=uint16
    ClusterState_0xA00040
      nv-datas:
        data Value: type=uint16
    ClusterState_0xA00041
      nv-datas:
        data Value: type=uint16
    ClusterState_0xA00042
      nv-datas:
        data Value: type=uint16
    ClusterState_0xA00043
      nv-datas:
        data Value: type=uint16
    ClusterState_0xA00044
      nv-datas:
        data Value: type=uint16
    ClusterState_0xA00049
      nv-datas:
        data Value: type=uint16
    Cluster_Variant
      nv-datas:
        data Value: type=uint8
    Cluster_Variant_ASIA
      nv-datas:
        data Value: type=uint8
    Cluster_Variant_CHINA
      nv-datas:
        data Value: type=uint8
    Cluster_Variant_Canada
      nv-datas:
        data Value: type=boolean
    Cluster_Variant_FBU
      nv-datas:
        data Value: type=boolean
    Cluster_Variant_USA
      nv-datas:
        data Value: type=uint8
    CodingCheck_4WD_Installed
      nv-datas:
        data Value: type=uint8
    CodingCheck_ACC_Installed
      nv-datas:
        data Value: type=uint8
    CodingCheck_ADA_Installed
      nv-datas:
        data Value: type=uint8
    CodingCheck_AFS_Installed
      nv-datas:
        data Value: type=uint8
    CodingCheck_AGA_Installed
      nv-datas:
        data Value: type=uint8
    CodingCheck_ARA_Installed
      nv-datas:
        data Value: type=uint8
    CodingCheck_ASTA_Installed
      nv-datas:
        data Value: type=uint8
    CodingCheck_AWV_BAP_Installed
      nv-datas:
        data Value: type=uint8
    CodingCheck_AWV_Installed
      nv-datas:
        data Value: type=uint8
    CodingCheck_Acceleration_Display_Available
      nv-datas:
        data Value: type=uint8
    CodingCheck_Audio_Installed
      nv-datas:
        data Value: type=uint8
    CodingCheck_BCmE_Installed
      nv-datas:
        data Value: type=uint8
    CodingCheck_BVA_with_BKL
      nv-datas:
        data Value: type=uint8
    CodingCheck_Bc_Display_Available
      nv-datas:
        data Value: type=uint8
    CodingCheck_CarBody
      nv-datas:
        data Value: type=uint16
    CodingCheck_Car_Leaving_Warning_Available
      nv-datas:
        data Value: type=uint8
    CodingCheck_Compass_Position
      nv-datas:
        data Value: type=uint8
    CodingCheck_Damper_Installed
      nv-datas:
        data Value: type=uint8
    CodingCheck_DayIlluminationPointers
      nv-datas:
        data Value: type=uint8
    CodingCheck_DayIlluminationScales
      nv-datas:
        data Value: type=uint8
    CodingCheck_Dig_OilTemp_Display_Available
      nv-datas:
        data Value: type=uint8
    CodingCheck_Digital_Key_Installed
      nv-datas:
        data Value: type=uint8
    CodingCheck_EBKV_Installed
      nv-datas:
        data Value: type=uint8
    CodingCheck_ELV_Installed
      nv-datas:
        data Value: type=uint8
    CodingCheck_Epb_Installed
      nv-datas:
        data Value: type=uint8
    CodingCheck_Eps_Installed
      nv-datas:
        data Value: type=uint8
    CodingCheck_FCWP_Installed
      nv-datas:
        data Value: type=uint8
    CodingCheck_Fuel_Variant
      nv-datas:
        data Value: type=uint32
    CodingCheck_GRA_High_Display
      nv-datas:
        data Value: type=uint8
    CodingCheck_HRE_Installed
      nv-datas:
        data Value: type=uint8
    CodingCheck_Hybrid_BAP_Installed
      nv-datas:
        data Value: type=uint8
    CodingCheck_Hybrid_Installed
      nv-datas:
        data Value: type=uint8
    CodingCheck_IAA_PSO_BAP_Installed
      nv-datas:
        data Value: type=uint8
    CodingCheck_Ignition_EV_LowVoltage
      nv-datas:
        data Value: type=uint8
    CodingCheck_Joker_Button_Installed
      nv-datas:
        data Value: type=uint8
    CodingCheck_KFG_Installed
      nv-datas:
        data Value: type=uint8
    CodingCheck_K_Number
      nv-datas:
        data Value: type=uint32
    CodingCheck_Key_Warning
      nv-datas:
        data Value: type=uint8
    CodingCheck_LDW_BAP_Installed
      nv-datas:
        data Value: type=uint8
    CodingCheck_LDW_Installed
      nv-datas:
        data Value: type=uint8
    CodingCheck_Laptimer
      nv-datas:
        data Value: type=uint8
    CodingCheck_Navigation_Compass_Installed
      nv-datas:
        data Value: type=uint8
    CodingCheck_OutsideTemperature_Indication
      nv-datas:
        data Value: type=uint8
    CodingCheck_PEA_BAP_Installed
      nv-datas:
        data Value: type=uint8
    CodingCheck_PLA3_Installed
      nv-datas:
        data Value: type=uint8
    CodingCheck_PLA_Installed
      nv-datas:
        data Value: type=uint8
    CodingCheck_PedestrianAssist_BAP_Installed
      nv-datas:
        data Value: type=uint8
    CodingCheck_Personalization_Installed
      nv-datas:
        data Value: type=uint8
    CodingCheck_Pointer_Kl_58
      nv-datas:
        data Value: type=uint8
    CodingCheck_QSP_Installed
      nv-datas:
        data Value: type=uint8
    CodingCheck_RDK_BAP_Installed
      nv-datas:
        data Value: type=uint8
    CodingCheck_RDK_Installed
      nv-datas:
        data Value: type=uint8
    CodingCheck_RKA_Installed
      nv-datas:
        data Value: type=uint8
    CodingCheck_RefulledVolume_Available
      nv-datas:
        data Value: type=uint8
    CodingCheck_Right_Drive
      nv-datas:
        data Value: type=uint8
    CodingCheck_SDS_BAP_Installed
      nv-datas:
        data Value: type=uint8
    CodingCheck_SWA_BAP_Installed
      nv-datas:
        data Value: type=uint8
    CodingCheck_SWA_Installed
      nv-datas:
        data Value: type=uint8
    CodingCheck_SeatbeltWarning
      nv-datas:
        data Value: type=uint8
    CodingCheck_Staging
      nv-datas:
        data Value: type=uint8
    CodingCheck_StartStopReasons_BAP_Installed
      nv-datas:
        data Value: type=uint8
    CodingCheck_StartUp_Screen
      nv-datas:
        data Value: type=uint8
    CodingCheck_Telephone2_Installed
      nv-datas:
        data Value: type=uint8
    CodingCheck_Telephone2_Installed_Obsolete
      nv-datas:
        data Value: type=Arr_u8_9
    CodingCheck_Telephone_Installed
      nv-datas:
        data Value: type=uint8
    CodingCheck_Two_Keys_Installed
      nv-datas:
        data Value: type=uint8
    CodingCheck_Unit_ClockFormat
      nv-datas:
        data Value: type=uint8
    CodingCheck_Unit_Consumption_Electric
      nv-datas:
        data Value: type=uint8
    CodingCheck_Unit_Consumption_Electric_Obsolete
      nv-datas:
        data Value: type=Arr_u8_9
    CodingCheck_Unit_DateFormat
      nv-datas:
        data Value: type=uint8
    CodingCheck_Unit_FuelConsumption
      nv-datas:
        data Value: type=uint8
    CodingCheck_Unit_FuelConsumption_Gas
      nv-datas:
        data Value: type=uint16
    CodingCheck_Unit_Language
      nv-datas:
        data Value: type=uint32
    CodingCheck_Unit_Language_Ext
      nv-datas:
        data Value: type=uint8
    CodingCheck_Unit_Language_Ext1
      nv-datas:
        data Value: type=uint8
    CodingCheck_Unit_OdoTripDistance
      nv-datas:
        data Value: type=uint8
    CodingCheck_Unit_Pressure
      nv-datas:
        data Value: type=uint8
    CodingCheck_Unit_Speed
      nv-datas:
        data Value: type=uint8
    CodingCheck_Unit_Temperature
      nv-datas:
        data Value: type=uint8
    CodingCheck_Unit_Volume
      nv-datas:
        data Value: type=uint8
    CodingCheck_Unit_Weight
      nv-datas:
        data Value: type=uint8
    CodingCheck_VZA_Installed
      nv-datas:
        data Value: type=uint8
    CodingCheck_V_Warning_Legal
      nv-datas:
        data Value: type=uint8
    CodingCheck_WBA_Installed
      nv-datas:
        data Value: type=uint8
    CodingCheck_eCall_Installed
      nv-datas:
        data Value: type=uint8
    Coding_4WD_Installed
      nv-datas:
        data Value: type=boolean
    Coding_ACC_Installed
      nv-datas:
        data Value: type=boolean
    Coding_ADA_Installed
      nv-datas:
        data Value: type=uint8
    Coding_AFS_Installed
      nv-datas:
        data Value: type=boolean
    Coding_AGA_Installed
      nv-datas:
        data Value: type=uint8
    Coding_ARA_Installed
      nv-datas:
        data Value: type=boolean
    Coding_ASTA_Installed
      nv-datas:
        data Value: type=boolean
    Coding_AWV_BAP_Installed
      nv-datas:
        data Value: type=boolean
    Coding_AWV_Installed
      nv-datas:
        data Value: type=boolean
    Coding_Audio_Installed
      nv-datas:
        data Value: type=boolean
    Coding_BCmE_Installed
      nv-datas:
        data Value: type=boolean
    Coding_BMS_Installed
      nv-datas:
        data Value: type=boolean
    Coding_BVA_with_BKL
      nv-datas:
        data Value: type=boolean
    Coding_CarBody
      nv-datas:
        data Value: type=uint8
    Coding_Car_Leaving_Warning_Active
      nv-datas:
        data Value: type=boolean
    Coding_Compass_Position
      nv-datas:
        data Value: type=uint8
    Coding_Damper_Installed
      nv-datas:
        data Value: type=boolean
    Coding_Date
      nv-datas:
        data Value: type=Arr_u8_3
    Coding_DayIlluminationPointers
      nv-datas:
        data Value: type=boolean
    Coding_DayIlluminationScales
      nv-datas:
        data Value: type=boolean
    Coding_Digital_Key_Installed
      nv-datas:
        data Value: type=boolean
    Coding_EBKV_Installed
      nv-datas:
        data Value: type=uint8
    Coding_ELV_Installed
      nv-datas:
        data Value: type=boolean
    Coding_EPS_Installed
      nv-datas:
        data Value: type=boolean
    Coding_Epb_Installed
      nv-datas:
        data Value: type=boolean
    Coding_FCWP_Installed
      nv-datas:
        data Value: type=boolean
    Coding_HRE_Installed
      nv-datas:
        data Value: type=boolean
    Coding_Hybrid_BAP_Installed
      nv-datas:
        data Value: type=boolean
    Coding_Hybrid_Installed
      nv-datas:
        data Value: type=boolean
    Coding_IAA_PSO_BAP_Installed
      nv-datas:
        data Value: type=boolean
    Coding_Ignition_EV_LowVoltage
      nv-datas:
        data Value: type=uint8
    Coding_Joker_Button_Installed
      nv-datas:
        data Value: type=boolean
    Coding_KFG_Installed
      nv-datas:
        data Value: type=uint8
    Coding_KeyWarning
      nv-datas:
        data Value: type=boolean
    Coding_LDW_BAP_Installed
      nv-datas:
        data Value: type=boolean
    Coding_LDW_Installed
      nv-datas:
        data Value: type=boolean
    Coding_Language
      nv-datas:
        data Value: type=uint8
    Coding_Laptimer
      nv-datas:
        data Value: type=boolean
    Coding_Navigation_Compass_Installed
      nv-datas:
        data Value: type=boolean
    Coding_PEA_BAP_Installed
      nv-datas:
        data Value: type=boolean
    Coding_PLA3_Installed
      nv-datas:
        data Value: type=boolean
    Coding_PLA_Installed
      nv-datas:
        data Value: type=boolean
    Coding_PedestrianAssist_BAP_Installed
      nv-datas:
        data Value: type=boolean
    Coding_Personalization_Installed
      nv-datas:
        data Value: type=boolean
    Coding_Pointer_Kl_58
      nv-datas:
        data Value: type=uint8
    Coding_Production_Mode_Acoustic
      nv-datas:
        data Value: type=boolean
    Coding_Production_Mode_Key_Lock
      nv-datas:
        data Value: type=boolean
    Coding_QSP_Installed
      nv-datas:
        data Value: type=boolean
    Coding_RDK_BAP_Installed
      nv-datas:
        data Value: type=boolean
    Coding_RDK_Installed
      nv-datas:
        data Value: type=boolean
    Coding_RKA_Installed
      nv-datas:
        data Value: type=boolean
    Coding_Right_Drive
      nv-datas:
        data Value: type=boolean
    Coding_SDS_BAP_Installed
      nv-datas:
        data Value: type=boolean
    Coding_SWA_BAP_Installed
      nv-datas:
        data Value: type=boolean
    Coding_SWA_Installed
      nv-datas:
        data Value: type=boolean
    Coding_SeatbeltWarning
      nv-datas:
        data Value: type=uint8
    Coding_Shop_Code
      nv-datas:
        data Value: type=Arr_u8_6
    Coding_Staging
      nv-datas:
        data Value: type=uint8
    Coding_StartStopReasons_BAP_Installed
      nv-datas:
        data Value: type=boolean
    Coding_StartUp_Screen
      nv-datas:
        data Value: type=uint8
    Coding_TCO_Installed
      nv-datas:
        data Value: type=boolean
    Coding_Telephone2_Installed
      nv-datas:
        data Value: type=boolean
    Coding_Telephone_Installed
      nv-datas:
        data Value: type=boolean
    Coding_Unit_ClockFormat
      nv-datas:
        data Value: type=boolean
    Coding_Unit_Consumption_Electrical
      nv-datas:
        data Value: type=uint8
    Coding_Unit_DateFormat
      nv-datas:
        data Value: type=uint8
    Coding_Unit_FuelConsumption
      nv-datas:
        data Value: type=uint8
    Coding_Unit_FuelConsumption_Gas
      nv-datas:
        data Value: type=uint8
    Coding_Unit_OdoTripDistance
      nv-datas:
        data Value: type=boolean
    Coding_Unit_Pressure
      nv-datas:
        data Value: type=uint8
    Coding_Unit_Speed
      nv-datas:
        data Value: type=boolean
    Coding_Unit_Temperature
      nv-datas:
        data Value: type=boolean
    Coding_Unit_Volume
      nv-datas:
        data Value: type=uint8
    Coding_Unit_Weight
      nv-datas:
        data Value: type=uint8
    Coding_VZA_Installed
      nv-datas:
        data Value: type=boolean
    Coding_V_Warning_Legal
      nv-datas:
        data Value: type=boolean
    Coding_WBA_Installed
      nv-datas:
        data Value: type=boolean
    Coding_eCall_Installed
      nv-datas:
        data Value: type=boolean
    Coding_two_keys
      nv-datas:
        data Value: type=boolean
    Compensation_Line_Shift_b
      nv-datas:
        data Value: type=uint16
    Compensation_Line_Shift_b_Left
      nv-datas:
        data Value: type=uint16
    Compensation_Line_Shift_b_Right
      nv-datas:
        data Value: type=uint16
    Compensation_Line_Slope_m
      nv-datas:
        data Value: type=uint32
    Compensation_Line_Slope_m_Left
      nv-datas:
        data Value: type=uint32
    Compensation_Line_Slope_m_Right
      nv-datas:
        data Value: type=uint32
    ConfigWarning_Schwelle1_Indien
      nv-datas:
        data Value: type=uint16
    ConsumptionCorrection
      nv-datas:
        data Value: type=uint8
    ConsumptionCorrection_Cng
      nv-datas:
        data Value: type=uint8
    CoolantTemp_Gauge_Hysteresis_Angle
      nv-datas:
        data Value: type=sint16
    CoolantTemperatureDelta
      nv-datas:
        data Value: type=uint8
    Coolant_Cold_Indication_Present
      nv-datas:
        data Value: type=boolean
    CorrectionCoefficient_k1
      nv-datas:
        data Value: type=uint16
    CorrectionCoefficient_k2
      nv-datas:
        data Value: type=uint16
    Counter_RamError
      nv-datas:
        data Value: type=uint8
    Customer_Request_Flag
      nv-datas:
        data Value: type=boolean
    CwlErrorCounter
      nv-datas:
        data Value: type=uint8
    CwlErrorPath
      nv-datas:
        data Value: type=uint16
    CylinderDeactivation_Active
      nv-datas:
        data Value: type=boolean
    DIAG_AdaptationChannel_VAR_0_Safety_CRC
      nv-datas:
        data Value: type=uint16
    DIAG_EOL_DiagCfg_CONST_Safety_CRC
      nv-datas:
        data Value: type=uint16
    DIAG_EOL_HWCalib_CONST_Safety_CRC
      nv-datas:
        data Value: type=uint16
    DIAG_VariantCoding_CONST_Safety_CRC
      nv-datas:
        data Value: type=uint16
    DLS_Auto_Day
      nv-datas:
        data Value: type=uint8
    DLS_Auto_Hour
      nv-datas:
        data Value: type=uint8
    DLS_Auto_Minute
      nv-datas:
        data Value: type=uint8
    DLS_Auto_Month
      nv-datas:
        data Value: type=uint8
    DLS_Auto_State
      nv-datas:
        data Value: type=uint8
    DTC_ECU_not_coded
      nv-datas:
        data Value: type=boolean
    DURMW
      nv-datas:
        data Value: type=uint32
    DailyMileage
      nv-datas:
        data Value: type=uint16
    Damping_Indic_Coolnt_Bargrph_OFF
      nv-datas:
        data Value: type=uint8
    Damping_Indic_Coolnt_Bargrph_ON
      nv-datas:
        data Value: type=uint8
    Date_Day
      nv-datas:
        data Value: type=uint8
    Date_Month
      nv-datas:
        data Value: type=uint8
    Date_Year
      nv-datas:
        data Value: type=uint16
    DcmDslRxTesterSourceAddr
      nv-datas:
        data Value: type=uint16
    Deactivate_SK_Function
      nv-datas:
        data Value: type=boolean
    Debouncing_AutomaticDrivingLight
      nv-datas:
        data Value: type=uint8
    Debouncing_FogLight
      nv-datas:
        data Value: type=uint8
    Debouncing_LowBeam
      nv-datas:
        data Value: type=uint8
    Debouncing_Sidelight
      nv-datas:
        data Value: type=uint8
    Default_AmbientLight_Color_Blue
      nv-datas:
        data Value: type=uint8
    Default_AmbientLight_Color_CHINA_index
      nv-datas:
        data Value: type=uint8
    Default_AmbientLight_Color_Green
      nv-datas:
        data Value: type=uint8
    Default_AmbientLight_Color_Red
      nv-datas:
        data Value: type=uint8
    Default_AmbientLight_Color_index
      nv-datas:
        data Value: type=uint8
    Diag_Blue_Gamma_Adjustment
      nv-datas:
        data Value: type=Arr_u8_3
    Diag_Blue_Gamma_Neg_Adjustment
      nv-datas:
        data Value: type=Arr_u8_30
    Diag_Blue_Gamma_Pos_Adjustment
      nv-datas:
        data Value: type=Arr_u8_30
    Diag_Compensation_Line_Shift_b
      nv-datas:
        data Value: type=Arr_u8_3
    Diag_Compensation_Line_Slope_m
      nv-datas:
        data Value: type=Arr_u8_3
    Diag_Gain_Adjustment
      nv-datas:
        data Value: type=Arr_u8_3
    Diag_Green_Gamma_Adjustment
      nv-datas:
        data Value: type=Arr_u8_3
    Diag_Green_Gamma_Neg_Adjustment
      nv-datas:
        data Value: type=Arr_u8_30
    Diag_Green_Gamma_Pos_Adjustment
      nv-datas:
        data Value: type=Arr_u8_30
    Diag_Red_Gamma_Adjustment
      nv-datas:
        data Value: type=Arr_u8_3
    Diag_Red_Gamma_Neg_Adjustment
      nv-datas:
        data Value: type=Arr_u8_30
    Diag_Red_Gamma_Pos_Adjustment
      nv-datas:
        data Value: type=Arr_u8_30
    Dig_OilTemp_Display_Available
      nv-datas:
        data Value: type=boolean
    DisplayDamping_Off_Bargraph_Tank
      nv-datas:
        data Value: type=uint8
    DisplayDamping_On_Bargraph_Tank
      nv-datas:
        data Value: type=uint8
    Display_FPA
      nv-datas:
        data Value: type=uint8
    Display_Illum_Max_Level
      nv-datas:
        data Value: type=uint16
    Display_Save_CP
      nv-datas:
        data Value: type=boolean
    Display_Type
      nv-datas:
        data Value: type=uint8
    DtcAging
      nv-datas:
        data Value: type=Arr_u8_4
    ECT_Gauge_Magnetic_Offset
      nv-datas:
        data Value: type=uint8
    EMSG_Mode_Active
      nv-datas:
        data Value: type=uint8
    ESP_number_of_teeth_lastmode
      nv-datas:
        data Value: type=uint8
    EpbErrorCounter
      nv-datas:
        data Value: type=uint8
    EpbErrorPath
      nv-datas:
        data Value: type=uint16
    EraseState_Block1
      nv-datas:
        data Value: type=uint8
    EraseState_Block2
      nv-datas:
        data Value: type=uint8
    EraseState_Block3
      nv-datas:
        data Value: type=uint8
    EraseState_Block4
      nv-datas:
        data Value: type=uint8
    EraseState_Block5
      nv-datas:
        data Value: type=uint8
    EraseState_Block6
      nv-datas:
        data Value: type=uint8
    ErrorType_0xA00041
      nv-datas:
        data Value: type=uint8
    ErrorType_0xA00042
      nv-datas:
        data Value: type=uint8
    ErrorType_0xA00044
      nv-datas:
        data Value: type=uint8
    EspErrorCounter
      nv-datas:
        data Value: type=uint8
    EspErrorPath
      nv-datas:
        data Value: type=uint16
    FAS_menu_ACC
      nv-datas:
        data Value: type=boolean
    FAS_menu_GRA
      nv-datas:
        data Value: type=boolean
    FAS_menu_LIM
      nv-datas:
        data Value: type=boolean
    FAZIT_Number
      nv-datas:
        data Value: type=Arr_u8_23
    FPK_zeigerdaempfung_drehzahl
      nv-datas:
        data Value: type=boolean
    FblShareDataPartOneReserved
      nv-datas:
        data Value: type=Arr_u8_72
    FblShareDataPartOneReserved1
      nv-datas:
        data Value: type=Arr_u8_10
    FblShareDataPartOneReserved2
      nv-datas:
        data Value: type=Arr_u8_11
    FblShareDataPartThreeReserved
      nv-datas:
        data Value: type=Arr_u8_50
    FblShareDataPartTwoReserved1
      nv-datas:
        data Value: type=Arr_u8_8
    Forcewrite_Qual_Time
      nv-datas:
        data Value: type=uint8
    FuelLevel_Gauge_Hysteresis_Angle
      nv-datas:
        data Value: type=sint16
    Fuel_AuxHeater_Consumption_Active
      nv-datas:
        data Value: type=boolean
    Fuel_Calib_DryCalibration
      nv-datas:
        data Value: type=uint8
    Fuel_Calib_Dry_Max
      nv-datas:
        data Value: type=uint8
    Fuel_Calib_FullCalibration
      nv-datas:
        data Value: type=uint8
    Fuel_Calib_Full_Max
      nv-datas:
        data Value: type=uint8
    Fuel_Calib_Full_Offset
      nv-datas:
        data Value: type=sint8
    Fuel_Calib_Vol_Dead
      nv-datas:
        data Value: type=uint16
    Fuel_Calib_Vol_Filled
      nv-datas:
        data Value: type=uint16
    Fuel_Calib_WetCalibration
      nv-datas:
        data Value: type=uint8
    Fuel_Calib_Wet_Max
      nv-datas:
        data Value: type=uint8
    Fuel_Consumption_Min
      nv-datas:
        data Value: type=uint8
    Fuel_Odometer_Log_n
      nv-datas:
        data Value: type=uint16
    Fuel_Odometer_Log_n1
      nv-datas:
        data Value: type=uint16
    Fuel_Odometer_Log_n2
      nv-datas:
        data Value: type=uint16
    Fuel_Odometer_Log_n3
      nv-datas:
        data Value: type=uint16
    Fuel_Offset_Sensor_1
      nv-datas:
        data Value: type=sint8
    Fuel_Offset_Sensor_2
      nv-datas:
        data Value: type=sint8
    Fuel_Offset_Sensor_3
      nv-datas:
        data Value: type=sint8
    Fuel_Offset_Sensor_4
      nv-datas:
        data Value: type=sint8
    Fuel_RefuelDetect_Log_Error_n
      nv-datas:
        data Value: type=uint8
    Fuel_RefuelDetect_Log_Error_n1
      nv-datas:
        data Value: type=uint8
    Fuel_RefuelDetect_Log_Error_n2
      nv-datas:
        data Value: type=uint8
    Fuel_RefuelDetect_Log_Error_n3
      nv-datas:
        data Value: type=uint8
    Fuel_Variant
      nv-datas:
        data Value: type=uint8
    Fuel_Vol_Display_Old_Log_n
      nv-datas:
        data Value: type=uint16
    Fuel_Vol_Display_Old_Log_n1
      nv-datas:
        data Value: type=uint16
    Fuel_Vol_Display_Old_Log_n2
      nv-datas:
        data Value: type=uint16
    Fuel_Vol_Display_Old_Log_n3
      nv-datas:
        data Value: type=uint16
    Fuel_Vol_Ref_Log_n
      nv-datas:
        data Value: type=uint16
    Fuel_Vol_Ref_Log_n1
      nv-datas:
        data Value: type=uint16
    Fuel_Vol_Ref_Log_n2
      nv-datas:
        data Value: type=uint16
    Fuel_Vol_Ref_Log_n3
      nv-datas:
        data Value: type=uint16
    Fuel_Vol_RefuelHandling_Log_n
      nv-datas:
        data Value: type=uint16
    Fuel_Vol_RefuelHandling_Log_n1
      nv-datas:
        data Value: type=uint16
    Fuel_Vol_RefuelHandling_Log_n2
      nv-datas:
        data Value: type=uint16
    Fuel_Vol_RefuelHandling_Log_n3
      nv-datas:
        data Value: type=uint16
    Fuel_Vol_Refueling_Drainage_1
      nv-datas:
        data Value: type=uint8
    Fuel_Vol_Refueling_Drainage_10
      nv-datas:
        data Value: type=uint8
    Fuel_Vol_Refueling_Drainage_11
      nv-datas:
        data Value: type=uint8
    Fuel_Vol_Refueling_Drainage_12
      nv-datas:
        data Value: type=uint8
    Fuel_Vol_Refueling_Drainage_13
      nv-datas:
        data Value: type=uint8
    Fuel_Vol_Refueling_Drainage_14
      nv-datas:
        data Value: type=uint8
    Fuel_Vol_Refueling_Drainage_15
      nv-datas:
        data Value: type=uint8
    Fuel_Vol_Refueling_Drainage_16
      nv-datas:
        data Value: type=uint8
    Fuel_Vol_Refueling_Drainage_17
      nv-datas:
        data Value: type=uint8
    Fuel_Vol_Refueling_Drainage_18
      nv-datas:
        data Value: type=uint8
    Fuel_Vol_Refueling_Drainage_19
      nv-datas:
        data Value: type=uint8
    Fuel_Vol_Refueling_Drainage_2
      nv-datas:
        data Value: type=uint8
    Fuel_Vol_Refueling_Drainage_20
      nv-datas:
        data Value: type=uint8
    Fuel_Vol_Refueling_Drainage_21
      nv-datas:
        data Value: type=uint8
    Fuel_Vol_Refueling_Drainage_22
      nv-datas:
        data Value: type=uint8
    Fuel_Vol_Refueling_Drainage_23
      nv-datas:
        data Value: type=uint8
    Fuel_Vol_Refueling_Drainage_24
      nv-datas:
        data Value: type=uint8
    Fuel_Vol_Refueling_Drainage_25
      nv-datas:
        data Value: type=uint8
    Fuel_Vol_Refueling_Drainage_26
      nv-datas:
        data Value: type=uint8
    Fuel_Vol_Refueling_Drainage_27
      nv-datas:
        data Value: type=uint8
    Fuel_Vol_Refueling_Drainage_28
      nv-datas:
        data Value: type=uint8
    Fuel_Vol_Refueling_Drainage_29
      nv-datas:
        data Value: type=uint8
    Fuel_Vol_Refueling_Drainage_3
      nv-datas:
        data Value: type=uint8
    Fuel_Vol_Refueling_Drainage_30
      nv-datas:
        data Value: type=uint8
    Fuel_Vol_Refueling_Drainage_31
      nv-datas:
        data Value: type=uint8
    Fuel_Vol_Refueling_Drainage_32
      nv-datas:
        data Value: type=uint8
    Fuel_Vol_Refueling_Drainage_4
      nv-datas:
        data Value: type=uint8
    Fuel_Vol_Refueling_Drainage_5
      nv-datas:
        data Value: type=uint8
    Fuel_Vol_Refueling_Drainage_6
      nv-datas:
        data Value: type=uint8
    Fuel_Vol_Refueling_Drainage_7
      nv-datas:
        data Value: type=uint8
    Fuel_Vol_Refueling_Drainage_8
      nv-datas:
        data Value: type=uint8
    Fuel_Vol_Refueling_Drainage_9
      nv-datas:
        data Value: type=uint8
    Fuel_Vol_Sensor_Avrg_RefuelHandling_Log_n
      nv-datas:
        data Value: type=uint16
    Fuel_Vol_Sensor_Avrg_RefuelHandling_Log_n1
      nv-datas:
        data Value: type=uint16
    Fuel_Vol_Sensor_Avrg_RefuelHandling_Log_n2
      nv-datas:
        data Value: type=uint16
    Fuel_Vol_Sensor_Avrg_RefuelHandling_Log_n3
      nv-datas:
        data Value: type=uint16
    GRA_High_Display_Available
      nv-datas:
        data Value: type=boolean
    Gamma_Adjustment_VAR_CRC
      nv-datas:
        data Value: type=uint16
    GasTank_Display_Attenuation_Off
      nv-datas:
        data Value: type=uint8
    GasTank_Display_Attenuation_On
      nv-datas:
        data Value: type=uint8
    GasTank_Duration_Red_LED_Flashing
      nv-datas:
        data Value: type=uint8
    GasTank_Warning_Special_State
      nv-datas:
        data Value: type=uint8
    GeneralBrakeErrorCounter
      nv-datas:
        data Value: type=uint8
    GeneralBrakeErrorPath
      nv-datas:
        data Value: type=uint16
    Green_Gamma_Adjustment_Display1
      nv-datas:
        data Value: type=Arr_u8_27
    Green_Gamma_Adjustment_Display2
      nv-datas:
        data Value: type=Arr_u8_48
    HmiZpm_0xA00044
      nv-datas:
        data Value: type=uint16
    Hmi_Skinning
      nv-datas:
        data Value: type=uint8
    Hmi_Variant
      nv-datas:
        data Value: type=boolean
    HookInfo_ApiId_Det_ErrorHook
      nv-datas:
        data Value: type=uint8
    HookInfo_BswModuleId_EcuM_BswErrorHook
      nv-datas:
        data Value: type=uint16
    HookInfo_EcuM_ErrorHook
      nv-datas:
        data Value: type=uint8
    HookInfo_ErrorHook
      nv-datas:
        data Value: type=uint8
    HookInfo_ErrorId_Det_ErrorHook
      nv-datas:
        data Value: type=uint8
    HookInfo_ErrorId_EcuM_BswErrorHook
      nv-datas:
        data Value: type=uint8
    HookInfo_InstanceId_Det_ErrorHook
      nv-datas:
        data Value: type=uint8
    HookInfo_ModuleId_Det_ErrorHook
      nv-datas:
        data Value: type=uint16
    HookInfo_ProtectionHook
      nv-datas:
        data Value: type=uint8
    HookInfo_ShutdownHook
      nv-datas:
        data Value: type=uint8
    Hot_Spot_Temp_Dimm_Time
      nv-datas:
        data Value: type=uint8
    I5CM_ID_NVM_BlockDET
      nv-datas:
        data Value: type=Arr_u8_64
    I5CM_ID_NVM_BlockDL
      nv-datas:
        data Value: type=Arr_u8_176
    I5CM_ID_NVM_BlockKEYLC
      nv-datas:
        data Value: type=Arr_u8_128
    I5CM_ID_NVM_BlockKEY_0
      nv-datas:
        data Value: type=Arr_u8_64
    I5CM_ID_NVM_BlockKEY_1
      nv-datas:
        data Value: type=Arr_u8_64
    I5CM_ID_NVM_BlockKEY_2
      nv-datas:
        data Value: type=Arr_u8_64
    I5CM_ID_NVM_BlockLEARN_0
      nv-datas:
        data Value: type=Arr_u8_80
    I5CM_ID_NVM_BlockLEARN_1
      nv-datas:
        data Value: type=Arr_u8_80
    I5CM_ID_NVM_BlockLEARN_2
      nv-datas:
        data Value: type=Arr_u8_80
    I5CM_ID_NVM_BlockPARAM_0
      nv-datas:
        data Value: type=Arr_u8_32
    I5CM_ID_NVM_BlockPARAM_1
      nv-datas:
        data Value: type=Arr_u8_32
    I5CM_ID_NVM_BlockPARAM_2
      nv-datas:
        data Value: type=Arr_u8_32
    I5CM_ID_NVM_BlockSRM_0
      nv-datas:
        data Value: type=Arr_u8_32
    I5CM_ID_NVM_BlockSRM_1
      nv-datas:
        data Value: type=Arr_u8_32
    I5CM_ID_NVM_BlockSRM_2
      nv-datas:
        data Value: type=Arr_u8_32
    I5CM_ID_NVM_BlockSTATE_0
      nv-datas:
        data Value: type=Arr_u8_16
    I5CM_ID_NVM_BlockSTATE_1
      nv-datas:
        data Value: type=Arr_u8_16
    I5CM_ID_NVM_BlockSTATE_2
      nv-datas:
        data Value: type=Arr_u8_16
    I5CM_ID_NVM_BlockSTS_0
      nv-datas:
        data Value: type=Arr_u8_16
    I5CM_ID_NVM_BlockSTS_1
      nv-datas:
        data Value: type=Arr_u8_16
    I5CM_ID_NVM_BlockSTS_2
      nv-datas:
        data Value: type=Arr_u8_16
    Ignition_Active_Message
      nv-datas:
        data Value: type=uint8
    IllumThreshold_CRC
      nv-datas:
        data Value: type=uint16
    Immo_DtcLastTestResult
      nv-datas:
        data Value: type=uint16
    Immo_Individual_Schluessel_Fahrberecht
      nv-datas:
        data Value: type=boolean
    Inspection_Elapsed_Days
      nv-datas:
        data Value: type=uint16
    Inspection_Elapsed_Km
      nv-datas:
        data Value: type=uint16
    Inspection_MaxNext_Days
      nv-datas:
        data Value: type=uint16
    Inspection_MaxNext_Km
      nv-datas:
        data Value: type=uint16
    Inspection_ResetValue_Days
      nv-datas:
        data Value: type=uint16
    Inspection_ResetValue_Km
      nv-datas:
        data Value: type=uint16
    InternalLogicalSoftwareBlockVersion_EEP
      nv-datas:
        data Value: type=Arr_u8_4
    K_Number
      nv-datas:
        data Value: type=uint8
    Knockout_Ctr
      nv-datas:
        data Value: type=uint8
    Knockout_Tmr
      nv-datas:
        data Value: type=uint8
    KsNvmBlockGfaKey_0
      nv-datas:
        data Value: type=Arr_u8_64
    KsNvmBlockGfaKey_1
      nv-datas:
        data Value: type=Arr_u8_64
    KsNvmBlockMisc_0
      nv-datas:
        data Value: type=Arr_u8_16
    KsNvmBlockMisc_1
      nv-datas:
        data Value: type=Arr_u8_16
    LIM_Display_Available
      nv-datas:
        data Value: type=boolean
    LeftIndicatorErrorCounter
      nv-datas:
        data Value: type=uint8
    LeftIndicatorErrorPath
      nv-datas:
        data Value: type=uint16
    Lookup_Compression_Curve_Photosensor_Bus_Coef_X
      nv-datas:
        data Value: type=Arr_u16_5
    Lookup_Compression_Curve_Photosensor_Bus_Coef_Y
      nv-datas:
        data Value: type=Arr_u8_5
    Lookup_Curve_Bargraphs_Red_Coef_X
      nv-datas:
        data Value: type=Arr_u16_6
    Lookup_Curve_Bargraphs_Red_Coef_Y
      nv-datas:
        data Value: type=Arr_u16_6
    MDO_EN_0xA00049
      nv-datas:
        data Value: type=uint8
    MFL_Valid
      nv-datas:
        data Value: type=boolean
    MO_StartStop_Coded
      nv-datas:
        data Value: type=boolean
    Main_Switch_Basis
      nv-datas:
        data Value: type=boolean
    Main_Switch_Keyless
      nv-datas:
        data Value: type=boolean
    Manuf_Assembly_Plant_Number
      nv-datas:
        data Value: type=Arr_u8_3
    Manuf_Equiped_PCB_Reference
      nv-datas:
        data Value: type=Arr_u8_5
    Manuf_Equiped_PCB_Revision
      nv-datas:
        data Value: type=Arr_u8_2
    Manuf_Equipped_PCB_Partnumber
      nv-datas:
        data Value: type=Arr_u8_18
    Manuf_PCB_Serial_Number
      nv-datas:
        data Value: type=Arr_u8_4
    Manuf_Product_Partnumber
      nv-datas:
        data Value: type=Arr_u8_18
    Manuf_Product_Reference
      nv-datas:
        data Value: type=Arr_u8_5
    Manuf_Product_Revision
      nv-datas:
        data Value: type=Arr_u8_2
    Manuf_SMD_Manufacturing_Date
      nv-datas:
        data Value: type=Arr_u8_8
    Manuf_SMD_Plant_Number
      nv-datas:
        data Value: type=Arr_u8_3
    Manuf_Traceability_PIM
      nv-datas:
        data Value: type=uint8
    Manuf_Traceability_Station_Nr
      nv-datas:
        data Value: type=Arr_u8_8
    Manufacturing_Mode
      nv-datas:
        data Value: type=uint8
    Manufacturing_PublicKey
      nv-datas:
        data Value: type=Arr_u8_32
    Manufacturing_SID
      nv-datas:
        data Value: type=Arr_u8_32
    Measured_Value_Max_Range_lx
      nv-datas:
        data Value: type=uint16
    Measured_Value_Max_lx
      nv-datas:
        data Value: type=uint16
    Measured_Value_Min_Range_lx
      nv-datas:
        data Value: type=uint16
    Measured_Value_Min_lx
      nv-datas:
        data Value: type=uint16
    NTC_TFT_Derating_step
      nv-datas:
        data Value: type=uint8
    NVM_BLOCK_IVD_0X0250
      nv-datas:
        data Value: type=Arr_u8_202
    NVM_BLOCK_SFD_ConfigurationFingerprint_Data
      nv-datas:
        data Value: type=Arr_u8_514
    NVM_BLOCK_SFD_PersistentData
      nv-datas:
        data Value: type=Arr_u8_30
    NVM_BLOCK_SFD_PublicKey
      nv-datas:
        data Value: type=Arr_u8_64
    NvM_VKMS
      nv-datas:
        data Value: type=Arr_u8_2
    Odometer_0
      nv-datas:
        data Value: type=Arr_u8_16
    Odometer_1
      nv-datas:
        data Value: type=Arr_u8_16
    Odometer_2
      nv-datas:
        data Value: type=Arr_u8_16
    Offset_Color_Blue
      nv-datas:
        data Value: type=sint8
    Offset_Color_Green
      nv-datas:
        data Value: type=sint8
    Offset_Color_Red
      nv-datas:
        data Value: type=sint8
    Oil_Elapsed_Days
      nv-datas:
        data Value: type=uint16
    Oil_Elapsed_Km
      nv-datas:
        data Value: type=uint32
    Oil_FixedNext_Days
      nv-datas:
        data Value: type=uint16
    Oil_FixedNext_Km
      nv-datas:
        data Value: type=uint16
    Oil_Quality
      nv-datas:
        data Value: type=uint8
    Oil_Reset
      nv-datas:
        data Value: type=uint8
    Oil_SootContamination_Sum
      nv-datas:
        data Value: type=uint32
    Oil_Theoretic_Km
      nv-datas:
        data Value: type=uint16
    Oil_ThermalWear_Sum
      nv-datas:
        data Value: type=uint32
    Oil_VariableMaxNext_Days
      nv-datas:
        data Value: type=uint16
    Oil_VariableMaxNext_Km
      nv-datas:
        data Value: type=uint16
    Oil_VariableMinNext_Days
      nv-datas:
        data Value: type=uint16
    Oil_VariableMinNext_Km
      nv-datas:
        data Value: type=uint16
    Old_Tank_Warning_Other_State_do_not_use
      nv-datas:
        data Value: type=uint8
    OperatingTimeStoredLSB
      nv-datas:
        data Value: type=uint32
    OperatingTimeStoredMSB
      nv-datas:
        data Value: type=uint8
    OutsideTemperature_Exclusive_DisplayArea
      nv-datas:
        data Value: type=boolean
    OutsideTemperature_Indication
      nv-datas:
        data Value: type=boolean
    Overheat_DIMM_primary
      nv-datas:
        data Value: type=uint8
    Overheat_DIMM_secondary
      nv-datas:
        data Value: type=uint8
    PCB_Hot_Spot_Threshold
      nv-datas:
        data Value: type=uint8
    PCB_Threshold1
      nv-datas:
        data Value: type=uint16
    PCB_Threshold2
      nv-datas:
        data Value: type=uint16
    PCB_Timer_Temp_Too_Hot
      nv-datas:
        data Value: type=uint8
    PCB_TrackResistance
      nv-datas:
        data Value: type=uint8
    PHEV_Statistic_Cycle
      nv-datas:
        data Value: type=uint8
    PHEV_Statistic_Distance
      nv-datas:
        data Value: type=uint8
    PSO_DataTag_USER_0
      nv-datas:
        data Value: type=Arr_u8_7
    PSO_DataTag_USER_1
      nv-datas:
        data Value: type=Arr_u8_7
    PSO_DataTag_USER_2
      nv-datas:
        data Value: type=Arr_u8_7
    PSO_DataTag_USER_3
      nv-datas:
        data Value: type=Arr_u8_7
    PSO_DataTag_USER_4
      nv-datas:
        data Value: type=Arr_u8_7
    PSO_DataTag_USER_5
      nv-datas:
        data Value: type=Arr_u8_7
    PSO_DataTag_USER_6
      nv-datas:
        data Value: type=Arr_u8_7
    PSO_DataTag_USER_7
      nv-datas:
        data Value: type=Arr_u8_7
    PTC_PCB_Derating_step
      nv-datas:
        data Value: type=uint8
    PWM_Damping_CurveSwitch
      nv-datas:
        data Value: type=uint16
    PWM_Display_X
      nv-datas:
        data Value: type=Arr_u16_6
    PWM_Display_Y
      nv-datas:
        data Value: type=Arr_u16_6
    PWM_Pointer_xd_X
      nv-datas:
        data Value: type=Arr_u16_6
    PWM_Pointer_xd_Y
      nv-datas:
        data Value: type=Arr_u16_6
    PWM_Pointer_xt_X
      nv-datas:
        data Value: type=Arr_u16_6
    PWM_Pointer_xt_Y
      nv-datas:
        data Value: type=Arr_u16_6
    Photosensor_Calib_Max_Lx
      nv-datas:
        data Value: type=uint16
    Photosensor_Calib_Max_Range_Lx
      nv-datas:
        data Value: type=uint16
    Photosensor_Calib_Min_Lx
      nv-datas:
        data Value: type=uint16
    Photosensor_Calib_Min_Range_Lx
      nv-datas:
        data Value: type=uint16
    Photosensor_Plausi_Threshold
      nv-datas:
        data Value: type=uint16
    Photosensor_available
      nv-datas:
        data Value: type=uint8
    Photosensor_enabled
      nv-datas:
        data Value: type=uint8
    Picture_Upload_Download
      nv-datas:
        data Value: type=boolean
    PointerType
      nv-datas:
        data Value: type=uint8
    Pointer_Kl_58xt_Kl_58xd
      nv-datas:
        data Value: type=uint8
    ProductionMode
      nv-datas:
        data Value: type=boolean
    ProgMarker
      nv-datas:
        data Value: type=uint8
    ProgReqFlag
      nv-datas:
        data Value: type=uint8
    QRS_Mode_Active
      nv-datas:
        data Value: type=boolean
    QuartzFrequencyOffset
      nv-datas:
        data Value: type=sint16
    RCC_IZ
      nv-datas:
        data Value: type=uint16
    RGB_Color_Calibration_PWM_AmbientLight_X
      nv-datas:
        data Value: type=Arr_u32_30
    RGB_Color_Calibration_PWM_AmbientLight_Y_Display
      nv-datas:
        data Value: type=Arr_u32_30
    RGB_Color_Calibration_PWM_AmbientLight_Y_Left
      nv-datas:
        data Value: type=Arr_u8_180
    RGB_Color_Calibration_PWM_AmbientLight_Y_Right
      nv-datas:
        data Value: type=Arr_u8_180
    ROE_Config
      nv-datas:
        data Value: type=Arr_u8_3
    RPM_Gauge_FIR_Coefficients
      nv-datas:
        data Value: type=Arr_u8_64
    RPM_Gauge_Hysteresis_Angle
      nv-datas:
        data Value: type=sint16
    RPM_Gauge_Magnetic_Offset
      nv-datas:
        data Value: type=uint8
    RangeAvgConsumption_High
      nv-datas:
        data Value: type=uint16
    RangeAvgConsumption_High_CNG
      nv-datas:
        data Value: type=uint16
    RangeAvgConsumption_High_LPG
      nv-datas:
        data Value: type=uint16
    Rate
      nv-datas:
        data Value: type=uint8
    Red_Gamma_Adjustment_Display1
      nv-datas:
        data Value: type=Arr_u8_27
    Red_Gamma_Adjustment_Display2
      nv-datas:
        data Value: type=Arr_u8_48
    RefulledVolume_Available
      nv-datas:
        data Value: type=boolean
    Reserved_1
      nv-datas:
        data Value: type=uint8
    Reserved_1_Bargraph_VAR
      nv-datas:
        data Value: type=uint8
    Reserved_1_DIAG_AC_IlluminationCfg_VAR_3
      nv-datas:
        data Value: type=Arr_u8_6
    Reserved_DIAG_AC_Curve_Scales_VAR
      nv-datas:
        data Value: type=Arr_u8_9
    Reserved_DIAG_AC_IlluminationCfg_VAR_0
      nv-datas:
        data Value: type=Arr_u8_6
    Reserved_DIAG_AC_IlluminationCfg_VAR_3
      nv-datas:
        data Value: type=Arr_u8_16
    ResetCounter_BURAMMarkerInvalid
      nv-datas:
        data Value: type=uint8
    ResetCounter_BuramChecksumError
      nv-datas:
        data Value: type=uint8
    ResetCounter_CSV_Error
      nv-datas:
        data Value: type=uint8
    ResetCounter_CTRL_App
      nv-datas:
        data Value: type=uint8
    ResetCounter_CTRL_Warning
      nv-datas:
        data Value: type=uint8
    ResetCounter_CXDR_ADC
      nv-datas:
        data Value: type=uint8
    ResetCounter_CXDR_DisplayMonitor
      nv-datas:
        data Value: type=uint8
    ResetCounter_CXDR_IOC
      nv-datas:
        data Value: type=uint8
    ResetCounter_CXDR_Illum
      nv-datas:
        data Value: type=uint8
    ResetCounter_CXDR_SafeTTMonitor
      nv-datas:
        data Value: type=uint8
    ResetCounter_CXDR_Sensors
      nv-datas:
        data Value: type=uint8
    ResetCounter_CXDR_Sound
      nv-datas:
        data Value: type=uint8
    ResetCounter_ClockMon
      nv-datas:
        data Value: type=uint8
    ResetCounter_DeepStopNotEntered
      nv-datas:
        data Value: type=uint8
    ResetCounter_Det_ErrorHook
      nv-datas:
        data Value: type=uint8
    ResetCounter_DpMainTaskError
      nv-datas:
        data Value: type=uint8
    ResetCounter_DpQueueError
      nv-datas:
        data Value: type=uint8
    ResetCounter_ECC_Error
      nv-datas:
        data Value: type=uint8
    ResetCounter_EcuMErrorHook
      nv-datas:
        data Value: type=uint8
    ResetCounter_EcuM_BswErrorHook
      nv-datas:
        data Value: type=uint8
    ResetCounter_EcuReset
      nv-datas:
        data Value: type=uint8
    ResetCounter_ErrorHook
      nv-datas:
        data Value: type=uint8
    ResetCounter_EventQueueError
      nv-datas:
        data Value: type=uint8
    ResetCounter_GuiQueueError
      nv-datas:
        data Value: type=uint8
    ResetCounter_HMITaskError
      nv-datas:
        data Value: type=uint8
    ResetCounter_IoHwAb
      nv-datas:
        data Value: type=uint8
    ResetCounter_JumpToZero
      nv-datas:
        data Value: type=uint8
    ResetCounter_LastResetReason
      nv-datas:
        data Value: type=uint32
    ResetCounter_MDL_BCCT
      nv-datas:
        data Value: type=uint8
    ResetCounter_MDL_CarModes
      nv-datas:
        data Value: type=uint8
    ResetCounter_MDL_Immobilizer
      nv-datas:
        data Value: type=uint8
    ResetCounter_MDL_SiWaLa
      nv-datas:
        data Value: type=uint8
    ResetCounter_MPU_Error
      nv-datas:
        data Value: type=uint8
    ResetCounter_POR
      nv-datas:
        data Value: type=uint8
    ResetCounter_ProtectionHook
      nv-datas:
        data Value: type=uint8
    ResetCounter_RamHashError
      nv-datas:
        data Value: type=uint8
    ResetCounter_RendererTaskError
      nv-datas:
        data Value: type=uint8
    ResetCounter_SRV_Cfg_Safety
      nv-datas:
        data Value: type=uint8
    ResetCounter_SRV_ComExt_Task50
      nv-datas:
        data Value: type=uint8
    ResetCounter_SRV_ComExt_TaskFast
      nv-datas:
        data Value: type=uint8
    ResetCounter_SRV_MemTest
      nv-datas:
        data Value: type=uint8
    ResetCounter_SRV_Monitor
      nv-datas:
        data Value: type=uint8
    ResetCounter_SRV_Power
      nv-datas:
        data Value: type=uint8
    ResetCounter_ShutdownHook
      nv-datas:
        data Value: type=uint8
    ResetCounter_StackMonitor
      nv-datas:
        data Value: type=uint8
    ResetCounter_TFT_alive
      nv-datas:
        data Value: type=uint8
    ResetCounter_TimeoutModule
      nv-datas:
        data Value: type=uint8
    ResetCounter_TmrFailure
      nv-datas:
        data Value: type=uint8
    ResetCounter_Trap
      nv-datas:
        data Value: type=uint8
    ResetCounter_Trap_GS
      nv-datas:
        data Value: type=uint8
    ResetCounter_VIEW_Sound
      nv-datas:
        data Value: type=uint8
    ResetCounter_WD
      nv-datas:
        data Value: type=uint8
    ResetCounter_WD_GS
      nv-datas:
        data Value: type=uint8
    ResetCounter_backlight
      nv-datas:
        data Value: type=uint8
    ResetResponseFlag
      nv-datas:
        data Value: type=uint8
    Rework_Param_1
      nv-datas:
        data Value: type=uint8
    Rework_Param_2
      nv-datas:
        data Value: type=uint8
    RightIndicatorErrorCounter
      nv-datas:
        data Value: type=uint8
    RightIndicatorErrorPath
      nv-datas:
        data Value: type=uint16
    RollTestStandMode
      nv-datas:
        data Value: type=boolean
    RunInMode_Config
      nv-datas:
        data Value: type=uint16
    RunInMode_Result
      nv-datas:
        data Value: type=uint16
    RunIn_FinalPointerPositions
      nv-datas:
        data Value: type=Arr_u16_4
    RunIn_FuelADC_Max
      nv-datas:
        data Value: type=uint8
    RunIn_FuelADC_Min
      nv-datas:
        data Value: type=uint8
    SFD_Group_Attribute
      nv-datas:
        data Value: type=Arr_u8_23
    SFD_Project_ID
      nv-datas:
        data Value: type=uint32
    SG_BusKnockout_Ctr
      nv-datas:
        data Value: type=uint8
    SG_BusKnockout_Tmr
      nv-datas:
        data Value: type=uint8
    SKey_Error_Counter
      nv-datas:
        data Value: type=uint16
    SRV_TKM_ZvCrH_TKM_ZvCrHPimTkKeyInCarNeed
      nv-datas:
        data Value: type=Arr_u8_16
    SSO_EdgeCount_Sum_lastmode
      nv-datas:
        data Value: type=uint32
    SWA_Telltales_Installed
      nv-datas:
        data Value: type=boolean
    SaveTimeDisplayOff
      nv-datas:
        data Value: type=uint8
    SaveTimeEngineOff
      nv-datas:
        data Value: type=uint16
    Scale_Luminosity_Calibration_PWM
      nv-datas:
        data Value: type=uint16
    Scales_DayResponseCurve
      nv-datas:
        data Value: type=uint8
    Scales_Day_X
      nv-datas:
        data Value: type=Arr_u16_6
    Scales_Day_Y
      nv-datas:
        data Value: type=Arr_u16_6
    Scales_Night_X
      nv-datas:
        data Value: type=Arr_u16_6
    Scales_Night_Y
      nv-datas:
        data Value: type=Arr_u16_6
    Seatbelt_Rear_Delaytime_acoustic
      nv-datas:
        data Value: type=uint8
    Seatbelt_Rear_Displaytime_buckle
      nv-datas:
        data Value: type=uint8
    Seatbelt_Rear_speed_blinking_off
      nv-datas:
        data Value: type=uint8
    Seatbelt_Rear_speed_blinking_on
      nv-datas:
        data Value: type=uint8
    Seatbelt_SBR_Installed
      nv-datas:
        data Value: type=uint8
    SecAccessDelayFlag
      nv-datas:
        data Value: type=uint8
    SecAccessInvalidCount
      nv-datas:
        data Value: type=uint8
    Security_InvalidKeyCounter
      nv-datas:
        data Value: type=uint8
    SegmentLengthList_Block1
      nv-datas:
        data Value: type=Arr_u8_4
    SegmentLengthList_Block2
      nv-datas:
        data Value: type=Arr_u8_4
    SegmentLengthList_Block3
      nv-datas:
        data Value: type=Arr_u8_4
    SegmentLengthList_Block4
      nv-datas:
        data Value: type=Arr_u8_4
    SegmentLengthList_Block5
      nv-datas:
        data Value: type=Arr_u8_4
    SegmentLengthList_Block6
      nv-datas:
        data Value: type=Arr_u8_4
    ServiceKey_Counter_Key_ID1
      nv-datas:
        data Value: type=uint16
    ServiceKey_Counter_Key_ID2
      nv-datas:
        data Value: type=uint16
    ServiceKey_Counter_Key_ID3
      nv-datas:
        data Value: type=uint16
    ServiceKey_Counter_Key_ID4
      nv-datas:
        data Value: type=uint16
    ServiceKey_Counter_Key_ID5
      nv-datas:
        data Value: type=uint16
    ServiceKey_Counter_Key_ID6
      nv-datas:
        data Value: type=uint16
    ServiceKey_Counter_Key_ID7
      nv-datas:
        data Value: type=uint16
    ServiceKey_Counter_Key_ID8
      nv-datas:
        data Value: type=uint16
    ServiceKey_Counter_Key_ID_Kessy
      nv-datas:
        data Value: type=uint16
    Service_Early_Warning_Prediction
      nv-datas:
        data Value: type=uint8
    Service_History
      nv-datas:
        data Value: type=Arr_u32_64
    Service_PreWarning_Days
      nv-datas:
        data Value: type=uint8
    Share_ASAM_ODXFileIdentifier_Old
      nv-datas:
        data Value: type=Arr_u8_21
    Share_ASAM_ODXFileIdentifier_obsolate
      nv-datas:
        data Value: type=Arr_u8_21
    Share_ASAM_ODXFileVersion_Old
      nv-datas:
        data Value: type=Arr_u8_6
    Share_BootloaderTPBlocksize
      nv-datas:
        data Value: type=uint8
    Share_ECUProgrammingInformation
      nv-datas:
        data Value: type=uint8
    Share_FDSProjectData
      nv-datas:
        data Value: type=Arr_u8_8
    Share_FblShareDataPartTwoReserved
      nv-datas:
        data Value: type=Arr_u8_76
    Share_Fingerprint_Block1
      nv-datas:
        data Value: type=Arr_u8_9
    Share_Fingerprint_Block2
      nv-datas:
        data Value: type=Arr_u8_9
    Share_Fingerprint_Block3
      nv-datas:
        data Value: type=Arr_u8_9
    Share_Fingerprint_Block4
      nv-datas:
        data Value: type=Arr_u8_9
    Share_Fingerprint_Block5
      nv-datas:
        data Value: type=Arr_u8_9
    Share_Fingerprint_Block6
      nv-datas:
        data Value: type=Arr_u8_9
    Share_InvalidKeyCounter
      nv-datas:
        data Value: type=uint8
    Share_ProgAttempts_Block1
      nv-datas:
        data Value: type=Arr_u8_2
    Share_ProgAttempts_Block2
      nv-datas:
        data Value: type=Arr_u8_2
    Share_ProgAttempts_Block3
      nv-datas:
        data Value: type=Arr_u8_2
    Share_ProgAttempts_Block4
      nv-datas:
        data Value: type=Arr_u8_2
    Share_ProgAttempts_Block5
      nv-datas:
        data Value: type=Arr_u8_2
    Share_ProgAttempts_Block6
      nv-datas:
        data Value: type=Arr_u8_2
    Share_VWECUHardwareNumber
      nv-datas:
        data Value: type=Arr_u8_11
    Share_VWECUHardwareNumber_Old
      nv-datas:
        data Value: type=Arr_u8_11
    Share_VWECUHardwareVersionNumber
      nv-datas:
        data Value: type=Arr_u8_3
    Share_VWECUHardwareVersionNumber_Old
      nv-datas:
        data Value: type=Arr_u8_3
    Share_VWFAZITIdentificationString
      nv-datas:
        data Value: type=Arr_u8_23
    Share_VWSparePartNumber
      nv-datas:
        data Value: type=Arr_u8_11
    Share_ValidityFlags
      nv-datas:
        data Value: type=uint8
    SiWalaACT_0xA00049
      nv-datas:
        data Value: type=uint8
    SiWalaActive_0xA00049
      nv-datas:
        data Value: type=uint8
    SiWalaExpState_0xA00049
      nv-datas:
        data Value: type=uint8
    SiWalaId_0xA00049
      nv-datas:
        data Value: type=uint8
    SlewRate
      nv-datas:
        data Value: type=uint8
    SpeedFastReading_X
      nv-datas:
        data Value: type=Arr_u16_10
    SpeedFastReading_Y
      nv-datas:
        data Value: type=Arr_u16_10
    SpeedThreshold
      nv-datas:
        data Value: type=uint8
    Speedo_Gauge_Hysteresis_Angle
      nv-datas:
        data Value: type=sint16
    Speedo_Gauge_Magnetic_Offset
      nv-datas:
        data Value: type=uint8
    SupplyVoltage_N1
      nv-datas:
        data Value: type=uint16
    SupplyVoltage_N2
      nv-datas:
        data Value: type=uint16
    SupplyVoltage_V1
      nv-datas:
        data Value: type=uint16
    SupplyVoltage_V2
      nv-datas:
        data Value: type=uint16
    SynchronizationTime_DriversDoor
      nv-datas:
        data Value: type=uint8
    TCO_Available
      nv-datas:
        data Value: type=boolean
    TFT_RGB_Gain
      nv-datas:
        data Value: type=Arr_u8_3
    TFT_Safety_Offset
      nv-datas:
        data Value: type=uint8
    TFT_Threshold1
      nv-datas:
        data Value: type=uint16
    TFT_Threshold2
      nv-datas:
        data Value: type=uint16
    TT_Green_Luminosity_Calibration_PWM
      nv-datas:
        data Value: type=uint16
    TT_Red_Luminosity_Calibration_PWM
      nv-datas:
        data Value: type=uint16
    TT_Yellow_Luminosity_Calibration_PWM
      nv-datas:
        data Value: type=uint16
    T_Mode_Active
      nv-datas:
        data Value: type=boolean
    Tank_Gauge_Magnetic_Offset
      nv-datas:
        data Value: type=uint8
    TaskListEntry1
      nv-datas:
        data Value: type=uint8
    TaskListEntry2
      nv-datas:
        data Value: type=uint8
    TaskListEntry3
      nv-datas:
        data Value: type=uint8
    TaskListEntry4
      nv-datas:
        data Value: type=uint8
    TaskListEntry5
      nv-datas:
        data Value: type=uint8
    Temp_Threshold_Max_QuartzTemp
      nv-datas:
        data Value: type=uint8
    Thermal_Timer1
      nv-datas:
        data Value: type=uint16
    Thermal_Timer2
      nv-datas:
        data Value: type=uint16
    Thermal_Timer3
      nv-datas:
        data Value: type=uint16
    TimeConstant
      nv-datas:
        data Value: type=uint8
    Time_TimeSource
      nv-datas:
        data Value: type=uint8
    TrGW_Function_Enable
      nv-datas:
        data Value: type=boolean
    TrendTime
      nv-datas:
        data Value: type=uint8
    Trend_Threshold
      nv-datas:
        data Value: type=uint8
    USER_PROFILE0
      nv-datas:
        data Value: type=Arr_u8_60
    USER_PROFILE1
      nv-datas:
        data Value: type=Arr_u8_60
    USER_PROFILE2
      nv-datas:
        data Value: type=Arr_u8_60
    USER_PROFILE3
      nv-datas:
        data Value: type=Arr_u8_60
    USER_PROFILE4
      nv-datas:
        data Value: type=Arr_u8_60
    USER_PROFILE5
      nv-datas:
        data Value: type=Arr_u8_60
    USER_PROFILE6
      nv-datas:
        data Value: type=Arr_u8_60
    USER_PROFILE7
      nv-datas:
        data Value: type=Arr_u8_60
    UnintendedMovement
      nv-datas:
        data Value: type=boolean
    Unit_KWh_per_mile_available
      nv-datas:
        data Value: type=boolean
    Unit_SpeedoScale
      nv-datas:
        data Value: type=boolean
    Unit_mpge_us_available
      nv-datas:
        data Value: type=boolean
    VCOM_Adjustment
      nv-datas:
        data Value: type=uint8
    VKMS_InitalKey_IS
      nv-datas:
        data Value: type=Arr_u8_32
    VKM_Range_Distance_Unclass
      nv-datas:
        data Value: type=uint8
    VKM_Range_RangeAvgConsumptiom_Default
      nv-datas:
        data Value: type=uint16
    VWLogicalSoftwareBlockVersion_EEP
      nv-datas:
        data Value: type=Arr_u8_4
    VWSoftwareVersionNumber
      nv-datas:
        data Value: type=Arr_u8_4
    VW_Data_Set_Number
      nv-datas:
        data Value: type=Arr_u8_11
    VW_Data_Set_Version
      nv-datas:
        data Value: type=Arr_u8_4
    VW_Workshop_System_Name
      nv-datas:
        data Value: type=Arr_u8_5
    V_Config_WarningThreshold1_Indien
      nv-datas:
        data Value: type=uint8
    V_Customer_Active
      nv-datas:
        data Value: type=boolean
    V_Customer_SpeedThreshold
      nv-datas:
        data Value: type=uint16
    V_Warning_Legal_India
      nv-datas:
        data Value: type=boolean
    Vehicle_Equipment_Code
      nv-datas:
        data Value: type=Arr_u8_12
    Vehicle_Network
      nv-datas:
        data Value: type=boolean
    VersionListEntry1
      nv-datas:
        data Value: type=Arr_u8_4
    VersionListEntry2
      nv-datas:
        data Value: type=Arr_u8_4
    VersionListEntry3
      nv-datas:
        data Value: type=Arr_u8_4
    VersionListEntry4
      nv-datas:
        data Value: type=Arr_u8_4
    VersionListEntry5
      nv-datas:
        data Value: type=Arr_u8_4
    VersionListFlash_Counter
      nv-datas:
        data Value: type=uint16
    VersionListIndex
      nv-datas:
        data Value: type=uint8
    WLTP_Concept
      nv-datas:
        data Value: type=boolean
    Whisper_Mode
      nv-datas:
        data Value: type=boolean
    Whisper_Mode_Loudness
      nv-datas:
        data Value: type=uint8
    WhitePointCorrectionMethod
      nv-datas:
        data Value: type=uint8
    Write_Delay_Speed
      nv-datas:
        data Value: type=uint8
    Write_Delay_Time
      nv-datas:
        data Value: type=uint8
    Write_Distance
      nv-datas:
        data Value: type=uint8
    Zero_Potential_Display_Active
      nv-datas:
        data Value: type=uint8
    Zreserved_Bargraph_VAR
      nv-datas:
        data Value: type=Arr_u8_12
    bap_bc_mfa_SpeedWarning_Speed_Unit
      nv-datas:
        data Value: type=uint8
    bap_bc_mfa_SpeedWarning_Speed_Value
      nv-datas:
        data Value: type=uint16
    bap_bc_mfa_SpeedWarning_State
      nv-datas:
        data Value: type=uint8
    bcme_consumer_available
      nv-datas:
        data Value: type=boolean
    bcme_consumption_unit
      nv-datas:
        data Value: type=uint8
    consum_correction_electro
      nv-datas:
        data Value: type=uint8
    counter_lost_communication_Distance
      nv-datas:
        data Value: type=uint32
    counter_lost_communication_EdgeCount
      nv-datas:
        data Value: type=uint32
    counter_lost_communication_clamp15
      nv-datas:
        data Value: type=uint16
    counter_lost_communication_time
      nv-datas:
        data Value: type=uint32
    da_3D_Geschw_verwenden
      nv-datas:
        data Value: type=boolean
    da_anzahl_tueren
      nv-datas:
        data Value: type=boolean
    da_gap_reset_tage
      nv-datas:
        data Value: type=boolean
    da_gap_tage
      nv-datas:
        data Value: type=sint16
    da_schalter_genaue_geschw
      nv-datas:
        data Value: type=boolean
    da_total_distance_pass_jump
      nv-datas:
        data Value: type=uint8
    distance_unit_default
      nv-datas:
        data Value: type=boolean
    dm_Balance_sheet_jumps_distance_pulse
      nv-datas:
        data Value: type=sint32
    dm_Biggest_negative_jump_distance_pulse
      nv-datas:
        data Value: type=uint32
    dm_Biggest_positive_jump_distance_pulse
      nv-datas:
        data Value: type=uint32
    dm_Esc_distance_pulse
      nv-datas:
        data Value: type=uint32
    dm_Longest_communication_failures_ESC
      nv-datas:
        data Value: type=uint16
    dm_Number_of_communication_failures_ESC
      nv-datas:
        data Value: type=uint16
    dm_Number_of_jumps_distance_pulse
      nv-datas:
        data Value: type=uint16
    dm_Sum_jumps_distance_pulse
      nv-datas:
        data Value: type=uint32
    dm_TimeStampDay
      nv-datas:
        data Value: type=uint8
    dm_TimeStampHour
      nv-datas:
        data Value: type=uint8
    dm_TimeStampMinute
      nv-datas:
        data Value: type=uint8
    dm_TimeStampMonth
      nv-datas:
        data Value: type=uint8
    dm_TimeStampSecond
      nv-datas:
        data Value: type=uint8
    dm_TimeStampYear
      nv-datas:
        data Value: type=uint16
    dm_Total_duration_communication_failures_ESC
      nv-datas:
        data Value: type=uint32
    dm_error_calculation_dates
      nv-datas:
        data Value: type=uint8
    dm_error_secure_storage_AR
      nv-datas:
        data Value: type=uint8
    dm_total_distance
      nv-datas:
        data Value: type=uint32
    edv_charge_suppress
      nv-datas:
        data Value: type=boolean
    ego_fahrzeug
      nv-datas:
        data Value: type=Arr_u8_16
    gap_FIFO_Day
      nv-datas:
        data Value: type=Arr_u8_5
    gap_FIFO_Distance
      nv-datas:
        data Value: type=Arr_u32_5
    gap_FIFO_Month
      nv-datas:
        data Value: type=Arr_u8_5
    gap_FIFO_NumberResets
      nv-datas:
        data Value: type=Arr_u8_5
    gap_FIFO_TimeLastGAP
      nv-datas:
        data Value: type=Arr_u16_5
    gap_FIFO_Year
      nv-datas:
        data Value: type=Arr_u8_5
    gap_mfa_max
      nv-datas:
        data Value: type=uint16
    gap_mfa_min
      nv-datas:
        data Value: type=boolean
    gap_tage_default
      nv-datas:
        data Value: type=uint16
    gap_vorhanden
      nv-datas:
        data Value: type=boolean
    gastank_warnung_cng_LED
      nv-datas:
        data Value: type=uint8
    glaettungsfaktor_g
      nv-datas:
        data Value: type=uint8
    hmi_anteil_gas_aktiv
      nv-datas:
        data Value: type=uint8
    hmi_t_RearBelt
      nv-datas:
        data Value: type=uint8
    kombi_variante_e_traktion
      nv-datas:
        data Value: type=uint8
    lautstaerke_offset
      nv-datas:
        data Value: type=uint8
    negative_calculations_allowed
      nv-datas:
        data Value: type=boolean
    offroad
      nv-datas:
        data Value: type=uint8
    p_BR_Systemart
      nv-datas:
        data Value: type=uint8
    p_Bargraph_Luminosity_Calibration_PWM
      nv-datas:
        data Value: type=Arr_u8_4
    p_Hmi_TripDistance_Max_Km
      nv-datas:
        data Value: type=uint32
    p_Hmi_TripDistance_Max_Miles
      nv-datas:
        data Value: type=uint32
    p_Oil_Exceeded_Days
      nv-datas:
        data Value: type=uint16
    p_Oil_Exceeded_Km
      nv-datas:
        data Value: type=uint16
    p_PWM_DampingCurve
      nv-datas:
        data Value: type=uint16
    p_Perso_NumberOfUserProfiles
      nv-datas:
        data Value: type=uint8
    p_canrw_initzeit
      nv-datas:
        data Value: type=uint8
    p_kilometerstand_last_value
      nv-datas:
        data Value: type=uint32
    p_kilometerstand_last_value_obsolete
      nv-datas:
        data Value: type=uint32
    p_mute_delay
      nv-datas:
        data Value: type=uint8
    personalisation_2x_active
      nv-datas:
        data Value: type=boolean
    primary_engine_type
      nv-datas:
        data Value: type=uint8
    rawVIN_lastmode
      nv-datas:
        data Value: type=Arr_u8_18
    rawVin_change_in_clamp15_lastmode
      nv-datas:
        data Value: type=uint8
    rw_calc_time
      nv-datas:
        data Value: type=uint8
    rw_fahrzg_faehrt
      nv-datas:
        data Value: type=uint8
    rw_fahrzg_steht
      nv-datas:
        data Value: type=uint8
    secondary_engine_type
      nv-datas:
        data Value: type=uint8
    size_n
      nv-datas:
        data Value: type=uint8
    skinning
      nv-datas:
        data Value: type=uint8
    sperrung_AnzahlListeneintraege
      nv-datas:
        data Value: type=uint8
    sperrung_CarDecorator
      nv-datas:
        data Value: type=uint8
    sperrung_Karte
      nv-datas:
        data Value: type=uint8
    sperrung_NPSCoverIntensitaet
      nv-datas:
        data Value: type=uint8
    sperrung_PiloFahrt
      nv-datas:
        data Value: type=uint8
    sperrung_bedienunterstuetzende_animationen
      nv-datas:
        data Value: type=uint8
    sperrung_dynamische_bilder
      nv-datas:
        data Value: type=uint8
    sperrung_funktionale_animationen
      nv-datas:
        data Value: type=uint8
    sperrung_funktionslisten
      nv-datas:
        data Value: type=uint8
    sperrung_infotainmentlisten
      nv-datas:
        data Value: type=uint8
    sperrung_listentimeout
      nv-datas:
        data Value: type=uint32
    sperrung_mfa_anzeigen
      nv-datas:
        data Value: type=uint8
    sperrung_schmuckanimationen
      nv-datas:
        data Value: type=uint8
    sperrung_systemzustandsanimationen
      nv-datas:
        data Value: type=uint8
    sport
      nv-datas:
        data Value: type=uint8
    t_Celeb_Pause_Until_EndDim_Scale
      nv-datas:
        data Value: type=uint16
    t_DisplayDelay_KL15Off
      nv-datas:
        data Value: type=uint16
    t_DisplayDelay_KL15On
      nv-datas:
        data Value: type=uint16
    t_Max_Delay_CLWError
      nv-datas:
        data Value: type=uint8
    tachoendwert
      nv-datas:
        data Value: type=uint8
    total_distance_jump_is_valid
      nv-datas:
        data Value: type=uint8
    total_distance_pass_jump
      nv-datas:
        data Value: type=boolean
    total_distance_pass_jump_lastmode
      nv-datas:
        data Value: type=uint8
    total_distance_sum_implaus_jump_high_ESP
      nv-datas:
        data Value: type=uint32
    total_distance_sum_implaus_jump_low_ESP
      nv-datas:
        data Value: type=uint32
    tuben_darstellung
      nv-datas:
        data Value: type=uint8
    vehicle_type
      nv-datas:
        data Value: type=uint8
    verlassenswarnung_VWN
      nv-datas:
        data Value: type=boolean
    vkmrw_Verbrauchsaequivalent
      nv-datas:
        data Value: type=uint8
    vkmrw_Verbrauchsaequivalent_ein
      nv-datas:
        data Value: type=uint8
    vkmrw_gesamtreichweite_vorhanden
      nv-datas:
        data Value: type=uint8
    vkmrw_rwdv_cng_default
      nv-datas:
        data Value: type=uint16
    vkmrw_rwdv_lpg_default
      nv-datas:
        data Value: type=uint16
    vkmrw_verbrauchsfaktor_kombi
      nv-datas:
        data Value: type=uint8
    wheel_circumference_lastmode
      nv-datas:
        data Value: type=uint16
    zIniSwVer
      nv-datas:
        data Value: type=uint8
    zIniSwVer_COMPONENTS_Cfg_CONST
      nv-datas:
        data Value: type=uint8
    zIniSwVer_DIAG_VariantCoding_CONST
      nv-datas:
        data Value: type=uint8
    zReservedAligmnet_DIAG_EOL_HWCalib_CONST
      nv-datas:
        data Value: type=boolean
    zReserved_1_COMPONENTS_Cfg_CONST
      nv-datas:
        data Value: type=uint8
    zReserved_1_COMPONENTS_Cfg_VAR
      nv-datas:
        data Value: type=Arr_u8_4
    zReserved_1_Com_Cfg_VAR
      nv-datas:
        data Value: type=Arr_u8_8
    zReserved_1_DIAG_EOL_DiagCfg_CONST
      nv-datas:
        data Value: type=Arr_u8_6
    zReserved_1_DIAG_VariantCodingCheck_CONST
      nv-datas:
        data Value: type=Arr_u8_5
    zReserved_1_DIAG_VariantCoding_CONST
      nv-datas:
        data Value: type=Arr_u8_8
    zReserved_2_DIAG_VariantCodingCheck_CONST
      nv-datas:
        data Value: type=Arr_u8_3
    zReserved_2_TANK_Variant_CONST
      nv-datas:
        data Value: type=uint8
    zReserved_3_TANK_Variant_CONST
      nv-datas:
        data Value: type=Arr_u8_10
    zReserved_Bcct_Cfg_VAR_1
      nv-datas:
        data Value: type=Arr_u8_4
    zReserved_CAN_VAR
      nv-datas:
        data Value: type=Arr_u8_3
    zReserved_COMPONENTS_Cfg_CONST
      nv-datas:
        data Value: type=Arr_u8_8
    zReserved_COMPONENTS_Cfg_VAR
      nv-datas:
        data Value: type=boolean
    zReserved_Cluster_Settings
      nv-datas:
        data Value: type=Arr_u8_5
    zReserved_Com_Cfg_VAR
      nv-datas:
        data Value: type=Arr_u8_5
    zReserved_DEV_Messages
      nv-datas:
        data Value: type=Arr_u8_7
    zReserved_DIAG_AC_IlluminationCfg_1_VAR
      nv-datas:
        data Value: type=Arr_u8_14
    zReserved_DIAG_AC_ServiceCfg_VAR
      nv-datas:
        data Value: type=Arr_u8_2
    zReserved_DIAG_AdaptationChannel_VAR_2
      nv-datas:
        data Value: type=Arr_u8_8
    zReserved_DIAG_EOL_DiagCfg_CONST
      nv-datas:
        data Value: type=Arr_u8_2
    zReserved_DIAG_EOL_HWCalib_CONST
      nv-datas:
        data Value: type=Arr_u8_4
    zReserved_DIAG_EOL_HWCalib_CONST_1
      nv-datas:
        data Value: type=Arr_u8_36
    zReserved_DIAG_EOL_VAR
      nv-datas:
        data Value: type=Arr_u8_3
    zReserved_DIAG_VariantCodingCheck_CONST
      nv-datas:
        data Value: type=Arr_u8_51
    zReserved_DIAG_VariantCoding_CONST_Handle
      nv-datas:
        data Value: type=Arr_u8_32
    zReserved_Diag_Adjustment_VAR
      nv-datas:
        data Value: type=Arr_u8_18
    zReserved_Gamma_Adjustment_VAR
      nv-datas:
        data Value: type=Arr_u8_17
    zReserved_Nvm_Block_Reserved_1
      nv-datas:
        data Value: type=Arr_u8_8
    zReserved_Nvm_Block_Reserved_4
      nv-datas:
        data Value: type=Arr_u8_27
    zReserved_OperatingTime_VAR
      nv-datas:
        data Value: type=Arr_u8_7
    zReserved_REFUEL_Logger_VAR
      nv-datas:
        data Value: type=Arr_u8_8
    zReserved_RGB_Calibration_VAR
      nv-datas:
        data Value: type=Arr_u8_12
    zReserved_Recorder_VAR
      nv-datas:
        data Value: type=uint8
    zReserved_Recorder_VAR_2
      nv-datas:
        data Value: type=Arr_u8_6
    zReserved_SAFETY_RECORD_VAR
      nv-datas:
        data Value: type=Arr_u8_4
    zReserved_SecDiag
      nv-datas:
        data Value: type=Arr_u8_27
    zReserved_ServiceKey_VAR
      nv-datas:
        data Value: type=Arr_u8_8
    zReserved_WLTP_Odo
      nv-datas:
        data Value: type=Arr_u8_15
    zReserveed_Bcct_Cfg_VAR_2
      nv-datas:
        data Value: type=Arr_u8_8
    zweitgeschwindigkeit_einheitenwechsel
      nv-datas:
        data Value: type=uint8
package /ARRoot/Types
  94 x impl type, all with category=STRUCTURE, sw-calibration-access=READ-ONLY, dynamic-array-size-profile=None:
    NV_Data_Bargraph_Hysteresis_Coolant
      element Bargraph_Hysteresis_Coolant: implementation-data-type=Arr_u8_15
    NV_Data_Bargraph_Treshold_Switch_Coolant
      element Bargraph_Treshold_Switch_Coolant: implementation-data-type=Arr_u8_15
    NV_Data_Bargraph_VAR
      9 x element, all with category=TYPE_REFERENCE:
        DisplayDamping_On_Bargraph_Tank: implementation-data-type=uint8
        DisplayDamping_Off_Bargraph_Tank: implementation-data-type=uint8
        Reserved_1_Bargraph_VAR: implementation-data-type=uint8
        Old_Tank_Warning_Other_State_do_not_use: implementation-data-type=uint8
        Bargraph_Primary_Engine_Type: implementation-data-type=uint8
        Bargraph_Secondary_Engine_Type: implementation-data-type=uint8
        Damping_Indic_Coolnt_Bargrph_ON: implementation-data-type=uint8
        Damping_Indic_Coolnt_Bargrph_OFF: implementation-data-type=uint8
        Zreserved_Bargraph_VAR: implementation-data-type=Arr_u8_12
    NV_Data_Bcct_Cfg_VAR_1
      element RGB_Color_Calibration_PWM_AmbientLight_X: implementation-data-type=Arr_u32_30
      element zReserved_Bcct_Cfg_VAR_1: implementation-data-type=Arr_u8_4
    NV_Data_Bcct_Cfg_VAR_2
      9 x element, all with category=TYPE_REFERENCE:
        BCCT_Lookup_Curve_AmbientLight_Dimming_Coef_X: implementation-data-type=Arr_u8_6
        BCCT_Lookup_Curve_AmbientLight_Dimming_Coef_Y: implementation-data-type=Arr_u8_6
        BCCT_Lookup_Curve_AmbientLight_Left_Temp_Coef_X: implementation-data-type=Arr_u8_6
        BCCT_Lookup_Curve_AmbientLight_Left_Temp_Coef_Y: implementation-data-type=Arr_u8_6
        BCCT_Lookup_Curve_AmbientLight_Right_Temp_Coef_X: implementation-data-type=Arr_u8_6
        BCCT_Lookup_Curve_AmbientLight_Right_Temp_Coef_Y: implementation-data-type=Arr_u8_6
        BCCT_Temperature_Sensor_AmbientLight_Conv_X: implementation-data-type=Arr_u16_32
        BCCT_Temperature_Sensor_AmbientLight_Conv_Y: implementation-data-type=Arr_u8_32
        zReserveed_Bcct_Cfg_VAR_2: implementation-data-type=Arr_u8_8
    NV_Data_Bcct_Cfg_VAR_3
      element RGB_Color_Calibration_PWM_AmbientLight_Y_Display: implementation-data-type=Arr_u32_30
    NV_Data_CAN_VAR
      element CanBusActive: implementation-data-type=boolean
      element zReserved_CAN_VAR: implementation-data-type=Arr_u8_3
    NV_Data_COMPONENTS_Cfg_CONST
      40 x element, all with category=TYPE_REFERENCE:
        Brightness_Photosensor_Cal_Init: implementation-data-type=uint8
        Cluster_Variant_Canada: implementation-data-type=boolean
        Brightness_Photosensor_Damp_Dimm_Down: implementation-data-type=uint16
        Brightness_Photosensor_Damp_Dimm_Up: implementation-data-type=uint16
        COMPONENTS_Cfg_CONST_Safety_CRC: implementation-data-type=uint16
        RunIn_FinalPointerPositions: implementation-data-type=Arr_u16_4
        SpeedFastReading_X: implementation-data-type=Arr_u16_10
        SpeedFastReading_Y: implementation-data-type=Arr_u16_10
        BAP_BC_MFA_FSG_Setup_Status_PrimaryEngineType: implementation-data-type=uint8
        Brand_Info: implementation-data-type=uint8
        Cluster_Variant: implementation-data-type=uint8
        Cluster_Variant_ASIA: implementation-data-type=uint8
        Cluster_Variant_CHINA: implementation-data-type=uint8
        Cluster_Variant_USA: implementation-data-type=uint8
        Display_Type: implementation-data-type=uint8
        ego_fahrzeug: implementation-data-type=Arr_u8_16
        Fuel_Consumption_Min: implementation-data-type=uint8
        zReserved_COMPONENTS_Cfg_CONST: implementation-data-type=Arr_u8_8
        Photosensor_available: implementation-data-type=uint8
        RunIn_FuelADC_Max: implementation-data-type=uint8
        RunIn_FuelADC_Min: implementation-data-type=uint8
        Service_Early_Warning_Prediction: implementation-data-type=uint8
        t_Max_Delay_CLWError: implementation-data-type=uint8
        Analog_CoolantTemperature_Available: implementation-data-type=boolean
        Cluster_Variant_FBU: implementation-data-type=boolean
        Immo_Individual_Schluessel_Fahrberecht: implementation-data-type=boolean
        LIM_Display_Available: implementation-data-type=boolean
        OutsideTemperature_Exclusive_DisplayArea: implementation-data-type=boolean
        SWA_Telltales_Installed: implementation-data-type=boolean
        UnintendedMovement: implementation-data-type=boolean
        Unit_SpeedoScale: implementation-data-type=boolean
        p_canrw_initzeit: implementation-data-type=uint8
        p_Perso_NumberOfUserProfiles: implementation-data-type=uint8
        total_distance_pass_jump: implementation-data-type=boolean
        WLTP_Concept: implementation-data-type=boolean
        da_anzahl_tueren: implementation-data-type=boolean
        zReserved_1_COMPONENTS_Cfg_CONST: implementation-data-type=uint8
        zIniSwVer_COMPONENTS_Cfg_CONST: implementation-data-type=uint8
        p_Hmi_TripDistance_Max_Km: implementation-data-type=uint32
        p_Hmi_TripDistance_Max_Miles: implementation-data-type=uint32
    NV_Data_COMPONENTS_Cfg_VAR
      39 x element, all with category=TYPE_REFERENCE:
        BAP_BC_MFA_ExternalFunctionControl_Set_Controlcode: implementation-data-type=uint16
        BAP_BC_MFA_ExternalFunctionControl_Status_Installation: implementation-data-type=uint16
        COMPONENTS_Cfg_VAR_Safety_CRC: implementation-data-type=uint16
        Immo_DtcLastTestResult: implementation-data-type=uint16
        V_Customer_SpeedThreshold: implementation-data-type=uint16
        BAP_BC_MFA_FSG_Setup_Status_Installation1: implementation-data-type=uint8
        BAP_BC_MFA_FSG_Setup_Status_Installation2: implementation-data-type=uint8
        BAP_BC_MFA_FSG_Setup_Status_SecondaryEngineType: implementation-data-type=uint8
        BAP_BC_MFA_MenueSetup_Status_Menue1_1: implementation-data-type=uint8
        BAP_BC_MFA_MenueSetup_Status_Menue1_2: implementation-data-type=uint8
        BAP_BC_MFA_MenueSetup_Status_Menue2_1: implementation-data-type=uint8
        BAP_BC_MFA_MenueSetup_Status_Menue2_2: implementation-data-type=uint8
        BAP_BC_MFA_MenueSetup_Status_Menue3_1: implementation-data-type=uint8
        BAP_BC_MFA_MenueSetup_Status_Menue3_2: implementation-data-type=uint8
        BAP_BC_MFA_MenueSetup_Status_Special: implementation-data-type=uint8
        bcme_consumption_unit: implementation-data-type=uint8
        DLS_Auto_Day: implementation-data-type=uint8
        DLS_Auto_Hour: implementation-data-type=uint8
        DLS_Auto_Minute: implementation-data-type=uint8
        DLS_Auto_Month: implementation-data-type=uint8
        DLS_Auto_State: implementation-data-type=uint8
        EMSG_Mode_Active: implementation-data-type=uint8
        p_BR_Systemart: implementation-data-type=uint8
        primary_engine_type: implementation-data-type=uint8
        ROE_Config: implementation-data-type=Arr_u8_3
        secondary_engine_type: implementation-data-type=uint8
        Time_TimeSource: implementation-data-type=uint8
        vehicle_type: implementation-data-type=uint8
        bcme_consumer_available: implementation-data-type=boolean
        Hmi_Variant: implementation-data-type=boolean
        MFL_Valid: implementation-data-type=boolean
        QRS_Mode_Active: implementation-data-type=boolean
        T_Mode_Active: implementation-data-type=boolean
        V_Customer_Active: implementation-data-type=boolean
        Unit_KWh_per_mile_available: implementation-data-type=boolean
        Unit_mpge_us_available: implementation-data-type=boolean
        zReserved_COMPONENTS_Cfg_VAR: implementation-data-type=boolean
        p_kilometerstand_last_value: implementation-data-type=uint32
        zReserved_1_COMPONENTS_Cfg_VAR: implementation-data-type=Arr_u8_4
    NV_Data_Cluster_Settings
      16 x element, all with category=TYPE_REFERENCE:
        Actual_Language: implementation-data-type=uint8
        Celeb_DimOffset_Scale: implementation-data-type=uint8
        t_Celeb_Pause_Until_EndDim_Scale: implementation-data-type=uint16
        Celeb_EndDim_Scale_Curve_X: implementation-data-type=Arr_u8_8
        Celeb_EndDim_Scale_Curve_Y: implementation-data-type=Arr_u8_8
        Celeb_PreStart_Scale_Curve_X: implementation-data-type=Arr_u8_6
        Celeb_PreStart_Scale_Curve_Y: implementation-data-type=Arr_u8_6
        Celeb_StartDim_Scale_Curve_X: implementation-data-type=Arr_u8_8
        Celeb_StartDim_Scale_Curve_Y: implementation-data-type=Arr_u8_8
        da_3D_Geschw_verwenden: implementation-data-type=boolean
        da_schalter_genaue_geschw: implementation-data-type=boolean
        BlockInfo_EEP_Units: implementation-data-type=uint8
        BlockInfo_EEP_Engine: implementation-data-type=uint8
        BlockInfo_EEP_Platform: implementation-data-type=uint16
        BlockInfo_EEP_Market: implementation-data-type=uint8
        zReserved_Cluster_Settings: implementation-data-type=Arr_u8_5
    NV_Data_Com_Cfg_VAR
      55 x element, all with category=TYPE_REFERENCE:
        zIniSwVer: implementation-data-type=uint8
        verlassenswarnung_VWN: implementation-data-type=boolean
        ConfigWarning_Schwelle1_Indien: implementation-data-type=uint16
        Compensation_Line_Slope_m: implementation-data-type=uint32
        Compensation_Line_Shift_b: implementation-data-type=uint16
        Brightness_Photosensor_Cal_Error: implementation-data-type=uint16
        Zero_Potential_Display_Active: implementation-data-type=uint8
        Knockout_Ctr: implementation-data-type=uint8
        SG_BusKnockout_Ctr: implementation-data-type=uint8
        MO_StartStop_Coded: implementation-data-type=boolean
        tuben_darstellung: implementation-data-type=uint8
        Display_FPA: implementation-data-type=uint8
        zweitgeschwindigkeit_einheitenwechsel: implementation-data-type=uint8
        offroad: implementation-data-type=uint8
        sperrung_infotainmentlisten: implementation-data-type=uint8
        sperrung_funktionslisten: implementation-data-type=uint8
        sperrung_mfa_anzeigen: implementation-data-type=uint8
        sperrung_dynamische_bilder: implementation-data-type=uint8
        sperrung_funktionale_animationen: implementation-data-type=uint8
        sperrung_schmuckanimationen: implementation-data-type=uint8
        sperrung_systemzustandsanimationen: implementation-data-type=uint8
        sperrung_bedienunterstuetzende_animationen: implementation-data-type=uint8
        sperrung_listentimeout: implementation-data-type=uint32
        sperrung_Karte: implementation-data-type=uint8
        sperrung_CarDecorator: implementation-data-type=uint8
        sperrung_PiloFahrt: implementation-data-type=uint8
        sperrung_NPSCoverIntensitaet: implementation-data-type=uint8
        sperrung_AnzahlListeneintraege: implementation-data-type=uint8
        sport: implementation-data-type=uint8
        glaettungsfaktor_g: implementation-data-type=uint8
        size_n: implementation-data-type=uint8
        TCO_Available: implementation-data-type=boolean
        PHEV_Statistic_Cycle: implementation-data-type=uint8
        PHEV_Statistic_Distance: implementation-data-type=uint8
        kombi_variante_e_traktion: implementation-data-type=uint8
        Knockout_Tmr: implementation-data-type=uint8
        SG_BusKnockout_Tmr: implementation-data-type=uint8
        PCB_Hot_Spot_Threshold: implementation-data-type=uint8
        Hot_Spot_Temp_Dimm_Time: implementation-data-type=uint8
        PCB_Timer_Temp_Too_Hot: implementation-data-type=uint8
        p_mute_delay: implementation-data-type=uint8
        TFT_RGB_Gain: implementation-data-type=Arr_u8_3
        BootloaderTPBlocksize: implementation-data-type=uint8
        Security_InvalidKeyCounter: implementation-data-type=uint8
        Default_AmbientLight_Color_index: implementation-data-type=uint8
        BAP_BC_MFA_Statistics_distance_ZE: implementation-data-type=boolean
        BAP_BC_MFA_Statistics_distance_currentInterval_ZE: implementation-data-type=boolean
        RangeAvgConsumption_High_CNG: implementation-data-type=uint16
        zReserved_1_Com_Cfg_VAR: implementation-data-type=Arr_u8_8
        FAZIT_Number: implementation-data-type=Arr_u8_23
        consum_correction_electro: implementation-data-type=uint8
        edv_charge_suppress: implementation-data-type=boolean
        negative_calculations_allowed: implementation-data-type=boolean
        Default_AmbientLight_Color_CHINA_index: implementation-data-type=uint8
        zReserved_Com_Cfg_VAR: implementation-data-type=Arr_u8_5
    NV_Data_DATE_VAR
      element Date_Year: implementation-data-type=uint16
      element Date_Day: implementation-data-type=uint8
      element Date_Month: implementation-data-type=uint8
    NV_Data_DIAG_AC_Curve_Scales_VAR
      7 x element, all with category=TYPE_REFERENCE:
        Scales_Day_X: implementation-data-type=Arr_u16_6
        Scales_Day_Y: implementation-data-type=Arr_u16_6
        Scales_Night_X: implementation-data-type=Arr_u16_6
        Scales_Night_Y: implementation-data-type=Arr_u16_6
        Scale_Luminosity_Calibration_PWM: implementation-data-type=uint16
        FPK_zeigerdaempfung_drehzahl: implementation-data-type=boolean
        Reserved_DIAG_AC_Curve_Scales_VAR: implementation-data-type=Arr_u8_9
    NV_Data_DIAG_AC_IlluminationCfg_VAR_0
      8 x element, all with category=TYPE_REFERENCE:
        PWM_Display_X: implementation-data-type=Arr_u16_6
        PWM_Display_Y: implementation-data-type=Arr_u16_6
        PWM_Pointer_xd_X: implementation-data-type=Arr_u16_6
        PWM_Pointer_xd_Y: implementation-data-type=Arr_u16_6
        TT_Red_Luminosity_Calibration_PWM: implementation-data-type=uint16
        TT_Green_Luminosity_Calibration_PWM: implementation-data-type=uint16
        TT_Yellow_Luminosity_Calibration_PWM: implementation-data-type=uint16
        Reserved_DIAG_AC_IlluminationCfg_VAR_0: implementation-data-type=Arr_u8_6
    NV_Data_DIAG_AC_IlluminationCfg_VAR_1
      12 x element, all with category=TYPE_REFERENCE:
        PWM_Damping_CurveSwitch: implementation-data-type=uint16
        PWM_Pointer_xt_X: implementation-data-type=Arr_u16_6
        PWM_Pointer_xt_Y: implementation-data-type=Arr_u16_6
        Debouncing_AutomaticDrivingLight: implementation-data-type=uint8
        Debouncing_FogLight: implementation-data-type=uint8
        Debouncing_LowBeam: implementation-data-type=uint8
        Debouncing_Sidelight: implementation-data-type=uint8
        Pointer_Kl_58xt_Kl_58xd: implementation-data-type=uint8
        Scales_DayResponseCurve: implementation-data-type=uint8
        p_PWM_DampingCurve: implementation-data-type=uint16
        p_Bargraph_Luminosity_Calibration_PWM: implementation-data-type=Arr_u8_4
        zReserved_DIAG_AC_IlluminationCfg_1_VAR: implementation-data-type=Arr_u8_14
    NV_Data_DIAG_AC_IlluminationCfg_VAR_3
      18 x element, all with category=TYPE_REFERENCE:
        Reserved_DIAG_AC_IlluminationCfg_VAR_3: implementation-data-type=Arr_u8_16
        IllumThreshold_CRC: implementation-data-type=uint16
        Overheat_DIMM_primary: implementation-data-type=uint8
        TFT_Threshold1: implementation-data-type=uint16
        TFT_Threshold2: implementation-data-type=uint16
        Temp_Threshold_Max_QuartzTemp: implementation-data-type=uint8
        PCB_Threshold1: implementation-data-type=uint16
        Rate: implementation-data-type=uint8
        PCB_Threshold2: implementation-data-type=uint16
        Overheat_DIMM_secondary: implementation-data-type=uint8
        Photosensor_enabled: implementation-data-type=uint8
        Compensation_Line_Slope_m_Left: implementation-data-type=uint32
        Compensation_Line_Shift_b_Left: implementation-data-type=uint16
        Compensation_Line_Slope_m_Right: implementation-data-type=uint32
        Compensation_Line_Shift_b_Right: implementation-data-type=uint16
        Photosensor_Plausi_Threshold: implementation-data-type=uint16
        TFT_Safety_Offset: implementation-data-type=uint8
        Reserved_1_DIAG_AC_IlluminationCfg_VAR_3: implementation-data-type=Arr_u8_6
    NV_Data_DIAG_AC_ServiceCfg_VAR
      25 x element, all with category=TYPE_REFERENCE:
        Oil_Elapsed_Km: implementation-data-type=uint32
        Oil_SootContamination_Sum: implementation-data-type=uint32
        Oil_ThermalWear_Sum: implementation-data-type=uint32
        DailyMileage: implementation-data-type=uint16
        Inspection_Elapsed_Days: implementation-data-type=uint16
        Inspection_Elapsed_Km: implementation-data-type=uint16
        Inspection_MaxNext_Days: implementation-data-type=uint16
        Inspection_MaxNext_Km: implementation-data-type=uint16
        Inspection_ResetValue_Days: implementation-data-type=uint16
        Inspection_ResetValue_Km: implementation-data-type=uint16
        Oil_Elapsed_Days: implementation-data-type=uint16
        Oil_FixedNext_Days: implementation-data-type=uint16
        Oil_FixedNext_Km: implementation-data-type=uint16
        Oil_Theoretic_Km: implementation-data-type=uint16
        Oil_VariableMaxNext_Days: implementation-data-type=uint16
        Oil_VariableMaxNext_Km: implementation-data-type=uint16
        Oil_VariableMinNext_Days: implementation-data-type=uint16
        Oil_VariableMinNext_Km: implementation-data-type=uint16
        p_Oil_Exceeded_Days: implementation-data-type=uint16
        p_Oil_Exceeded_Km: implementation-data-type=uint16
        Oil_Quality: implementation-data-type=uint8
        Oil_Reset: implementation-data-type=uint8
        Service_PreWarning_Days: implementation-data-type=uint8
        Coolant_Cold_Indication_Present: implementation-data-type=boolean
        zReserved_DIAG_AC_ServiceCfg_VAR: implementation-data-type=Arr_u8_2
    NV_Data_DIAG_AdaptationChannel_VAR_0
      45 x element, all with category=TYPE_REFERENCE:
        bap_bc_mfa_SpeedWarning_Speed_Value: implementation-data-type=uint16
        DIAG_AdaptationChannel_VAR_0_Safety_CRC: implementation-data-type=uint16
        Fuel_Calib_Vol_Dead: implementation-data-type=uint16
        Fuel_Calib_Vol_Filled: implementation-data-type=uint16
        RangeAvgConsumption_High: implementation-data-type=uint16
        t_DisplayDelay_KL15Off: implementation-data-type=uint16
        t_DisplayDelay_KL15On: implementation-data-type=uint16
        VKM_Range_RangeAvgConsumptiom_Default: implementation-data-type=uint16
        Adaption_SeatbeltWarning: implementation-data-type=uint8
        bap_bc_mfa_SpeedWarning_Speed_Unit: implementation-data-type=uint8
        bap_bc_mfa_SpeedWarning_State: implementation-data-type=uint8
        Bc_Layer3_Auto_Reset: implementation-data-type=uint8
        Bc_Layer3_Auto_Reset_Gas: implementation-data-type=uint8
        Bc_Layer3_Manual_Reset: implementation-data-type=uint8
        Calibration_Date: implementation-data-type=Arr_u8_3
        Calibration_Shop_Code: implementation-data-type=Arr_u8_6
        ConsumptionCorrection: implementation-data-type=uint8
        ConsumptionCorrection_Cng: implementation-data-type=uint8
        Fuel_Calib_Full_Offset: implementation-data-type=sint8
        Fuel_Offset_Sensor_{1..4}: implementation-data-type=sint8
        Hmi_Skinning: implementation-data-type=uint8
        hmi_t_RearBelt: implementation-data-type=uint8
        Ignition_Active_Message: implementation-data-type=uint8
        Seatbelt_Rear_Delaytime_acoustic: implementation-data-type=uint8
        Seatbelt_Rear_Displaytime_buckle: implementation-data-type=uint8
        Seatbelt_Rear_speed_blinking_off: implementation-data-type=uint8
        Seatbelt_Rear_speed_blinking_on: implementation-data-type=uint8
        Seatbelt_SBR_Installed: implementation-data-type=uint8
        SynchronizationTime_DriversDoor: implementation-data-type=uint8
        VKM_Range_Distance_Unclass: implementation-data-type=uint8
        BAP_Debug_Mode_enabled: implementation-data-type=boolean
        CylinderDeactivation_Active: implementation-data-type=boolean
        Display_Save_CP: implementation-data-type=boolean
        Picture_Upload_Download: implementation-data-type=boolean
        ProductionMode: implementation-data-type=boolean
        RollTestStandMode: implementation-data-type=boolean
        Vehicle_Network: implementation-data-type=boolean
        lautstaerke_offset: implementation-data-type=uint8
        tachoendwert: implementation-data-type=uint8
        skinning: implementation-data-type=uint8
        Bc_Layer3_Auto_Reset_EV: implementation-data-type=boolean
        V_Config_WarningThreshold1_Indien: implementation-data-type=uint8
    NV_Data_DIAG_AdaptationChannel_VAR_1
      34 x element, all with category=TYPE_REFERENCE:
        BlockingDistanceVehicleMoving: implementation-data-type=uint16
        Lookup_Compression_Curve_Photosensor_Bus_Coef_X: implementation-data-type=Arr_u16_5
        SaveTimeEngineOff: implementation-data-type=uint16
        BlackIceThresholdHighTemp: implementation-data-type=sint8
        BlackIceThresholdLowTemp: implementation-data-type=sint8
        BlockingTimeVehicleMoving: implementation-data-type=uint8
        CoolantTemperatureDelta: implementation-data-type=uint8
        Forcewrite_Qual_Time: implementation-data-type=uint8
        Lookup_Compression_Curve_Photosensor_Bus_Coef_Y: implementation-data-type=Arr_u8_5
        Offset_Color_Blue: implementation-data-type=sint8
        Offset_Color_Green: implementation-data-type=sint8
        Offset_Color_Red: implementation-data-type=sint8
        SaveTimeDisplayOff: implementation-data-type=uint8
        SlewRate: implementation-data-type=uint8
        SpeedThreshold: implementation-data-type=uint8
        TimeConstant: implementation-data-type=uint8
        Trend_Threshold: implementation-data-type=uint8
        TrendTime: implementation-data-type=uint8
        VCOM_Adjustment: implementation-data-type=uint8
        Write_Delay_Speed: implementation-data-type=uint8
        Write_Delay_Time: implementation-data-type=uint8
        Write_Distance: implementation-data-type=uint8
        Deactivate_SK_Function: implementation-data-type=boolean
        FAS_menu_ACC: implementation-data-type=boolean
        FAS_menu_GRA: implementation-data-type=boolean
        FAS_menu_LIM: implementation-data-type=boolean
        Fuel_AuxHeater_Consumption_Active: implementation-data-type=boolean
        Main_Switch_Basis: implementation-data-type=boolean
        Main_Switch_Keyless: implementation-data-type=boolean
        TrGW_Function_Enable: implementation-data-type=boolean
        personalisation_2x_active: implementation-data-type=boolean
        vkmrw_rwdv_cng_default: implementation-data-type=uint16
        vkmrw_rwdv_lpg_default: implementation-data-type=uint16
        RangeAvgConsumption_High_LPG: implementation-data-type=uint16
    NV_Data_DIAG_AdaptationChannel_VAR_2
      9 x element, all with category=TYPE_REFERENCE:
        ACC_Darstellung: implementation-data-type=boolean
        hmi_anteil_gas_aktiv: implementation-data-type=uint8
        vkmrw_gesamtreichweite_vorhanden: implementation-data-type=uint8
        vkmrw_verbrauchsfaktor_kombi: implementation-data-type=uint8
        vkmrw_Verbrauchsaequivalent_ein: implementation-data-type=uint8
        vkmrw_Verbrauchsaequivalent: implementation-data-type=uint8
        rw_fahrzg_steht: implementation-data-type=uint8
        rw_fahrzg_faehrt: implementation-data-type=uint8
        zReserved_DIAG_AdaptationChannel_VAR_2: implementation-data-type=Arr_u8_8
    NV_Data_DIAG_Adjustment_VAR
      14 x element, all with category=TYPE_REFERENCE:
        Diag_Gain_Adjustment: implementation-data-type=Arr_u8_3
        Diag_Red_Gamma_Adjustment: implementation-data-type=Arr_u8_3
        Diag_Green_Gamma_Adjustment: implementation-data-type=Arr_u8_3
        Diag_Blue_Gamma_Adjustment: implementation-data-type=Arr_u8_3
        Diag_Red_Gamma_Pos_Adjustment: implementation-data-type=Arr_u8_30
        Diag_Green_Gamma_Pos_Adjustment: implementation-data-type=Arr_u8_30
        Diag_Blue_Gamma_Pos_Adjustment: implementation-data-type=Arr_u8_30
        Diag_Red_Gamma_Neg_Adjustment: implementation-data-type=Arr_u8_30
        Diag_Green_Gamma_Neg_Adjustment: implementation-data-type=Arr_u8_30
        Diag_Blue_Gamma_Neg_Adjustment: implementation-data-type=Arr_u8_30
        Diag_Compensation_Line_Slope_m: implementation-data-type=Arr_u8_3
        Diag_Compensation_Line_Shift_b: implementation-data-type=Arr_u8_3
        p_kilometerstand_last_value_obsolete: implementation-data-type=uint32
        zReserved_Diag_Adjustment_VAR: implementation-data-type=Arr_u8_18
    NV_Data_DIAG_EOL_DiagCfg_CONST
      19 x element, all with category=TYPE_REFERENCE:
        DIAG_EOL_DiagCfg_CONST_Safety_CRC: implementation-data-type=uint16
        RunInMode_Config: implementation-data-type=uint16
        RunInMode_Result: implementation-data-type=uint16
        Manuf_Assembly_Plant_Number: implementation-data-type=Arr_u8_3
        Manuf_Equiped_PCB_Reference: implementation-data-type=Arr_u8_5
        Manuf_Equiped_PCB_Revision: implementation-data-type=Arr_u8_2
        Manuf_PCB_Serial_Number: implementation-data-type=Arr_u8_4
        Manuf_Product_Reference: implementation-data-type=Arr_u8_5
        Manuf_Product_Revision: implementation-data-type=Arr_u8_2
        Manuf_SMD_Manufacturing_Date: implementation-data-type=Arr_u8_8
        Manuf_SMD_Plant_Number: implementation-data-type=Arr_u8_3
        Manuf_Traceability_PIM: implementation-data-type=uint8
        Manuf_Traceability_Station_Nr: implementation-data-type=Arr_u8_8
        zReserved_DIAG_EOL_DiagCfg_CONST: implementation-data-type=Arr_u8_2
        Manufacturing_Mode: implementation-data-type=uint8
        Rework_Param_1: implementation-data-type=uint8
        Rework_Param_2: implementation-data-type=uint8
        RCC_IZ: implementation-data-type=uint16
        zReserved_1_DIAG_EOL_DiagCfg_CONST: implementation-data-type=Arr_u8_6
    NV_Data_DIAG_EOL_HWCalib_CONST
      29 x element, all with category=TYPE_REFERENCE:
        AD_Value_Max_lx: implementation-data-type=uint16
        AD_Value_Min_lx: implementation-data-type=uint16
        CorrectionCoefficient_k1: implementation-data-type=uint16
        CorrectionCoefficient_k2: implementation-data-type=uint16
        DIAG_EOL_HWCalib_CONST_Safety_CRC: implementation-data-type=uint16
        Display_Illum_Max_Level: implementation-data-type=uint16
        Photosensor_Calib_Max_Lx: implementation-data-type=uint16
        Photosensor_Calib_Min_Lx: implementation-data-type=uint16
        QuartzFrequencyOffset: implementation-data-type=sint16
        SupplyVoltage_N1: implementation-data-type=uint16
        SupplyVoltage_N2: implementation-data-type=uint16
        SupplyVoltage_V1: implementation-data-type=uint16
        SupplyVoltage_V2: implementation-data-type=uint16
        Calibrated_RGB_Font_Colour_Triple: implementation-data-type=Arr_u8_3
        ECT_Gauge_Magnetic_Offset: implementation-data-type=uint8
        PCB_TrackResistance: implementation-data-type=uint8
        RPM_Gauge_Magnetic_Offset: implementation-data-type=uint8
        Speedo_Gauge_Magnetic_Offset: implementation-data-type=uint8
        Tank_Gauge_Magnetic_Offset: implementation-data-type=uint8
        Whisper_Mode_Loudness: implementation-data-type=uint8
        WhitePointCorrectionMethod: implementation-data-type=uint8
        Whisper_Mode: implementation-data-type=boolean
        zReservedAligmnet_DIAG_EOL_HWCalib_CONST: implementation-data-type=boolean
        Measured_Value_Max_lx: implementation-data-type=uint16
        Measured_Value_Min_lx: implementation-data-type=uint16
        PTC_PCB_Derating_step: implementation-data-type=uint8
        NTC_TFT_Derating_step: implementation-data-type=uint8
        DURMW: implementation-data-type=uint32
        zReserved_DIAG_EOL_HWCalib_CONST: implementation-data-type=Arr_u8_4
    NV_Data_DIAG_EOL_HWCalib_CONST_1
      9 x element, all with category=TYPE_REFERENCE:
        Measured_Value_Max_Range_lx: implementation-data-type=uint16
        Measured_Value_Min_Range_lx: implementation-data-type=uint16
        Photosensor_Calib_Max_Range_Lx: implementation-data-type=uint16
        Photosensor_Calib_Min_Range_Lx: implementation-data-type=uint16
        CoolantTemp_Gauge_Hysteresis_Angle: implementation-data-type=sint16
        FuelLevel_Gauge_Hysteresis_Angle: implementation-data-type=sint16
        RPM_Gauge_Hysteresis_Angle: implementation-data-type=sint16
        Speedo_Gauge_Hysteresis_Angle: implementation-data-type=sint16
        zReserved_DIAG_EOL_HWCalib_CONST_1: implementation-data-type=Arr_u8_36
    NV_Data_DIAG_EOL_PartNumber_CONST
      element Manuf_Equipped_PCB_Partnumber: implementation-data-type=Arr_u8_18
      element Manuf_Product_Partnumber: implementation-data-type=Arr_u8_18
    NV_Data_DIAG_EOL_VAR
      6 x element, all with category=TYPE_REFERENCE:
        PointerType: implementation-data-type=uint8
        Vehicle_Equipment_Code: implementation-data-type=Arr_u8_12
        VW_Data_Set_Number: implementation-data-type=Arr_u8_11
        VW_Data_Set_Version: implementation-data-type=Arr_u8_4
        VW_Workshop_System_Name: implementation-data-type=Arr_u8_5
        zReserved_DIAG_EOL_VAR: implementation-data-type=Arr_u8_3
    NV_Data_DIAG_VariantCodingCheck_CONST
      89 x element, all with category=TYPE_REFERENCE:
        CodingCheck_Unit_Language: implementation-data-type=uint32
        CodingCheck_CarBody: implementation-data-type=uint16
        CodingCheck_4WD_Installed: implementation-data-type=uint8
        CodingCheck_ACC_Installed: implementation-data-type=uint8
        CodingCheck_Acceleration_Display_Available: implementation-data-type=uint8
        CodingCheck_AFS_Installed: implementation-data-type=uint8
        CodingCheck_ARA_Installed: implementation-data-type=uint8
        CodingCheck_ASTA_Installed: implementation-data-type=uint8
        CodingCheck_Audio_Installed: implementation-data-type=uint8
        CodingCheck_AWV_BAP_Installed: implementation-data-type=uint8
        CodingCheck_AWV_Installed: implementation-data-type=uint8
        CodingCheck_Bc_Display_Available: implementation-data-type=uint8
        CodingCheck_BCmE_Installed: implementation-data-type=uint8
        CodingCheck_BVA_with_BKL: implementation-data-type=uint8
        CodingCheck_Car_Leaving_Warning_Available: implementation-data-type=uint8
        CodingCheck_Compass_Position: implementation-data-type=uint8
        CodingCheck_Damper_Installed: implementation-data-type=uint8
        CodingCheck_DayIlluminationPointers: implementation-data-type=uint8
        CodingCheck_DayIlluminationScales: implementation-data-type=uint8
        CodingCheck_Dig_OilTemp_Display_Available: implementation-data-type=uint8
        CodingCheck_eCall_Installed: implementation-data-type=uint8
        CodingCheck_ELV_Installed: implementation-data-type=uint8
        CodingCheck_Epb_Installed: implementation-data-type=uint8
        CodingCheck_Eps_Installed: implementation-data-type=uint8
        CodingCheck_FCWP_Installed: implementation-data-type=uint8
        CodingCheck_Telephone2_Installed: implementation-data-type=uint8
        CodingCheck_GRA_High_Display: implementation-data-type=uint8
        CodingCheck_HRE_Installed: implementation-data-type=uint8
        CodingCheck_Hybrid_BAP_Installed: implementation-data-type=uint8
        CodingCheck_Hybrid_Installed: implementation-data-type=uint8
        CodingCheck_Joker_Button_Installed: implementation-data-type=uint8
        Reserved_1: implementation-data-type=uint8
        CodingCheck_Key_Warning: implementation-data-type=uint8
        CodingCheck_Laptimer: implementation-data-type=uint8
        CodingCheck_LDW_BAP_Installed: implementation-data-type=uint8
        CodingCheck_LDW_Installed: implementation-data-type=uint8
        CodingCheck_Navigation_Compass_Installed: implementation-data-type=uint8
        CodingCheck_OutsideTemperature_Indication: implementation-data-type=uint8
        CodingCheck_PEA_BAP_Installed: implementation-data-type=uint8
        CodingCheck_PedestrianAssist_BAP_Installed: implementation-data-type=uint8
        CodingCheck_Personalization_Installed: implementation-data-type=uint8
        CodingCheck_PLA_Installed: implementation-data-type=uint8
        CodingCheck_PLA3_Installed: implementation-data-type=uint8
        CodingCheck_Pointer_Kl_58: implementation-data-type=uint8
        CodingCheck_QSP_Installed: implementation-data-type=uint8
        CodingCheck_RDK_BAP_Installed: implementation-data-type=uint8
        CodingCheck_RDK_Installed: implementation-data-type=uint8
        CodingCheck_RefulledVolume_Available: implementation-data-type=uint8
        CodingCheck_Right_Drive: implementation-data-type=uint8
        CodingCheck_RKA_Installed: implementation-data-type=uint8
        CodingCheck_SDS_BAP_Installed: implementation-data-type=uint8
        CodingCheck_SeatbeltWarning: implementation-data-type=uint8
        CodingCheck_Staging: implementation-data-type=uint8
        CodingCheck_StartStopReasons_BAP_Installed: implementation-data-type=uint8
        CodingCheck_StartUp_Screen: implementation-data-type=uint8
        CodingCheck_SWA_BAP_Installed: implementation-data-type=uint8
        CodingCheck_SWA_Installed: implementation-data-type=uint8
        CodingCheck_Telephone_Installed: implementation-data-type=uint8
        CodingCheck_Unit_ClockFormat: implementation-data-type=uint8
        CodingCheck_Unit_DateFormat: implementation-data-type=uint8
        CodingCheck_Unit_FuelConsumption: implementation-data-type=uint8
        CodingCheck_IAA_PSO_BAP_Installed: implementation-data-type=uint8
        CodingCheck_Unit_Language_Ext: implementation-data-type=uint8
        CodingCheck_Unit_Language_Ext1: implementation-data-type=uint8
        CodingCheck_Unit_OdoTripDistance: implementation-data-type=uint8
        CodingCheck_Unit_Pressure: implementation-data-type=uint8
        CodingCheck_Unit_Speed: implementation-data-type=uint8
        CodingCheck_Unit_Temperature: implementation-data-type=uint8
        CodingCheck_Unit_Volume: implementation-data-type=uint8
        CodingCheck_Unit_Weight: implementation-data-type=uint8
        CodingCheck_V_Warning_Legal: implementation-data-type=uint8
        CodingCheck_VZA_Installed: implementation-data-type=uint8
        CodingCheck_WBA_Installed: implementation-data-type=uint8
        CodingCheck_AGA_Installed: implementation-data-type=uint8
        CodingCheck_EBKV_Installed: implementation-data-type=uint8
        CodingCheck_Unit_Consumption_Electric: implementation-data-type=uint8
        CodingCheck_Ignition_EV_LowVoltage: implementation-data-type=uint8
        CodingCheck_KFG_Installed: implementation-data-type=uint8
        CodingCheck_Fuel_Variant: implementation-data-type=uint32
        CodingCheck_K_Number: implementation-data-type=uint32
        CodingCheck_Unit_FuelConsumption_Gas: implementation-data-type=uint16
        CodingCheck_Digital_Key_Installed: implementation-data-type=uint8
        CodingCheck_Two_Keys_Installed: implementation-data-type=uint8
        CodingCheck_ADA_Installed: implementation-data-type=uint8
        zReserved_2_DIAG_VariantCodingCheck_CONST: implementation-data-type=Arr_u8_3
        zReserved_DIAG_VariantCodingCheck_CONST: implementation-data-type=Arr_u8_51
        CodingCheck_Telephone2_Installed_Obsolete: implementation-data-type=Arr_u8_9
        CodingCheck_Unit_Consumption_Electric_Obsolete: implementation-data-type=Arr_u8_9
        zReserved_1_DIAG_VariantCodingCheck_CONST: implementation-data-type=Arr_u8_5
    NV_Data_DIAG_VariantCoding_CONST
      94 x element, all with category=TYPE_REFERENCE:
        DIAG_VariantCoding_CONST_Safety_CRC: implementation-data-type=uint16
        Coding_CarBody: implementation-data-type=uint8
        Coding_Compass_Position: implementation-data-type=uint8
        Coding_Date: implementation-data-type=Arr_u8_3
        Coding_Language: implementation-data-type=uint8
        Coding_Pointer_Kl_58: implementation-data-type=uint8
        Coding_SeatbeltWarning: implementation-data-type=uint8
        Coding_Shop_Code: implementation-data-type=Arr_u8_6
        Coding_Staging: implementation-data-type=uint8
        Coding_StartUp_Screen: implementation-data-type=uint8
        Coding_Unit_DateFormat: implementation-data-type=uint8
        Coding_Unit_FuelConsumption: implementation-data-type=uint8
        Coding_Unit_FuelConsumption_Gas: implementation-data-type=uint8
        Coding_Unit_Pressure: implementation-data-type=uint8
        Coding_Unit_Volume: implementation-data-type=uint8
        Coding_Unit_Weight: implementation-data-type=uint8
        Fuel_Variant: implementation-data-type=uint8
        K_Number: implementation-data-type=uint8
        Acceleration_Display_Available: implementation-data-type=boolean
        Bc_Display_Available: implementation-data-type=boolean
        Coding_4WD_Installed: implementation-data-type=boolean
        Coding_ACC_Installed: implementation-data-type=boolean
        Coding_AFS_Installed: implementation-data-type=boolean
        Coding_ARA_Installed: implementation-data-type=boolean
        Coding_ASTA_Installed: implementation-data-type=boolean
        Coding_Audio_Installed: implementation-data-type=boolean
        Coding_AWV_BAP_Installed: implementation-data-type=boolean
        Coding_AWV_Installed: implementation-data-type=boolean
        Coding_BCmE_Installed: implementation-data-type=boolean
        Coding_BVA_with_BKL: implementation-data-type=boolean
        Coding_Car_Leaving_Warning_Active: implementation-data-type=boolean
        Coding_Damper_Installed: implementation-data-type=boolean
        Coding_DayIlluminationPointers: implementation-data-type=boolean
        Coding_DayIlluminationScales: implementation-data-type=boolean
        Coding_eCall_Installed: implementation-data-type=boolean
        Coding_ELV_Installed: implementation-data-type=boolean
        Coding_Epb_Installed: implementation-data-type=boolean
        Coding_EPS_Installed: implementation-data-type=boolean
        Coding_FCWP_Installed: implementation-data-type=boolean
        Coding_HRE_Installed: implementation-data-type=boolean
        Coding_Hybrid_BAP_Installed: implementation-data-type=boolean
        Coding_Hybrid_Installed: implementation-data-type=boolean
        Coding_Joker_Button_Installed: implementation-data-type=boolean
        Coding_KeyWarning: implementation-data-type=boolean
        Coding_Laptimer: implementation-data-type=boolean
        Coding_LDW_BAP_Installed: implementation-data-type=boolean
        Coding_LDW_Installed: implementation-data-type=boolean
        Coding_Navigation_Compass_Installed: implementation-data-type=boolean
        Coding_PEA_BAP_Installed: implementation-data-type=boolean
        Coding_PedestrianAssist_BAP_Installed: implementation-data-type=boolean
        Coding_Personalization_Installed: implementation-data-type=boolean
        Coding_PLA_Installed: implementation-data-type=boolean
        Coding_PLA3_Installed: implementation-data-type=boolean
        Coding_QSP_Installed: implementation-data-type=boolean
        Coding_RDK_BAP_Installed: implementation-data-type=boolean
        Coding_RDK_Installed: implementation-data-type=boolean
        Coding_Right_Drive: implementation-data-type=boolean
        Coding_RKA_Installed: implementation-data-type=boolean
        Coding_SDS_BAP_Installed: implementation-data-type=boolean
        Coding_StartStopReasons_BAP_Installed: implementation-data-type=boolean
        Coding_SWA_BAP_Installed: implementation-data-type=boolean
        Coding_SWA_Installed: implementation-data-type=boolean
        Coding_TCO_Installed: implementation-data-type=boolean
        Coding_Telephone_Installed: implementation-data-type=boolean
        Coding_Unit_ClockFormat: implementation-data-type=boolean
        Coding_Unit_OdoTripDistance: implementation-data-type=boolean
        Coding_Unit_Speed: implementation-data-type=boolean
        Coding_Unit_Temperature: implementation-data-type=boolean
        Coding_V_Warning_Legal: implementation-data-type=boolean
        Coding_VZA_Installed: implementation-data-type=boolean
        Coding_WBA_Installed: implementation-data-type=boolean
        Customer_Request_Flag: implementation-data-type=boolean
        Dig_OilTemp_Display_Available: implementation-data-type=boolean
        DTC_ECU_not_coded: implementation-data-type=boolean
        GRA_High_Display_Available: implementation-data-type=boolean
        OutsideTemperature_Indication: implementation-data-type=boolean
        RefulledVolume_Available: implementation-data-type=boolean
        V_Warning_Legal_India: implementation-data-type=boolean
        Coding_Digital_Key_Installed: implementation-data-type=boolean
        Coding_IAA_PSO_BAP_Installed: implementation-data-type=boolean
        Coding_Telephone2_Installed: implementation-data-type=boolean
        Coding_two_keys: implementation-data-type=boolean
        Coding_Production_Mode_Acoustic: implementation-data-type=boolean
        Coding_BMS_Installed: implementation-data-type=boolean
        Coding_Unit_Consumption_Electrical: implementation-data-type=uint8
        Coding_Production_Mode_Key_Lock: implementation-data-type=boolean
        Coding_ADA_Installed: implementation-data-type=uint8
        zReserved_DIAG_VariantCoding_CONST_Handle: implementation-data-type=Arr_u8_32
        zIniSwVer_DIAG_VariantCoding_CONST: implementation-data-type=uint8
        Coding_AGA_Installed: implementation-data-type=uint8
        Coding_EBKV_Installed: implementation-data-type=uint8
        Coding_Ignition_EV_LowVoltage: implementation-data-type=uint8
        Coding_KFG_Installed: implementation-data-type=uint8
        zReserved_1_DIAG_VariantCoding_CONST: implementation-data-type=Arr_u8_8
    NV_Data_Dev_Messages
      element CAN_DEV_Monitoring_Blocks: implementation-data-type=Arr_u8_20
      element CAN_DEV_Monitoring_Status: implementation-data-type=uint8
      element zReserved_DEV_Messages: implementation-data-type=Arr_u8_7
    NV_Data_DtcAgingAdminDataBlock
      element DtcAging: implementation-data-type=Arr_u8_4
    NV_Data_EEPVersionInfo_CONST
      element InternalLogicalSoftwareBlockVersion_EEP: implementation-data-type=Arr_u8_4
      element VWLogicalSoftwareBlockVersion_EEP: implementation-data-type=Arr_u8_4
    NV_Data_Gamma_Adjustment_VAR
      8 x element, all with category=TYPE_REFERENCE:
        Red_Gamma_Adjustment_Display1: implementation-data-type=Arr_u8_27
        Green_Gamma_Adjustment_Display1: implementation-data-type=Arr_u8_27
        Blue_Gamma_Adjustment_Display1: implementation-data-type=Arr_u8_27
        Red_Gamma_Adjustment_Display2: implementation-data-type=Arr_u8_48
        Green_Gamma_Adjustment_Display2: implementation-data-type=Arr_u8_48
        Blue_Gamma_Adjustment_Display2: implementation-data-type=Arr_u8_48
        zReserved_Gamma_Adjustment_VAR: implementation-data-type=Arr_u8_17
        Gamma_Adjustment_VAR_CRC: implementation-data-type=uint16
    NV_Data_I5CM_ID_NVM_BlockDET
      element I5CM_ID_NVM_BlockDET: implementation-data-type=Arr_u8_64
    NV_Data_I5CM_ID_NVM_BlockDL
      element I5CM_ID_NVM_BlockDL: implementation-data-type=Arr_u8_176
    NV_Data_I5CM_ID_NVM_BlockKEYLC
      element I5CM_ID_NVM_BlockKEYLC: implementation-data-type=Arr_u8_128
    NV_Data_I5CM_ID_NVM_BlockKEY_0
      element I5CM_ID_NVM_BlockKEY_0: implementation-data-type=Arr_u8_64
    NV_Data_I5CM_ID_NVM_BlockKEY_1
      element I5CM_ID_NVM_BlockKEY_1: implementation-data-type=Arr_u8_64
    NV_Data_I5CM_ID_NVM_BlockKEY_2
      element I5CM_ID_NVM_BlockKEY_2: implementation-data-type=Arr_u8_64
    NV_Data_I5CM_ID_NVM_BlockLEARN_0
      element I5CM_ID_NVM_BlockLEARN_0: implementation-data-type=Arr_u8_80
    NV_Data_I5CM_ID_NVM_BlockLEARN_1
      element I5CM_ID_NVM_BlockLEARN_1: implementation-data-type=Arr_u8_80
    NV_Data_I5CM_ID_NVM_BlockLEARN_2
      element I5CM_ID_NVM_BlockLEARN_2: implementation-data-type=Arr_u8_80
    NV_Data_I5CM_ID_NVM_BlockPARAM_0
      element I5CM_ID_NVM_BlockPARAM_0: implementation-data-type=Arr_u8_32
    NV_Data_I5CM_ID_NVM_BlockPARAM_1
      element I5CM_ID_NVM_BlockPARAM_1: implementation-data-type=Arr_u8_32
    NV_Data_I5CM_ID_NVM_BlockPARAM_2
      element I5CM_ID_NVM_BlockPARAM_2: implementation-data-type=Arr_u8_32
    NV_Data_I5CM_ID_NVM_BlockSRM_0
      element I5CM_ID_NVM_BlockSRM_0: implementation-data-type=Arr_u8_32
    NV_Data_I5CM_ID_NVM_BlockSRM_1
      element I5CM_ID_NVM_BlockSRM_1: implementation-data-type=Arr_u8_32
    NV_Data_I5CM_ID_NVM_BlockSRM_2
      element I5CM_ID_NVM_BlockSRM_2: implementation-data-type=Arr_u8_32
    NV_Data_I5CM_ID_NVM_BlockSTATE_0
      element I5CM_ID_NVM_BlockSTATE_0: implementation-data-type=Arr_u8_16
    NV_Data_I5CM_ID_NVM_BlockSTATE_1
      element I5CM_ID_NVM_BlockSTATE_1: implementation-data-type=Arr_u8_16
    NV_Data_I5CM_ID_NVM_BlockSTATE_2
      element I5CM_ID_NVM_BlockSTATE_2: implementation-data-type=Arr_u8_16
    NV_Data_I5CM_ID_NVM_BlockSTS_0
      element I5CM_ID_NVM_BlockSTS_0: implementation-data-type=Arr_u8_16
    NV_Data_I5CM_ID_NVM_BlockSTS_1
      element I5CM_ID_NVM_BlockSTS_1: implementation-data-type=Arr_u8_16
    NV_Data_I5CM_ID_NVM_BlockSTS_2
      element I5CM_ID_NVM_BlockSTS_2: implementation-data-type=Arr_u8_16
    NV_Data_KsNvmBlockGfaKey_0
      element KsNvmBlockGfaKey_0: implementation-data-type=Arr_u8_64
    NV_Data_KsNvmBlockGfaKey_1
      element KsNvmBlockGfaKey_1: implementation-data-type=Arr_u8_64
    NV_Data_KsNvmBlockMisc_0
      element KsNvmBlockMisc_0: implementation-data-type=Arr_u8_16
    NV_Data_KsNvmBlockMisc_1
      element KsNvmBlockMisc_1: implementation-data-type=Arr_u8_16
    NV_Data_NVM_BLOCK_IVD_0X0250
      element NVM_BLOCK_IVD_0X0250: implementation-data-type=Arr_u8_202
    NV_Data_NVM_BLOCK_SFD_ConfigurationFingerprint_Data
      element NVM_BLOCK_SFD_ConfigurationFingerprint_Data: implementation-data-type=Arr_u8_514
    NV_Data_NVM_BLOCK_SFD_PersistentData
      element NVM_BLOCK_SFD_PersistentData: implementation-data-type=Arr_u8_30
    NV_Data_NVM_BLOCK_SFD_PublicKey
      element NVM_BLOCK_SFD_PublicKey: implementation-data-type=Arr_u8_64
    NV_Data_NvMFblGeneral
      10 x element, all with category=TYPE_REFERENCE:
        ProgReqFlag: implementation-data-type=uint8
        Share_ValidityFlags: implementation-data-type=uint8
        ResetResponseFlag: implementation-data-type=uint8
        ApplValidity: implementation-data-type=uint8
        ProgMarker: implementation-data-type=uint8
        SecAccessDelayFlag: implementation-data-type=uint8
        SecAccessInvalidCount: implementation-data-type=uint8
        BSBlockSizeActive: implementation-data-type=uint8
        BSBlockSize: implementation-data-type=uint8
        DcmDslRxTesterSourceAddr: implementation-data-type=uint16
    NV_Data_NvMFblMetaData
      42 x element, all with category=TYPE_REFERENCE:
        Share_Fingerprint_Block1: implementation-data-type=Arr_u8_9
        Share_ProgAttempts_Block1: implementation-data-type=Arr_u8_2
        CRCValue_Block1: implementation-data-type=Arr_u8_4
        CRCStart_Block1: implementation-data-type=Arr_u8_4
        CRCLength_Block1: implementation-data-type=Arr_u8_4
        EraseState_Block1: implementation-data-type=uint8
        SegmentLengthList_Block1: implementation-data-type=Arr_u8_4
        Share_Fingerprint_Block2: implementation-data-type=Arr_u8_9
        Share_ProgAttempts_Block2: implementation-data-type=Arr_u8_2
        CRCValue_Block2: implementation-data-type=Arr_u8_4
        CRCStart_Block2: implementation-data-type=Arr_u8_4
        CRCLength_Block2: implementation-data-type=Arr_u8_4
        EraseState_Block2: implementation-data-type=uint8
        SegmentLengthList_Block2: implementation-data-type=Arr_u8_4
        Share_Fingerprint_Block3: implementation-data-type=Arr_u8_9
        Share_ProgAttempts_Block3: implementation-data-type=Arr_u8_2
        CRCValue_Block3: implementation-data-type=Arr_u8_4
        CRCStart_Block3: implementation-data-type=Arr_u8_4
        CRCLength_Block3: implementation-data-type=Arr_u8_4
        EraseState_Block3: implementation-data-type=uint8
        SegmentLengthList_Block3: implementation-data-type=Arr_u8_4
        Share_Fingerprint_Block4: implementation-data-type=Arr_u8_9
        Share_ProgAttempts_Block4: implementation-data-type=Arr_u8_2
        CRCValue_Block4: implementation-data-type=Arr_u8_4
        CRCStart_Block4: implementation-data-type=Arr_u8_4
        CRCLength_Block4: implementation-data-type=Arr_u8_4
        EraseState_Block4: implementation-data-type=uint8
        SegmentLengthList_Block4: implementation-data-type=Arr_u8_4
        Share_Fingerprint_Block5: implementation-data-type=Arr_u8_9
        Share_ProgAttempts_Block5: implementation-data-type=Arr_u8_2
        CRCValue_Block5: implementation-data-type=Arr_u8_4
        CRCStart_Block5: implementation-data-type=Arr_u8_4
        CRCLength_Block5: implementation-data-type=Arr_u8_4
        EraseState_Block5: implementation-data-type=uint8
        SegmentLengthList_Block5: implementation-data-type=Arr_u8_4
        Share_Fingerprint_Block6: implementation-data-type=Arr_u8_9
        Share_ProgAttempts_Block6: implementation-data-type=Arr_u8_2
        CRCValue_Block6: implementation-data-type=Arr_u8_4
        CRCStart_Block6: implementation-data-type=Arr_u8_4
        CRCLength_Block6: implementation-data-type=Arr_u8_4
        EraseState_Block6: implementation-data-type=uint8
        SegmentLengthList_Block6: implementation-data-type=Arr_u8_4
    NV_Data_NvMFblShareDataPartOne
      6 x element, all with category=TYPE_REFERENCE:
        FblShareDataPartOneReserved1: implementation-data-type=Arr_u8_10
        Share_BootloaderTPBlocksize: implementation-data-type=uint8
        Share_VWFAZITIdentificationString: implementation-data-type=Arr_u8_23
        FblShareDataPartOneReserved2: implementation-data-type=Arr_u8_11
        Share_VWECUHardwareNumber_Old: implementation-data-type=Arr_u8_11
        FblShareDataPartOneReserved: implementation-data-type=Arr_u8_72
    NV_Data_NvMFblShareDataPartThree
      7 x element, all with category=TYPE_REFERENCE:
        Share_VWSparePartNumber: implementation-data-type=Arr_u8_11
        Share_VWECUHardwareNumber: implementation-data-type=Arr_u8_11
        Share_ASAM_ODXFileIdentifier_obsolate: implementation-data-type=Arr_u8_21
        ASAMFileVersion: implementation-data-type=Arr_u8_6
        Share_VWECUHardwareVersionNumber: implementation-data-type=Arr_u8_3
        ASAMFileIdentifier: implementation-data-type=Arr_u8_26
        FblShareDataPartThreeReserved: implementation-data-type=Arr_u8_50
    NV_Data_NvMFblShareDataPartTwo
      9 x element, all with category=TYPE_REFERENCE:
        FblShareDataPartTwoReserved1: implementation-data-type=Arr_u8_8
        Share_ASAM_ODXFileIdentifier_Old: implementation-data-type=Arr_u8_21
        Share_ASAM_ODXFileVersion_Old: implementation-data-type=Arr_u8_6
        Share_VWECUHardwareVersionNumber_Old: implementation-data-type=Arr_u8_3
        Share_FDSProjectData: implementation-data-type=Arr_u8_8
        Share_ECUProgrammingInformation: implementation-data-type=uint8
        Share_InvalidKeyCounter: implementation-data-type=uint8
        VWSoftwareVersionNumber: implementation-data-type=Arr_u8_4
        Share_FblShareDataPartTwoReserved: implementation-data-type=Arr_u8_76
    NV_Data_NvM_VKMS
      element NvM_VKMS: implementation-data-type=Arr_u8_2
    NV_Data_Nvm_Block_Reserved_1
      9 x element, all with category=TYPE_REFERENCE:
        PSO_DataTag_USER_{0..7}: implementation-data-type=Arr_u8_7
        zReserved_Nvm_Block_Reserved_1: implementation-data-type=Arr_u8_8
    NV_Data_Nvm_Block_Reserved_2
      32 x element, all with category=TYPE_REFERENCE, implementation-data-type=uint8:
        Fuel_Vol_Refueling_Drainage_{1..32}
    NV_Data_Nvm_Block_Reserved_4
      34 x element, all with category=TYPE_REFERENCE:
        AmbientLight_Left_Red_LED_Coef: implementation-data-type=uint16
        AmbientLight_Left_Green_LED_Coef: implementation-data-type=uint16
        AmbientLight_Left_Blue_LED_Coef: implementation-data-type=uint16
        AmbientLight_Right_Red_LED_Coef: implementation-data-type=uint16
        AmbientLight_Right_Green_LED_Coef: implementation-data-type=uint16
        AmbientLight_Right_Blue_LED_Coef: implementation-data-type=uint16
        Thermal_Timer{1..3}: implementation-data-type=uint16
        Bargraphs_X: implementation-data-type=Arr_u16_6
        Bargraphs_Y: implementation-data-type=Arr_u16_6
        Lookup_Curve_Bargraphs_Red_Coef_X: implementation-data-type=Arr_u16_6
        Lookup_Curve_Bargraphs_Red_Coef_Y: implementation-data-type=Arr_u16_6
        gap_FIFO_Year: implementation-data-type=Arr_u8_5
        gap_FIFO_Month: implementation-data-type=Arr_u8_5
        gap_FIFO_Day: implementation-data-type=Arr_u8_5
        gap_FIFO_TimeLastGAP: implementation-data-type=Arr_u16_5
        gap_FIFO_Distance: implementation-data-type=Arr_u32_5
        gap_FIFO_NumberResets: implementation-data-type=Arr_u8_5
        da_gap_tage: implementation-data-type=sint16
        da_gap_reset_tage: implementation-data-type=boolean
        gap_tage_default: implementation-data-type=uint16
        gap_mfa_max: implementation-data-type=uint16
        gap_mfa_min: implementation-data-type=boolean
        gap_vorhanden: implementation-data-type=boolean
        Default_AmbientLight_Color_Green: implementation-data-type=uint8
        Default_AmbientLight_Color_Red: implementation-data-type=uint8
        Default_AmbientLight_Color_Blue: implementation-data-type=uint8
        gastank_warnung_cng_LED: implementation-data-type=uint8
        GasTank_Display_Attenuation_On: implementation-data-type=uint8
        GasTank_Display_Attenuation_Off: implementation-data-type=uint8
        GasTank_Duration_Red_LED_Flashing: implementation-data-type=uint8
        GasTank_Warning_Special_State: implementation-data-type=uint8
        zReserved_Nvm_Block_Reserved_4: implementation-data-type=Arr_u8_27
    NV_Data_Odometer_0
      element Odometer_0: implementation-data-type=Arr_u8_16
    NV_Data_Odometer_1
      element Odometer_1: implementation-data-type=Arr_u8_16
    NV_Data_Odometer_2
      element Odometer_2: implementation-data-type=Arr_u8_16
    NV_Data_OperatingTime_VAR
      element OperatingTimeStoredLSB: implementation-data-type=uint32
      element OperatingTimeStoredMSB: implementation-data-type=uint8
      element zReserved_OperatingTime_VAR: implementation-data-type=Arr_u8_7
    NV_Data_REFUEL_Logger_VAR
      25 x element, all with category=TYPE_REFERENCE:
        Fuel_Odometer_Log_n: implementation-data-type=uint16
        Fuel_Odometer_Log_n{1..3}: implementation-data-type=uint16
        Fuel_Vol_Display_Old_Log_n: implementation-data-type=uint16
        Fuel_Vol_Display_Old_Log_n{1..3}: implementation-data-type=uint16
        Fuel_Vol_Ref_Log_n: implementation-data-type=uint16
        Fuel_Vol_Ref_Log_n{1..3}: implementation-data-type=uint16
        Fuel_Vol_RefuelHandling_Log_n: implementation-data-type=uint16
        Fuel_Vol_RefuelHandling_Log_n{1..3}: implementation-data-type=uint16
        Fuel_Vol_Sensor_Avrg_RefuelHandling_Log_n: implementation-data-type=uint16
        Fuel_Vol_Sensor_Avrg_RefuelHandling_Log_n{1..3}: implementation-data-type=uint16
        Fuel_RefuelDetect_Log_Error_n: implementation-data-type=uint8
        Fuel_RefuelDetect_Log_Error_n{1..3}: implementation-data-type=uint8
        zReserved_REFUEL_Logger_VAR: implementation-data-type=Arr_u8_8
    NV_Data_RGB_Calibration_VAR
      4 x element, all with category=TYPE_REFERENCE:
        RGB_Color_Calibration_PWM_AmbientLight_Y_Left: implementation-data-type=Arr_u8_180
        RGB_Color_Calibration_PWM_AmbientLight_Y_Right: implementation-data-type=Arr_u8_180
        Bargraph_Color_Calibration: implementation-data-type=Arr_u8_8
        zReserved_RGB_Calibration_VAR: implementation-data-type=Arr_u8_12
    NV_Data_RPM_Gauge_FIR_Coefficients
      element RPM_Gauge_FIR_Coefficients: implementation-data-type=Arr_u8_64
    NV_Data_Recorder_VAR
      87 x element, all with category=TYPE_REFERENCE:
        AdcTicks_0xA00044: implementation-data-type=uint16
        AdcTicks_0xA00049: implementation-data-type=uint16
        ClusterState_0xA00000: implementation-data-type=uint16
        ClusterState_0xA{00040..00044}: implementation-data-type=uint16
        ClusterState_0xA00049: implementation-data-type=uint16
        HmiZpm_0xA00044: implementation-data-type=uint16
        AcuRequest_0xA00044: implementation-data-type=uint8
        AcuStatus_0xA00044: implementation-data-type=uint8
        BattVoltage_0xA00000: implementation-data-type=uint8
        BattVoltage_0xA{00040..00044}: implementation-data-type=uint8
        BattVoltage_0xA00049: implementation-data-type=uint8
        ClusterFunction_0xA00000: implementation-data-type=uint8
        ClusterFunction_0xA{00040..00044}: implementation-data-type=uint8
        ClusterFunction_0xA00049: implementation-data-type=uint8
        Counter_RamError: implementation-data-type=uint8
        ErrorType_0xA00041: implementation-data-type=uint8
        ErrorType_0xA00042: implementation-data-type=uint8
        ErrorType_0xA00044: implementation-data-type=uint8
        MDO_EN_0xA00049: implementation-data-type=uint8
        ResetCounter_ClockMon: implementation-data-type=uint8
        ResetCounter_EcuReset: implementation-data-type=uint8
        ResetCounter_JumpToZero: implementation-data-type=uint8
        ResetCounter_POR: implementation-data-type=uint8
        ResetCounter_StackMonitor: implementation-data-type=uint8
        ResetCounter_TimeoutModule: implementation-data-type=uint8
        ResetCounter_Trap: implementation-data-type=uint8
        ResetCounter_Trap_GS: implementation-data-type=uint8
        ResetCounter_WD: implementation-data-type=uint8
        ResetCounter_WD_GS: implementation-data-type=uint8
        ResetCounter_CTRL_App: implementation-data-type=uint8
        ResetCounter_CTRL_Warning: implementation-data-type=uint8
        ResetCounter_CXDR_ADC: implementation-data-type=uint8
        ResetCounter_CXDR_IOC: implementation-data-type=uint8
        ResetCounter_CXDR_SafeTTMonitor: implementation-data-type=uint8
        ResetCounter_CXDR_Sound: implementation-data-type=uint8
        ResetCounter_IoHwAb: implementation-data-type=uint8
        ResetCounter_MDL_BCCT: implementation-data-type=uint8
        ResetCounter_MDL_CarModes: implementation-data-type=uint8
        ResetCounter_SRV_Cfg_Safety: implementation-data-type=uint8
        ResetCounter_SRV_Power: implementation-data-type=uint8
        ResetCounter_VIEW_Sound: implementation-data-type=uint8
        ResetCounter_SRV_ComExt_TaskFast: implementation-data-type=uint8
        ResetCounter_BURAMMarkerInvalid: implementation-data-type=uint8
        ResetCounter_BuramChecksumError: implementation-data-type=uint8
        ResetCounter_RamHashError: implementation-data-type=uint8
        ResetCounter_EcuMErrorHook: implementation-data-type=uint8
        ResetCounter_DeepStopNotEntered: implementation-data-type=uint8
        ResetCounter_EcuM_BswErrorHook: implementation-data-type=uint8
        ResetCounter_TmrFailure: implementation-data-type=uint8
        ResetCounter_SRV_ComExt_Task50: implementation-data-type=uint8
        ResetCounter_CXDR_DisplayMonitor: implementation-data-type=uint8
        ResetCounter_SRV_MemTest: implementation-data-type=uint8
        ResetCounter_ECC_Error: implementation-data-type=uint8
        ResetCounter_MPU_Error: implementation-data-type=uint8
        ResetCounter_CSV_Error: implementation-data-type=uint8
        ResetCounter_CXDR_Illum: implementation-data-type=uint8
        ResetCounter_TFT_alive: implementation-data-type=uint8
        ResetCounter_backlight: implementation-data-type=uint8
        ResetCounter_CXDR_Sensors: implementation-data-type=uint8
        SiWalaACT_0xA00049: implementation-data-type=uint8
        SiWalaActive_0xA00049: implementation-data-type=uint8
        SiWalaExpState_0xA00049: implementation-data-type=uint8
        SiWalaId_0xA00049: implementation-data-type=uint8
        ResetCounter_MDL_Immobilizer: implementation-data-type=uint8
        ResetCounter_MDL_SiWaLa: implementation-data-type=uint8
        ResetCounter_SRV_Monitor: implementation-data-type=uint8
        BlackScreen_Reason: implementation-data-type=uint8
        ResetCounter_LastResetReason: implementation-data-type=uint32
        ResetCounter_RendererTaskError: implementation-data-type=uint8
        ResetCounter_HMITaskError: implementation-data-type=uint8
        ResetCounter_DpMainTaskError: implementation-data-type=uint8
        ResetCounter_GuiQueueError: implementation-data-type=uint8
        ResetCounter_DpQueueError: implementation-data-type=uint8
        ResetCounter_EventQueueError: implementation-data-type=uint8
        zReserved_Recorder_VAR: implementation-data-type=uint8
    NV_Data_Recorder_VAR_2
      27 x element, all with category=TYPE_REFERENCE:
        ResetCounter_ProtectionHook: implementation-data-type=uint8
        ResetCounter_ErrorHook: implementation-data-type=uint8
        ResetCounter_ShutdownHook: implementation-data-type=uint8
        ResetCounter_Det_ErrorHook: implementation-data-type=uint8
        TaskListEntry{1..5}: implementation-data-type=uint8
        HookInfo_ProtectionHook: implementation-data-type=uint8
        HookInfo_ErrorHook: implementation-data-type=uint8
        HookInfo_ShutdownHook: implementation-data-type=uint8
        HookInfo_BswModuleId_EcuM_BswErrorHook: implementation-data-type=uint16
        HookInfo_ErrorId_EcuM_BswErrorHook: implementation-data-type=uint8
        HookInfo_EcuM_ErrorHook: implementation-data-type=uint8
        HookInfo_ModuleId_Det_ErrorHook: implementation-data-type=uint16
        HookInfo_InstanceId_Det_ErrorHook: implementation-data-type=uint8
        HookInfo_ApiId_Det_ErrorHook: implementation-data-type=uint8
        HookInfo_ErrorId_Det_ErrorHook: implementation-data-type=uint8
        VersionListEntry{1..5}: implementation-data-type=Arr_u8_4
        VersionListIndex: implementation-data-type=uint8
        VersionListFlash_Counter: implementation-data-type=uint16
        zReserved_Recorder_VAR_2: implementation-data-type=Arr_u8_6
    NV_Data_SAFETY_RECORD_VAR
      17 x element, all with category=TYPE_REFERENCE:
        AbsErrorPath: implementation-data-type=uint16
        AirbagErrorPath: implementation-data-type=uint16
        CwlErrorPath: implementation-data-type=uint16
        EpbErrorPath: implementation-data-type=uint16
        EspErrorPath: implementation-data-type=uint16
        GeneralBrakeErrorPath: implementation-data-type=uint16
        LeftIndicatorErrorPath: implementation-data-type=uint16
        RightIndicatorErrorPath: implementation-data-type=uint16
        AbsErrorCounter: implementation-data-type=uint8
        AirbagErrorCounter: implementation-data-type=uint8
        CwlErrorCounter: implementation-data-type=uint8
        EpbErrorCounter: implementation-data-type=uint8
        EspErrorCounter: implementation-data-type=uint8
        GeneralBrakeErrorCounter: implementation-data-type=uint8
        LeftIndicatorErrorCounter: implementation-data-type=uint8
        RightIndicatorErrorCounter: implementation-data-type=uint8
        zReserved_SAFETY_RECORD_VAR: implementation-data-type=Arr_u8_4
    NV_Data_SRV_TKM_ZvCrH_TKM_ZvCrHPimTkKeyInCarNeed
      element SRV_TKM_ZvCrH_TKM_ZvCrHPimTkKeyInCarNeed: implementation-data-type=Arr_u8_16
    NV_Data_SecDiag
      6 x element, all with category=TYPE_REFERENCE:
        Manufacturing_PublicKey: implementation-data-type=Arr_u8_32
        Manufacturing_SID: implementation-data-type=Arr_u8_32
        SFD_Project_ID: implementation-data-type=uint32
        SFD_Group_Attribute: implementation-data-type=Arr_u8_23
        VKMS_InitalKey_IS: implementation-data-type=Arr_u8_32
        zReserved_SecDiag: implementation-data-type=Arr_u8_27
    NV_Data_ServiceKey_VAR
      11 x element, all with category=TYPE_REFERENCE:
        ServiceKey_Counter_Key_ID_Kessy: implementation-data-type=uint16
        ServiceKey_Counter_Key_ID{1..8}: implementation-data-type=uint16
        SKey_Error_Counter: implementation-data-type=uint16
        zReserved_ServiceKey_VAR: implementation-data-type=Arr_u8_8
    NV_Data_Service_History_Data
      element Service_History: implementation-data-type=Arr_u32_64
    NV_Data_TANK_Variant_CONST
      9 x element, all with category=TYPE_REFERENCE:
        rw_calc_time: implementation-data-type=uint8
        Fuel_Calib_Dry_Max: implementation-data-type=uint8
        Fuel_Calib_DryCalibration: implementation-data-type=uint8
        Fuel_Calib_Full_Max: implementation-data-type=uint8
        Fuel_Calib_FullCalibration: implementation-data-type=uint8
        zReserved_2_TANK_Variant_CONST: implementation-data-type=uint8
        Fuel_Calib_Wet_Max: implementation-data-type=uint8
        Fuel_Calib_WetCalibration: implementation-data-type=uint8
        zReserved_3_TANK_Variant_CONST: implementation-data-type=Arr_u8_10
    NV_Data_USER_PROFILE0
      element USER_PROFILE0: implementation-data-type=Arr_u8_60
    NV_Data_USER_PROFILE1
      element USER_PROFILE1: implementation-data-type=Arr_u8_60
    NV_Data_USER_PROFILE2
      element USER_PROFILE2: implementation-data-type=Arr_u8_60
    NV_Data_USER_PROFILE3
      element USER_PROFILE3: implementation-data-type=Arr_u8_60
    NV_Data_USER_PROFILE4
      element USER_PROFILE4: implementation-data-type=Arr_u8_60
    NV_Data_USER_PROFILE5
      element USER_PROFILE5: implementation-data-type=Arr_u8_60
    NV_Data_USER_PROFILE6
      element USER_PROFILE6: implementation-data-type=Arr_u8_60
    NV_Data_USER_PROFILE7
      element USER_PROFILE7: implementation-data-type=Arr_u8_60
    NV_Data_WLTP_Odo_VAR
      34 x element, all with category=TYPE_REFERENCE:
        dm_Esc_distance_pulse: implementation-data-type=uint32
        dm_Number_of_jumps_distance_pulse: implementation-data-type=uint16
        dm_Biggest_negative_jump_distance_pulse: implementation-data-type=uint32
        dm_Biggest_positive_jump_distance_pulse: implementation-data-type=uint32
        dm_Sum_jumps_distance_pulse: implementation-data-type=uint32
        dm_Balance_sheet_jumps_distance_pulse: implementation-data-type=sint32
        dm_Number_of_communication_failures_ESC: implementation-data-type=uint16
        dm_Total_duration_communication_failures_ESC: implementation-data-type=uint32
        dm_Longest_communication_failures_ESC: implementation-data-type=uint16
        dm_error_secure_storage_AR: implementation-data-type=uint8
        dm_TimeStampYear: implementation-data-type=uint16
        dm_TimeStampMonth: implementation-data-type=uint8
        dm_TimeStampDay: implementation-data-type=uint8
        dm_TimeStampHour: implementation-data-type=uint8
        dm_TimeStampMinute: implementation-data-type=uint8
        dm_TimeStampSecond: implementation-data-type=uint8
        total_distance_sum_implaus_jump_low_ESP: implementation-data-type=uint32
        total_distance_sum_implaus_jump_high_ESP: implementation-data-type=uint32
        counter_lost_communication_Distance: implementation-data-type=uint32
        counter_lost_communication_EdgeCount: implementation-data-type=uint32
        counter_lost_communication_time: implementation-data-type=uint32
        counter_lost_communication_clamp15: implementation-data-type=uint16
        dm_total_distance: implementation-data-type=uint32
        dm_error_calculation_dates: implementation-data-type=uint8
        ESP_number_of_teeth_lastmode: implementation-data-type=uint8
        wheel_circumference_lastmode: implementation-data-type=uint16
        rawVIN_lastmode: implementation-data-type=Arr_u8_18
        total_distance_pass_jump_lastmode: implementation-data-type=uint8
        rawVin_change_in_clamp15_lastmode: implementation-data-type=uint8
        da_total_distance_pass_jump: implementation-data-type=uint8
        SSO_EdgeCount_Sum_lastmode: implementation-data-type=uint32
        total_distance_jump_is_valid: implementation-data-type=uint8
        distance_unit_default: implementation-data-type=boolean
        zReserved_WLTP_Odo: implementation-data-type=Arr_u8_15
