[part 3 of 4: package /ComponentTypes]
AUTOSAR XML (schema 4-2-1)
package /ComponentTypes  (continued)
  nv block sw component type NvBlockSwComponentType  (continued)
    94 x nv block descriptor, all with support-dirty-flag=true:  (continued)
      NVBlockDescriptor_DIAG_AC_IlluminationCfg_VAR_1: client-server-ports=role-based-port-assignment={port-prototype=DIAG_AC_IlluminationCfg_VAR_1_NvM_JobFinished, role=DIAG_AC_IlluminationCfg_VAR_1_NvM_JobFinished}
        nv-block-data-mappings:
          nv-ram-block-element=autosar-variable-in-impl-datatype=PWM_Damping_CurveSwitch, written-read-nv-data=PWM_Damping_CurveSwitch.Value
          nv-ram-block-element=autosar-variable-in-impl-datatype=PWM_Pointer_xt_X, written-read-nv-data=PWM_Pointer_xt_X.Value
          nv-ram-block-element=autosar-variable-in-impl-datatype=PWM_Pointer_xt_Y, written-read-nv-data=PWM_Pointer_xt_Y.Value
          nv-ram-block-element=autosar-variable-in-impl-datatype=Debouncing_AutomaticDrivingLight, written-read-nv-data=Debouncing_AutomaticDrivingLight.Value
          nv-ram-block-element=autosar-variable-in-impl-datatype=Debouncing_FogLight, written-read-nv-data=Debouncing_FogLight.Value
          nv-ram-block-element=autosar-variable-in-impl-datatype=Debouncing_LowBeam, written-read-nv-data=Debouncing_LowBeam.Value
          nv-ram-block-element=autosar-variable-in-impl-datatype=Debouncing_Sidelight, written-read-nv-data=Debouncing_Sidelight.Value
          nv-ram-block-element=autosar-variable-in-impl-datatype=Pointer_Kl_58xt_Kl_58xd, written-read-nv-data=Pointer_Kl_58xt_Kl_58xd.Value
          nv-ram-block-element=autosar-variable-in-impl-datatype=Scales_DayResponseCurve, written-read-nv-data=Scales_DayResponseCurve.Value
          nv-ram-block-element=autosar-variable-in-impl-datatype=p_PWM_DampingCurve, written-read-nv-data=p_PWM_DampingCurve.Value
          nv-ram-block-element=autosar-variable-in-impl-datatype=p_Bargraph_Luminosity_Calibration_PWM, written-read-nv-data=p_Bargraph_Luminosity_Calibration_PWM.Value
          nv-ram-block-element=autosar-variable-in-impl-datatype=zReserved_DIAG_AC_IlluminationCfg_1_VAR, written-read-nv-data=zReserved_DIAG_AC_IlluminationCfg_1_VAR.Value
        nv block needs NVNeed_NVBlockDescriptor: n-data-sets=2, ram-block-status-control=API, reliability=NO-PROTECTION, restore-at-start=true, store-at-shutdown=false, store-immediate=true, write-verification=false
        ram block RAM_NVBlockDescriptor_DIAG_AC_IlluminationCfg_VAR_1: type=NV_Data_DIAG_AC_IlluminationCfg_VAR_1, init-value=fields=[PWM_Damping_CurveSwitch:0, PWM_Pointer_xt_X:[0, 200, 300, 500, 700, 1000], PWM_Pointer_xt_Y:[0, 200, 300, 500, 700, 1000], Debouncing_AutomaticDrivingLight:2, Debouncing_FogLight:2, Debouncing_LowBeam:2, Debouncing_Sidelight:2, Pointer_Kl_58xt_Kl_58xd:1, Scales_DayResponseCurve:2, p_PWM_DampingCurve:100, p_Bargraph_Luminosity_Calibration_PWM:[16, 39, 16, 39], zReserved_DIAG_AC_IlluminationCfg_1_VAR:14 x 255]
        rom block ROM_NVBlockDescriptor_DIAG_AC_IlluminationCfg_VAR_1:
          sw-calibration-access=READ-WRITE
          type=NV_Data_DIAG_AC_IlluminationCfg_VAR_1
          init-value=fields=[PWM_Damping_CurveSwitch:0, PWM_Pointer_xt_X:[0, 200, 300, 500, 700, 1000], PWM_Pointer_xt_Y:[0, 200, 300, 500, 700, 1000], Debouncing_AutomaticDrivingLight:2, Debouncing_FogLight:2, Debouncing_LowBeam:2, Debouncing_Sidelight:2, Pointer_Kl_58xt_Kl_58xd:1, Scales_DayResponseCurve:2, p_PWM_DampingCurve:100, p_Bargraph_Luminosity_Calibration_PWM:[16, 39, 16, 39], zReserved_DIAG_AC_IlluminationCfg_1_VAR:14 x 255]
      NVBlockDescriptor_DIAG_AC_IlluminationCfg_VAR_3: client-server-ports=role-based-port-assignment={port-prototype=DIAG_AC_IlluminationCfg_VAR_3_NvM_JobFinished, role=DIAG_AC_IlluminationCfg_VAR_3_NvM_JobFinished}
        nv-block-data-mappings:
          nv-ram-block-element=autosar-variable-in-impl-datatype=Reserved_DIAG_AC_IlluminationCfg_VAR_3, written-read-nv-data=Reserved_DIAG_AC_IlluminationCfg_VAR_3.Value
          nv-ram-block-element=autosar-variable-in-impl-datatype=IllumThreshold_CRC, written-read-nv-data=IllumThreshold_CRC.Value
          nv-ram-block-element=autosar-variable-in-impl-datatype=Overheat_DIMM_primary, written-read-nv-data=Overheat_DIMM_primary.Value
          nv-ram-block-element=autosar-variable-in-impl-datatype=TFT_Threshold1, written-read-nv-data=TFT_Threshold1.Value
          nv-ram-block-element=autosar-variable-in-impl-datatype=TFT_Threshold2, written-read-nv-data=TFT_Threshold2.Value
          nv-ram-block-element=autosar-variable-in-impl-datatype=Temp_Threshold_Max_QuartzTemp, written-read-nv-data=Temp_Threshold_Max_QuartzTemp.Value
          nv-ram-block-element=autosar-variable-in-impl-datatype=PCB_Threshold1, written-read-nv-data=PCB_Threshold1.Value
          nv-ram-block-element=autosar-variable-in-impl-datatype=Rate, written-read-nv-data=Rate.Value
          nv-ram-block-element=autosar-variable-in-impl-datatype=PCB_Threshold2, written-read-nv-data=PCB_Threshold2.Value
          nv-ram-block-element=autosar-variable-in-impl-datatype=Overheat_DIMM_secondary, written-read-nv-data=Overheat_DIMM_secondary.Value
          nv-ram-block-element=autosar-variable-in-impl-datatype=Photosensor_enabled, written-read-nv-data=Photosensor_enabled.Value
          nv-ram-block-element=autosar-variable-in-impl-datatype=Compensation_Line_Slope_m_Left, written-read-nv-data=Compensation_Line_Slope_m_Left.Value
          nv-ram-block-element=autosar-variable-in-impl-datatype=Compensation_Line_Shift_b_Left, written-read-nv-data=Compensation_Line_Shift_b_Left.Value
          nv-ram-block-element=autosar-variable-in-impl-datatype=Compensation_Line_Slope_m_Right, written-read-nv-data=Compensation_Line_Slope_m_Right.Value
          nv-ram-block-element=autosar-variable-in-impl-datatype=Compensation_Line_Shift_b_Right, written-read-nv-data=Compensation_Line_Shift_b_Right.Value
          nv-ram-block-element=autosar-variable-in-impl-datatype=Photosensor_Plausi_Threshold, written-read-nv-data=Photosensor_Plausi_Threshold.Value
          nv-ram-block-element=autosar-variable-in-impl-datatype=TFT_Safety_Offset, written-read-nv-data=TFT_Safety_Offset.Value
          nv-ram-block-element=autosar-variable-in-impl-datatype=Reserved_1_DIAG_AC_IlluminationCfg_VAR_3, written-read-nv-data=Reserved_1_DIAG_AC_IlluminationCfg_VAR_3.Value
        nv block needs NVNeed_NVBlockDescriptor: n-data-sets=2, ram-block-status-control=API, reliability=NO-PROTECTION, restore-at-start=true, store-at-shutdown=false, store-immediate=true, write-verification=false
        ram block RAM_NVBlockDescriptor_DIAG_AC_IlluminationCfg_VAR_3: type=NV_Data_DIAG_AC_IlluminationCfg_VAR_3, init-value=fields=[Reserved_DIAG_AC_IlluminationCfg_VAR_3:16 x 255, IllumThreshold_CRC:42880, Overheat_DIMM_primary:0, TFT_Threshold1:233, TFT_Threshold2:269, Temp_Threshold_Max_QuartzTemp:100, PCB_Threshold1:2379, Rate:100, PCB_Threshold2:2453, Overheat_DIMM_secondary:0, Photosensor_enabled:0, Compensation_Line_Slope_m_Left:113570, Compensation_Line_Shift_b_Left:11, Compensation_Line_Slope_m_Right:113570, Compensation_Line_Shift_b_Right:11, Photosensor_Plausi_Threshold:5000, TFT_Safety_Offset:21, Reserved_1_DIAG_AC_IlluminationCfg_VAR_3:6 x 255]
        rom block ROM_NVBlockDescriptor_DIAG_AC_IlluminationCfg_VAR_3:
          sw-calibration-access=READ-WRITE
          type=NV_Data_DIAG_AC_IlluminationCfg_VAR_3
          init-value=fields=[Reserved_DIAG_AC_IlluminationCfg_VAR_3:16 x 255, IllumThreshold_CRC:42880, Overheat_DIMM_primary:0, TFT_Threshold1:233, TFT_Threshold2:269, Temp_Threshold_Max_QuartzTemp:100, PCB_Threshold1:2379, Rate:100, PCB_Threshold2:2453, Overheat_DIMM_secondary:0, Photosensor_enabled:0, Compensation_Line_Slope_m_Left:113570, Compensation_Line_Shift_b_Left:11, Compensation_Line_Slope_m_Right:113570, Compensation_Line_Shift_b_Right:11, Photosensor_Plausi_Threshold:5000, TFT_Safety_Offset:21, Reserved_1_DIAG_AC_IlluminationCfg_VAR_3:6 x 255]
      NVBlockDescriptor_DIAG_AC_ServiceCfg_VAR: client-server-ports=role-based-port-assignment={port-prototype=DIAG_AC_ServiceCfg_VAR_NvM_JobFinished, role=DIAG_AC_ServiceCfg_VAR_NvM_JobFinished}
        nv-block-data-mappings:
          nv-ram-block-element=autosar-variable-in-impl-datatype=Oil_Elapsed_Km, written-read-nv-data=Oil_Elapsed_Km.Value
          nv-ram-block-element=autosar-variable-in-impl-datatype=Oil_SootContamination_Sum, written-read-nv-data=Oil_SootContamination_Sum.Value
          nv-ram-block-element=autosar-variable-in-impl-datatype=Oil_ThermalWear_Sum, written-read-nv-data=Oil_ThermalWear_Sum.Value
          nv-ram-block-element=autosar-variable-in-impl-datatype=DailyMileage, written-read-nv-data=DailyMileage.Value
          nv-ram-block-element=autosar-variable-in-impl-datatype=Inspection_Elapsed_Days, written-read-nv-data=Inspection_Elapsed_Days.Value
          nv-ram-block-element=autosar-variable-in-impl-datatype=Inspection_Elapsed_Km, written-read-nv-data=Inspection_Elapsed_Km.Value
          nv-ram-block-element=autosar-variable-in-impl-datatype=Inspection_MaxNext_Days, written-read-nv-data=Inspection_MaxNext_Days.Value
          nv-ram-block-element=autosar-variable-in-impl-datatype=Inspection_MaxNext_Km, written-read-nv-data=Inspection_MaxNext_Km.Value
          nv-ram-block-element=autosar-variable-in-impl-datatype=Inspection_ResetValue_Days, written-read-nv-data=Inspection_ResetValue_Days.Value
          nv-ram-block-element=autosar-variable-in-impl-datatype=Inspection_ResetValue_Km, written-read-nv-data=Inspection_ResetValue_Km.Value
          nv-ram-block-element=autosar-variable-in-impl-datatype=Oil_Elapsed_Days, written-read-nv-data=Oil_Elapsed_Days.Value
          nv-ram-block-element=autosar-variable-in-impl-datatype=Oil_FixedNext_Days, written-read-nv-data=Oil_FixedNext_Days.Value
          nv-ram-block-element=autosar-variable-in-impl-datatype=Oil_FixedNext_Km, written-read-nv-data=Oil_FixedNext_Km.Value
          nv-ram-block-element=autosar-variable-in-impl-datatype=Oil_Theoretic_Km, written-read-nv-data=Oil_Theoretic_Km.Value
          nv-ram-block-element=autosar-variable-in-impl-datatype=Oil_VariableMaxNext_Days, written-read-nv-data=Oil_VariableMaxNext_Days.Value
          nv-ram-block-element=autosar-variable-in-impl-datatype=Oil_VariableMaxNext_Km, written-read-nv-data=Oil_VariableMaxNext_Km.Value
          nv-ram-block-element=autosar-variable-in-impl-datatype=Oil_VariableMinNext_Days, written-read-nv-data=Oil_VariableMinNext_Days.Value
          nv-ram-block-element=autosar-variable-in-impl-datatype=Oil_VariableMinNext_Km, written-read-nv-data=Oil_VariableMinNext_Km.Value
          nv-ram-block-element=autosar-variable-in-impl-datatype=p_Oil_Exceeded_Days, written-read-nv-data=p_Oil_Exceeded_Days.Value
          nv-ram-block-element=autosar-variable-in-impl-datatype=p_Oil_Exceeded_Km, written-read-nv-data=p_Oil_Exceeded_Km.Value
          nv-ram-block-element=autosar-variable-in-impl-datatype=Oil_Quality, written-read-nv-data=Oil_Quality.Value
          nv-ram-block-element=autosar-variable-in-impl-datatype=Oil_Reset, written-read-nv-data=Oil_Reset.Value
          nv-ram-block-element=autosar-variable-in-impl-datatype=Service_PreWarning_Days, written-read-nv-data=Service_PreWarning_Days.Value
          nv-ram-block-element=autosar-variable-in-impl-datatype=Coolant_Cold_Indication_Present, written-read-nv-data=Coolant_Cold_Indication_Present.Value
          nv-ram-block-element=autosar-variable-in-impl-datatype=zReserved_DIAG_AC_ServiceCfg_VAR, written-read-nv-data=zReserved_DIAG_AC_ServiceCfg_VAR.Value
        nv block needs NVNeed_NVBlockDescriptor: n-data-sets=2, ram-block-status-control=API, reliability=NO-PROTECTION, restore-at-start=true, store-at-shutdown=false, store-immediate=true, write-verification=false
        ram block RAM_NVBlockDescriptor_DIAG_AC_ServiceCfg_VAR: type=NV_Data_DIAG_AC_ServiceCfg_VAR, init-value=fields=[Oil_Elapsed_Km:0, Oil_SootContamination_Sum:0, Oil_ThermalWear_Sum:0, DailyMileage:100, Inspection_Elapsed_Days:0, Inspection_Elapsed_Km:0, Inspection_MaxNext_Days:1095, Inspection_MaxNext_Km:300, Inspection_ResetValue_Days:365, Inspection_ResetValue_Km:300, Oil_Elapsed_Days:0, Oil_FixedNext_Days:365, Oil_FixedNext_Km:150, Oil_Theoretic_Km:150, Oil_VariableMaxNext_Days:730, Oil_VariableMaxNext_Km:300, Oil_VariableMinNext_Days:365, Oil_VariableMinNext_Km:150, p_Oil_Exceeded_Days:0, p_Oil_Exceeded_Km:0, Oil_Quality:1, Oil_Reset:0, Service_PreWarning_Days:30, Coolant_Cold_Indication_Present:0, zReserved_DIAG_AC_ServiceCfg_VAR:[255, 255]]
        rom block ROM_NVBlockDescriptor_DIAG_AC_ServiceCfg_VAR:
          sw-calibration-access=READ-WRITE
          type=NV_Data_DIAG_AC_ServiceCfg_VAR
          init-value=fields=[Oil_Elapsed_Km:0, Oil_SootContamination_Sum:0, Oil_ThermalWear_Sum:0, DailyMileage:100, Inspection_Elapsed_Days:0, Inspection_Elapsed_Km:0, Inspection_MaxNext_Days:1095, Inspection_MaxNext_Km:300, Inspection_ResetValue_Days:365, Inspection_ResetValue_Km:300, Oil_Elapsed_Days:0, Oil_FixedNext_Days:365, Oil_FixedNext_Km:150, Oil_Theoretic_Km:150, Oil_VariableMaxNext_Days:730, Oil_VariableMaxNext_Km:300, Oil_VariableMinNext_Days:365, Oil_VariableMinNext_Km:150, p_Oil_Exceeded_Days:0, p_Oil_Exceeded_Km:0, Oil_Quality:1, Oil_Reset:0, Service_PreWarning_Days:30, Coolant_Cold_Indication_Present:0, zReserved_DIAG_AC_ServiceCfg_VAR:[255, 255]]
      NVBlockDescriptor_DIAG_AdaptationChannel_VAR_0: client-server-ports=role-based-port-assignment={port-prototype=DIAG_AdaptationChannel_VAR_0_NvM_JobFinished, role=DIAG_AdaptationChannel_VAR_0_NvM_JobFinished}
        nv-block-data-mappings:
          nv-ram-block-element=autosar-variable-in-impl-datatype=bap_bc_mfa_SpeedWarning_Speed_Value, written-read-nv-data=bap_bc_mfa_SpeedWarning_Speed_Value.Value
          nv-ram-block-element=autosar-variable-in-impl-datatype=DIAG_AdaptationChannel_VAR_0_Safety_CRC, written-read-nv-data=DIAG_AdaptationChannel_VAR_0_Safety_CRC.Value
          nv-ram-block-element=autosar-variable-in-impl-datatype=Fuel_Calib_Vol_Dead, written-read-nv-data=Fuel_Calib_Vol_Dead.Value
          nv-ram-block-element=autosar-variable-in-impl-datatype=Fuel_Calib_Vol_Filled, written-read-nv-data=Fuel_Calib_Vol_Filled.Value
          nv-ram-block-element=autosar-variable-in-impl-datatype=RangeAvgConsumption_High, written-read-nv-data=RangeAvgConsumption_High.Value
          nv-ram-block-element=autosar-variable-in-impl-datatype=t_DisplayDelay_KL15Off, written-read-nv-data=t_DisplayDelay_KL15Off.Value
          nv-ram-block-element=autosar-variable-in-impl-datatype=t_DisplayDelay_KL15On, written-read-nv-data=t_DisplayDelay_KL15On.Value
          nv-ram-block-element=autosar-variable-in-impl-datatype=VKM_Range_RangeAvgConsumptiom_Default, written-read-nv-data=VKM_Range_RangeAvgConsumptiom_Default.Value
          nv-ram-block-element=autosar-variable-in-impl-datatype=Adaption_SeatbeltWarning, written-read-nv-data=Adaption_SeatbeltWarning.Value
          nv-ram-block-element=autosar-variable-in-impl-datatype=bap_bc_mfa_SpeedWarning_Speed_Unit, written-read-nv-data=bap_bc_mfa_SpeedWarning_Speed_Unit.Value
          nv-ram-block-element=autosar-variable-in-impl-datatype=bap_bc_mfa_SpeedWarning_State, written-read-nv-data=bap_bc_mfa_SpeedWarning_State.Value
          nv-ram-block-element=autosar-variable-in-impl-datatype=Bc_Layer3_Auto_Reset, written-read-nv-data=Bc_Layer3_Auto_Reset.Value
          nv-ram-block-element=autosar-variable-in-impl-datatype=Bc_Layer3_Auto_Reset_Gas, written-read-nv-data=Bc_Layer3_Auto_Reset_Gas.Value
          nv-ram-block-element=autosar-variable-in-impl-datatype=Bc_Layer3_Manual_Reset, written-read-nv-data=Bc_Layer3_Manual_Reset.Value
          nv-ram-block-element=autosar-variable-in-impl-datatype=Calibration_Date, written-read-nv-data=Calibration_Date.Value
          nv-ram-block-element=autosar-variable-in-impl-datatype=Calibration_Shop_Code, written-read-nv-data=Calibration_Shop_Code.Value
          nv-ram-block-element=autosar-variable-in-impl-datatype=ConsumptionCorrection, written-read-nv-data=ConsumptionCorrection.Value
          nv-ram-block-element=autosar-variable-in-impl-datatype=ConsumptionCorrection_Cng, written-read-nv-data=ConsumptionCorrection_Cng.Value
          nv-ram-block-element=autosar-variable-in-impl-datatype=Fuel_Calib_Full_Offset, written-read-nv-data=Fuel_Calib_Full_Offset.Value
          nv-ram-block-element=autosar-variable-in-impl-datatype=Fuel_Offset_Sensor_{1..4}, written-read-nv-data=Fuel_Offset_Sensor_{1..4}.Value
          nv-ram-block-element=autosar-variable-in-impl-datatype=Hmi_Skinning, written-read-nv-data=Hmi_Skinning.Value
          nv-ram-block-element=autosar-variable-in-impl-datatype=hmi_t_RearBelt, written-read-nv-data=hmi_t_RearBelt.Value
          nv-ram-block-element=autosar-variable-in-impl-datatype=Ignition_Active_Message, written-read-nv-data=Ignition_Active_Message.Value
          nv-ram-block-element=autosar-variable-in-impl-datatype=Seatbelt_Rear_Delaytime_acoustic, written-read-nv-data=Seatbelt_Rear_Delaytime_acoustic.Value
          nv-ram-block-element=autosar-variable-in-impl-datatype=Seatbelt_Rear_Displaytime_buckle, written-read-nv-data=Seatbelt_Rear_Displaytime_buckle.Value
          nv-ram-block-element=autosar-variable-in-impl-datatype=Seatbelt_Rear_speed_blinking_off, written-read-nv-data=Seatbelt_Rear_speed_blinking_off.Value
          nv-ram-block-element=autosar-variable-in-impl-datatype=Seatbelt_Rear_speed_blinking_on, written-read-nv-data=Seatbelt_Rear_speed_blinking_on.Value
          nv-ram-block-element=autosar-variable-in-impl-datatype=Seatbelt_SBR_Installed, written-read-nv-data=Seatbelt_SBR_Installed.Value
          nv-ram-block-element=autosar-variable-in-impl-datatype=SynchronizationTime_DriversDoor, written-read-nv-data=SynchronizationTime_DriversDoor.Value
          nv-ram-block-element=autosar-variable-in-impl-datatype=VKM_Range_Distance_Unclass, written-read-nv-data=VKM_Range_Distance_Unclass.Value
          nv-ram-block-element=autosar-variable-in-impl-datatype=BAP_Debug_Mode_enabled, written-read-nv-data=BAP_Debug_Mode_enabled.Value
          nv-ram-block-element=autosar-variable-in-impl-datatype=CylinderDeactivation_Active, written-read-nv-data=CylinderDeactivation_Active.Value
          nv-ram-block-element=autosar-variable-in-impl-datatype=Display_Save_CP, written-read-nv-data=Display_Save_CP.Value
          nv-ram-block-element=autosar-variable-in-impl-datatype=Picture_Upload_Download, written-read-nv-data=Picture_Upload_Download.Value
          nv-ram-block-element=autosar-variable-in-impl-datatype=ProductionMode, written-read-nv-data=ProductionMode.Value
          nv-ram-block-element=autosar-variable-in-impl-datatype=RollTestStandMode, written-read-nv-data=RollTestStandMode.Value
          nv-ram-block-element=autosar-variable-in-impl-datatype=Vehicle_Network, written-read-nv-data=Vehicle_Network.Value
          nv-ram-block-element=autosar-variable-in-impl-datatype=lautstaerke_offset, written-read-nv-data=lautstaerke_offset.Value
          nv-ram-block-element=autosar-variable-in-impl-datatype=tachoendwert, written-read-nv-data=tachoendwert.Value
          nv-ram-block-element=autosar-variable-in-impl-datatype=skinning, written-read-nv-data=skinning.Value
          nv-ram-block-element=autosar-variable-in-impl-datatype=Bc_Layer3_Auto_Reset_EV, written-read-nv-data=Bc_Layer3_Auto_Reset_EV.Value
          nv-ram-block-element=autosar-variable-in-impl-datatype=V_Config_WarningThreshold1_Indien, written-read-nv-data=V_Config_WarningThreshold1_Indien.Value
        nv block needs NVNeed_NVBlockDescriptor: n-data-sets=2, ram-block-status-control=API, reliability=NO-PROTECTION, restore-at-start=true, store-at-shutdown=false, store-immediate=true, write-verification=false
        ram block RAM_NVBlockDescriptor_DIAG_AdaptationChannel_VAR_0: type=NV_Data_DIAG_AdaptationChannel_VAR_0, init-value=fields=[bap_bc_mfa_SpeedWarning_Speed_Value:0, DIAG_AdaptationChannel_VAR_0_Safety_CRC:39665, Fuel_Calib_Vol_Dead:0, Fuel_Calib_Vol_Filled:0, RangeAvgConsumption_High:1023, t_DisplayDelay_KL15Off:3, t_DisplayDelay_KL15On:0, VKM_Range_RangeAvgConsumptiom_Default:80, Adaption_SeatbeltWarning:0, bap_bc_mfa_SpeedWarning_Speed_Unit:0, bap_bc_mfa_SpeedWarning_State:0, Bc_Layer3_Auto_Reset:1, Bc_Layer3_Auto_Reset_Gas:1, Bc_Layer3_Manual_Reset:0, Calibration_Date:[0, 1, 1], Calibration_Shop_Code:6 x 0, ConsumptionCorrection:100, ConsumptionCorrection_Cng:100, Fuel_Calib_Full_Offset:-128, Fuel_Offset_Sensor_1:-128, Fuel_Offset_Sensor_2:-128, Fuel_Offset_Sensor_3:127, Fuel_Offset_Sensor_4:127, Hmi_Skinning:0, hmi_t_RearBelt:65, Ignition_Active_Message:1, Seatbelt_Rear_Delaytime_acoustic:0, Seatbelt_Rear_Displaytime_buckle:31, Seatbelt_Rear_speed_blinking_off:5, Seatbelt_Rear_speed_blinking_on:25, Seatbelt_SBR_Installed:3, SynchronizationTime_DriversDoor:30, VKM_Range_Distance_Unclass:100, BAP_Debug_Mode_enabled:0, CylinderDeactivation_Active:1, Display_Save_CP:1, Picture_Upload_Download:0, ProductionMode:0, RollTestStandMode:0, Vehicle_Network:0, lautstaerke_offset:100, tachoendwert:0, skinning:0, Bc_Layer3_Auto_Reset_EV:1, V_Config_WarningThreshold1_Indien:12]
        rom block ROM_NVBlockDescriptor_DIAG_AdaptationChannel_VAR_0:
          sw-calibration-access=READ-WRITE
          type=NV_Data_DIAG_AdaptationChannel_VAR_0
          init-value=fields=[bap_bc_mfa_SpeedWarning_Speed_Value:0, DIAG_AdaptationChannel_VAR_0_Safety_CRC:39665, Fuel_Calib_Vol_Dead:0, Fuel_Calib_Vol_Filled:0, RangeAvgConsumption_High:1023, t_DisplayDelay_KL15Off:3, t_DisplayDelay_KL15On:0, VKM_Range_RangeAvgConsumptiom_Default:80, Adaption_SeatbeltWarning:0, bap_bc_mfa_SpeedWarning_Speed_Unit:0, bap_bc_mfa_SpeedWarning_State:0, Bc_Layer3_Auto_Reset:1, Bc_Layer3_Auto_Reset_Gas:1, Bc_Layer3_Manual_Reset:0, Calibration_Date:[0, 1, 1], Calibration_Shop_Code:6 x 0, ConsumptionCorrection:100, ConsumptionCorrection_Cng:100, Fuel_Calib_Full_Offset:-128, Fuel_Offset_Sensor_1:-128, Fuel_Offset_Sensor_2:-128, Fuel_Offset_Sensor_3:127, Fuel_Offset_Sensor_4:127, Hmi_Skinning:0, hmi_t_RearBelt:65, Ignition_Active_Message:1, Seatbelt_Rear_Delaytime_acoustic:0, Seatbelt_Rear_Displaytime_buckle:31, Seatbelt_Rear_speed_blinking_off:5, Seatbelt_Rear_speed_blinking_on:25, Seatbelt_SBR_Installed:3, SynchronizationTime_DriversDoor:30, VKM_Range_Distance_Unclass:100, BAP_Debug_Mode_enabled:0, CylinderDeactivation_Active:1, Display_Save_CP:1, Picture_Upload_Download:0, ProductionMode:0, RollTestStandMode:0, Vehicle_Network:0, lautstaerke_offset:100, tachoendwert:0, skinning:0, Bc_Layer3_Auto_Reset_EV:1, V_Config_WarningThreshold1_Indien:12]
      NVBlockDescriptor_DIAG_AdaptationChannel_VAR_1: client-server-ports=role-based-port-assignment={port-prototype=DIAG_AdaptationChannel_VAR_1_NvM_JobFinished, role=DIAG_AdaptationChannel_VAR_1_NvM_JobFinished}
        nv-block-data-mappings:
          nv-ram-block-element=autosar-variable-in-impl-datatype=BlockingDistanceVehicleMoving, written-read-nv-data=BlockingDistanceVehicleMoving.Value
          nv-ram-block-element=autosar-variable-in-impl-datatype=Lookup_Compression_Curve_Photosensor_Bus_Coef_X, written-read-nv-data=Lookup_Compression_Curve_Photosensor_Bus_Coef_X.Value
          nv-ram-block-element=autosar-variable-in-impl-datatype=SaveTimeEngineOff, written-read-nv-data=SaveTimeEngineOff.Value
          nv-ram-block-element=autosar-variable-in-impl-datatype=BlackIceThresholdHighTemp, written-read-nv-data=BlackIceThresholdHighTemp.Value
          nv-ram-block-element=autosar-variable-in-impl-datatype=BlackIceThresholdLowTemp, written-read-nv-data=BlackIceThresholdLowTemp.Value
          nv-ram-block-element=autosar-variable-in-impl-datatype=BlockingTimeVehicleMoving, written-read-nv-data=BlockingTimeVehicleMoving.Value
          nv-ram-block-element=autosar-variable-in-impl-datatype=CoolantTemperatureDelta, written-read-nv-data=CoolantTemperatureDelta.Value
          nv-ram-block-element=autosar-variable-in-impl-datatype=Forcewrite_Qual_Time, written-read-nv-data=Forcewrite_Qual_Time.Value
          nv-ram-block-element=autosar-variable-in-impl-datatype=Lookup_Compression_Curve_Photosensor_Bus_Coef_Y, written-read-nv-data=Lookup_Compression_Curve_Photosensor_Bus_Coef_Y.Value
          nv-ram-block-element=autosar-variable-in-impl-datatype=Offset_Color_Blue, written-read-nv-data=Offset_Color_Blue.Value
          nv-ram-block-element=autosar-variable-in-impl-datatype=Offset_Color_Green, written-read-nv-data=Offset_Color_Green.Value
          nv-ram-block-element=autosar-variable-in-impl-datatype=Offset_Color_Red, written-read-nv-data=Offset_Color_Red.Value
          nv-ram-block-element=autosar-variable-in-impl-datatype=SaveTimeDisplayOff, written-read-nv-data=SaveTimeDisplayOff.Value
          nv-ram-block-element=autosar-variable-in-impl-datatype=SlewRate, written-read-nv-data=SlewRate.Value
          nv-ram-block-element=autosar-variable-in-impl-datatype=SpeedThreshold, written-read-nv-data=SpeedThreshold.Value
          nv-ram-block-element=autosar-variable-in-impl-datatype=TimeConstant, written-read-nv-data=TimeConstant.Value
          nv-ram-block-element=autosar-variable-in-impl-datatype=Trend_Threshold, written-read-nv-data=Trend_Threshold.Value
          nv-ram-block-element=autosar-variable-in-impl-datatype=TrendTime, written-read-nv-data=TrendTime.Value
          nv-ram-block-element=autosar-variable-in-impl-datatype=VCOM_Adjustment, written-read-nv-data=VCOM_Adjustment.Value
          nv-ram-block-element=autosar-variable-in-impl-datatype=Write_Delay_Speed, written-read-nv-data=Write_Delay_Speed.Value
          nv-ram-block-element=autosar-variable-in-impl-datatype=Write_Delay_Time, written-read-nv-data=Write_Delay_Time.Value
          nv-ram-block-element=autosar-variable-in-impl-datatype=Write_Distance, written-read-nv-data=Write_Distance.Value
          nv-ram-block-element=autosar-variable-in-impl-datatype=Deactivate_SK_Function, written-read-nv-data=Deactivate_SK_Function.Value
          nv-ram-block-element=autosar-variable-in-impl-datatype=FAS_menu_ACC, written-read-nv-data=FAS_menu_ACC.Value
          nv-ram-block-element=autosar-variable-in-impl-datatype=FAS_menu_GRA, written-read-nv-data=FAS_menu_GRA.Value
          nv-ram-block-element=autosar-variable-in-impl-datatype=FAS_menu_LIM, written-read-nv-data=FAS_menu_LIM.Value
          nv-ram-block-element=autosar-variable-in-impl-datatype=Fuel_AuxHeater_Consumption_Active, written-read-nv-data=Fuel_AuxHeater_Consumption_Active.Value
          nv-ram-block-element=autosar-variable-in-impl-datatype=Main_Switch_Basis, written-read-nv-data=Main_Switch_Basis.Value
          nv-ram-block-element=autosar-variable-in-impl-datatype=Main_Switch_Keyless, written-read-nv-data=Main_Switch_Keyless.Value
          nv-ram-block-element=autosar-variable-in-impl-datatype=TrGW_Function_Enable, written-read-nv-data=TrGW_Function_Enable.Value
          nv-ram-block-element=autosar-variable-in-impl-datatype=personalisation_2x_active, written-read-nv-data=personalisation_2x_active.Value
          nv-ram-block-element=autosar-variable-in-impl-datatype=vkmrw_rwdv_cng_default, written-read-nv-data=vkmrw_rwdv_cng_default.Value
          nv-ram-block-element=autosar-variable-in-impl-datatype=vkmrw_rwdv_lpg_default, written-read-nv-data=vkmrw_rwdv_lpg_default.Value
          nv-ram-block-element=autosar-variable-in-impl-datatype=RangeAvgConsumption_High_LPG, written-read-nv-data=RangeAvgConsumption_High_LPG.Value
        nv block needs NVNeed_NVBlockDescriptor: n-data-sets=2, ram-block-status-control=API, reliability=NO-PROTECTION, restore-at-start=true, store-at-shutdown=false, store-immediate=true, write-verification=false
        ram block RAM_NVBlockDescriptor_DIAG_AdaptationChannel_VAR_1: type=NV_Data_DIAG_AdaptationChannel_VAR_1, init-value=fields=[BlockingDistanceVehicleMoving:50, Lookup_Compression_Curve_Photosensor_Bus_Coef_X:[0, 50, 100, 250, 500], SaveTimeEngineOff:180, BlackIceThresholdHighTemp:6, BlackIceThresholdLowTemp:4, BlockingTimeVehicleMoving:15, CoolantTemperatureDelta:70, Forcewrite_Qual_Time:10, Lookup_Compression_Curve_Photosensor_Bus_Coef_Y:[0, 40, 80, 150, 253], Offset_Color_Blue:0, Offset_Color_Green:0, Offset_Color_Red:0, SaveTimeDisplayOff:10, SlewRate:20, SpeedThreshold:20, TimeConstant:40, Trend_Threshold:10, TrendTime:15, VCOM_Adjustment:105, Write_Delay_Speed:20, Write_Delay_Time:40, Write_Distance:2, Deactivate_SK_Function:1, FAS_menu_ACC:0, FAS_menu_GRA:0, FAS_menu_LIM:0, Fuel_AuxHeater_Consumption_Active:0, Main_Switch_Basis:1, Main_Switch_Keyless:1, TrGW_Function_Enable:1, personalisation_2x_active:1, vkmrw_rwdv_cng_default:60, vkmrw_rwdv_lpg_default:100, RangeAvgConsumption_High_LPG:1023]
        rom block ROM_NVBlockDescriptor_DIAG_AdaptationChannel_VAR_1:
          sw-calibration-access=READ-WRITE
          type=NV_Data_DIAG_AdaptationChannel_VAR_1
          init-value=fields=[BlockingDistanceVehicleMoving:50, Lookup_Compression_Curve_Photosensor_Bus_Coef_X:[0, 50, 100, 250, 500], SaveTimeEngineOff:180, BlackIceThresholdHighTemp:6, BlackIceThresholdLowTemp:4, BlockingTimeVehicleMoving:15, CoolantTemperatureDelta:70, Forcewrite_Qual_Time:10, Lookup_Compression_Curve_Photosensor_Bus_Coef_Y:[0, 40, 80, 150, 253], Offset_Color_Blue:0, Offset_Color_Green:0, Offset_Color_Red:0, SaveTimeDisplayOff:10, SlewRate:20, SpeedThreshold:20, TimeConstant:40, Trend_Threshold:10, TrendTime:15, VCOM_Adjustment:105, Write_Delay_Speed:20, Write_Delay_Time:40, Write_Distance:2, Deactivate_SK_Function:1, FAS_menu_ACC:0, FAS_menu_GRA:0, FAS_menu_LIM:0, Fuel_AuxHeater_Consumption_Active:0, Main_Switch_Basis:1, Main_Switch_Keyless:1, TrGW_Function_Enable:1, personalisation_2x_active:1, vkmrw_rwdv_cng_default:60, vkmrw_rwdv_lpg_default:100, RangeAvgConsumption_High_LPG:1023]
      NVBlockDescriptor_DIAG_AdaptationChannel_VAR_2: client-server-ports=role-based-port-assignment={port-prototype=DIAG_AdaptationChannel_VAR_2_NvM_JobFinished, role=DIAG_AdaptationChannel_VAR_2_NvM_JobFinished}
        nv-block-data-mappings:
          nv-ram-block-element=autosar-variable-in-impl-datatype=ACC_Darstellung, written-read-nv-data=ACC_Darstellung.Value
          nv-ram-block-element=autosar-variable-in-impl-datatype=hmi_anteil_gas_aktiv, written-read-nv-data=hmi_anteil_gas_aktiv.Value
          nv-ram-block-element=autosar-variable-in-impl-datatype=vkmrw_gesamtreichweite_vorhanden, written-read-nv-data=vkmrw_gesamtreichweite_vorhanden.Value
          nv-ram-block-element=autosar-variable-in-impl-datatype=vkmrw_verbrauchsfaktor_kombi, written-read-nv-data=vkmrw_verbrauchsfaktor_kombi.Value
          nv-ram-block-element=autosar-variable-in-impl-datatype=vkmrw_Verbrauchsaequivalent_ein, written-read-nv-data=vkmrw_Verbrauchsaequivalent_ein.Value
          nv-ram-block-element=autosar-variable-in-impl-datatype=vkmrw_Verbrauchsaequivalent, written-read-nv-data=vkmrw_Verbrauchsaequivalent.Value
          nv-ram-block-element=autosar-variable-in-impl-datatype=rw_fahrzg_steht, written-read-nv-data=rw_fahrzg_steht.Value
          nv-ram-block-element=autosar-variable-in-impl-datatype=rw_fahrzg_faehrt, written-read-nv-data=rw_fahrzg_faehrt.Value
          nv-ram-block-element=autosar-variable-in-impl-datatype=zReserved_DIAG_AdaptationChannel_VAR_2, written-read-nv-data=zReserved_DIAG_AdaptationChannel_VAR_2.Value
        nv block needs NVNeed_NVBlockDescriptor: n-data-sets=2, ram-block-status-control=API, reliability=NO-PROTECTION, restore-at-start=true, store-at-shutdown=false, store-immediate=true, write-verification=false
        ram block RAM_NVBlockDescriptor_DIAG_AdaptationChannel_VAR_2: type=NV_Data_DIAG_AdaptationChannel_VAR_2, init-value=fields=[ACC_Darstellung:0, hmi_anteil_gas_aktiv:0, vkmrw_gesamtreichweite_vorhanden:0, vkmrw_verbrauchsfaktor_kombi:0, vkmrw_Verbrauchsaequivalent_ein:1, vkmrw_Verbrauchsaequivalent:175, rw_fahrzg_steht:30, rw_fahrzg_faehrt:50, zReserved_DIAG_AdaptationChannel_VAR_2:8 x 255]
        rom block ROM_NVBlockDescriptor_DIAG_AdaptationChannel_VAR_2: sw-calibration-access=READ-WRITE, type=NV_Data_DIAG_AdaptationChannel_VAR_2, init-value=fields=[ACC_Darstellung:0, hmi_anteil_gas_aktiv:0, vkmrw_gesamtreichweite_vorhanden:0, vkmrw_verbrauchsfaktor_kombi:0, vkmrw_Verbrauchsaequivalent_ein:1, vkmrw_Verbrauchsaequivalent:175, rw_fahrzg_steht:30, rw_fahrzg_faehrt:50, zReserved_DIAG_AdaptationChannel_VAR_2:8 x 255]
      NVBlockDescriptor_DIAG_Adjustment_VAR: client-server-ports=role-based-port-assignment={port-prototype=DIAG_Adjustment_VAR_NvM_JobFinished, role=DIAG_Adjustment_VAR_NvM_JobFinished}
        nv-block-data-mappings:
          nv-ram-block-element=autosar-variable-in-impl-datatype=Diag_Gain_Adjustment, written-read-nv-data=Diag_Gain_Adjustment.Value
          nv-ram-block-element=autosar-variable-in-impl-datatype=Diag_Red_Gamma_Adjustment, written-read-nv-data=Diag_Red_Gamma_Adjustment.Value
          nv-ram-block-element=autosar-variable-in-impl-datatype=Diag_Green_Gamma_Adjustment, written-read-nv-data=Diag_Green_Gamma_Adjustment.Value
          nv-ram-block-element=autosar-variable-in-impl-datatype=Diag_Blue_Gamma_Adjustment, written-read-nv-data=Diag_Blue_Gamma_Adjustment.Value
          nv-ram-block-element=autosar-variable-in-impl-datatype=Diag_Red_Gamma_Pos_Adjustment, written-read-nv-data=Diag_Red_Gamma_Pos_Adjustment.Value
          nv-ram-block-element=autosar-variable-in-impl-datatype=Diag_Green_Gamma_Pos_Adjustment, written-read-nv-data=Diag_Green_Gamma_Pos_Adjustment.Value
          nv-ram-block-element=autosar-variable-in-impl-datatype=Diag_Blue_Gamma_Pos_Adjustment, written-read-nv-data=Diag_Blue_Gamma_Pos_Adjustment.Value
          nv-ram-block-element=autosar-variable-in-impl-datatype=Diag_Red_Gamma_Neg_Adjustment, written-read-nv-data=Diag_Red_Gamma_Neg_Adjustment.Value
          nv-ram-block-element=autosar-variable-in-impl-datatype=Diag_Green_Gamma_Neg_Adjustment, written-read-nv-data=Diag_Green_Gamma_Neg_Adjustment.Value
          nv-ram-block-element=autosar-variable-in-impl-datatype=Diag_Blue_Gamma_Neg_Adjustment, written-read-nv-data=Diag_Blue_Gamma_Neg_Adjustment.Value
          nv-ram-block-element=autosar-variable-in-impl-datatype=Diag_Compensation_Line_Slope_m, written-read-nv-data=Diag_Compensation_Line_Slope_m.Value
          nv-ram-block-element=autosar-variable-in-impl-datatype=Diag_Compensation_Line_Shift_b, written-read-nv-data=Diag_Compensation_Line_Shift_b.Value
          nv-ram-block-element=autosar-variable-in-impl-datatype=p_kilometerstand_last_value_obsolete, written-read-nv-data=p_kilometerstand_last_value_obsolete.Value
          nv-ram-block-element=autosar-variable-in-impl-datatype=zReserved_Diag_Adjustment_VAR, written-read-nv-data=zReserved_Diag_Adjustment_VAR.Value
        nv block needs NVNeed_NVBlockDescriptor: n-data-sets=2, ram-block-status-control=API, reliability=NO-PROTECTION, restore-at-start=true, store-at-shutdown=false, store-immediate=true, write-verification=false
        ram block RAM_NVBlockDescriptor_DIAG_Adjustment_VAR: type=NV_Data_DIAG_Adjustment_VAR, init-value=fields=[Diag_Gain_Adjustment:[255, 255, 255], Diag_Red_Gamma_Adjustment:[192, 12, 0], Diag_Green_Gamma_Adjustment:[192, 12, 0], Diag_Blue_Gamma_Adjustment:[192, 12, 0], Diag_Red_Gamma_Pos_Adjustment:[23, 24, 42, 56, 67, 76, 84, 92, 103, 214, 214, 233, 239, 231, 218, 220, 212, 219, 233, 4, 9, 142, 149, 157, 166, 175, 189, 204, 224, 241], Diag_Green_Gamma_Pos_Adjustment:[23, 24, 42, 56, 67, 76, 84, 92, 103, 214, 214, 233, 239, 231, 218, 220, 212, 219, 233, 4, 9, 142, 149, 157, 166, 175, 189, 204, 224, 241], Diag_Blue_Gamma_Pos_Adjustment:[23, 24, 42, 56, 67, 76, 84, 92, 103, 214, 214, 233, 239, 231, 218, 220, 212, 219, 233, 4, 9, 142, 149, 157, 166, 175, 189, 204, 224, 241], Diag_Red_Gamma_Neg_Adjustment:[23, 24, 42, 56, 67, 76, 84, 92, 93, 204, 206, 225, 231, 227, 218, 220, 212, 217, 231, 0, 5, 138, 145, 153, 162, 171, 183, 198, 218, 235], Diag_Green_Gamma_Neg_Adjustment:[23, 24, 42, 56, 67, 76, 84, 92, 93, 204, 206, 225, 231, 227, 218, 220, 212, 217, 231, 0, 5, 138, 145, 153, 162, 171, 183, 198, 218, 235], Diag_Blue_Gamma_Neg_Adjustment:[23, 24, 42, 56, 67, 76, 84, 92, 93, 204, 206, 225, 231, 227, 218, 220, 212, 217, 231, 0, 5, 138, 145, 153, 162, 171, 183, 198, 218, 235], Diag_Compensation_Line_Slope_m:[0, 173, 145], Diag_Compensation_Line_Shift_b:[0, 0, 11], p_kilometerstand_last_value_obsolete:1048573, zReserved_Diag_Adjustment_VAR:18 x 255]
        rom block ROM_NVBlockDescriptor_DIAG_Adjustment_VAR:
          sw-calibration-access=READ-WRITE
          type=NV_Data_DIAG_Adjustment_VAR
          init-value=fields=[Diag_Gain_Adjustment:[255, 255, 255], Diag_Red_Gamma_Adjustment:[192, 12, 0], Diag_Green_Gamma_Adjustment:[192, 12, 0], Diag_Blue_Gamma_Adjustment:[192, 12, 0], Diag_Red_Gamma_Pos_Adjustment:[23, 24, 42, 56, 67, 76, 84, 92, 103, 214, 214, 233, 239, 231, 218, 220, 212, 219, 233, 4, 9, 142, 149, 157, 166, 175, 189, 204, 224, 241], Diag_Green_Gamma_Pos_Adjustment:[23, 24, 42, 56, 67, 76, 84, 92, 103, 214, 214, 233, 239, 231, 218, 220, 212, 219, 233, 4, 9, 142, 149, 157, 166, 175, 189, 204, 224, 241], Diag_Blue_Gamma_Pos_Adjustment:[23, 24, 42, 56, 67, 76, 84, 92, 103, 214, 214, 233, 239, 231, 218, 220, 212, 219, 233, 4, 9, 142, 149, 157, 166, 175, 189, 204, 224, 241], Diag_Red_Gamma_Neg_Adjustment:[23, 24, 42, 56, 67, 76, 84, 92, 93, 204, 206, 225, 231, 227, 218, 220, 212, 217, 231, 0, 5, 138, 145, 153, 162, 171, 183, 198, 218, 235], Diag_Green_Gamma_Neg_Adjustment:[23, 24, 42, 56, 67, 76, 84, 92, 93, 204, 206, 225, 231, 227, 218, 220, 212, 217, 231, 0, 5, 138, 145, 153, 162, 171, 183, 198, 218, 235], Diag_Blue_Gamma_Neg_Adjustment:[23, 24, 42, 56, 67, 76, 84, 92, 93, 204, 206, 225, 231, 227, 218, 220, 212, 217, 231, 0, 5, 138, 145, 153, 162, 171, 183, 198, 218, 235], Diag_Compensation_Line_Slope_m:[0, 173, 145], Diag_Compensation_Line_Shift_b:[0, 0, 11], p_kilometerstand_last_value_obsolete:1048573, zReserved_Diag_Adjustment_VAR:18 x 255]
      NVBlockDescriptor_DIAG_EOL_DiagCfg_CONST: client-server-ports=role-based-port-assignment={port-prototype=DIAG_EOL_DiagCfg_CONST_NvM_JobFinished, role=DIAG_EOL_DiagCfg_CONST_NvM_JobFinished}
        nv-block-data-mappings:
          nv-ram-block-element=autosar-variable-in-impl-datatype=DIAG_EOL_DiagCfg_CONST_Safety_CRC, written-read-nv-data=DIAG_EOL_DiagCfg_CONST_Safety_CRC.Value
          nv-ram-block-element=autosar-variable-in-impl-datatype=RunInMode_Config, written-read-nv-data=RunInMode_Config.Value
          nv-ram-block-element=autosar-variable-in-impl-datatype=RunInMode_Result, written-read-nv-data=RunInMode_Result.Value
          nv-ram-block-element=autosar-variable-in-impl-datatype=Manuf_Assembly_Plant_Number, written-read-nv-data=Manuf_Assembly_Plant_Number.Value
          nv-ram-block-element=autosar-variable-in-impl-datatype=Manuf_Equiped_PCB_Reference, written-read-nv-data=Manuf_Equiped_PCB_Reference.Value
          nv-ram-block-element=autosar-variable-in-impl-datatype=Manuf_Equiped_PCB_Revision, written-read-nv-data=Manuf_Equiped_PCB_Revision.Value
          nv-ram-block-element=autosar-variable-in-impl-datatype=Manuf_PCB_Serial_Number, written-read-nv-data=Manuf_PCB_Serial_Number.Value
          nv-ram-block-element=autosar-variable-in-impl-datatype=Manuf_Product_Reference, written-read-nv-data=Manuf_Product_Reference.Value
          nv-ram-block-element=autosar-variable-in-impl-datatype=Manuf_Product_Revision, written-read-nv-data=Manuf_Product_Revision.Value
          nv-ram-block-element=autosar-variable-in-impl-datatype=Manuf_SMD_Manufacturing_Date, written-read-nv-data=Manuf_SMD_Manufacturing_Date.Value
          nv-ram-block-element=autosar-variable-in-impl-datatype=Manuf_SMD_Plant_Number, written-read-nv-data=Manuf_SMD_Plant_Number.Value
          nv-ram-block-element=autosar-variable-in-impl-datatype=Manuf_Traceability_PIM, written-read-nv-data=Manuf_Traceability_PIM.Value
          nv-ram-block-element=autosar-variable-in-impl-datatype=Manuf_Traceability_Station_Nr, written-read-nv-data=Manuf_Traceability_Station_Nr.Value
          nv-ram-block-element=autosar-variable-in-impl-datatype=zReserved_DIAG_EOL_DiagCfg_CONST, written-read-nv-data=zReserved_DIAG_EOL_DiagCfg_CONST.Value
          nv-ram-block-element=autosar-variable-in-impl-datatype=Manufacturing_Mode, written-read-nv-data=Manufacturing_Mode.Value
          nv-ram-block-element=autosar-variable-in-impl-datatype=Rework_Param_1, written-read-nv-data=Rework_Param_1.Value
          nv-ram-block-element=autosar-variable-in-impl-datatype=Rework_Param_2, written-read-nv-data=Rework_Param_2.Value
          nv-ram-block-element=autosar-variable-in-impl-datatype=RCC_IZ, written-read-nv-data=RCC_IZ.Value
          nv-ram-block-element=autosar-variable-in-impl-datatype=zReserved_1_DIAG_EOL_DiagCfg_CONST, written-read-nv-data=zReserved_1_DIAG_EOL_DiagCfg_CONST.Value
        nv block needs NVNeed_NVBlockDescriptor: n-data-sets=2, ram-block-status-control=API, reliability=NO-PROTECTION, restore-at-start=true, store-at-shutdown=false, store-immediate=true, write-verification=false
        ram block RAM_NVBlockDescriptor_DIAG_EOL_DiagCfg_CONST: type=NV_Data_DIAG_EOL_DiagCfg_CONST, init-value=fields=[DIAG_EOL_DiagCfg_CONST_Safety_CRC:57840, RunInMode_Config:0, RunInMode_Result:0, Manuf_Assembly_Plant_Number:[255, 255, 255], Manuf_Equiped_PCB_Reference:5 x 255, Manuf_Equiped_PCB_Revision:[255, 255], Manuf_PCB_Serial_Number:[255, 255, 255, 255], Manuf_Product_Reference:5 x 255, Manuf_Product_Revision:[255, 255], Manuf_SMD_Manufacturing_Date:[48, 49, 46, 48, 49, 46, 48, 48], Manuf_SMD_Plant_Number:[255, 255, 255], Manuf_Traceability_PIM:0, Manuf_Traceability_Station_Nr:8 x 0, zReserved_DIAG_EOL_DiagCfg_CONST:[0, 0], Manufacturing_Mode:0, Rework_Param_1:0, Rework_Param_2:0, RCC_IZ:4660, zReserved_1_DIAG_EOL_DiagCfg_CONST:6 x 255]
        rom block ROM_NVBlockDescriptor_DIAG_EOL_DiagCfg_CONST:
          sw-calibration-access=READ-WRITE
          type=NV_Data_DIAG_EOL_DiagCfg_CONST
          init-value=fields=[DIAG_EOL_DiagCfg_CONST_Safety_CRC:57840, RunInMode_Config:0, RunInMode_Result:0, Manuf_Assembly_Plant_Number:[255, 255, 255], Manuf_Equiped_PCB_Reference:5 x 255, Manuf_Equiped_PCB_Revision:[255, 255], Manuf_PCB_Serial_Number:[255, 255, 255, 255], Manuf_Product_Reference:5 x 255, Manuf_Product_Revision:[255, 255], Manuf_SMD_Manufacturing_Date:[48, 49, 46, 48, 49, 46, 48, 48], Manuf_SMD_Plant_Number:[255, 255, 255], Manuf_Traceability_PIM:0, Manuf_Traceability_Station_Nr:8 x 0, zReserved_DIAG_EOL_DiagCfg_CONST:[0, 0], Manufacturing_Mode:0, Rework_Param_1:0, Rework_Param_2:0, RCC_IZ:4660, zReserved_1_DIAG_EOL_DiagCfg_CONST:6 x 255]
      NVBlockDescriptor_DIAG_EOL_HWCalib_CONST: client-server-ports=role-based-port-assignment={port-prototype=DIAG_EOL_HWCalib_CONST_NvM_JobFinished, role=DIAG_EOL_HWCalib_CONST_NvM_JobFinished}
        nv-block-data-mappings:
          nv-ram-block-element=autosar-variable-in-impl-datatype=AD_Value_Max_lx, written-read-nv-data=AD_Value_Max_lx.Value
          nv-ram-block-element=autosar-variable-in-impl-datatype=AD_Value_Min_lx, written-read-nv-data=AD_Value_Min_lx.Value
          nv-ram-block-element=autosar-variable-in-impl-datatype=CorrectionCoefficient_k1, written-read-nv-data=CorrectionCoefficient_k1.Value
          nv-ram-block-element=autosar-variable-in-impl-datatype=CorrectionCoefficient_k2, written-read-nv-data=CorrectionCoefficient_k2.Value
          nv-ram-block-element=autosar-variable-in-impl-datatype=DIAG_EOL_HWCalib_CONST_Safety_CRC, written-read-nv-data=DIAG_EOL_HWCalib_CONST_Safety_CRC.Value
          nv-ram-block-element=autosar-variable-in-impl-datatype=Display_Illum_Max_Level, written-read-nv-data=Display_Illum_Max_Level.Value
          nv-ram-block-element=autosar-variable-in-impl-datatype=Photosensor_Calib_Max_Lx, written-read-nv-data=Photosensor_Calib_Max_Lx.Value
          nv-ram-block-element=autosar-variable-in-impl-datatype=Photosensor_Calib_Min_Lx, written-read-nv-data=Photosensor_Calib_Min_Lx.Value
          nv-ram-block-element=autosar-variable-in-impl-datatype=QuartzFrequencyOffset, written-read-nv-data=QuartzFrequencyOffset.Value
          nv-ram-block-element=autosar-variable-in-impl-datatype=SupplyVoltage_N1, written-read-nv-data=SupplyVoltage_N1.Value
          nv-ram-block-element=autosar-variable-in-impl-datatype=SupplyVoltage_N2, written-read-nv-data=SupplyVoltage_N2.Value
          nv-ram-block-element=autosar-variable-in-impl-datatype=SupplyVoltage_V1, written-read-nv-data=SupplyVoltage_V1.Value
          nv-ram-block-element=autosar-variable-in-impl-datatype=SupplyVoltage_V2, written-read-nv-data=SupplyVoltage_V2.Value
          nv-ram-block-element=autosar-variable-in-impl-datatype=Calibrated_RGB_Font_Colour_Triple, written-read-nv-data=Calibrated_RGB_Font_Colour_Triple.Value
          nv-ram-block-element=autosar-variable-in-impl-datatype=ECT_Gauge_Magnetic_Offset, written-read-nv-data=ECT_Gauge_Magnetic_Offset.Value
          nv-ram-block-element=autosar-variable-in-impl-datatype=PCB_TrackResistance, written-read-nv-data=PCB_TrackResistance.Value
          nv-ram-block-element=autosar-variable-in-impl-datatype=RPM_Gauge_Magnetic_Offset, written-read-nv-data=RPM_Gauge_Magnetic_Offset.Value
          nv-ram-block-element=autosar-variable-in-impl-datatype=Speedo_Gauge_Magnetic_Offset, written-read-nv-data=Speedo_Gauge_Magnetic_Offset.Value
          nv-ram-block-element=autosar-variable-in-impl-datatype=Tank_Gauge_Magnetic_Offset, written-read-nv-data=Tank_Gauge_Magnetic_Offset.Value
          nv-ram-block-element=autosar-variable-in-impl-datatype=Whisper_Mode_Loudness, written-read-nv-data=Whisper_Mode_Loudness.Value
          nv-ram-block-element=autosar-variable-in-impl-datatype=WhitePointCorrectionMethod, written-read-nv-data=WhitePointCorrectionMethod.Value
          nv-ram-block-element=autosar-variable-in-impl-datatype=Whisper_Mode, written-read-nv-data=Whisper_Mode.Value
          nv-ram-block-element=autosar-variable-in-impl-datatype=zReservedAligmnet_DIAG_EOL_HWCalib_CONST, written-read-nv-data=zReservedAligmnet_DIAG_EOL_HWCalib_CONST.Value
          nv-ram-block-element=autosar-variable-in-impl-datatype=Measured_Value_Max_lx, written-read-nv-data=Measured_Value_Max_lx.Value
          nv-ram-block-element=autosar-variable-in-impl-datatype=Measured_Value_Min_lx, written-read-nv-data=Measured_Value_Min_lx.Value
          nv-ram-block-element=autosar-variable-in-impl-datatype=PTC_PCB_Derating_step, written-read-nv-data=PTC_PCB_Derating_step.Value
          nv-ram-block-element=autosar-variable-in-impl-datatype=NTC_TFT_Derating_step, written-read-nv-data=NTC_TFT_Derating_step.Value
          nv-ram-block-element=autosar-variable-in-impl-datatype=DURMW, written-read-nv-data=DURMW.Value
          nv-ram-block-element=autosar-variable-in-impl-datatype=zReserved_DIAG_EOL_HWCalib_CONST, written-read-nv-data=zReserved_DIAG_EOL_HWCalib_CONST.Value
        nv block needs NVNeed_NVBlockDescriptor: n-data-sets=2, ram-block-status-control=API, reliability=NO-PROTECTION, restore-at-start=true, store-at-shutdown=false, store-immediate=true, write-verification=false
        ram block RAM_NVBlockDescriptor_DIAG_EOL_HWCalib_CONST: type=NV_Data_DIAG_EOL_HWCalib_CONST, init-value=fields=[AD_Value_Max_lx:300, AD_Value_Min_lx:12, CorrectionCoefficient_k1:9920, CorrectionCoefficient_k2:20, DIAG_EOL_HWCalib_CONST_Safety_CRC:8701, Display_Illum_Max_Level:10000, Photosensor_Calib_Max_Lx:500, Photosensor_Calib_Min_Lx:20, QuartzFrequencyOffset:0, SupplyVoltage_N1:581, SupplyVoltage_N2:1613, SupplyVoltage_V1:630, SupplyVoltage_V2:1750, Calibrated_RGB_Font_Colour_Triple:[255, 255, 255], ECT_Gauge_Magnetic_Offset:0, PCB_TrackResistance:0, RPM_Gauge_Magnetic_Offset:0, Speedo_Gauge_Magnetic_Offset:0, Tank_Gauge_Magnetic_Offset:0, Whisper_Mode_Loudness:30, WhitePointCorrectionMethod:1, Whisper_Mode:0, zReservedAligmnet_DIAG_EOL_HWCalib_CONST:255, Measured_Value_Max_lx:30000, Measured_Value_Min_lx:1200, PTC_PCB_Derating_step:2, NTC_TFT_Derating_step:5, DURMW:999936, zReserved_DIAG_EOL_HWCalib_CONST:[255, 255, 255, 255]]
        rom block ROM_NVBlockDescriptor_DIAG_EOL_HWCalib_CONST:
          sw-calibration-access=READ-WRITE
          type=NV_Data_DIAG_EOL_HWCalib_CONST
          init-value=fields=[AD_Value_Max_lx:300, AD_Value_Min_lx:12, CorrectionCoefficient_k1:9920, CorrectionCoefficient_k2:20, DIAG_EOL_HWCalib_CONST_Safety_CRC:8701, Display_Illum_Max_Level:10000, Photosensor_Calib_Max_Lx:500, Photosensor_Calib_Min_Lx:20, QuartzFrequencyOffset:0, SupplyVoltage_N1:581, SupplyVoltage_N2:1613, SupplyVoltage_V1:630, SupplyVoltage_V2:1750, Calibrated_RGB_Font_Colour_Triple:[255, 255, 255], ECT_Gauge_Magnetic_Offset:0, PCB_TrackResistance:0, RPM_Gauge_Magnetic_Offset:0, Speedo_Gauge_Magnetic_Offset:0, Tank_Gauge_Magnetic_Offset:0, Whisper_Mode_Loudness:30, WhitePointCorrectionMethod:1, Whisper_Mode:0, zReservedAligmnet_DIAG_EOL_HWCalib_CONST:255, Measured_Value_Max_lx:30000, Measured_Value_Min_lx:1200, PTC_PCB_Derating_step:2, NTC_TFT_Derating_step:5, DURMW:999936, zReserved_DIAG_EOL_HWCalib_CONST:[255, 255, 255, 255]]
      NVBlockDescriptor_DIAG_EOL_HWCalib_CONST_1: client-server-ports=role-based-port-assignment={port-prototype=DIAG_EOL_HWCalib_CONST_1_NvM_JobFinished, role=DIAG_EOL_HWCalib_CONST_1_NvM_JobFinished}
        nv-block-data-mappings:
          nv-ram-block-element=autosar-variable-in-impl-datatype=Measured_Value_Max_Range_lx, written-read-nv-data=Measured_Value_Max_Range_lx.Value
          nv-ram-block-element=autosar-variable-in-impl-datatype=Measured_Value_Min_Range_lx, written-read-nv-data=Measured_Value_Min_Range_lx.Value
          nv-ram-block-element=autosar-variable-in-impl-datatype=Photosensor_Calib_Max_Range_Lx, written-read-nv-data=Photosensor_Calib_Max_Range_Lx.Value
          nv-ram-block-element=autosar-variable-in-impl-datatype=Photosensor_Calib_Min_Range_Lx, written-read-nv-data=Photosensor_Calib_Min_Range_Lx.Value
          nv-ram-block-element=autosar-variable-in-impl-datatype=CoolantTemp_Gauge_Hysteresis_Angle, written-read-nv-data=CoolantTemp_Gauge_Hysteresis_Angle.Value
          nv-ram-block-element=autosar-variable-in-impl-datatype=FuelLevel_Gauge_Hysteresis_Angle, written-read-nv-data=FuelLevel_Gauge_Hysteresis_Angle.Value
          nv-ram-block-element=autosar-variable-in-impl-datatype=RPM_Gauge_Hysteresis_Angle, written-read-nv-data=RPM_Gauge_Hysteresis_Angle.Value
          nv-ram-block-element=autosar-variable-in-impl-datatype=Speedo_Gauge_Hysteresis_Angle, written-read-nv-data=Speedo_Gauge_Hysteresis_Angle.Value
          nv-ram-block-element=autosar-variable-in-impl-datatype=zReserved_DIAG_EOL_HWCalib_CONST_1, written-read-nv-data=zReserved_DIAG_EOL_HWCalib_CONST_1.Value
        nv block needs NVNeed_NVBlockDescriptor: n-data-sets=2, ram-block-status-control=API, reliability=NO-PROTECTION, restore-at-start=true, store-at-shutdown=false, store-immediate=true, write-verification=false
        ram block RAM_NVBlockDescriptor_DIAG_EOL_HWCalib_CONST_1: type=NV_Data_DIAG_EOL_HWCalib_CONST_1, init-value=fields=[Measured_Value_Max_Range_lx:50000, Measured_Value_Min_Range_lx:0, Photosensor_Calib_Max_Range_Lx:50000, Photosensor_Calib_Min_Range_Lx:0, CoolantTemp_Gauge_Hysteresis_Angle:0, FuelLevel_Gauge_Hysteresis_Angle:0, RPM_Gauge_Hysteresis_Angle:0, Speedo_Gauge_Hysteresis_Angle:0, zReserved_DIAG_EOL_HWCalib_CONST_1:36 x 255]
        rom block ROM_NVBlockDescriptor_DIAG_EOL_HWCalib_CONST_1:
          sw-calibration-access=READ-WRITE
          type=NV_Data_DIAG_EOL_HWCalib_CONST_1
          init-value=fields=[Measured_Value_Max_Range_lx:50000, Measured_Value_Min_Range_lx:0, Photosensor_Calib_Max_Range_Lx:50000, Photosensor_Calib_Min_Range_Lx:0, CoolantTemp_Gauge_Hysteresis_Angle:0, FuelLevel_Gauge_Hysteresis_Angle:0, RPM_Gauge_Hysteresis_Angle:0, Speedo_Gauge_Hysteresis_Angle:0, zReserved_DIAG_EOL_HWCalib_CONST_1:36 x 255]
      NVBlockDescriptor_DIAG_EOL_PartNumber_CONST: client-server-ports=role-based-port-assignment={port-prototype=DIAG_EOL_PartNumber_CONST_NvM_JobFinished, role=DIAG_EOL_PartNumber_CONST_NvM_JobFinished}
        nv-block-data-mappings:
          nv-ram-block-element=autosar-variable-in-impl-datatype=Manuf_Equipped_PCB_Partnumber, written-read-nv-data=Manuf_Equipped_PCB_Partnumber.Value
          nv-ram-block-element=autosar-variable-in-impl-datatype=Manuf_Product_Partnumber, written-read-nv-data=Manuf_Product_Partnumber.Value
        nv block needs NVNeed_NVBlockDescriptor: n-data-sets=2, ram-block-status-control=API, reliability=NO-PROTECTION, restore-at-start=true, store-at-shutdown=false, store-immediate=true, write-verification=false
        ram block RAM_NVBlockDescriptor_DIAG_EOL_PartNumber_CONST: type=NV_Data_DIAG_EOL_PartNumber_CONST, init-value=fields=[Manuf_Equipped_PCB_Partnumber:18 x 255, Manuf_Product_Partnumber:[86, 80, 76, 86, 65, 70, 45, 49, 48, 56, 52, 57, 32, 45, 73, 71, 32, 32]]
        rom block ROM_NVBlockDescriptor_DIAG_EOL_PartNumber_CONST: sw-calibration-access=READ-WRITE, type=NV_Data_DIAG_EOL_PartNumber_CONST, init-value=fields=[Manuf_Equipped_PCB_Partnumber:18 x 255, Manuf_Product_Partnumber:[86, 80, 76, 86, 65, 70, 45, 49, 48, 56, 52, 57, 32, 45, 73, 71, 32, 32]]
      NVBlockDescriptor_DIAG_EOL_VAR: client-server-ports=role-based-port-assignment={port-prototype=DIAG_EOL_VAR_NvM_JobFinished, role=DIAG_EOL_VAR_NvM_JobFinished}
        nv-block-data-mappings:
          nv-ram-block-element=autosar-variable-in-impl-datatype=PointerType, written-read-nv-data=PointerType.Value
          nv-ram-block-element=autosar-variable-in-impl-datatype=Vehicle_Equipment_Code, written-read-nv-data=Vehicle_Equipment_Code.Value
          nv-ram-block-element=autosar-variable-in-impl-datatype=VW_Data_Set_Number, written-read-nv-data=VW_Data_Set_Number.Value
          nv-ram-block-element=autosar-variable-in-impl-datatype=VW_Data_Set_Version, written-read-nv-data=VW_Data_Set_Version.Value
          nv-ram-block-element=autosar-variable-in-impl-datatype=VW_Workshop_System_Name, written-read-nv-data=VW_Workshop_System_Name.Value
          nv-ram-block-element=autosar-variable-in-impl-datatype=zReserved_DIAG_EOL_VAR, written-read-nv-data=zReserved_DIAG_EOL_VAR.Value
        nv block needs NVNeed_NVBlockDescriptor: n-data-sets=2, ram-block-status-control=API, reliability=NO-PROTECTION, restore-at-start=true, store-at-shutdown=false, store-immediate=true, write-verification=false
        ram block RAM_NVBlockDescriptor_DIAG_EOL_VAR: type=NV_Data_DIAG_EOL_VAR, init-value=fields=[PointerType:0, Vehicle_Equipment_Code:12 x 0, VW_Data_Set_Number:11 x 45, VW_Data_Set_Version:[45, 45, 45, 45], VW_Workshop_System_Name:[74, 50, 56, 53, 32], zReserved_DIAG_EOL_VAR:[255, 255, 255]]
        rom block ROM_NVBlockDescriptor_DIAG_EOL_VAR: sw-calibration-access=READ-WRITE, type=NV_Data_DIAG_EOL_VAR, init-value=fields=[PointerType:0, Vehicle_Equipment_Code:12 x 0, VW_Data_Set_Number:11 x 45, VW_Data_Set_Version:[45, 45, 45, 45], VW_Workshop_System_Name:[74, 50, 56, 53, 32], zReserved_DIAG_EOL_VAR:[255, 255, 255]]
      NVBlockDescriptor_DIAG_VariantCodingCheck_CONST: client-server-ports=role-based-port-assignment={port-prototype=DIAG_VariantCodingCheck_CONST_NvM_JobFinished, role=DIAG_VariantCodingCheck_CONST_NvM_JobFinished}
        nv-block-data-mappings:
          nv-ram-block-element=autosar-variable-in-impl-datatype=CodingCheck_Unit_Language, written-read-nv-data=CodingCheck_Unit_Language.Value
          nv-ram-block-element=autosar-variable-in-impl-datatype=CodingCheck_CarBody, written-read-nv-data=CodingCheck_CarBody.Value
          nv-ram-block-element=autosar-variable-in-impl-datatype=CodingCheck_4WD_Installed, written-read-nv-data=CodingCheck_4WD_Installed.Value
          nv-ram-block-element=autosar-variable-in-impl-datatype=CodingCheck_ACC_Installed, written-read-nv-data=CodingCheck_ACC_Installed.Value
          nv-ram-block-element=autosar-variable-in-impl-datatype=CodingCheck_Acceleration_Display_Available, written-read-nv-data=CodingCheck_Acceleration_Display_Available.Value
          nv-ram-block-element=autosar-variable-in-impl-datatype=CodingCheck_AFS_Installed, written-read-nv-data=CodingCheck_AFS_Installed.Value
          nv-ram-block-element=autosar-variable-in-impl-datatype=CodingCheck_ARA_Installed, written-read-nv-data=CodingCheck_ARA_Installed.Value
          nv-ram-block-element=autosar-variable-in-impl-datatype=CodingCheck_ASTA_Installed, written-read-nv-data=CodingCheck_ASTA_Installed.Value
          nv-ram-block-element=autosar-variable-in-impl-datatype=CodingCheck_Audio_Installed, written-read-nv-data=CodingCheck_Audio_Installed.Value
          nv-ram-block-element=autosar-variable-in-impl-datatype=CodingCheck_AWV_BAP_Installed, written-read-nv-data=CodingCheck_AWV_BAP_Installed.Value
          nv-ram-block-element=autosar-variable-in-impl-datatype=CodingCheck_AWV_Installed, written-read-nv-data=CodingCheck_AWV_Installed.Value
          nv-ram-block-element=autosar-variable-in-impl-datatype=CodingCheck_Bc_Display_Available, written-read-nv-data=CodingCheck_Bc_Display_Available.Value
          nv-ram-block-element=autosar-variable-in-impl-datatype=CodingCheck_BCmE_Installed, written-read-nv-data=CodingCheck_BCmE_Installed.Value
          nv-ram-block-element=autosar-variable-in-impl-datatype=CodingCheck_BVA_with_BKL, written-read-nv-data=CodingCheck_BVA_with_BKL.Value
          nv-ram-block-element=autosar-variable-in-impl-datatype=CodingCheck_Car_Leaving_Warning_Available, written-read-nv-data=CodingCheck_Car_Leaving_Warning_Available.Value
          nv-ram-block-element=autosar-variable-in-impl-datatype=CodingCheck_Compass_Position, written-read-nv-data=CodingCheck_Compass_Position.Value
          nv-ram-block-element=autosar-variable-in-impl-datatype=CodingCheck_Damper_Installed, written-read-nv-data=CodingCheck_Damper_Installed.Value
          nv-ram-block-element=autosar-variable-in-impl-datatype=CodingCheck_DayIlluminationPointers, written-read-nv-data=CodingCheck_DayIlluminationPointers.Value
          nv-ram-block-element=autosar-variable-in-impl-datatype=CodingCheck_DayIlluminationScales, written-read-nv-data=CodingCheck_DayIlluminationScales.Value
          nv-ram-block-element=autosar-variable-in-impl-datatype=CodingCheck_Dig_OilTemp_Display_Available, written-read-nv-data=CodingCheck_Dig_OilTemp_Display_Available.Value
          nv-ram-block-element=autosar-variable-in-impl-datatype=CodingCheck_eCall_Installed, written-read-nv-data=CodingCheck_eCall_Installed.Value
          nv-ram-block-element=autosar-variable-in-impl-datatype=CodingCheck_ELV_Installed, written-read-nv-data=CodingCheck_ELV_Installed.Value
          nv-ram-block-element=autosar-variable-in-impl-datatype=CodingCheck_Epb_Installed, written-read-nv-data=CodingCheck_Epb_Installed.Value
          nv-ram-block-element=autosar-variable-in-impl-datatype=CodingCheck_Eps_Installed, written-read-nv-data=CodingCheck_Eps_Installed.Value
          nv-ram-block-element=autosar-variable-in-impl-datatype=CodingCheck_FCWP_Installed, written-read-nv-data=CodingCheck_FCWP_Installed.Value
          nv-ram-block-element=autosar-variable-in-impl-datatype=CodingCheck_Telephone2_Installed, written-read-nv-data=CodingCheck_Telephone2_Installed.Value
          nv-ram-block-element=autosar-variable-in-impl-datatype=CodingCheck_GRA_High_Display, written-read-nv-data=CodingCheck_GRA_High_Display.Value
          nv-ram-block-element=autosar-variable-in-impl-datatype=CodingCheck_HRE_Installed, written-read-nv-data=CodingCheck_HRE_Installed.Value
          nv-ram-block-element=autosar-variable-in-impl-datatype=CodingCheck_Hybrid_BAP_Installed, written-read-nv-data=CodingCheck_Hybrid_BAP_Installed.Value
          nv-ram-block-element=autosar-variable-in-impl-datatype=CodingCheck_Hybrid_Installed, written-read-nv-data=CodingCheck_Hybrid_Installed.Value
          nv-ram-block-element=autosar-variable-in-impl-datatype=CodingCheck_Joker_Button_Installed, written-read-nv-data=CodingCheck_Joker_Button_Installed.Value
          nv-ram-block-element=autosar-variable-in-impl-datatype=Reserved_1, written-read-nv-data=Reserved_1.Value
          nv-ram-block-element=autosar-variable-in-impl-datatype=CodingCheck_Key_Warning, written-read-nv-data=CodingCheck_Key_Warning.Value
          nv-ram-block-element=autosar-variable-in-impl-datatype=CodingCheck_Laptimer, written-read-nv-data=CodingCheck_Laptimer.Value
          nv-ram-block-element=autosar-variable-in-impl-datatype=CodingCheck_LDW_BAP_Installed, written-read-nv-data=CodingCheck_LDW_BAP_Installed.Value
          nv-ram-block-element=autosar-variable-in-impl-datatype=CodingCheck_LDW_Installed, written-read-nv-data=CodingCheck_LDW_Installed.Value
          nv-ram-block-element=autosar-variable-in-impl-datatype=CodingCheck_Navigation_Compass_Installed, written-read-nv-data=CodingCheck_Navigation_Compass_Installed.Value
          nv-ram-block-element=autosar-variable-in-impl-datatype=CodingCheck_OutsideTemperature_Indication, written-read-nv-data=CodingCheck_OutsideTemperature_Indication.Value
          nv-ram-block-element=autosar-variable-in-impl-datatype=CodingCheck_PEA_BAP_Installed, written-read-nv-data=CodingCheck_PEA_BAP_Installed.Value
          nv-ram-block-element=autosar-variable-in-impl-datatype=CodingCheck_PedestrianAssist_BAP_Installed, written-read-nv-data=CodingCheck_PedestrianAssist_BAP_Installed.Value
          nv-ram-block-element=autosar-variable-in-impl-datatype=CodingCheck_Personalization_Installed, written-read-nv-data=CodingCheck_Personalization_Installed.Value
          nv-ram-block-element=autosar-variable-in-impl-datatype=CodingCheck_PLA_Installed, written-read-nv-data=CodingCheck_PLA_Installed.Value
          nv-ram-block-element=autosar-variable-in-impl-datatype=CodingCheck_PLA3_Installed, written-read-nv-data=CodingCheck_PLA3_Installed.Value
          nv-ram-block-element=autosar-variable-in-impl-datatype=CodingCheck_Pointer_Kl_58, written-read-nv-data=CodingCheck_Pointer_Kl_58.Value
          nv-ram-block-element=autosar-variable-in-impl-datatype=CodingCheck_QSP_Installed, written-read-nv-data=CodingCheck_QSP_Installed.Value
          nv-ram-block-element=autosar-variable-in-impl-datatype=CodingCheck_RDK_BAP_Installed, written-read-nv-data=CodingCheck_RDK_BAP_Installed.Value
          nv-ram-block-element=autosar-variable-in-impl-datatype=CodingCheck_RDK_Installed, written-read-nv-data=CodingCheck_RDK_Installed.Value
          nv-ram-block-element=autosar-variable-in-impl-datatype=CodingCheck_RefulledVolume_Available, written-read-nv-data=CodingCheck_RefulledVolume_Available.Value
          nv-ram-block-element=autosar-variable-in-impl-datatype=CodingCheck_Right_Drive, written-read-nv-data=CodingCheck_Right_Drive.Value
          nv-ram-block-element=autosar-variable-in-impl-datatype=CodingCheck_RKA_Installed, written-read-nv-data=CodingCheck_RKA_Installed.Value
          nv-ram-block-element=autosar-variable-in-impl-datatype=CodingCheck_SDS_BAP_Installed, written-read-nv-data=CodingCheck_SDS_BAP_Installed.Value
          nv-ram-block-element=autosar-variable-in-impl-datatype=CodingCheck_SeatbeltWarning, written-read-nv-data=CodingCheck_SeatbeltWarning.Value
          nv-ram-block-element=autosar-variable-in-impl-datatype=CodingCheck_Staging, written-read-nv-data=CodingCheck_Staging.Value
          nv-ram-block-element=autosar-variable-in-impl-datatype=CodingCheck_StartStopReasons_BAP_Installed, written-read-nv-data=CodingCheck_StartStopReasons_BAP_Installed.Value
          nv-ram-block-element=autosar-variable-in-impl-datatype=CodingCheck_StartUp_Screen, written-read-nv-data=CodingCheck_StartUp_Screen.Value
          nv-ram-block-element=autosar-variable-in-impl-datatype=CodingCheck_SWA_BAP_Installed, written-read-nv-data=CodingCheck_SWA_BAP_Installed.Value
          nv-ram-block-element=autosar-variable-in-impl-datatype=CodingCheck_SWA_Installed, written-read-nv-data=CodingCheck_SWA_Installed.Value
          nv-ram-block-element=autosar-variable-in-impl-datatype=CodingCheck_Telephone_Installed, written-read-nv-data=CodingCheck_Telephone_Installed.Value
          nv-ram-block-element=autosar-variable-in-impl-datatype=CodingCheck_Unit_ClockFormat, written-read-nv-data=CodingCheck_Unit_ClockFormat.Value
          nv-ram-block-element=autosar-variable-in-impl-datatype=CodingCheck_Unit_DateFormat, written-read-nv-data=CodingCheck_Unit_DateFormat.Value
          nv-ram-block-element=autosar-variable-in-impl-datatype=CodingCheck_Unit_FuelConsumption, written-read-nv-data=CodingCheck_Unit_FuelConsumption.Value
          nv-ram-block-element=autosar-variable-in-impl-datatype=CodingCheck_IAA_PSO_BAP_Installed, written-read-nv-data=CodingCheck_IAA_PSO_BAP_Installed.Value
          nv-ram-block-element=autosar-variable-in-impl-datatype=CodingCheck_Unit_Language_Ext, written-read-nv-data=CodingCheck_Unit_Language_Ext.Value
          nv-ram-block-element=autosar-variable-in-impl-datatype=CodingCheck_Unit_Language_Ext1, written-read-nv-data=CodingCheck_Unit_Language_Ext1.Value
          nv-ram-block-element=autosar-variable-in-impl-datatype=CodingCheck_Unit_OdoTripDistance, written-read-nv-data=CodingCheck_Unit_OdoTripDistance.Value
          nv-ram-block-element=autosar-variable-in-impl-datatype=CodingCheck_Unit_Pressure, written-read-nv-data=CodingCheck_Unit_Pressure.Value
          nv-ram-block-element=autosar-variable-in-impl-datatype=CodingCheck_Unit_Speed, written-read-nv-data=CodingCheck_Unit_Speed.Value
          nv-ram-block-element=autosar-variable-in-impl-datatype=CodingCheck_Unit_Temperature, written-read-nv-data=CodingCheck_Unit_Temperature.Value
          nv-ram-block-element=autosar-variable-in-impl-datatype=CodingCheck_Unit_Volume, written-read-nv-data=CodingCheck_Unit_Volume.Value
          nv-ram-block-element=autosar-variable-in-impl-datatype=CodingCheck_Unit_Weight, written-read-nv-data=CodingCheck_Unit_Weight.Value
          nv-ram-block-element=autosar-variable-in-impl-datatype=CodingCheck_V_Warning_Legal, written-read-nv-data=CodingCheck_V_Warning_Legal.Value
          nv-ram-block-element=autosar-variable-in-impl-datatype=CodingCheck_VZA_Installed, written-read-nv-data=CodingCheck_VZA_Installed.Value
          nv-ram-block-element=autosar-variable-in-impl-datatype=CodingCheck_WBA_Installed, written-read-nv-data=CodingCheck_WBA_Installed.Value
          nv-ram-block-element=autosar-variable-in-impl-datatype=CodingCheck_AGA_Installed, written-read-nv-data=CodingCheck_AGA_Installed.Value
          nv-ram-block-element=autosar-variable-in-impl-datatype=CodingCheck_EBKV_Installed, written-read-nv-data=CodingCheck_EBKV_Installed.Value
          nv-ram-block-element=autosar-variable-in-impl-datatype=CodingCheck_Unit_Consumption_Electric, written-read-nv-data=CodingCheck_Unit_Consumption_Electric.Value
          nv-ram-block-element=autosar-variable-in-impl-datatype=CodingCheck_Ignition_EV_LowVoltage, written-read-nv-data=CodingCheck_Ignition_EV_LowVoltage.Value
          nv-ram-block-element=autosar-variable-in-impl-datatype=CodingCheck_KFG_Installed, written-read-nv-data=CodingCheck_KFG_Installed.Value
          nv-ram-block-element=autosar-variable-in-impl-datatype=CodingCheck_Fuel_Variant, written-read-nv-data=CodingCheck_Fuel_Variant.Value
          nv-ram-block-element=autosar-variable-in-impl-datatype=CodingCheck_K_Number, written-read-nv-data=CodingCheck_K_Number.Value
          nv-ram-block-element=autosar-variable-in-impl-datatype=CodingCheck_Unit_FuelConsumption_Gas, written-read-nv-data=CodingCheck_Unit_FuelConsumption_Gas.Value
          nv-ram-block-element=autosar-variable-in-impl-datatype=CodingCheck_Digital_Key_Installed, written-read-nv-data=CodingCheck_Digital_Key_Installed.Value
          nv-ram-block-element=autosar-variable-in-impl-datatype=CodingCheck_Two_Keys_Installed, written-read-nv-data=CodingCheck_Two_Keys_Installed.Value
          nv-ram-block-element=autosar-variable-in-impl-datatype=CodingCheck_ADA_Installed, written-read-nv-data=CodingCheck_ADA_Installed.Value
          nv-ram-block-element=autosar-variable-in-impl-datatype=zReserved_2_DIAG_VariantCodingCheck_CONST, written-read-nv-data=zReserved_2_DIAG_VariantCodingCheck_CONST.Value
          nv-ram-block-element=autosar-variable-in-impl-datatype=zReserved_DIAG_VariantCodingCheck_CONST, written-read-nv-data=zReserved_DIAG_VariantCodingCheck_CONST.Value
          nv-ram-block-element=autosar-variable-in-impl-datatype=CodingCheck_Telephone2_Installed_Obsolete, written-read-nv-data=CodingCheck_Telephone2_Installed_Obsolete.Value
          nv-ram-block-element=autosar-variable-in-impl-datatype=CodingCheck_Unit_Consumption_Electric_Obsolete, written-read-nv-data=CodingCheck_Unit_Consumption_Electric_Obsolete.Value
          nv-ram-block-element=autosar-variable-in-impl-datatype=zReserved_1_DIAG_VariantCodingCheck_CONST, written-read-nv-data=zReserved_1_DIAG_VariantCodingCheck_CONST.Value
        nv block needs NVNeed_NVBlockDescriptor: n-data-sets=2, ram-block-status-control=API, reliability=NO-PROTECTION, restore-at-start=true, store-at-shutdown=false, store-immediate=true, write-verification=false
        ram block RAM_NVBlockDescriptor_DIAG_VariantCodingCheck_CONST: type=NV_Data_DIAG_VariantCodingCheck_CONST, init-value=fields=[CodingCheck_Unit_Language:3890216959, CodingCheck_CarBody:3, CodingCheck_4WD_Installed:3, CodingCheck_ACC_Installed:3, CodingCheck_Acceleration_Display_Available:3, CodingCheck_AFS_Installed:3, CodingCheck_ARA_Installed:3, CodingCheck_ASTA_Installed:3, CodingCheck_Audio_Installed:3, CodingCheck_AWV_BAP_Installed:3, CodingCheck_AWV_Installed:3, CodingCheck_Bc_Display_Available:3, CodingCheck_BCmE_Installed:3, CodingCheck_BVA_with_BKL:3, CodingCheck_Car_Leaving_Warning_Available:3, CodingCheck_Compass_Position:3, CodingCheck_Damper_Installed:3, CodingCheck_DayIlluminationPointers:3, CodingCheck_DayIlluminationScales:3, CodingCheck_Dig_OilTemp_Display_Available:3, CodingCheck_eCall_Installed:3, CodingCheck_ELV_Installed:3, CodingCheck_Epb_Installed:3, CodingCheck_Eps_Installed:3, CodingCheck_FCWP_Installed:3, CodingCheck_Telephone2_Installed:3, CodingCheck_GRA_High_Display:3, CodingCheck_HRE_Installed:3, CodingCheck_Hybrid_BAP_Installed:3, CodingCheck_Hybrid_Installed:3, CodingCheck_Joker_Button_Installed:3, Reserved_1:5, CodingCheck_Key_Warning:3, CodingCheck_Laptimer:3, CodingCheck_LDW_BAP_Installed:3, CodingCheck_LDW_Installed:3, CodingCheck_Navigation_Compass_Installed:3, CodingCheck_OutsideTemperature_Indication:3, CodingCheck_PEA_BAP_Installed:3, CodingCheck_PedestrianAssist_BAP_Installed:3, CodingCheck_Personalization_Installed:3, CodingCheck_PLA_Installed:3, CodingCheck_PLA3_Installed:3, CodingCheck_Pointer_Kl_58:3, CodingCheck_QSP_Installed:3, CodingCheck_RDK_BAP_Installed:3, CodingCheck_RDK_Installed:3, CodingCheck_RefulledVolume_Available:3, CodingCheck_Right_Drive:3, CodingCheck_RKA_Installed:3, CodingCheck_SDS_BAP_Installed:3, CodingCheck_SeatbeltWarning:7, CodingCheck_Staging:3, CodingCheck_StartStopReasons_BAP_Installed:3, CodingCheck_StartUp_Screen:9, CodingCheck_SWA_BAP_Installed:3, CodingCheck_SWA_Installed:3, CodingCheck_Telephone_Installed:3, CodingCheck_Unit_ClockFormat:3, CodingCheck_Unit_DateFormat:7, CodingCheck_Unit_FuelConsumption:15, CodingCheck_IAA_PSO_BAP_Installed:3, CodingCheck_Unit_Language_Ext:227, CodingCheck_Unit_Language_Ext1:15, CodingCheck_Unit_OdoTripDistance:3, CodingCheck_Unit_Pressure:7, CodingCheck_Unit_Speed:3, CodingCheck_Unit_Temperature:3, CodingCheck_Unit_Volume:7, CodingCheck_Unit_Weight:3, CodingCheck_V_Warning_Legal:3, CodingCheck_VZA_Installed:3, CodingCheck_WBA_Installed:3, CodingCheck_AGA_Installed:3, CodingCheck_EBKV_Installed:3, CodingCheck_Unit_Consumption_Electric:31, CodingCheck_Ignition_EV_LowVoltage:3, CodingCheck_KFG_Installed:3, CodingCheck_Fuel_Variant:4027056127, CodingCheck_K_Number:5, CodingCheck_Unit_FuelConsumption_Gas:511, CodingCheck_Digital_Key_Installed:3, CodingCheck_Two_Keys_Installed:3, CodingCheck_ADA_Installed:0, zReserved_2_DIAG_VariantCodingCheck_CONST:[255, 255, 255], zReserved_DIAG_VariantCodingCheck_CONST:51 x 255, CodingCheck_Telephone2_Installed_Obsolete:9 x 3, CodingCheck_Unit_Consumption_Electric_Obsolete:9 x 3, zReserved_1_DIAG_VariantCodingCheck_CONST:5 x 255]
        rom block ROM_NVBlockDescriptor_DIAG_VariantCodingCheck_CONST:
          sw-calibration-access=READ-WRITE
          type=NV_Data_DIAG_VariantCodingCheck_CONST
          init-value=fields=[CodingCheck_Unit_Language:3890216959, CodingCheck_CarBody:3, CodingCheck_4WD_Installed:3, CodingCheck_ACC_Installed:3, CodingCheck_Acceleration_Display_Available:3, CodingCheck_AFS_Installed:3, CodingCheck_ARA_Installed:3, CodingCheck_ASTA_Installed:3, CodingCheck_Audio_Installed:3, CodingCheck_AWV_BAP_Installed:3, CodingCheck_AWV_Installed:3, CodingCheck_Bc_Display_Available:3, CodingCheck_BCmE_Installed:3, CodingCheck_BVA_with_BKL:3, CodingCheck_Car_Leaving_Warning_Available:3, CodingCheck_Compass_Position:3, CodingCheck_Damper_Installed:3, CodingCheck_DayIlluminationPointers:3, CodingCheck_DayIlluminationScales:3, CodingCheck_Dig_OilTemp_Display_Available:3, CodingCheck_eCall_Installed:3, CodingCheck_ELV_Installed:3, CodingCheck_Epb_Installed:3, CodingCheck_Eps_Installed:3, CodingCheck_FCWP_Installed:3, CodingCheck_Telephone2_Installed:3, CodingCheck_GRA_High_Display:3, CodingCheck_HRE_Installed:3, CodingCheck_Hybrid_BAP_Installed:3, CodingCheck_Hybrid_Installed:3, CodingCheck_Joker_Button_Installed:3, Reserved_1:5, CodingCheck_Key_Warning:3, CodingCheck_Laptimer:3, CodingCheck_LDW_BAP_Installed:3, CodingCheck_LDW_Installed:3, CodingCheck_Navigation_Compass_Installed:3, CodingCheck_OutsideTemperature_Indication:3, CodingCheck_PEA_BAP_Installed:3, CodingCheck_PedestrianAssist_BAP_Installed:3, CodingCheck_Personalization_Installed:3, CodingCheck_PLA_Installed:3, CodingCheck_PLA3_Installed:3, CodingCheck_Pointer_Kl_58:3, CodingCheck_QSP_Installed:3, CodingCheck_RDK_BAP_Installed:3, CodingCheck_RDK_Installed:3, CodingCheck_RefulledVolume_Available:3, CodingCheck_Right_Drive:3, CodingCheck_RKA_Installed:3, CodingCheck_SDS_BAP_Installed:3, CodingCheck_SeatbeltWarning:7, CodingCheck_Staging:3, CodingCheck_StartStopReasons_BAP_Installed:3, CodingCheck_StartUp_Screen:9, CodingCheck_SWA_BAP_Installed:3, CodingCheck_SWA_Installed:3, CodingCheck_Telephone_Installed:3, CodingCheck_Unit_ClockFormat:3, CodingCheck_Unit_DateFormat:7, CodingCheck_Unit_FuelConsumption:15, CodingCheck_IAA_PSO_BAP_Installed:3, CodingCheck_Unit_Language_Ext:227, CodingCheck_Unit_Language_Ext1:15, CodingCheck_Unit_OdoTripDistance:3, CodingCheck_Unit_Pressure:7, CodingCheck_Unit_Speed:3, CodingCheck_Unit_Temperature:3, CodingCheck_Unit_Volume:7, CodingCheck_Unit_Weight:3, CodingCheck_V_Warning_Legal:3, CodingCheck_VZA_Installed:3, CodingCheck_WBA_Installed:3, CodingCheck_AGA_Installed:3, CodingCheck_EBKV_Installed:3, CodingCheck_Unit_Consumption_Electric:31, CodingCheck_Ignition_EV_LowVoltage:3, CodingCheck_KFG_Installed:3, CodingCheck_Fuel_Variant:4027056127, CodingCheck_K_Number:5, CodingCheck_Unit_FuelConsumption_Gas:511, CodingCheck_Digital_Key_Installed:3, CodingCheck_Two_Keys_Installed:3, CodingCheck_ADA_Installed:0, zReserved_2_DIAG_VariantCodingCheck_CONST:[255, 255, 255], zReserved_DIAG_VariantCodingCheck_CONST:51 x 255, CodingCheck_Telephone2_Installed_Obsolete:9 x 3, CodingCheck_Unit_Consumption_Electric_Obsolete:9 x 3, zReserved_1_DIAG_VariantCodingCheck_CONST:5 x 255]
      NVBlockDescriptor_DIAG_VariantCoding_CONST: client-server-ports=role-based-port-assignment={port-prototype=DIAG_VariantCoding_CONST_NvM_JobFinished, role=DIAG_VariantCoding_CONST_NvM_JobFinished}
        nv-block-data-mappings:
          nv-ram-block-element=autosar-variable-in-impl-datatype=DIAG_VariantCoding_CONST_Safety_CRC, written-read-nv-data=DIAG_VariantCoding_CONST_Safety_CRC.Value
          nv-ram-block-element=autosar-variable-in-impl-datatype=Coding_CarBody, written-read-nv-data=Coding_CarBody.Value
          nv-ram-block-element=autosar-variable-in-impl-datatype=Coding_Compass_Position, written-read-nv-data=Coding_Compass_Position.Value
          nv-ram-block-element=autosar-variable-in-impl-datatype=Coding_Date, written-read-nv-data=Coding_Date.Value
          nv-ram-block-element=autosar-variable-in-impl-datatype=Coding_Language, written-read-nv-data=Coding_Language.Value
          nv-ram-block-element=autosar-variable-in-impl-datatype=Coding_Pointer_Kl_58, written-read-nv-data=Coding_Pointer_Kl_58.Value
          nv-ram-block-element=autosar-variable-in-impl-datatype=Coding_SeatbeltWarning, written-read-nv-data=Coding_SeatbeltWarning.Value
          nv-ram-block-element=autosar-variable-in-impl-datatype=Coding_Shop_Code, written-read-nv-data=Coding_Shop_Code.Value
          nv-ram-block-element=autosar-variable-in-impl-datatype=Coding_Staging, written-read-nv-data=Coding_Staging.Value
          nv-ram-block-element=autosar-variable-in-impl-datatype=Coding_StartUp_Screen, written-read-nv-data=Coding_StartUp_Screen.Value
          nv-ram-block-element=autosar-variable-in-impl-datatype=Coding_Unit_DateFormat, written-read-nv-data=Coding_Unit_DateFormat.Value
          nv-ram-block-element=autosar-variable-in-impl-datatype=Coding_Unit_FuelConsumption, written-read-nv-data=Coding_Unit_FuelConsumption.Value
          nv-ram-block-element=autosar-variable-in-impl-datatype=Coding_Unit_FuelConsumption_Gas, written-read-nv-data=Coding_Unit_FuelConsumption_Gas.Value
          nv-ram-block-element=autosar-variable-in-impl-datatype=Coding_Unit_Pressure, written-read-nv-data=Coding_Unit_Pressure.Value
          nv-ram-block-element=autosar-variable-in-impl-datatype=Coding_Unit_Volume, written-read-nv-data=Coding_Unit_Volume.Value
          nv-ram-block-element=autosar-variable-in-impl-datatype=Coding_Unit_Weight, written-read-nv-data=Coding_Unit_Weight.Value
          nv-ram-block-element=autosar-variable-in-impl-datatype=Fuel_Variant, written-read-nv-data=Fuel_Variant.Value
          nv-ram-block-element=autosar-variable-in-impl-datatype=K_Number, written-read-nv-data=K_Number.Value
          nv-ram-block-element=autosar-variable-in-impl-datatype=Acceleration_Display_Available, written-read-nv-data=Acceleration_Display_Available.Value
          nv-ram-block-element=autosar-variable-in-impl-datatype=Bc_Display_Available, written-read-nv-data=Bc_Display_Available.Value
          nv-ram-block-element=autosar-variable-in-impl-datatype=Coding_4WD_Installed, written-read-nv-data=Coding_4WD_Installed.Value
          nv-ram-block-element=autosar-variable-in-impl-datatype=Coding_ACC_Installed, written-read-nv-data=Coding_ACC_Installed.Value
          nv-ram-block-element=autosar-variable-in-impl-datatype=Coding_AFS_Installed, written-read-nv-data=Coding_AFS_Installed.Value
          nv-ram-block-element=autosar-variable-in-impl-datatype=Coding_ARA_Installed, written-read-nv-data=Coding_ARA_Installed.Value
          nv-ram-block-element=autosar-variable-in-impl-datatype=Coding_ASTA_Installed, written-read-nv-data=Coding_ASTA_Installed.Value
          nv-ram-block-element=autosar-variable-in-impl-datatype=Coding_Audio_Installed, written-read-nv-data=Coding_Audio_Installed.Value
          nv-ram-block-element=autosar-variable-in-impl-datatype=Coding_AWV_BAP_Installed, written-read-nv-data=Coding_AWV_BAP_Installed.Value
          nv-ram-block-element=autosar-variable-in-impl-datatype=Coding_AWV_Installed, written-read-nv-data=Coding_AWV_Installed.Value
          nv-ram-block-element=autosar-variable-in-impl-datatype=Coding_BCmE_Installed, written-read-nv-data=Coding_BCmE_Installed.Value
          nv-ram-block-element=autosar-variable-in-impl-datatype=Coding_BVA_with_BKL, written-read-nv-data=Coding_BVA_with_BKL.Value
          nv-ram-block-element=autosar-variable-in-impl-datatype=Coding_Car_Leaving_Warning_Active, written-read-nv-data=Coding_Car_Leaving_Warning_Active.Value
          nv-ram-block-element=autosar-variable-in-impl-datatype=Coding_Damper_Installed, written-read-nv-data=Coding_Damper_Installed.Value
          nv-ram-block-element=autosar-variable-in-impl-datatype=Coding_DayIlluminationPointers, written-read-nv-data=Coding_DayIlluminationPointers.Value
          nv-ram-block-element=autosar-variable-in-impl-datatype=Coding_DayIlluminationScales, written-read-nv-data=Coding_DayIlluminationScales.Value
          nv-ram-block-element=autosar-variable-in-impl-datatype=Coding_eCall_Installed, written-read-nv-data=Coding_eCall_Installed.Value
          nv-ram-block-element=autosar-variable-in-impl-datatype=Coding_ELV_Installed, written-read-nv-data=Coding_ELV_Installed.Value
          nv-ram-block-element=autosar-variable-in-impl-datatype=Coding_Epb_Installed, written-read-nv-data=Coding_Epb_Installed.Value
          nv-ram-block-element=autosar-variable-in-impl-datatype=Coding_EPS_Installed, written-read-nv-data=Coding_EPS_Installed.Value
          nv-ram-block-element=autosar-variable-in-impl-datatype=Coding_FCWP_Installed, written-read-nv-data=Coding_FCWP_Installed.Value
          nv-ram-block-element=autosar-variable-in-impl-datatype=Coding_HRE_Installed, written-read-nv-data=Coding_HRE_Installed.Value
          nv-ram-block-element=autosar-variable-in-impl-datatype=Coding_Hybrid_BAP_Installed, written-read-nv-data=Coding_Hybrid_BAP_Installed.Value
          nv-ram-block-element=autosar-variable-in-impl-datatype=Coding_Hybrid_Installed, written-read-nv-data=Coding_Hybrid_Installed.Value
          nv-ram-block-element=autosar-variable-in-impl-datatype=Coding_Joker_Button_Installed, written-read-nv-data=Coding_Joker_Button_Installed.Value
          nv-ram-block-element=autosar-variable-in-impl-datatype=Coding_KeyWarning, written-read-nv-data=Coding_KeyWarning.Value
          nv-ram-block-element=autosar-variable-in-impl-datatype=Coding_Laptimer, written-read-nv-data=Coding_Laptimer.Value
          nv-ram-block-element=autosar-variable-in-impl-datatype=Coding_LDW_BAP_Installed, written-read-nv-data=Coding_LDW_BAP_Installed.Value
          nv-ram-block-element=autosar-variable-in-impl-datatype=Coding_LDW_Installed, written-read-nv-data=Coding_LDW_Installed.Value
          nv-ram-block-element=autosar-variable-in-impl-datatype=Coding_Navigation_Compass_Installed, written-read-nv-data=Coding_Navigation_Compass_Installed.Value
          nv-ram-block-element=autosar-variable-in-impl-datatype=Coding_PEA_BAP_Installed, written-read-nv-data=Coding_PEA_BAP_Installed.Value
          nv-ram-block-element=autosar-variable-in-impl-datatype=Coding_PedestrianAssist_BAP_Installed, written-read-nv-data=Coding_PedestrianAssist_BAP_Installed.Value
          nv-ram-block-element=autosar-variable-in-impl-datatype=Coding_Personalization_Installed, written-read-nv-data=Coding_Personalization_Installed.Value
          nv-ram-block-element=autosar-variable-in-impl-datatype=Coding_PLA_Installed, written-read-nv-data=Coding_PLA_Installed.Value
          nv-ram-block-element=autosar-variable-in-impl-datatype=Coding_PLA3_Installed, written-read-nv-data=Coding_PLA3_Installed.Value
          nv-ram-block-element=autosar-variable-in-impl-datatype=Coding_QSP_Installed, written-read-nv-data=Coding_QSP_Installed.Value
          nv-ram-block-element=autosar-variable-in-impl-datatype=Coding_RDK_BAP_Installed, written-read-nv-data=Coding_RDK_BAP_Installed.Value
          nv-ram-block-element=autosar-variable-in-impl-datatype=Coding_RDK_Installed, written-read-nv-data=Coding_RDK_Installed.Value
          nv-ram-block-element=autosar-variable-in-impl-datatype=Coding_Right_Drive, written-read-nv-data=Coding_Right_Drive.Value
          nv-ram-block-element=autosar-variable-in-impl-datatype=Coding_RKA_Installed, written-read-nv-data=Coding_RKA_Installed.Value
          nv-ram-block-element=autosar-variable-in-impl-datatype=Coding_SDS_BAP_Installed, written-read-nv-data=Coding_SDS_BAP_Installed.Value
          nv-ram-block-element=autosar-variable-in-impl-datatype=Coding_StartStopReasons_BAP_Installed, written-read-nv-data=Coding_StartStopReasons_BAP_Installed.Value
          nv-ram-block-element=autosar-variable-in-impl-datatype=Coding_SWA_BAP_Installed, written-read-nv-data=Coding_SWA_BAP_Installed.Value
          nv-ram-block-element=autosar-variable-in-impl-datatype=Coding_SWA_Installed, written-read-nv-data=Coding_SWA_Installed.Value
          nv-ram-block-element=autosar-variable-in-impl-datatype=Coding_TCO_Installed, written-read-nv-data=Coding_TCO_Installed.Value
          nv-ram-block-element=autosar-variable-in-impl-datatype=Coding_Telephone_Installed, written-read-nv-data=Coding_Telephone_Installed.Value
          nv-ram-block-element=autosar-variable-in-impl-datatype=Coding_Unit_ClockFormat, written-read-nv-data=Coding_Unit_ClockFormat.Value
          nv-ram-block-element=autosar-variable-in-impl-datatype=Coding_Unit_OdoTripDistance, written-read-nv-data=Coding_Unit_OdoTripDistance.Value
          nv-ram-block-element=autosar-variable-in-impl-datatype=Coding_Unit_Speed, written-read-nv-data=Coding_Unit_Speed.Value
          nv-ram-block-element=autosar-variable-in-impl-datatype=Coding_Unit_Temperature, written-read-nv-data=Coding_Unit_Temperature.Value
          nv-ram-block-element=autosar-variable-in-impl-datatype=Coding_V_Warning_Legal, written-read-nv-data=Coding_V_Warning_Legal.Value
          nv-ram-block-element=autosar-variable-in-impl-datatype=Coding_VZA_Installed, written-read-nv-data=Coding_VZA_Installed.Value
          nv-ram-block-element=autosar-variable-in-impl-datatype=Coding_WBA_Installed, written-read-nv-data=Coding_WBA_Installed.Value
          nv-ram-block-element=autosar-variable-in-impl-datatype=Customer_Request_Flag, written-read-nv-data=Customer_Request_Flag.Value
          nv-ram-block-element=autosar-variable-in-impl-datatype=Dig_OilTemp_Display_Available, written-read-nv-data=Dig_OilTemp_Display_Available.Value
          nv-ram-block-element=autosar-variable-in-impl-datatype=DTC_ECU_not_coded, written-read-nv-data=DTC_ECU_not_coded.Value
          nv-ram-block-element=autosar-variable-in-impl-datatype=GRA_High_Display_Available, written-read-nv-data=GRA_High_Display_Available.Value
          nv-ram-block-element=autosar-variable-in-impl-datatype=OutsideTemperature_Indication, written-read-nv-data=OutsideTemperature_Indication.Value
          nv-ram-block-element=autosar-variable-in-impl-datatype=RefulledVolume_Available, written-read-nv-data=RefulledVolume_Available.Value
          nv-ram-block-element=autosar-variable-in-impl-datatype=V_Warning_Legal_India, written-read-nv-data=V_Warning_Legal_India.Value
          nv-ram-block-element=autosar-variable-in-impl-datatype=Coding_Digital_Key_Installed, written-read-nv-data=Coding_Digital_Key_Installed.Value
          nv-ram-block-element=autosar-variable-in-impl-datatype=Coding_IAA_PSO_BAP_Installed, written-read-nv-data=Coding_IAA_PSO_BAP_Installed.Value
          nv-ram-block-element=autosar-variable-in-impl-datatype=Coding_Telephone2_Installed, written-read-nv-data=Coding_Telephone2_Installed.Value
          nv-ram-block-element=autosar-variable-in-impl-datatype=Coding_two_keys, written-read-nv-data=Coding_two_keys.Value
          nv-ram-block-element=autosar-variable-in-impl-datatype=Coding_Production_Mode_Acoustic, written-read-nv-data=Coding_Production_Mode_Acoustic.Value
          nv-ram-block-element=autosar-variable-in-impl-datatype=Coding_BMS_Installed, written-read-nv-data=Coding_BMS_Installed.Value
          nv-ram-block-element=autosar-variable-in-impl-datatype=Coding_Unit_Consumption_Electrical, written-read-nv-data=Coding_Unit_Consumption_Electrical.Value
          nv-ram-block-element=autosar-variable-in-impl-datatype=Coding_Production_Mode_Key_Lock, written-read-nv-data=Coding_Production_Mode_Key_Lock.Value
          nv-ram-block-element=autosar-variable-in-impl-datatype=Coding_ADA_Installed, written-read-nv-data=Coding_ADA_Installed.Value
          nv-ram-block-element=autosar-variable-in-impl-datatype=zReserved_DIAG_VariantCoding_CONST_Handle, written-read-nv-data=zReserved_DIAG_VariantCoding_CONST_Handle.Value
          nv-ram-block-element=autosar-variable-in-impl-datatype=zIniSwVer_DIAG_VariantCoding_CONST, written-read-nv-data=zIniSwVer_DIAG_VariantCoding_CONST.Value
          nv-ram-block-element=autosar-variable-in-impl-datatype=Coding_AGA_Installed, written-read-nv-data=Coding_AGA_Installed.Value
          nv-ram-block-element=autosar-variable-in-impl-datatype=Coding_EBKV_Installed, written-read-nv-data=Coding_EBKV_Installed.Value
          nv-ram-block-element=autosar-variable-in-impl-datatype=Coding_Ignition_EV_LowVoltage, written-read-nv-data=Coding_Ignition_EV_LowVoltage.Value
          nv-ram-block-element=autosar-variable-in-impl-datatype=Coding_KFG_Installed, written-read-nv-data=Coding_KFG_Installed.Value
          nv-ram-block-element=autosar-variable-in-impl-datatype=zReserved_1_DIAG_VariantCoding_CONST, written-read-nv-data=zReserved_1_DIAG_VariantCoding_CONST.Value
        nv block needs NVNeed_NVBlockDescriptor: n-data-sets=2, ram-block-status-control=API, reliability=NO-PROTECTION, restore-at-start=true, store-at-shutdown=false, store-immediate=true, write-verification=false
        ram block RAM_NVBlockDescriptor_DIAG_VariantCoding_CONST: type=NV_Data_DIAG_VariantCoding_CONST, init-value=fields=[DIAG_VariantCoding_CONST_Safety_CRC:52380, Coding_CarBody:0, Coding_Compass_Position:1, Coding_Date:[0, 1, 1], Coding_Language:0, Coding_Pointer_Kl_58:1, Coding_SeatbeltWarning:1, Coding_Shop_Code:6 x 0, Coding_Staging:0, Coding_StartUp_Screen:0, Coding_Unit_DateFormat:0, Coding_Unit_FuelConsumption:2, Coding_Unit_FuelConsumption_Gas:0, Coding_Unit_Pressure:0, Coding_Unit_Volume:0, Coding_Unit_Weight:0, Fuel_Variant:0, K_Number:0, Acceleration_Display_Available:0, Bc_Display_Available:1, Coding_4WD_Installed:0, Coding_ACC_Installed:0, Coding_AFS_Installed:0, Coding_ARA_Installed:0, Coding_ASTA_Installed:0, Coding_Audio_Installed:0, Coding_AWV_BAP_Installed:0, Coding_AWV_Installed:0, Coding_BCmE_Installed:0, Coding_BVA_with_BKL:0, Coding_Car_Leaving_Warning_Active:0, Coding_Damper_Installed:0, Coding_DayIlluminationPointers:1, Coding_DayIlluminationScales:1, Coding_eCall_Installed:0, Coding_ELV_Installed:0, Coding_Epb_Installed:0, Coding_EPS_Installed:0, Coding_FCWP_Installed:0, Coding_HRE_Installed:0, Coding_Hybrid_BAP_Installed:0, Coding_Hybrid_Installed:0, Coding_Joker_Button_Installed:0, Coding_KeyWarning:0, Coding_Laptimer:0, Coding_LDW_BAP_Installed:0, Coding_LDW_Installed:0, Coding_Navigation_Compass_Installed:0, Coding_PEA_BAP_Installed:0, Coding_PedestrianAssist_BAP_Installed:0, Coding_Personalization_Installed:1, Coding_PLA_Installed:0, Coding_PLA3_Installed:0, Coding_QSP_Installed:0, Coding_RDK_BAP_Installed:0, Coding_RDK_Installed:0, Coding_Right_Drive:0, Coding_RKA_Installed:0, Coding_SDS_BAP_Installed:0, Coding_StartStopReasons_BAP_Installed:0, Coding_SWA_BAP_Installed:0, Coding_SWA_Installed:0, Coding_TCO_Installed:0, Coding_Telephone_Installed:0, Coding_Unit_ClockFormat:0, Coding_Unit_OdoTripDistance:0, Coding_Unit_Speed:0, Coding_Unit_Temperature:0, Coding_V_Warning_Legal:0, Coding_VZA_Installed:0, Coding_WBA_Installed:0, Customer_Request_Flag:0, Dig_OilTemp_Display_Available:0, DTC_ECU_not_coded:1, GRA_High_Display_Available:0, OutsideTemperature_Indication:1, RefulledVolume_Available:0, V_Warning_Legal_India:0, Coding_Digital_Key_Installed:0, Coding_IAA_PSO_BAP_Installed:0, Coding_Telephone2_Installed:0, Coding_two_keys:0, Coding_Production_Mode_Acoustic:0, Coding_BMS_Installed:1, Coding_Unit_Consumption_Electrical:0, Coding_Production_Mode_Key_Lock:0, Coding_ADA_Installed:0, zReserved_DIAG_VariantCoding_CONST_Handle:32 x 255, zIniSwVer_DIAG_VariantCoding_CONST:1, Coding_AGA_Installed:0, Coding_EBKV_Installed:0, Coding_Ignition_EV_LowVoltage:0, Coding_KFG_Installed:0, zReserved_1_DIAG_VariantCoding_CONST:[0, 255, 255, 255, 255, 255, 255, 255]]
        rom block ROM_NVBlockDescriptor_DIAG_VariantCoding_CONST:
          sw-calibration-access=READ-WRITE
          type=NV_Data_DIAG_VariantCoding_CONST
          init-value=fields=[DIAG_VariantCoding_CONST_Safety_CRC:52380, Coding_CarBody:0, Coding_Compass_Position:1, Coding_Date:[0, 1, 1], Coding_Language:0, Coding_Pointer_Kl_58:1, Coding_SeatbeltWarning:1, Coding_Shop_Code:6 x 0, Coding_Staging:0, Coding_StartUp_Screen:0, Coding_Unit_DateFormat:0, Coding_Unit_FuelConsumption:2, Coding_Unit_FuelConsumption_Gas:0, Coding_Unit_Pressure:0, Coding_Unit_Volume:0, Coding_Unit_Weight:0, Fuel_Variant:0, K_Number:0, Acceleration_Display_Available:0, Bc_Display_Available:1, Coding_4WD_Installed:0, Coding_ACC_Installed:0, Coding_AFS_Installed:0, Coding_ARA_Installed:0, Coding_ASTA_Installed:0, Coding_Audio_Installed:0, Coding_AWV_BAP_Installed:0, Coding_AWV_Installed:0, Coding_BCmE_Installed:0, Coding_BVA_with_BKL:0, Coding_Car_Leaving_Warning_Active:0, Coding_Damper_Installed:0, Coding_DayIlluminationPointers:1, Coding_DayIlluminationScales:1, Coding_eCall_Installed:0, Coding_ELV_Installed:0, Coding_Epb_Installed:0, Coding_EPS_Installed:0, Coding_FCWP_Installed:0, Coding_HRE_Installed:0, Coding_Hybrid_BAP_Installed:0, Coding_Hybrid_Installed:0, Coding_Joker_Button_Installed:0, Coding_KeyWarning:0, Coding_Laptimer:0, Coding_LDW_BAP_Installed:0, Coding_LDW_Installed:0, Coding_Navigation_Compass_Installed:0, Coding_PEA_BAP_Installed:0, Coding_PedestrianAssist_BAP_Installed:0, Coding_Personalization_Installed:1, Coding_PLA_Installed:0, Coding_PLA3_Installed:0, Coding_QSP_Installed:0, Coding_RDK_BAP_Installed:0, Coding_RDK_Installed:0, Coding_Right_Drive:0, Coding_RKA_Installed:0, Coding_SDS_BAP_Installed:0, Coding_StartStopReasons_BAP_Installed:0, Coding_SWA_BAP_Installed:0, Coding_SWA_Installed:0, Coding_TCO_Installed:0, Coding_Telephone_Installed:0, Coding_Unit_ClockFormat:0, Coding_Unit_OdoTripDistance:0, Coding_Unit_Speed:0, Coding_Unit_Temperature:0, Coding_V_Warning_Legal:0, Coding_VZA_Installed:0, Coding_WBA_Installed:0, Customer_Request_Flag:0, Dig_OilTemp_Display_Available:0, DTC_ECU_not_coded:1, GRA_High_Display_Available:0, OutsideTemperature_Indication:1, RefulledVolume_Available:0, V_Warning_Legal_India:0, Coding_Digital_Key_Installed:0, Coding_IAA_PSO_BAP_Installed:0, Coding_Telephone2_Installed:0, Coding_two_keys:0, Coding_Production_Mode_Acoustic:0, Coding_BMS_Installed:1, Coding_Unit_Consumption_Electrical:0, Coding_Production_Mode_Key_Lock:0, Coding_ADA_Installed:0, zReserved_DIAG_VariantCoding_CONST_Handle:32 x 255, zIniSwVer_DIAG_VariantCoding_CONST:1, Coding_AGA_Installed:0, Coding_EBKV_Installed:0, Coding_Ignition_EV_LowVoltage:0, Coding_KFG_Installed:0, zReserved_1_DIAG_VariantCoding_CONST:[0, 255, 255, 255, 255, 255, 255, 255]]
      NVBlockDescriptor_Dev_Messages: client-server-ports=role-based-port-assignment={port-prototype=Dev_Messages_NvM_JobFinished, role=Dev_Messages_NvM_JobFinished}
        nv-block-data-mappings:
          nv-ram-block-element=autosar-variable-in-impl-datatype=CAN_DEV_Monitoring_Blocks, written-read-nv-data=CAN_DEV_Monitoring_Blocks.Value
          nv-ram-block-element=autosar-variable-in-impl-datatype=CAN_DEV_Monitoring_Status, written-read-nv-data=CAN_DEV_Monitoring_Status.Value
          nv-ram-block-element=autosar-variable-in-impl-datatype=zReserved_DEV_Messages, written-read-nv-data=zReserved_DEV_Messages.Value
        nv block needs NVNeed_NVBlockDescriptor: n-data-sets=2, ram-block-status-control=API, reliability=NO-PROTECTION, restore-at-start=true, store-at-shutdown=false, store-immediate=true, write-verification=false
        ram block RAM_NVBlockDescriptor_Dev_Messages: type=NV_Data_Dev_Messages, init-value=fields=[CAN_DEV_Monitoring_Blocks:20 x 0, CAN_DEV_Monitoring_Status:0, zReserved_DEV_Messages:7 x 255]
        rom block ROM_NVBlockDescriptor_Dev_Messages: sw-calibration-access=READ-WRITE, type=NV_Data_Dev_Messages, init-value=fields=[CAN_DEV_Monitoring_Blocks:20 x 0, CAN_DEV_Monitoring_Status:0, zReserved_DEV_Messages:7 x 255]
      NVBlockDescriptor_DtcAgingAdminDataBlock: client-server-ports=role-based-port-assignment={port-prototype=DtcAgingAdminDataBlock_NvM_JobFinished, role=DtcAgingAdminDataBlock_NvM_JobFinished}, nv-block-data-mapping{nv-ram-block-element=autosar-variable-in-impl-datatype=DtcAging, written-read-nv-data=DtcAging.Value}
        nv block needs NVNeed_NVBlockDescriptor: n-data-sets=2, ram-block-status-control=API, reliability=NO-PROTECTION, restore-at-start=true, store-at-shutdown=false, store-immediate=true, write-verification=false
        ram block RAM_NVBlockDescriptor_DtcAgingAdminDataBlock: type=NV_Data_DtcAgingAdminDataBlock, init-value=fields=DtcAging:[0, 0, 0, 0]
        rom block ROM_NVBlockDescriptor_DtcAgingAdminDataBlock: sw-calibration-access=READ-WRITE, type=NV_Data_DtcAgingAdminDataBlock, init-value=fields=DtcAging:[0, 0, 0, 0]
      NVBlockDescriptor_EEPVersionInfo_CONST: client-server-ports=role-based-port-assignment={port-prototype=EEPVersionInfo_CONST_NvM_JobFinished, role=EEPVersionInfo_CONST_NvM_JobFinished}
        nv-block-data-mappings:
          nv-ram-block-element=autosar-variable-in-impl-datatype=InternalLogicalSoftwareBlockVersion_EEP, written-read-nv-data=InternalLogicalSoftwareBlockVersion_EEP.Value
          nv-ram-block-element=autosar-variable-in-impl-datatype=VWLogicalSoftwareBlockVersion_EEP, written-read-nv-data=VWLogicalSoftwareBlockVersion_EEP.Value
        nv block needs NVNeed_NVBlockDescriptor: n-data-sets=2, ram-block-status-control=API, reliability=NO-PROTECTION, restore-at-start=true, store-at-shutdown=false, store-immediate=true, write-verification=false
        ram block RAM_NVBlockDescriptor_EEPVersionInfo_CONST: type=NV_Data_EEPVersionInfo_CONST, init-value=fields=[InternalLogicalSoftwareBlockVersion_EEP:[36, 9, 17, 17], VWLogicalSoftwareBlockVersion_EEP:[89, 56, 50, 49]]
        rom block ROM_NVBlockDescriptor_EEPVersionInfo_CONST: sw-calibration-access=READ-WRITE, type=NV_Data_EEPVersionInfo_CONST, init-value=fields=[InternalLogicalSoftwareBlockVersion_EEP:[36, 9, 17, 17], VWLogicalSoftwareBlockVersion_EEP:[89, 56, 50, 49]]
      NVBlockDescriptor_Gamma_Adjustment_VAR: client-server-ports=role-based-port-assignment={port-prototype=Gamma_Adjustment_VAR_NvM_JobFinished, role=Gamma_Adjustment_VAR_NvM_JobFinished}
        nv-block-data-mappings:
          nv-ram-block-element=autosar-variable-in-impl-datatype=Red_Gamma_Adjustment_Display1, written-read-nv-data=Red_Gamma_Adjustment_Display1.Value
          nv-ram-block-element=autosar-variable-in-impl-datatype=Green_Gamma_Adjustment_Display1, written-read-nv-data=Green_Gamma_Adjustment_Display1.Value
          nv-ram-block-element=autosar-variable-in-impl-datatype=Blue_Gamma_Adjustment_Display1, written-read-nv-data=Blue_Gamma_Adjustment_Display1.Value
          nv-ram-block-element=autosar-variable-in-impl-datatype=Red_Gamma_Adjustment_Display2, written-read-nv-data=Red_Gamma_Adjustment_Display2.Value
          nv-ram-block-element=autosar-variable-in-impl-datatype=Green_Gamma_Adjustment_Display2, written-read-nv-data=Green_Gamma_Adjustment_Display2.Value
          nv-ram-block-element=autosar-variable-in-impl-datatype=Blue_Gamma_Adjustment_Display2, written-read-nv-data=Blue_Gamma_Adjustment_Display2.Value
          nv-ram-block-element=autosar-variable-in-impl-datatype=zReserved_Gamma_Adjustment_VAR, written-read-nv-data=zReserved_Gamma_Adjustment_VAR.Value
          nv-ram-block-element=autosar-variable-in-impl-datatype=Gamma_Adjustment_VAR_CRC, written-read-nv-data=Gamma_Adjustment_VAR_CRC.Value
        nv block needs NVNeed_NVBlockDescriptor: n-data-sets=2, ram-block-status-control=API, reliability=NO-PROTECTION, restore-at-start=true, store-at-shutdown=false, store-immediate=true, write-verification=false
        ram block RAM_NVBlockDescriptor_Gamma_Adjustment_VAR: type=NV_Data_Gamma_Adjustment_VAR, init-value=fields=[Red_Gamma_Adjustment_Display1:[0, 64, 128, 192, 0, 64, 128, 192, 0, 64, 128, 192, 0, 64, 128, 192, 255, 0, 85, 170, 255, 3, 0, 0, 0, 0, 0], Green_Gamma_Adjustment_Display1:[0, 64, 128, 192, 0, 64, 128, 192, 0, 64, 128, 192, 0, 64, 128, 192, 255, 0, 85, 170, 255, 3, 0, 0, 0, 0, 0], Blue_Gamma_Adjustment_Display1:[0, 64, 128, 192, 0, 64, 128, 192, 0, 64, 128, 192, 0, 64, 128, 192, 255, 0, 85, 170, 255, 3, 0, 0, 0, 0, 0], Red_Gamma_Adjustment_Display2:[96, 140, 178, 210, 238, 56, 102, 146, 202, 2, 52, 122, 168, 220, 46, 72, 111, 144, 208, 0, 84, 169, 250, 63, 96, 140, 178, 210, 238, 56, 102, 146, 202, 2, 52, 122, 168, 220, 46, 72, 111, 144, 208, 0, 84, 169, 250, 63], Green_Gamma_Adjustment_Display2:[96, 140, 178, 210, 238, 56, 102, 146, 202, 2, 52, 122, 168, 220, 46, 72, 111, 144, 208, 0, 84, 169, 250, 63, 96, 140, 178, 210, 238, 56, 102, 146, 202, 2, 52, 122, 168, 220, 46, 72, 111, 144, 208, 0, 84, 169, 250, 63], Blue_Gamma_Adjustment_Display2:[96, 140, 178, 210, 238, 56, 102, 146, 202, 2, 52, 122, 168, 220, 46, 72, 111, 144, 208, 0, 84, 169, 250, 63, 96, 140, 178, 210, 238, 56, 102, 146, 202, 2, 52, 122, 168, 220, 46, 72, 111, 144, 208, 0, 84, 169, 250, 63], zReserved_Gamma_Adjustment_VAR:17 x 255, Gamma_Adjustment_VAR_CRC:55471]
        rom block ROM_NVBlockDescriptor_Gamma_Adjustment_VAR:
          sw-calibration-access=READ-WRITE
          type=NV_Data_Gamma_Adjustment_VAR
          init-value=fields=[Red_Gamma_Adjustment_Display1:[0, 64, 128, 192, 0, 64, 128, 192, 0, 64, 128, 192, 0, 64, 128, 192, 255, 0, 85, 170, 255, 3, 0, 0, 0, 0, 0], Green_Gamma_Adjustment_Display1:[0, 64, 128, 192, 0, 64, 128, 192, 0, 64, 128, 192, 0, 64, 128, 192, 255, 0, 85, 170, 255, 3, 0, 0, 0, 0, 0], Blue_Gamma_Adjustment_Display1:[0, 64, 128, 192, 0, 64, 128, 192, 0, 64, 128, 192, 0, 64, 128, 192, 255, 0, 85, 170, 255, 3, 0, 0, 0, 0, 0], Red_Gamma_Adjustment_Display2:[96, 140, 178, 210, 238, 56, 102, 146, 202, 2, 52, 122, 168, 220, 46, 72, 111, 144, 208, 0, 84, 169, 250, 63, 96, 140, 178, 210, 238, 56, 102, 146, 202, 2, 52, 122, 168, 220, 46, 72, 111, 144, 208, 0, 84, 169, 250, 63], Green_Gamma_Adjustment_Display2:[96, 140, 178, 210, 238, 56, 102, 146, 202, 2, 52, 122, 168, 220, 46, 72, 111, 144, 208, 0, 84, 169, 250, 63, 96, 140, 178, 210, 238, 56, 102, 146, 202, 2, 52, 122, 168, 220, 46, 72, 111, 144, 208, 0, 84, 169, 250, 63], Blue_Gamma_Adjustment_Display2:[96, 140, 178, 210, 238, 56, 102, 146, 202, 2, 52, 122, 168, 220, 46, 72, 111, 144, 208, 0, 84, 169, 250, 63, 96, 140, 178, 210, 238, 56, 102, 146, 202, 2, 52, 122, 168, 220, 46, 72, 111, 144, 208, 0, 84, 169, 250, 63], zReserved_Gamma_Adjustment_VAR:17 x 255, Gamma_Adjustment_VAR_CRC:55471]
      NVBlockDescriptor_I5CM_ID_NVM_BlockDET: client-server-ports=role-based-port-assignment={port-prototype=I5CM_ID_NVM_BlockDET_NvM_JobFinished, role=I5CM_ID_NVM_BlockDET_NvM_JobFinished}, nv-block-data-mapping{nv-ram-block-element=autosar-variable-in-impl-datatype=I5CM_ID_NVM_BlockDET, written-read-nv-data=I5CM_ID_NVM_BlockDET.Value}
        nv block needs NVNeed_NVBlockDescriptor: n-data-sets=2, ram-block-status-control=API, reliability=NO-PROTECTION, restore-at-start=true, store-at-shutdown=false, store-immediate=true, write-verification=false
        ram block RAM_NVBlockDescriptor_I5CM_ID_NVM_BlockDET: type=NV_Data_I5CM_ID_NVM_BlockDET, init-value=fields=I5CM_ID_NVM_BlockDET:64 x 0
        rom block ROM_NVBlockDescriptor_I5CM_ID_NVM_BlockDET: sw-calibration-access=READ-WRITE, type=NV_Data_I5CM_ID_NVM_BlockDET, init-value=fields=I5CM_ID_NVM_BlockDET:64 x 0
      NVBlockDescriptor_I5CM_ID_NVM_BlockDL: client-server-ports=role-based-port-assignment={port-prototype=I5CM_ID_NVM_BlockDL_NvM_JobFinished, role=I5CM_ID_NVM_BlockDL_NvM_JobFinished}, nv-block-data-mapping{nv-ram-block-element=autosar-variable-in-impl-datatype=I5CM_ID_NVM_BlockDL, written-read-nv-data=I5CM_ID_NVM_BlockDL.Value}
        nv block needs NVNeed_NVBlockDescriptor: n-data-sets=2, ram-block-status-control=API, reliability=NO-PROTECTION, restore-at-start=true, store-at-shutdown=false, store-immediate=true, write-verification=false
        ram block RAM_NVBlockDescriptor_I5CM_ID_NVM_BlockDL: type=NV_Data_I5CM_ID_NVM_BlockDL, init-value=fields=I5CM_ID_NVM_BlockDL:176 x 0
        rom block ROM_NVBlockDescriptor_I5CM_ID_NVM_BlockDL: sw-calibration-access=READ-WRITE, type=NV_Data_I5CM_ID_NVM_BlockDL, init-value=fields=I5CM_ID_NVM_BlockDL:176 x 0
      NVBlockDescriptor_I5CM_ID_NVM_BlockKEYLC: client-server-ports=role-based-port-assignment={port-prototype=I5CM_ID_NVM_BlockKEYLC_NvM_JobFinished, role=I5CM_ID_NVM_BlockKEYLC_NvM_JobFinished}, nv-block-data-mapping{nv-ram-block-element=autosar-variable-in-impl-datatype=I5CM_ID_NVM_BlockKEYLC, written-read-nv-data=I5CM_ID_NVM_BlockKEYLC.Value}
        nv block needs NVNeed_NVBlockDescriptor: n-data-sets=2, ram-block-status-control=API, reliability=NO-PROTECTION, restore-at-start=true, store-at-shutdown=false, store-immediate=true, write-verification=false
        ram block RAM_NVBlockDescriptor_I5CM_ID_NVM_BlockKEYLC: type=NV_Data_I5CM_ID_NVM_BlockKEYLC, init-value=fields=I5CM_ID_NVM_BlockKEYLC:128 x 0
        rom block ROM_NVBlockDescriptor_I5CM_ID_NVM_BlockKEYLC: sw-calibration-access=READ-WRITE, type=NV_Data_I5CM_ID_NVM_BlockKEYLC, init-value=fields=I5CM_ID_NVM_BlockKEYLC:128 x 0
      NVBlockDescriptor_I5CM_ID_NVM_BlockKEY_0: client-server-ports=role-based-port-assignment={port-prototype=I5CM_ID_NVM_BlockKEY_0_NvM_JobFinished, role=I5CM_ID_NVM_BlockKEY_0_NvM_JobFinished}, nv-block-data-mapping{nv-ram-block-element=autosar-variable-in-impl-datatype=I5CM_ID_NVM_BlockKEY_0, written-read-nv-data=I5CM_ID_NVM_BlockKEY_0.Value}
        nv block needs NVNeed_NVBlockDescriptor: n-data-sets=2, ram-block-status-control=API, reliability=NO-PROTECTION, restore-at-start=true, store-at-shutdown=false, store-immediate=true, write-verification=false
        ram block RAM_NVBlockDescriptor_I5CM_ID_NVM_BlockKEY_0: type=NV_Data_I5CM_ID_NVM_BlockKEY_0, init-value=fields=I5CM_ID_NVM_BlockKEY_0:64 x 0
        rom block ROM_NVBlockDescriptor_I5CM_ID_NVM_BlockKEY_0: sw-calibration-access=READ-WRITE, type=NV_Data_I5CM_ID_NVM_BlockKEY_0, init-value=fields=I5CM_ID_NVM_BlockKEY_0:64 x 0
      NVBlockDescriptor_I5CM_ID_NVM_BlockKEY_1: client-server-ports=role-based-port-assignment={port-prototype=I5CM_ID_NVM_BlockKEY_1_NvM_JobFinished, role=I5CM_ID_NVM_BlockKEY_1_NvM_JobFinished}, nv-block-data-mapping{nv-ram-block-element=autosar-variable-in-impl-datatype=I5CM_ID_NVM_BlockKEY_1, written-read-nv-data=I5CM_ID_NVM_BlockKEY_1.Value}
        nv block needs NVNeed_NVBlockDescriptor: n-data-sets=2, ram-block-status-control=API, reliability=NO-PROTECTION, restore-at-start=true, store-at-shutdown=false, store-immediate=true, write-verification=false
        ram block RAM_NVBlockDescriptor_I5CM_ID_NVM_BlockKEY_1: type=NV_Data_I5CM_ID_NVM_BlockKEY_1, init-value=fields=I5CM_ID_NVM_BlockKEY_1:64 x 0
        rom block ROM_NVBlockDescriptor_I5CM_ID_NVM_BlockKEY_1: sw-calibration-access=READ-WRITE, type=NV_Data_I5CM_ID_NVM_BlockKEY_1, init-value=fields=I5CM_ID_NVM_BlockKEY_1:64 x 0
      NVBlockDescriptor_I5CM_ID_NVM_BlockKEY_2: client-server-ports=role-based-port-assignment={port-prototype=I5CM_ID_NVM_BlockKEY_2_NvM_JobFinished, role=I5CM_ID_NVM_BlockKEY_2_NvM_JobFinished}, nv-block-data-mapping{nv-ram-block-element=autosar-variable-in-impl-datatype=I5CM_ID_NVM_BlockKEY_2, written-read-nv-data=I5CM_ID_NVM_BlockKEY_2.Value}
        nv block needs NVNeed_NVBlockDescriptor: n-data-sets=2, ram-block-status-control=API, reliability=NO-PROTECTION, restore-at-start=true, store-at-shutdown=false, store-immediate=true, write-verification=false
        ram block RAM_NVBlockDescriptor_I5CM_ID_NVM_BlockKEY_2: type=NV_Data_I5CM_ID_NVM_BlockKEY_2, init-value=fields=I5CM_ID_NVM_BlockKEY_2:64 x 0
        rom block ROM_NVBlockDescriptor_I5CM_ID_NVM_BlockKEY_2: sw-calibration-access=READ-WRITE, type=NV_Data_I5CM_ID_NVM_BlockKEY_2, init-value=fields=I5CM_ID_NVM_BlockKEY_2:64 x 0
      NVBlockDescriptor_I5CM_ID_NVM_BlockLEARN_0: client-server-ports=role-based-port-assignment={port-prototype=I5CM_ID_NVM_BlockLEARN_0_NvM_JobFinished, role=I5CM_ID_NVM_BlockLEARN_0_NvM_JobFinished}, nv-block-data-mapping{nv-ram-block-element=autosar-variable-in-impl-datatype=I5CM_ID_NVM_BlockLEARN_0, written-read-nv-data=I5CM_ID_NVM_BlockLEARN_0.Value}
        nv block needs NVNeed_NVBlockDescriptor: n-data-sets=2, ram-block-status-control=API, reliability=NO-PROTECTION, restore-at-start=true, store-at-shutdown=false, store-immediate=true, write-verification=false
        ram block RAM_NVBlockDescriptor_I5CM_ID_NVM_BlockLEARN_0: type=NV_Data_I5CM_ID_NVM_BlockLEARN_0, init-value=fields=I5CM_ID_NVM_BlockLEARN_0:80 x 0
        rom block ROM_NVBlockDescriptor_I5CM_ID_NVM_BlockLEARN_0: sw-calibration-access=READ-WRITE, type=NV_Data_I5CM_ID_NVM_BlockLEARN_0, init-value=fields=I5CM_ID_NVM_BlockLEARN_0:80 x 0
      NVBlockDescriptor_I5CM_ID_NVM_BlockLEARN_1: client-server-ports=role-based-port-assignment={port-prototype=I5CM_ID_NVM_BlockLEARN_1_NvM_JobFinished, role=I5CM_ID_NVM_BlockLEARN_1_NvM_JobFinished}, nv-block-data-mapping{nv-ram-block-element=autosar-variable-in-impl-datatype=I5CM_ID_NVM_BlockLEARN_1, written-read-nv-data=I5CM_ID_NVM_BlockLEARN_1.Value}
        nv block needs NVNeed_NVBlockDescriptor: n-data-sets=2, ram-block-status-control=API, reliability=NO-PROTECTION, restore-at-start=true, store-at-shutdown=false, store-immediate=true, write-verification=false
        ram block RAM_NVBlockDescriptor_I5CM_ID_NVM_BlockLEARN_1: type=NV_Data_I5CM_ID_NVM_BlockLEARN_1, init-value=fields=I5CM_ID_NVM_BlockLEARN_1:80 x 0
        rom block ROM_NVBlockDescriptor_I5CM_ID_NVM_BlockLEARN_1: sw-calibration-access=READ-WRITE, type=NV_Data_I5CM_ID_NVM_BlockLEARN_1, init-value=fields=I5CM_ID_NVM_BlockLEARN_1:80 x 0
      NVBlockDescriptor_I5CM_ID_NVM_BlockLEARN_2: client-server-ports=role-based-port-assignment={port-prototype=I5CM_ID_NVM_BlockLEARN_2_NvM_JobFinished, role=I5CM_ID_NVM_BlockLEARN_2_NvM_JobFinished}, nv-block-data-mapping{nv-ram-block-element=autosar-variable-in-impl-datatype=I5CM_ID_NVM_BlockLEARN_2, written-read-nv-data=I5CM_ID_NVM_BlockLEARN_2.Value}
        nv block needs NVNeed_NVBlockDescriptor: n-data-sets=2, ram-block-status-control=API, reliability=NO-PROTECTION, restore-at-start=true, store-at-shutdown=false, store-immediate=true, write-verification=false
        ram block RAM_NVBlockDescriptor_I5CM_ID_NVM_BlockLEARN_2: type=NV_Data_I5CM_ID_NVM_BlockLEARN_2, init-value=fields=I5CM_ID_NVM_BlockLEARN_2:80 x 0
        rom block ROM_NVBlockDescriptor_I5CM_ID_NVM_BlockLEARN_2: sw-calibration-access=READ-WRITE, type=NV_Data_I5CM_ID_NVM_BlockLEARN_2, init-value=fields=I5CM_ID_NVM_BlockLEARN_2:80 x 0
      NVBlockDescriptor_I5CM_ID_NVM_BlockPARAM_0: client-server-ports=role-based-port-assignment={port-prototype=I5CM_ID_NVM_BlockPARAM_0_NvM_JobFinished, role=I5CM_ID_NVM_BlockPARAM_0_NvM_JobFinished}, nv-block-data-mapping{nv-ram-block-element=autosar-variable-in-impl-datatype=I5CM_ID_NVM_BlockPARAM_0, written-read-nv-data=I5CM_ID_NVM_BlockPARAM_0.Value}
        nv block needs NVNeed_NVBlockDescriptor: n-data-sets=2, ram-block-status-control=API, reliability=NO-PROTECTION, restore-at-start=true, store-at-shutdown=false, store-immediate=true, write-verification=false
        ram block RAM_NVBlockDescriptor_I5CM_ID_NVM_BlockPARAM_0: type=NV_Data_I5CM_ID_NVM_BlockPARAM_0, init-value=fields=I5CM_ID_NVM_BlockPARAM_0:32 x 0
        rom block ROM_NVBlockDescriptor_I5CM_ID_NVM_BlockPARAM_0: sw-calibration-access=READ-WRITE, type=NV_Data_I5CM_ID_NVM_BlockPARAM_0, init-value=fields=I5CM_ID_NVM_BlockPARAM_0:32 x 0
      NVBlockDescriptor_I5CM_ID_NVM_BlockPARAM_1: client-server-ports=role-based-port-assignment={port-prototype=I5CM_ID_NVM_BlockPARAM_1_NvM_JobFinished, role=I5CM_ID_NVM_BlockPARAM_1_NvM_JobFinished}, nv-block-data-mapping{nv-ram-block-element=autosar-variable-in-impl-datatype=I5CM_ID_NVM_BlockPARAM_1, written-read-nv-data=I5CM_ID_NVM_BlockPARAM_1.Value}
        nv block needs NVNeed_NVBlockDescriptor: n-data-sets=2, ram-block-status-control=API, reliability=NO-PROTECTION, restore-at-start=true, store-at-shutdown=false, store-immediate=true, write-verification=false
        ram block RAM_NVBlockDescriptor_I5CM_ID_NVM_BlockPARAM_1: type=NV_Data_I5CM_ID_NVM_BlockPARAM_1, init-value=fields=I5CM_ID_NVM_BlockPARAM_1:32 x 0
        rom block ROM_NVBlockDescriptor_I5CM_ID_NVM_BlockPARAM_1: sw-calibration-access=READ-WRITE, type=NV_Data_I5CM_ID_NVM_BlockPARAM_1, init-value=fields=I5CM_ID_NVM_BlockPARAM_1:32 x 0
      NVBlockDescriptor_I5CM_ID_NVM_BlockPARAM_2: client-server-ports=role-based-port-assignment={port-prototype=I5CM_ID_NVM_BlockPARAM_2_NvM_JobFinished, role=I5CM_ID_NVM_BlockPARAM_2_NvM_JobFinished}, nv-block-data-mapping{nv-ram-block-element=autosar-variable-in-impl-datatype=I5CM_ID_NVM_BlockPARAM_2, written-read-nv-data=I5CM_ID_NVM_BlockPARAM_2.Value}
        nv block needs NVNeed_NVBlockDescriptor: n-data-sets=2, ram-block-status-control=API, reliability=NO-PROTECTION, restore-at-start=true, store-at-shutdown=false, store-immediate=true, write-verification=false
        ram block RAM_NVBlockDescriptor_I5CM_ID_NVM_BlockPARAM_2: type=NV_Data_I5CM_ID_NVM_BlockPARAM_2, init-value=fields=I5CM_ID_NVM_BlockPARAM_2:32 x 0
        rom block ROM_NVBlockDescriptor_I5CM_ID_NVM_BlockPARAM_2: sw-calibration-access=READ-WRITE, type=NV_Data_I5CM_ID_NVM_BlockPARAM_2, init-value=fields=I5CM_ID_NVM_BlockPARAM_2:32 x 0
      NVBlockDescriptor_I5CM_ID_NVM_BlockSRM_0: client-server-ports=role-based-port-assignment={port-prototype=I5CM_ID_NVM_BlockSRM_0_NvM_JobFinished, role=I5CM_ID_NVM_BlockSRM_0_NvM_JobFinished}, nv-block-data-mapping{nv-ram-block-element=autosar-variable-in-impl-datatype=I5CM_ID_NVM_BlockSRM_0, written-read-nv-data=I5CM_ID_NVM_BlockSRM_0.Value}
        nv block needs NVNeed_NVBlockDescriptor: n-data-sets=2, ram-block-status-control=API, reliability=NO-PROTECTION, restore-at-start=true, store-at-shutdown=false, store-immediate=true, write-verification=false
        ram block RAM_NVBlockDescriptor_I5CM_ID_NVM_BlockSRM_0: type=NV_Data_I5CM_ID_NVM_BlockSRM_0, init-value=fields=I5CM_ID_NVM_BlockSRM_0:32 x 0
        rom block ROM_NVBlockDescriptor_I5CM_ID_NVM_BlockSRM_0: sw-calibration-access=READ-WRITE, type=NV_Data_I5CM_ID_NVM_BlockSRM_0, init-value=fields=I5CM_ID_NVM_BlockSRM_0:32 x 0
      NVBlockDescriptor_I5CM_ID_NVM_BlockSRM_1: client-server-ports=role-based-port-assignment={port-prototype=I5CM_ID_NVM_BlockSRM_1_NvM_JobFinished, role=I5CM_ID_NVM_BlockSRM_1_NvM_JobFinished}, nv-block-data-mapping{nv-ram-block-element=autosar-variable-in-impl-datatype=I5CM_ID_NVM_BlockSRM_1, written-read-nv-data=I5CM_ID_NVM_BlockSRM_1.Value}
        nv block needs NVNeed_NVBlockDescriptor: n-data-sets=2, ram-block-status-control=API, reliability=NO-PROTECTION, restore-at-start=true, store-at-shutdown=false, store-immediate=true, write-verification=false
        ram block RAM_NVBlockDescriptor_I5CM_ID_NVM_BlockSRM_1: type=NV_Data_I5CM_ID_NVM_BlockSRM_1, init-value=fields=I5CM_ID_NVM_BlockSRM_1:32 x 0
        rom block ROM_NVBlockDescriptor_I5CM_ID_NVM_BlockSRM_1: sw-calibration-access=READ-WRITE, type=NV_Data_I5CM_ID_NVM_BlockSRM_1, init-value=fields=I5CM_ID_NVM_BlockSRM_1:32 x 0
      NVBlockDescriptor_I5CM_ID_NVM_BlockSRM_2: client-server-ports=role-based-port-assignment={port-prototype=I5CM_ID_NVM_BlockSRM_2_NvM_JobFinished, role=I5CM_ID_NVM_BlockSRM_2_NvM_JobFinished}, nv-block-data-mapping{nv-ram-block-element=autosar-variable-in-impl-datatype=I5CM_ID_NVM_BlockSRM_2, written-read-nv-data=I5CM_ID_NVM_BlockSRM_2.Value}
        nv block needs NVNeed_NVBlockDescriptor: n-data-sets=2, ram-block-status-control=API, reliability=NO-PROTECTION, restore-at-start=true, store-at-shutdown=false, store-immediate=true, write-verification=false
        ram block RAM_NVBlockDescriptor_I5CM_ID_NVM_BlockSRM_2: type=NV_Data_I5CM_ID_NVM_BlockSRM_2, init-value=fields=I5CM_ID_NVM_BlockSRM_2:32 x 0
        rom block ROM_NVBlockDescriptor_I5CM_ID_NVM_BlockSRM_2: sw-calibration-access=READ-WRITE, type=NV_Data_I5CM_ID_NVM_BlockSRM_2, init-value=fields=I5CM_ID_NVM_BlockSRM_2:32 x 0
      NVBlockDescriptor_I5CM_ID_NVM_BlockSTATE_0: client-server-ports=role-based-port-assignment={port-prototype=I5CM_ID_NVM_BlockSTATE_0_NvM_JobFinished, role=I5CM_ID_NVM_BlockSTATE_0_NvM_JobFinished}, nv-block-data-mapping{nv-ram-block-element=autosar-variable-in-impl-datatype=I5CM_ID_NVM_BlockSTATE_0, written-read-nv-data=I5CM_ID_NVM_BlockSTATE_0.Value}
        nv block needs NVNeed_NVBlockDescriptor: n-data-sets=2, ram-block-status-control=API, reliability=NO-PROTECTION, restore-at-start=true, store-at-shutdown=false, store-immediate=true, write-verification=false
        ram block RAM_NVBlockDescriptor_I5CM_ID_NVM_BlockSTATE_0: type=NV_Data_I5CM_ID_NVM_BlockSTATE_0, init-value=fields=I5CM_ID_NVM_BlockSTATE_0:16 x 0
        rom block ROM_NVBlockDescriptor_I5CM_ID_NVM_BlockSTATE_0: sw-calibration-access=READ-WRITE, type=NV_Data_I5CM_ID_NVM_BlockSTATE_0, init-value=fields=I5CM_ID_NVM_BlockSTATE_0:16 x 0
      NVBlockDescriptor_I5CM_ID_NVM_BlockSTATE_1: client-server-ports=role-based-port-assignment={port-prototype=I5CM_ID_NVM_BlockSTATE_1_NvM_JobFinished, role=I5CM_ID_NVM_BlockSTATE_1_NvM_JobFinished}, nv-block-data-mapping{nv-ram-block-element=autosar-variable-in-impl-datatype=I5CM_ID_NVM_BlockSTATE_1, written-read-nv-data=I5CM_ID_NVM_BlockSTATE_1.Value}
        nv block needs NVNeed_NVBlockDescriptor: n-data-sets=2, ram-block-status-control=API, reliability=NO-PROTECTION, restore-at-start=true, store-at-shutdown=false, store-immediate=true, write-verification=false
        ram block RAM_NVBlockDescriptor_I5CM_ID_NVM_BlockSTATE_1: type=NV_Data_I5CM_ID_NVM_BlockSTATE_1, init-value=fields=I5CM_ID_NVM_BlockSTATE_1:16 x 0
        rom block ROM_NVBlockDescriptor_I5CM_ID_NVM_BlockSTATE_1: sw-calibration-access=READ-WRITE, type=NV_Data_I5CM_ID_NVM_BlockSTATE_1, init-value=fields=I5CM_ID_NVM_BlockSTATE_1:16 x 0
      NVBlockDescriptor_I5CM_ID_NVM_BlockSTATE_2: client-server-ports=role-based-port-assignment={port-prototype=I5CM_ID_NVM_BlockSTATE_2_NvM_JobFinished, role=I5CM_ID_NVM_BlockSTATE_2_NvM_JobFinished}, nv-block-data-mapping{nv-ram-block-element=autosar-variable-in-impl-datatype=I5CM_ID_NVM_BlockSTATE_2, written-read-nv-data=I5CM_ID_NVM_BlockSTATE_2.Value}
        nv block needs NVNeed_NVBlockDescriptor: n-data-sets=2, ram-block-status-control=API, reliability=NO-PROTECTION, restore-at-start=true, store-at-shutdown=false, store-immediate=true, write-verification=false
        ram block RAM_NVBlockDescriptor_I5CM_ID_NVM_BlockSTATE_2: type=NV_Data_I5CM_ID_NVM_BlockSTATE_2, init-value=fields=I5CM_ID_NVM_BlockSTATE_2:16 x 0
        rom block ROM_NVBlockDescriptor_I5CM_ID_NVM_BlockSTATE_2: sw-calibration-access=READ-WRITE, type=NV_Data_I5CM_ID_NVM_BlockSTATE_2, init-value=fields=I5CM_ID_NVM_BlockSTATE_2:16 x 0
      NVBlockDescriptor_I5CM_ID_NVM_BlockSTS_0: client-server-ports=role-based-port-assignment={port-prototype=I5CM_ID_NVM_BlockSTS_0_NvM_JobFinished, role=I5CM_ID_NVM_BlockSTS_0_NvM_JobFinished}, nv-block-data-mapping{nv-ram-block-element=autosar-variable-in-impl-datatype=I5CM_ID_NVM_BlockSTS_0, written-read-nv-data=I5CM_ID_NVM_BlockSTS_0.Value}
        nv block needs NVNeed_NVBlockDescriptor: n-data-sets=2, ram-block-status-control=API, reliability=NO-PROTECTION, restore-at-start=true, store-at-shutdown=false, store-immediate=true, write-verification=false
        ram block RAM_NVBlockDescriptor_I5CM_ID_NVM_BlockSTS_0: type=NV_Data_I5CM_ID_NVM_BlockSTS_0, init-value=fields=I5CM_ID_NVM_BlockSTS_0:16 x 0
        rom block ROM_NVBlockDescriptor_I5CM_ID_NVM_BlockSTS_0: sw-calibration-access=READ-WRITE, type=NV_Data_I5CM_ID_NVM_BlockSTS_0, init-value=fields=I5CM_ID_NVM_BlockSTS_0:16 x 0
      NVBlockDescriptor_I5CM_ID_NVM_BlockSTS_1: client-server-ports=role-based-port-assignment={port-prototype=I5CM_ID_NVM_BlockSTS_1_NvM_JobFinished, role=I5CM_ID_NVM_BlockSTS_1_NvM_JobFinished}, nv-block-data-mapping{nv-ram-block-element=autosar-variable-in-impl-datatype=I5CM_ID_NVM_BlockSTS_1, written-read-nv-data=I5CM_ID_NVM_BlockSTS_1.Value}
        nv block needs NVNeed_NVBlockDescriptor: n-data-sets=2, ram-block-status-control=API, reliability=NO-PROTECTION, restore-at-start=true, store-at-shutdown=false, store-immediate=true, write-verification=false
        ram block RAM_NVBlockDescriptor_I5CM_ID_NVM_BlockSTS_1: type=NV_Data_I5CM_ID_NVM_BlockSTS_1, init-value=fields=I5CM_ID_NVM_BlockSTS_1:16 x 0
        rom block ROM_NVBlockDescriptor_I5CM_ID_NVM_BlockSTS_1: sw-calibration-access=READ-WRITE, type=NV_Data_I5CM_ID_NVM_BlockSTS_1, init-value=fields=I5CM_ID_NVM_BlockSTS_1:16 x 0
      NVBlockDescriptor_I5CM_ID_NVM_BlockSTS_2: client-server-ports=role-based-port-assignment={port-prototype=I5CM_ID_NVM_BlockSTS_2_NvM_JobFinished, role=I5CM_ID_NVM_BlockSTS_2_NvM_JobFinished}, nv-block-data-mapping{nv-ram-block-element=autosar-variable-in-impl-datatype=I5CM_ID_NVM_BlockSTS_2, written-read-nv-data=I5CM_ID_NVM_BlockSTS_2.Value}
        nv block needs NVNeed_NVBlockDescriptor: n-data-sets=2, ram-block-status-control=API, reliability=NO-PROTECTION, restore-at-start=true, store-at-shutdown=false, store-immediate=true, write-verification=false
        ram block RAM_NVBlockDescriptor_I5CM_ID_NVM_BlockSTS_2: type=NV_Data_I5CM_ID_NVM_BlockSTS_2, init-value=fields=I5CM_ID_NVM_BlockSTS_2:16 x 0
        rom block ROM_NVBlockDescriptor_I5CM_ID_NVM_BlockSTS_2: sw-calibration-access=READ-WRITE, type=NV_Data_I5CM_ID_NVM_BlockSTS_2, init-value=fields=I5CM_ID_NVM_BlockSTS_2:16 x 0
      NVBlockDescriptor_KsNvmBlockGfaKey_0: client-server-ports=role-based-port-assignment={port-prototype=KsNvmBlockGfaKey_0_NvM_JobFinished, role=KsNvmBlockGfaKey_0_NvM_JobFinished}, nv-block-data-mapping{nv-ram-block-element=autosar-variable-in-impl-datatype=KsNvmBlockGfaKey_0, written-read-nv-data=KsNvmBlockGfaKey_0.Value}
        nv block needs NVNeed_NVBlockDescriptor: n-data-sets=2, ram-block-status-control=API, reliability=NO-PROTECTION, restore-at-start=true, store-at-shutdown=false, store-immediate=true, write-verification=false
        ram block RAM_NVBlockDescriptor_KsNvmBlockGfaKey_0: type=NV_Data_KsNvmBlockGfaKey_0, init-value=fields=KsNvmBlockGfaKey_0:64 x 255
        rom block ROM_NVBlockDescriptor_KsNvmBlockGfaKey_0: sw-calibration-access=READ-WRITE, type=NV_Data_KsNvmBlockGfaKey_0, init-value=fields=KsNvmBlockGfaKey_0:64 x 255
      NVBlockDescriptor_KsNvmBlockGfaKey_1: client-server-ports=role-based-port-assignment={port-prototype=KsNvmBlockGfaKey_1_NvM_JobFinished, role=KsNvmBlockGfaKey_1_NvM_JobFinished}, nv-block-data-mapping{nv-ram-block-element=autosar-variable-in-impl-datatype=KsNvmBlockGfaKey_1, written-read-nv-data=KsNvmBlockGfaKey_1.Value}
        nv block needs NVNeed_NVBlockDescriptor: n-data-sets=2, ram-block-status-control=API, reliability=NO-PROTECTION, restore-at-start=true, store-at-shutdown=false, store-immediate=true, write-verification=false
        ram block RAM_NVBlockDescriptor_KsNvmBlockGfaKey_1: type=NV_Data_KsNvmBlockGfaKey_1, init-value=fields=KsNvmBlockGfaKey_1:64 x 255
        rom block ROM_NVBlockDescriptor_KsNvmBlockGfaKey_1: sw-calibration-access=READ-WRITE, type=NV_Data_KsNvmBlockGfaKey_1, init-value=fields=KsNvmBlockGfaKey_1:64 x 255
      NVBlockDescriptor_KsNvmBlockMisc_0: client-server-ports=role-based-port-assignment={port-prototype=KsNvmBlockMisc_0_NvM_JobFinished, role=KsNvmBlockMisc_0_NvM_JobFinished}, nv-block-data-mapping{nv-ram-block-element=autosar-variable-in-impl-datatype=KsNvmBlockMisc_0, written-read-nv-data=KsNvmBlockMisc_0.Value}
        nv block needs NVNeed_NVBlockDescriptor: n-data-sets=2, ram-block-status-control=API, reliability=NO-PROTECTION, restore-at-start=true, store-at-shutdown=false, store-immediate=true, write-verification=false
        ram block RAM_NVBlockDescriptor_KsNvmBlockMisc_0: type=NV_Data_KsNvmBlockMisc_0, init-value=fields=KsNvmBlockMisc_0:[233, 127, 244, 170, 47, 39, 100, 114, 168, 247, 8, 100, 216, 21, 109, 47]
        rom block ROM_NVBlockDescriptor_KsNvmBlockMisc_0: sw-calibration-access=READ-WRITE, type=NV_Data_KsNvmBlockMisc_0, init-value=fields=KsNvmBlockMisc_0:[233, 127, 244, 170, 47, 39, 100, 114, 168, 247, 8, 100, 216, 21, 109, 47]
      NVBlockDescriptor_KsNvmBlockMisc_1: client-server-ports=role-based-port-assignment={port-prototype=KsNvmBlockMisc_1_NvM_JobFinished, role=KsNvmBlockMisc_1_NvM_JobFinished}, nv-block-data-mapping{nv-ram-block-element=autosar-variable-in-impl-datatype=KsNvmBlockMisc_1, written-read-nv-data=KsNvmBlockMisc_1.Value}
        nv block needs NVNeed_NVBlockDescriptor: n-data-sets=2, ram-block-status-control=API, reliability=NO-PROTECTION, restore-at-start=true, store-at-shutdown=false, store-immediate=true, write-verification=false
        ram block RAM_NVBlockDescriptor_KsNvmBlockMisc_1: type=NV_Data_KsNvmBlockMisc_1, init-value=fields=KsNvmBlockMisc_1:[233, 127, 244, 170, 47, 39, 100, 114, 168, 247, 8, 100, 216, 21, 109, 47]
        rom block ROM_NVBlockDescriptor_KsNvmBlockMisc_1: sw-calibration-access=READ-WRITE, type=NV_Data_KsNvmBlockMisc_1, init-value=fields=KsNvmBlockMisc_1:[233, 127, 244, 170, 47, 39, 100, 114, 168, 247, 8, 100, 216, 21, 109, 47]
      NVBlockDescriptor_NVM_BLOCK_IVD_0X0250: client-server-ports=role-based-port-assignment={port-prototype=NVM_BLOCK_IVD_0X0250_NvM_JobFinished, role=NVM_BLOCK_IVD_0X0250_NvM_JobFinished}, nv-block-data-mapping{nv-ram-block-element=autosar-variable-in-impl-datatype=NVM_BLOCK_IVD_0X0250, written-read-nv-data=NVM_BLOCK_IVD_0X0250.Value}
        nv block needs NVNeed_NVBlockDescriptor: n-data-sets=2, ram-block-status-control=API, reliability=NO-PROTECTION, restore-at-start=true, store-at-shutdown=false, store-immediate=true, write-verification=false
        ram block RAM_NVBlockDescriptor_NVM_BLOCK_IVD_0X0250: type=NV_Data_NVM_BLOCK_IVD_0X0250, init-value=fields=NVM_BLOCK_IVD_0X0250:202 x 255
        rom block ROM_NVBlockDescriptor_NVM_BLOCK_IVD_0X0250: sw-calibration-access=READ-WRITE, type=NV_Data_NVM_BLOCK_IVD_0X0250, init-value=fields=NVM_BLOCK_IVD_0X0250:202 x 255
      NVBlockDescriptor_NVM_BLOCK_SFD_ConfigurationFingerprint_Data: client-server-ports=role-based-port-assignment={port-prototype=NVM_BLOCK_SFD_ConfigurationFingerprint_Data_NvM_JobFinished, role=NVM_BLOCK_SFD_ConfigurationFingerprint_Data_NvM_JobFinished}, nv-block-data-mapping{nv-ram-block-element=autosar-variable-in-impl-datatype=NVM_BLOCK_SFD_ConfigurationFingerprint_Data, written-read-nv-data=NVM_BLOCK_SFD_ConfigurationFingerprint_Data.Value}
        nv block needs NVNeed_NVBlockDescriptor: n-data-sets=2, ram-block-status-control=API, reliability=NO-PROTECTION, restore-at-start=true, store-at-shutdown=false, store-immediate=true, write-verification=false
        ram block RAM_NVBlockDescriptor_NVM_BLOCK_SFD_ConfigurationFingerprint_Data: type=NV_Data_NVM_BLOCK_SFD_ConfigurationFingerprint_Data, init-value=fields=NVM_BLOCK_SFD_ConfigurationFingerprint_Data:514 x 255
        rom block ROM_NVBlockDescriptor_NVM_BLOCK_SFD_ConfigurationFingerprint_Data: sw-calibration-access=READ-WRITE, type=NV_Data_NVM_BLOCK_SFD_ConfigurationFingerprint_Data, init-value=fields=NVM_BLOCK_SFD_ConfigurationFingerprint_Data:514 x 255
      NVBlockDescriptor_NVM_BLOCK_SFD_PersistentData: client-server-ports=role-based-port-assignment={port-prototype=NVM_BLOCK_SFD_PersistentData_NvM_JobFinished, role=NVM_BLOCK_SFD_PersistentData_NvM_JobFinished}, nv-block-data-mapping{nv-ram-block-element=autosar-variable-in-impl-datatype=NVM_BLOCK_SFD_PersistentData, written-read-nv-data=NVM_BLOCK_SFD_PersistentData.Value}
        nv block needs NVNeed_NVBlockDescriptor: n-data-sets=2, ram-block-status-control=API, reliability=NO-PROTECTION, restore-at-start=true, store-at-shutdown=false, store-immediate=true, write-verification=false
        ram block RAM_NVBlockDescriptor_NVM_BLOCK_SFD_PersistentData: type=NV_Data_NVM_BLOCK_SFD_PersistentData, init-value=fields=NVM_BLOCK_SFD_PersistentData:30 x 255
        rom block ROM_NVBlockDescriptor_NVM_BLOCK_SFD_PersistentData: sw-calibration-access=READ-WRITE, type=NV_Data_NVM_BLOCK_SFD_PersistentData, init-value=fields=NVM_BLOCK_SFD_PersistentData:30 x 255
      NVBlockDescriptor_NVM_BLOCK_SFD_PublicKey: client-server-ports=role-based-port-assignment={port-prototype=NVM_BLOCK_SFD_PublicKey_NvM_JobFinished, role=NVM_BLOCK_SFD_PublicKey_NvM_JobFinished}, nv-block-data-mapping{nv-ram-block-element=autosar-variable-in-impl-datatype=NVM_BLOCK_SFD_PublicKey, written-read-nv-data=NVM_BLOCK_SFD_PublicKey.Value}
        nv block needs NVNeed_NVBlockDescriptor: n-data-sets=2, ram-block-status-control=API, reliability=NO-PROTECTION, restore-at-start=true, store-at-shutdown=false, store-immediate=true, write-verification=false
        ram block RAM_NVBlockDescriptor_NVM_BLOCK_SFD_PublicKey: type=NV_Data_NVM_BLOCK_SFD_PublicKey, init-value=fields=NVM_BLOCK_SFD_PublicKey:[162, 116, 6, 241, 69, 185, 82, 238, 112, 6, 178, 61, 208, 120, 250, 208, 102, 39, 182, 71, 203, 44, 209, 32, 61, 199, 205, 206, 30, 35, 252, 141, 194, 124, 221, 37, 43, 38, 106, 96, 191, 198, 122, 159, 219, 202, 200, 63, 9, 158, 170, 34, 31, 205, 75, 92, 104, 255, 207, 83, 154, 147, 199, 4]
        rom block ROM_NVBlockDescriptor_NVM_BLOCK_SFD_PublicKey:
          sw-calibration-access=READ-WRITE
          type=NV_Data_NVM_BLOCK_SFD_PublicKey
          init-value=fields=NVM_BLOCK_SFD_PublicKey:[162, 116, 6, 241, 69, 185, 82, 238, 112, 6, 178, 61, 208, 120, 250, 208, 102, 39, 182, 71, 203, 44, 209, 32, 61, 199, 205, 206, 30, 35, 252, 141, 194, 124, 221, 37, 43, 38, 106, 96, 191, 198, 122, 159, 219, 202, 200, 63, 9, 158, 170, 34, 31, 205, 75, 92, 104, 255, 207, 83, 154, 147, 199, 4]
      NVBlockDescriptor_NvMFblGeneral: client-server-ports=role-based-port-assignment={port-prototype=NvMFblGeneral_NvM_JobFinished, role=NvMFblGeneral_NvM_JobFinished}
        nv-block-data-mappings:
          nv-ram-block-element=autosar-variable-in-impl-datatype=ProgReqFlag, written-read-nv-data=ProgReqFlag.Value
          nv-ram-block-element=autosar-variable-in-impl-datatype=Share_ValidityFlags, written-read-nv-data=Share_ValidityFlags.Value
          nv-ram-block-element=autosar-variable-in-impl-datatype=ResetResponseFlag, written-read-nv-data=ResetResponseFlag.Value
          nv-ram-block-element=autosar-variable-in-impl-datatype=ApplValidity, written-read-nv-data=ApplValidity.Value
          nv-ram-block-element=autosar-variable-in-impl-datatype=ProgMarker, written-read-nv-data=ProgMarker.Value
          nv-ram-block-element=autosar-variable-in-impl-datatype=SecAccessDelayFlag, written-read-nv-data=SecAccessDelayFlag.Value
          nv-ram-block-element=autosar-variable-in-impl-datatype=SecAccessInvalidCount, written-read-nv-data=SecAccessInvalidCount.Value
          nv-ram-block-element=autosar-variable-in-impl-datatype=BSBlockSizeActive, written-read-nv-data=BSBlockSizeActive.Value
          nv-ram-block-element=autosar-variable-in-impl-datatype=BSBlockSize, written-read-nv-data=BSBlockSize.Value
          nv-ram-block-element=autosar-variable-in-impl-datatype=DcmDslRxTesterSourceAddr, written-read-nv-data=DcmDslRxTesterSourceAddr.Value
        nv block needs NVNeed_NVBlockDescriptor: n-data-sets=2, ram-block-status-control=API, reliability=NO-PROTECTION, restore-at-start=true, store-at-shutdown=false, store-immediate=true, write-verification=false
        ram block RAM_NVBlockDescriptor_NvMFblGeneral: type=NV_Data_NvMFblGeneral, init-value=fields=[ProgReqFlag:255, Share_ValidityFlags:192, ResetResponseFlag:255, ApplValidity:209, ProgMarker:255, SecAccessDelayFlag:255, SecAccessInvalidCount:255, BSBlockSizeActive:255, BSBlockSize:255, DcmDslRxTesterSourceAddr:65535]
        rom block ROM_NVBlockDescriptor_NvMFblGeneral: sw-calibration-access=READ-WRITE, type=NV_Data_NvMFblGeneral, init-value=fields=[ProgReqFlag:255, Share_ValidityFlags:192, ResetResponseFlag:255, ApplValidity:209, ProgMarker:255, SecAccessDelayFlag:255, SecAccessInvalidCount:255, BSBlockSizeActive:255, BSBlockSize:255, DcmDslRxTesterSourceAddr:65535]
      NVBlockDescriptor_NvMFblMetaData: client-server-ports=role-based-port-assignment={port-prototype=NvMFblMetaData_NvM_JobFinished, role=NvMFblMetaData_NvM_JobFinished}
        nv-block-data-mappings:
          nv-ram-block-element=autosar-variable-in-impl-datatype=Share_Fingerprint_Block1, written-read-nv-data=Share_Fingerprint_Block1.Value
          nv-ram-block-element=autosar-variable-in-impl-datatype=Share_ProgAttempts_Block1, written-read-nv-data=Share_ProgAttempts_Block1.Value
          nv-ram-block-element=autosar-variable-in-impl-datatype=CRCValue_Block1, written-read-nv-data=CRCValue_Block1.Value
          nv-ram-block-element=autosar-variable-in-impl-datatype=CRCStart_Block1, written-read-nv-data=CRCStart_Block1.Value
          nv-ram-block-element=autosar-variable-in-impl-datatype=CRCLength_Block1, written-read-nv-data=CRCLength_Block1.Value
          nv-ram-block-element=autosar-variable-in-impl-datatype=EraseState_Block1, written-read-nv-data=EraseState_Block1.Value
          nv-ram-block-element=autosar-variable-in-impl-datatype=SegmentLengthList_Block1, written-read-nv-data=SegmentLengthList_Block1.Value
          nv-ram-block-element=autosar-variable-in-impl-datatype=Share_Fingerprint_Block2, written-read-nv-data=Share_Fingerprint_Block2.Value
          nv-ram-block-element=autosar-variable-in-impl-datatype=Share_ProgAttempts_Block2, written-read-nv-data=Share_ProgAttempts_Block2.Value
          nv-ram-block-element=autosar-variable-in-impl-datatype=CRCValue_Block2, written-read-nv-data=CRCValue_Block2.Value
          nv-ram-block-element=autosar-variable-in-impl-datatype=CRCStart_Block2, written-read-nv-data=CRCStart_Block2.Value
          nv-ram-block-element=autosar-variable-in-impl-datatype=CRCLength_Block2, written-read-nv-data=CRCLength_Block2.Value
          nv-ram-block-element=autosar-variable-in-impl-datatype=EraseState_Block2, written-read-nv-data=EraseState_Block2.Value
          nv-ram-block-element=autosar-variable-in-impl-datatype=SegmentLengthList_Block2, written-read-nv-data=SegmentLengthList_Block2.Value
          nv-ram-block-element=autosar-variable-in-impl-datatype=Share_Fingerprint_Block3, written-read-nv-data=Share_Fingerprint_Block3.Value
          nv-ram-block-element=autosar-variable-in-impl-datatype=Share_ProgAttempts_Block3, written-read-nv-data=Share_ProgAttempts_Block3.Value
          nv-ram-block-element=autosar-variable-in-impl-datatype=CRCValue_Block3, written-read-nv-data=CRCValue_Block3.Value
          nv-ram-block-element=autosar-variable-in-impl-datatype=CRCStart_Block3, written-read-nv-data=CRCStart_Block3.Value
          nv-ram-block-element=autosar-variable-in-impl-datatype=CRCLength_Block3, written-read-nv-data=CRCLength_Block3.Value
          nv-ram-block-element=autosar-variable-in-impl-datatype=EraseState_Block3, written-read-nv-data=EraseState_Block3.Value
          nv-ram-block-element=autosar-variable-in-impl-datatype=SegmentLengthList_Block3, written-read-nv-data=SegmentLengthList_Block3.Value
          nv-ram-block-element=autosar-variable-in-impl-datatype=Share_Fingerprint_Block4, written-read-nv-data=Share_Fingerprint_Block4.Value
          nv-ram-block-element=autosar-variable-in-impl-datatype=Share_ProgAttempts_Block4, written-read-nv-data=Share_ProgAttempts_Block4.Value
          nv-ram-block-element=autosar-variable-in-impl-datatype=CRCValue_Block4, written-read-nv-data=CRCValue_Block4.Value
          nv-ram-block-element=autosar-variable-in-impl-datatype=CRCStart_Block4, written-read-nv-data=CRCStart_Block4.Value
          nv-ram-block-element=autosar-variable-in-impl-datatype=CRCLength_Block4, written-read-nv-data=CRCLength_Block4.Value
          nv-ram-block-element=autosar-variable-in-impl-datatype=EraseState_Block4, written-read-nv-data=EraseState_Block4.Value
          nv-ram-block-element=autosar-variable-in-impl-datatype=SegmentLengthList_Block4, written-read-nv-data=SegmentLengthList_Block4.Value
          nv-ram-block-element=autosar-variable-in-impl-datatype=Share_Fingerprint_Block5, written-read-nv-data=Share_Fingerprint_Block5.Value
          nv-ram-block-element=autosar-variable-in-impl-datatype=Share_ProgAttempts_Block5, written-read-nv-data=Share_ProgAttempts_Block5.Value
          nv-ram-block-element=autosar-variable-in-impl-datatype=CRCValue_Block5, written-read-nv-data=CRCValue_Block5.Value
          nv-ram-block-element=autosar-variable-in-impl-datatype=CRCStart_Block5, written-read-nv-data=CRCStart_Block5.Value
          nv-ram-block-element=autosar-variable-in-impl-datatype=CRCLength_Block5, written-read-nv-data=CRCLength_Block5.Value
          nv-ram-block-element=autosar-variable-in-impl-datatype=EraseState_Block5, written-read-nv-data=EraseState_Block5.Value
          nv-ram-block-element=autosar-variable-in-impl-datatype=SegmentLengthList_Block5, written-read-nv-data=SegmentLengthList_Block5.Value
          nv-ram-block-element=autosar-variable-in-impl-datatype=Share_Fingerprint_Block6, written-read-nv-data=Share_Fingerprint_Block6.Value
          nv-ram-block-element=autosar-variable-in-impl-datatype=Share_ProgAttempts_Block6, written-read-nv-data=Share_ProgAttempts_Block6.Value
          nv-ram-block-element=autosar-variable-in-impl-datatype=CRCValue_Block6, written-read-nv-data=CRCValue_Block6.Value
          nv-ram-block-element=autosar-variable-in-impl-datatype=CRCStart_Block6, written-read-nv-data=CRCStart_Block6.Value
          nv-ram-block-element=autosar-variable-in-impl-datatype=CRCLength_Block6, written-read-nv-data=CRCLength_Block6.Value
          nv-ram-block-element=autosar-variable-in-impl-datatype=EraseState_Block6, written-read-nv-data=EraseState_Block6.Value
          nv-ram-block-element=autosar-variable-in-impl-datatype=SegmentLengthList_Block6, written-read-nv-data=SegmentLengthList_Block6.Value
        nv block needs NVNeed_NVBlockDescriptor: n-data-sets=2, ram-block-status-control=API, reliability=NO-PROTECTION, restore-at-start=true, store-at-shutdown=false, store-immediate=true, write-verification=false
        ram block RAM_NVBlockDescriptor_NvMFblMetaData: type=NV_Data_NvMFblMetaData, init-value=fields=[Share_Fingerprint_Block1:[0, 1, 1, 0, 0, 0, 0, 0, 0], Share_ProgAttempts_Block1:[0, 0], CRCValue_Block1:[255, 255, 255, 255], CRCStart_Block1:[255, 255, 255, 255], CRCLength_Block1:[255, 255, 255, 255], EraseState_Block1:255, SegmentLengthList_Block1:[255, 255, 255, 255], Share_Fingerprint_Block2:[0, 1, 1, 0, 0, 0, 0, 0, 0], Share_ProgAttempts_Block2:[0, 0], CRCValue_Block2:[255, 255, 255, 255], CRCStart_Block2:[255, 255, 255, 255], CRCLength_Block2:[255, 255, 255, 255], EraseState_Block2:255, SegmentLengthList_Block2:[255, 255, 255, 255], Share_Fingerprint_Block3:[0, 1, 1, 0, 0, 0, 0, 0, 0], Share_ProgAttempts_Block3:[0, 0], CRCValue_Block3:[255, 255, 255, 255], CRCStart_Block3:[255, 255, 255, 255], CRCLength_Block3:[255, 255, 255, 255], EraseState_Block3:255, SegmentLengthList_Block3:[255, 255, 255, 255], Share_Fingerprint_Block4:[0, 1, 1, 0, 0, 0, 0, 0, 0], Share_ProgAttempts_Block4:[0, 0], CRCValue_Block4:[255, 255, 255, 255], CRCStart_Block4:[255, 255, 255, 255], CRCLength_Block4:[255, 255, 255, 255], EraseState_Block4:255, SegmentLengthList_Block4:[255, 255, 255, 255], Share_Fingerprint_Block5:[0, 1, 1, 0, 0, 0, 0, 0, 0], Share_ProgAttempts_Block5:[0, 0], CRCValue_Block5:[255, 255, 255, 255], CRCStart_Block5:[255, 255, 255, 255], CRCLength_Block5:[255, 255, 255, 255], EraseState_Block5:255, SegmentLengthList_Block5:[255, 255, 255, 255], Share_Fingerprint_Block6:[0, 1, 1, 0, 0, 0, 0, 0, 0], Share_ProgAttempts_Block6:[0, 0], CRCValue_Block6:[255, 255, 255, 255], CRCStart_Block6:[255, 255, 255, 255], CRCLength_Block6:[255, 255, 255, 255], EraseState_Block6:255, SegmentLengthList_Block6:[255, 255, 255, 255]]
        rom block ROM_NVBlockDescriptor_NvMFblMetaData:
          sw-calibration-access=READ-WRITE
          type=NV_Data_NvMFblMetaData
          init-value=fields=[Share_Fingerprint_Block1:[0, 1, 1, 0, 0, 0, 0, 0, 0], Share_ProgAttempts_Block1:[0, 0], CRCValue_Block1:[255, 255, 255, 255], CRCStart_Block1:[255, 255, 255, 255], CRCLength_Block1:[255, 255, 255, 255], EraseState_Block1:255, SegmentLengthList_Block1:[255, 255, 255, 255], Share_Fingerprint_Block2:[0, 1, 1, 0, 0, 0, 0, 0, 0], Share_ProgAttempts_Block2:[0, 0], CRCValue_Block2:[255, 255, 255, 255], CRCStart_Block2:[255, 255, 255, 255], CRCLength_Block2:[255, 255, 255, 255], EraseState_Block2:255, SegmentLengthList_Block2:[255, 255, 255, 255], Share_Fingerprint_Block3:[0, 1, 1, 0, 0, 0, 0, 0, 0], Share_ProgAttempts_Block3:[0, 0], CRCValue_Block3:[255, 255, 255, 255], CRCStart_Block3:[255, 255, 255, 255], CRCLength_Block3:[255, 255, 255, 255], EraseState_Block3:255, SegmentLengthList_Block3:[255, 255, 255, 255], Share_Fingerprint_Block4:[0, 1, 1, 0, 0, 0, 0, 0, 0], Share_ProgAttempts_Block4:[0, 0], CRCValue_Block4:[255, 255, 255, 255], CRCStart_Block4:[255, 255, 255, 255], CRCLength_Block4:[255, 255, 255, 255], EraseState_Block4:255, SegmentLengthList_Block4:[255, 255, 255, 255], Share_Fingerprint_Block5:[0, 1, 1, 0, 0, 0, 0, 0, 0], Share_ProgAttempts_Block5:[0, 0], CRCValue_Block5:[255, 255, 255, 255], CRCStart_Block5:[255, 255, 255, 255], CRCLength_Block5:[255, 255, 255, 255], EraseState_Block5:255, SegmentLengthList_Block5:[255, 255, 255, 255], Share_Fingerprint_Block6:[0, 1, 1, 0, 0, 0, 0, 0, 0], Share_ProgAttempts_Block6:[0, 0], CRCValue_Block6:[255, 255, 255, 255], CRCStart_Block6:[255, 255, 255, 255], CRCLength_Block6:[255, 255, 255, 255], EraseState_Block6:255, SegmentLengthList_Block6:[255, 255, 255, 255]]
      NVBlockDescriptor_NvMFblShareDataPartOne: client-server-ports=role-based-port-assignment={port-prototype=NvMFblShareDataPartOne_NvM_JobFinished, role=NvMFblShareDataPartOne_NvM_JobFinished}
        nv-block-data-mappings:
          nv-ram-block-element=autosar-variable-in-impl-datatype=FblShareDataPartOneReserved1, written-read-nv-data=FblShareDataPartOneReserved1.Value
          nv-ram-block-element=autosar-variable-in-impl-datatype=Share_BootloaderTPBlocksize, written-read-nv-data=Share_BootloaderTPBlocksize.Value
          nv-ram-block-element=autosar-variable-in-impl-datatype=Share_VWFAZITIdentificationString, written-read-nv-data=Share_VWFAZITIdentificationString.Value
          nv-ram-block-element=autosar-variable-in-impl-datatype=FblShareDataPartOneReserved2, written-read-nv-data=FblShareDataPartOneReserved2.Value
          nv-ram-block-element=autosar-variable-in-impl-datatype=Share_VWECUHardwareNumber_Old, written-read-nv-data=Share_VWECUHardwareNumber_Old.Value
          nv-ram-block-element=autosar-variable-in-impl-datatype=FblShareDataPartOneReserved, written-read-nv-data=FblShareDataPartOneReserved.Value
        nv block needs NVNeed_NVBlockDescriptor: n-data-sets=2, ram-block-status-control=API, reliability=NO-PROTECTION, restore-at-start=true, store-at-shutdown=false, store-immediate=true, write-verification=false
        ram block RAM_NVBlockDescriptor_NvMFblShareDataPartOne: type=NV_Data_NvMFblShareDataPartOne, init-value=fields=[FblShareDataPartOneReserved1:[3, 232, 3, 232, 3, 232, 255, 255, 255, 255], Share_BootloaderTPBlocksize:15, Share_VWFAZITIdentificationString:23 x 255, FblShareDataPartOneReserved2:11 x 255, Share_VWECUHardwareNumber_Old:11 x 255, FblShareDataPartOneReserved:72 x 255]
        rom block ROM_NVBlockDescriptor_NvMFblShareDataPartOne: sw-calibration-access=READ-WRITE, type=NV_Data_NvMFblShareDataPartOne, init-value=fields=[FblShareDataPartOneReserved1:[3, 232, 3, 232, 3, 232, 255, 255, 255, 255], Share_BootloaderTPBlocksize:15, Share_VWFAZITIdentificationString:23 x 255, FblShareDataPartOneReserved2:11 x 255, Share_VWECUHardwareNumber_Old:11 x 255, FblShareDataPartOneReserved:72 x 255]
      NVBlockDescriptor_NvMFblShareDataPartThree: client-server-ports=role-based-port-assignment={port-prototype=NvMFblShareDataPartThree_NvM_JobFinished, role=NvMFblShareDataPartThree_NvM_JobFinished}
        nv-block-data-mappings:
          nv-ram-block-element=autosar-variable-in-impl-datatype=Share_VWSparePartNumber, written-read-nv-data=Share_VWSparePartNumber.Value
          nv-ram-block-element=autosar-variable-in-impl-datatype=Share_VWECUHardwareNumber, written-read-nv-data=Share_VWECUHardwareNumber.Value
          nv-ram-block-element=autosar-variable-in-impl-datatype=Share_ASAM_ODXFileIdentifier_obsolate, written-read-nv-data=Share_ASAM_ODXFileIdentifier_obsolate.Value
          nv-ram-block-element=autosar-variable-in-impl-datatype=ASAMFileVersion, written-read-nv-data=ASAMFileVersion.Value
          nv-ram-block-element=autosar-variable-in-impl-datatype=Share_VWECUHardwareVersionNumber, written-read-nv-data=Share_VWECUHardwareVersionNumber.Value
          nv-ram-block-element=autosar-variable-in-impl-datatype=ASAMFileIdentifier, written-read-nv-data=ASAMFileIdentifier.Value
          nv-ram-block-element=autosar-variable-in-impl-datatype=FblShareDataPartThreeReserved, written-read-nv-data=FblShareDataPartThreeReserved.Value
        nv block needs NVNeed_NVBlockDescriptor: n-data-sets=2, ram-block-status-control=API, reliability=NO-PROTECTION, restore-at-start=true, store-at-shutdown=false, store-immediate=true, write-verification=false
        ram block RAM_NVBlockDescriptor_NvMFblShareDataPartThree: type=NV_Data_NvMFblShareDataPartThree, init-value=fields=[Share_VWSparePartNumber:[53, 78, 65, 57, 50, 48, 51, 49, 48, 32, 32], Share_VWECUHardwareNumber:[53, 78, 65, 57, 50, 48, 51, 49, 48, 32, 32], Share_ASAM_ODXFileIdentifier_obsolate:[69, 86, 95, 68, 97, 115, 104, 66, 111, 97, 114, 100, 74, 67, 73, 77, 81, 66, 65, 66, 0], ASAMFileVersion:[48, 49, 49, 48, 48, 49], Share_VWECUHardwareVersionNumber:[48, 50, 48], ASAMFileIdentifier:[69, 86, 95, 68, 97, 115, 104, 66, 111, 97, 114, 100, 74, 67, 73, 77, 81, 66, 65, 66, 0, 0, 0, 0, 0, 0], FblShareDataPartThreeReserved:50 x 255]
        rom block ROM_NVBlockDescriptor_NvMFblShareDataPartThree:
          sw-calibration-access=READ-WRITE
          type=NV_Data_NvMFblShareDataPartThree
          init-value=fields=[Share_VWSparePartNumber:[53, 78, 65, 57, 50, 48, 51, 49, 48, 32, 32], Share_VWECUHardwareNumber:[53, 78, 65, 57, 50, 48, 51, 49, 48, 32, 32], Share_ASAM_ODXFileIdentifier_obsolate:[69, 86, 95, 68, 97, 115, 104, 66, 111, 97, 114, 100, 74, 67, 73, 77, 81, 66, 65, 66, 0], ASAMFileVersion:[48, 49, 49, 48, 48, 49], Share_VWECUHardwareVersionNumber:[48, 50, 48], ASAMFileIdentifier:[69, 86, 95, 68, 97, 115, 104, 66, 111, 97, 114, 100, 74, 67, 73, 77, 81, 66, 65, 66, 0, 0, 0, 0, 0, 0], FblShareDataPartThreeReserved:50 x 255]
      NVBlockDescriptor_NvMFblShareDataPartTwo: client-server-ports=role-based-port-assignment={port-prototype=NvMFblShareDataPartTwo_NvM_JobFinished, role=NvMFblShareDataPartTwo_NvM_JobFinished}
        nv-block-data-mappings:
          nv-ram-block-element=autosar-variable-in-impl-datatype=FblShareDataPartTwoReserved1, written-read-nv-data=FblShareDataPartTwoReserved1.Value
          nv-ram-block-element=autosar-variable-in-impl-datatype=Share_ASAM_ODXFileIdentifier_Old, written-read-nv-data=Share_ASAM_ODXFileIdentifier_Old.Value
          nv-ram-block-element=autosar-variable-in-impl-datatype=Share_ASAM_ODXFileVersion_Old, written-read-nv-data=Share_ASAM_ODXFileVersion_Old.Value
          nv-ram-block-element=autosar-variable-in-impl-datatype=Share_VWECUHardwareVersionNumber_Old, written-read-nv-data=Share_VWECUHardwareVersionNumber_Old.Value
          nv-ram-block-element=autosar-variable-in-impl-datatype=Share_FDSProjectData, written-read-nv-data=Share_FDSProjectData.Value
          nv-ram-block-element=autosar-variable-in-impl-datatype=Share_ECUProgrammingInformation, written-read-nv-data=Share_ECUProgrammingInformation.Value
          nv-ram-block-element=autosar-variable-in-impl-datatype=Share_InvalidKeyCounter, written-read-nv-data=Share_InvalidKeyCounter.Value
          nv-ram-block-element=autosar-variable-in-impl-datatype=VWSoftwareVersionNumber, written-read-nv-data=VWSoftwareVersionNumber.Value
          nv-ram-block-element=autosar-variable-in-impl-datatype=Share_FblShareDataPartTwoReserved, written-read-nv-data=Share_FblShareDataPartTwoReserved.Value
        nv block needs NVNeed_NVBlockDescriptor: n-data-sets=2, ram-block-status-control=API, reliability=NO-PROTECTION, restore-at-start=true, store-at-shutdown=false, store-immediate=true, write-verification=false
        ram block RAM_NVBlockDescriptor_NvMFblShareDataPartTwo: type=NV_Data_NvMFblShareDataPartTwo, init-value=fields=[FblShareDataPartTwoReserved1:8 x 255, Share_ASAM_ODXFileIdentifier_Old:21 x 255, Share_ASAM_ODXFileVersion_Old:6 x 255, Share_VWECUHardwareVersionNumber_Old:[255, 255, 255], Share_FDSProjectData:8 x 255, Share_ECUProgrammingInformation:64, Share_InvalidKeyCounter:0, VWSoftwareVersionNumber:[45, 45, 45, 45], Share_FblShareDataPartTwoReserved:76 x 255]
        rom block ROM_NVBlockDescriptor_NvMFblShareDataPartTwo:
          sw-calibration-access=READ-WRITE
          type=NV_Data_NvMFblShareDataPartTwo
          init-value=fields=[FblShareDataPartTwoReserved1:8 x 255, Share_ASAM_ODXFileIdentifier_Old:21 x 255, Share_ASAM_ODXFileVersion_Old:6 x 255, Share_VWECUHardwareVersionNumber_Old:[255, 255, 255], Share_FDSProjectData:8 x 255, Share_ECUProgrammingInformation:64, Share_InvalidKeyCounter:0, VWSoftwareVersionNumber:[45, 45, 45, 45], Share_FblShareDataPartTwoReserved:76 x 255]
      NVBlockDescriptor_NvM_VKMS: client-server-ports=role-based-port-assignment={port-prototype=NvM_VKMS_NvM_JobFinished, role=NvM_VKMS_NvM_JobFinished}, nv-block-data-mapping{nv-ram-block-element=autosar-variable-in-impl-datatype=NvM_VKMS, written-read-nv-data=NvM_VKMS.Value}
        nv block needs NVNeed_NVBlockDescriptor: n-data-sets=2, ram-block-status-control=API, reliability=NO-PROTECTION, restore-at-start=true, store-at-shutdown=false, store-immediate=true, write-verification=false
        ram block RAM_NVBlockDescriptor_NvM_VKMS: type=NV_Data_NvM_VKMS, init-value=fields=NvM_VKMS:[0, 0]
        rom block ROM_NVBlockDescriptor_NvM_VKMS: sw-calibration-access=READ-WRITE, type=NV_Data_NvM_VKMS, init-value=fields=NvM_VKMS:[0, 0]
      NVBlockDescriptor_Nvm_Block_Reserved_1: client-server-ports=role-based-port-assignment={port-prototype=Nvm_Block_Reserved_1_NvM_JobFinished, role=Nvm_Block_Reserved_1_NvM_JobFinished}
        nv-block-data-mappings:
          nv-ram-block-element=autosar-variable-in-impl-datatype=PSO_DataTag_USER_{0..7}, written-read-nv-data=PSO_DataTag_USER_{0..7}.Value
          nv-ram-block-element=autosar-variable-in-impl-datatype=zReserved_Nvm_Block_Reserved_1, written-read-nv-data=zReserved_Nvm_Block_Reserved_1.Value
        nv block needs NVNeed_NVBlockDescriptor: n-data-sets=2, ram-block-status-control=API, reliability=NO-PROTECTION, restore-at-start=true, store-at-shutdown=false, store-immediate=true, write-verification=false
        ram block RAM_NVBlockDescriptor_Nvm_Block_Reserved_1: type=NV_Data_Nvm_Block_Reserved_1, init-value=fields=[PSO_DataTag_USER_0:7 x 255, PSO_DataTag_USER_1:7 x 255, PSO_DataTag_USER_2:7 x 255, PSO_DataTag_USER_3:7 x 255, PSO_DataTag_USER_4:7 x 255, PSO_DataTag_USER_5:7 x 255, PSO_DataTag_USER_6:7 x 255, PSO_DataTag_USER_7:7 x 255, zReserved_Nvm_Block_Reserved_1:8 x 255]
        rom block ROM_NVBlockDescriptor_Nvm_Block_Reserved_1: sw-calibration-access=READ-WRITE, type=NV_Data_Nvm_Block_Reserved_1, init-value=fields=[PSO_DataTag_USER_0:7 x 255, PSO_DataTag_USER_1:7 x 255, PSO_DataTag_USER_2:7 x 255, PSO_DataTag_USER_3:7 x 255, PSO_DataTag_USER_4:7 x 255, PSO_DataTag_USER_5:7 x 255, PSO_DataTag_USER_6:7 x 255, PSO_DataTag_USER_7:7 x 255, zReserved_Nvm_Block_Reserved_1:8 x 255]
      NVBlockDescriptor_Nvm_Block_Reserved_2: client-server-ports=role-based-port-assignment={port-prototype=Nvm_Block_Reserved_2_NvM_JobFinished, role=Nvm_Block_Reserved_2_NvM_JobFinished}
        nv-block-data-mappings:
          nv-ram-block-element=autosar-variable-in-impl-datatype=Fuel_Vol_Refueling_Drainage_{1..32}, written-read-nv-data=Fuel_Vol_Refueling_Drainage_{1..32}.Value
        nv block needs NVNeed_NVBlockDescriptor: n-data-sets=2, ram-block-status-control=API, reliability=NO-PROTECTION, restore-at-start=true, store-at-shutdown=false, store-immediate=true, write-verification=false
        ram block RAM_NVBlockDescriptor_Nvm_Block_Reserved_2: type=NV_Data_Nvm_Block_Reserved_2, init-value=fields=[Fuel_Vol_Refueling_Drainage_1:9, Fuel_Vol_Refueling_Drainage_2:9, Fuel_Vol_Refueling_Drainage_3:9, Fuel_Vol_Refueling_Drainage_4:9, Fuel_Vol_Refueling_Drainage_5:8, Fuel_Vol_Refueling_Drainage_6:8, Fuel_Vol_Refueling_Drainage_7:5, Fuel_Vol_Refueling_Drainage_8:9, Fuel_Vol_Refueling_Drainage_9:9, Fuel_Vol_Refueling_Drainage_10:9, Fuel_Vol_Refueling_Drainage_11:9, Fuel_Vol_Refueling_Drainage_12:5, Fuel_Vol_Refueling_Drainage_13:9, Fuel_Vol_Refueling_Drainage_14:9, Fuel_Vol_Refueling_Drainage_15:9, Fuel_Vol_Refueling_Drainage_16:9, Fuel_Vol_Refueling_Drainage_17:9, Fuel_Vol_Refueling_Drainage_18:9, Fuel_Vol_Refueling_Drainage_19:9, Fuel_Vol_Refueling_Drainage_20:9, Fuel_Vol_Refueling_Drainage_21:9, Fuel_Vol_Refueling_Drainage_22:9, Fuel_Vol_Refueling_Drainage_23:9, Fuel_Vol_Refueling_Drainage_24:9, Fuel_Vol_Refueling_Drainage_25:9, Fuel_Vol_Refueling_Drainage_26:9, Fuel_Vol_Refueling_Drainage_27:9, Fuel_Vol_Refueling_Drainage_28:9, Fuel_Vol_Refueling_Drainage_29:9, Fuel_Vol_Refueling_Drainage_30:9, Fuel_Vol_Refueling_Drainage_31:9, Fuel_Vol_Refueling_Drainage_32:9]
        rom block ROM_NVBlockDescriptor_Nvm_Block_Reserved_2:
          sw-calibration-access=READ-WRITE
          type=NV_Data_Nvm_Block_Reserved_2
          init-value=fields=[Fuel_Vol_Refueling_Drainage_1:9, Fuel_Vol_Refueling_Drainage_2:9, Fuel_Vol_Refueling_Drainage_3:9, Fuel_Vol_Refueling_Drainage_4:9, Fuel_Vol_Refueling_Drainage_5:8, Fuel_Vol_Refueling_Drainage_6:8, Fuel_Vol_Refueling_Drainage_7:5, Fuel_Vol_Refueling_Drainage_8:9, Fuel_Vol_Refueling_Drainage_9:9, Fuel_Vol_Refueling_Drainage_10:9, Fuel_Vol_Refueling_Drainage_11:9, Fuel_Vol_Refueling_Drainage_12:5, Fuel_Vol_Refueling_Drainage_13:9, Fuel_Vol_Refueling_Drainage_14:9, Fuel_Vol_Refueling_Drainage_15:9, Fuel_Vol_Refueling_Drainage_16:9, Fuel_Vol_Refueling_Drainage_17:9, Fuel_Vol_Refueling_Drainage_18:9, Fuel_Vol_Refueling_Drainage_19:9, Fuel_Vol_Refueling_Drainage_20:9, Fuel_Vol_Refueling_Drainage_21:9, Fuel_Vol_Refueling_Drainage_22:9, Fuel_Vol_Refueling_Drainage_23:9, Fuel_Vol_Refueling_Drainage_24:9, Fuel_Vol_Refueling_Drainage_25:9, Fuel_Vol_Refueling_Drainage_26:9, Fuel_Vol_Refueling_Drainage_27:9, Fuel_Vol_Refueling_Drainage_28:9, Fuel_Vol_Refueling_Drainage_29:9, Fuel_Vol_Refueling_Drainage_30:9, Fuel_Vol_Refueling_Drainage_31:9, Fuel_Vol_Refueling_Drainage_32:9]
      NVBlockDescriptor_Nvm_Block_Reserved_4: client-server-ports=role-based-port-assignment={port-prototype=Nvm_Block_Reserved_4_NvM_JobFinished, role=Nvm_Block_Reserved_4_NvM_JobFinished}
        nv-block-data-mappings:
          nv-ram-block-element=autosar-variable-in-impl-datatype=AmbientLight_Left_Red_LED_Coef, written-read-nv-data=AmbientLight_Left_Red_LED_Coef.Value
          nv-ram-block-element=autosar-variable-in-impl-datatype=AmbientLight_Left_Green_LED_Coef, written-read-nv-data=AmbientLight_Left_Green_LED_Coef.Value
          nv-ram-block-element=autosar-variable-in-impl-datatype=AmbientLight_Left_Blue_LED_Coef, written-read-nv-data=AmbientLight_Left_Blue_LED_Coef.Value
          nv-ram-block-element=autosar-variable-in-impl-datatype=AmbientLight_Right_Red_LED_Coef, written-read-nv-data=AmbientLight_Right_Red_LED_Coef.Value
          nv-ram-block-element=autosar-variable-in-impl-datatype=AmbientLight_Right_Green_LED_Coef, written-read-nv-data=AmbientLight_Right_Green_LED_Coef.Value
          nv-ram-block-element=autosar-variable-in-impl-datatype=AmbientLight_Right_Blue_LED_Coef, written-read-nv-data=AmbientLight_Right_Blue_LED_Coef.Value
          nv-ram-block-element=autosar-variable-in-impl-datatype=Thermal_Timer{1..3}, written-read-nv-data=Thermal_Timer{1..3}.Value
          nv-ram-block-element=autosar-variable-in-impl-datatype=Bargraphs_X, written-read-nv-data=Bargraphs_X.Value
          nv-ram-block-element=autosar-variable-in-impl-datatype=Bargraphs_Y, written-read-nv-data=Bargraphs_Y.Value
          nv-ram-block-element=autosar-variable-in-impl-datatype=Lookup_Curve_Bargraphs_Red_Coef_X, written-read-nv-data=Lookup_Curve_Bargraphs_Red_Coef_X.Value
          nv-ram-block-element=autosar-variable-in-impl-datatype=Lookup_Curve_Bargraphs_Red_Coef_Y, written-read-nv-data=Lookup_Curve_Bargraphs_Red_Coef_Y.Value
          nv-ram-block-element=autosar-variable-in-impl-datatype=gap_FIFO_Year, written-read-nv-data=gap_FIFO_Year.Value
          nv-ram-block-element=autosar-variable-in-impl-datatype=gap_FIFO_Month, written-read-nv-data=gap_FIFO_Month.Value
          nv-ram-block-element=autosar-variable-in-impl-datatype=gap_FIFO_Day, written-read-nv-data=gap_FIFO_Day.Value
          nv-ram-block-element=autosar-variable-in-impl-datatype=gap_FIFO_TimeLastGAP, written-read-nv-data=gap_FIFO_TimeLastGAP.Value
          nv-ram-block-element=autosar-variable-in-impl-datatype=gap_FIFO_Distance, written-read-nv-data=gap_FIFO_Distance.Value
          nv-ram-block-element=autosar-variable-in-impl-datatype=gap_FIFO_NumberResets, written-read-nv-data=gap_FIFO_NumberResets.Value
          nv-ram-block-element=autosar-variable-in-impl-datatype=da_gap_tage, written-read-nv-data=da_gap_tage.Value
          nv-ram-block-element=autosar-variable-in-impl-datatype=da_gap_reset_tage, written-read-nv-data=da_gap_reset_tage.Value
          nv-ram-block-element=autosar-variable-in-impl-datatype=gap_tage_default, written-read-nv-data=gap_tage_default.Value
          nv-ram-block-element=autosar-variable-in-impl-datatype=gap_mfa_max, written-read-nv-data=gap_mfa_max.Value
          nv-ram-block-element=autosar-variable-in-impl-datatype=gap_mfa_min, written-read-nv-data=gap_mfa_min.Value
          nv-ram-block-element=autosar-variable-in-impl-datatype=gap_vorhanden, written-read-nv-data=gap_vorhanden.Value
          nv-ram-block-element=autosar-variable-in-impl-datatype=Default_AmbientLight_Color_Green, written-read-nv-data=Default_AmbientLight_Color_Green.Value
          nv-ram-block-element=autosar-variable-in-impl-datatype=Default_AmbientLight_Color_Red, written-read-nv-data=Default_AmbientLight_Color_Red.Value
          nv-ram-block-element=autosar-variable-in-impl-datatype=Default_AmbientLight_Color_Blue, written-read-nv-data=Default_AmbientLight_Color_Blue.Value
          nv-ram-block-element=autosar-variable-in-impl-datatype=gastank_warnung_cng_LED, written-read-nv-data=gastank_warnung_cng_LED.Value
          nv-ram-block-element=autosar-variable-in-impl-datatype=GasTank_Display_Attenuation_On, written-read-nv-data=GasTank_Display_Attenuation_On.Value
          nv-ram-block-element=autosar-variable-in-impl-datatype=GasTank_Display_Attenuation_Off, written-read-nv-data=GasTank_Display_Attenuation_Off.Value
          nv-ram-block-element=autosar-variable-in-impl-datatype=GasTank_Duration_Red_LED_Flashing, written-read-nv-data=GasTank_Duration_Red_LED_Flashing.Value
          nv-ram-block-element=autosar-variable-in-impl-datatype=GasTank_Warning_Special_State, written-read-nv-data=GasTank_Warning_Special_State.Value
          nv-ram-block-element=autosar-variable-in-impl-datatype=zReserved_Nvm_Block_Reserved_4, written-read-nv-data=zReserved_Nvm_Block_Reserved_4.Value
        nv block needs NVNeed_NVBlockDescriptor: n-data-sets=2, ram-block-status-control=API, reliability=NO-PROTECTION, restore-at-start=true, store-at-shutdown=false, store-immediate=true, write-verification=false
        ram block RAM_NVBlockDescriptor_Nvm_Block_Reserved_4: type=NV_Data_Nvm_Block_Reserved_4, init-value=fields=[AmbientLight_Left_Red_LED_Coef:32767, AmbientLight_Left_Green_LED_Coef:32767, AmbientLight_Left_Blue_LED_Coef:32767, AmbientLight_Right_Red_LED_Coef:32767, AmbientLight_Right_Green_LED_Coef:32767, AmbientLight_Right_Blue_LED_Coef:32767, Thermal_Timer1:1000, Thermal_Timer2:3500, Thermal_Timer3:2000, Bargraphs_X:[0, 100, 500, 1000, 1500, 2530], Bargraphs_Y:[20, 20, 50, 80, 500, 1000], Lookup_Curve_Bargraphs_Red_Coef_X:[0, 100, 500, 1000, 1500, 2530], Lookup_Curve_Bargraphs_Red_Coef_Y:[20, 20, 50, 80, 500, 1000], gap_FIFO_Year:5 x 0, gap_FIFO_Month:5 x 1, gap_FIFO_Day:5 x 1, gap_FIFO_TimeLastGAP:5 x 65535, gap_FIFO_Distance:5 x 0, gap_FIFO_NumberResets:5 x 0, da_gap_tage:1460, da_gap_reset_tage:0, gap_tage_default:1460, gap_mfa_max:365, gap_mfa_min:1, gap_vorhanden:1, Default_AmbientLight_Color_Green:175, Default_AmbientLight_Color_Red:255, Default_AmbientLight_Color_Blue:64, gastank_warnung_cng_LED:0, GasTank_Display_Attenuation_On:4, GasTank_Display_Attenuation_Off:4, GasTank_Duration_Red_LED_Flashing:0, GasTank_Warning_Special_State:1, zReserved_Nvm_Block_Reserved_4:27 x 255]
        rom block ROM_NVBlockDescriptor_Nvm_Block_Reserved_4:
          sw-calibration-access=READ-WRITE
          type=NV_Data_Nvm_Block_Reserved_4
          init-value=fields=[AmbientLight_Left_Red_LED_Coef:32767, AmbientLight_Left_Green_LED_Coef:32767, AmbientLight_Left_Blue_LED_Coef:32767, AmbientLight_Right_Red_LED_Coef:32767, AmbientLight_Right_Green_LED_Coef:32767, AmbientLight_Right_Blue_LED_Coef:32767, Thermal_Timer1:1000, Thermal_Timer2:3500, Thermal_Timer3:2000, Bargraphs_X:[0, 100, 500, 1000, 1500, 2530], Bargraphs_Y:[20, 20, 50, 80, 500, 1000], Lookup_Curve_Bargraphs_Red_Coef_X:[0, 100, 500, 1000, 1500, 2530], Lookup_Curve_Bargraphs_Red_Coef_Y:[20, 20, 50, 80, 500, 1000], gap_FIFO_Year:5 x 0, gap_FIFO_Month:5 x 1, gap_FIFO_Day:5 x 1, gap_FIFO_TimeLastGAP:5 x 65535, gap_FIFO_Distance:5 x 0, gap_FIFO_NumberResets:5 x 0, da_gap_tage:1460, da_gap_reset_tage:0, gap_tage_default:1460, gap_mfa_max:365, gap_mfa_min:1, gap_vorhanden:1, Default_AmbientLight_Color_Green:175, Default_AmbientLight_Color_Red:255, Default_AmbientLight_Color_Blue:64, gastank_warnung_cng_LED:0, GasTank_Display_Attenuation_On:4, GasTank_Display_Attenuation_Off:4, GasTank_Duration_Red_LED_Flashing:0, GasTank_Warning_Special_State:1, zReserved_Nvm_Block_Reserved_4:27 x 255]
      NVBlockDescriptor_Odometer_0: client-server-ports=role-based-port-assignment={port-prototype=Odometer_0_NvM_JobFinished, role=Odometer_0_NvM_JobFinished}, nv-block-data-mapping{nv-ram-block-element=autosar-variable-in-impl-datatype=Odometer_0, written-read-nv-data=Odometer_0.Value}
        nv block needs NVNeed_NVBlockDescriptor: n-data-sets=2, ram-block-status-control=API, reliability=NO-PROTECTION, restore-at-start=true, store-at-shutdown=false, store-immediate=true, write-verification=false
        ram block RAM_NVBlockDescriptor_Odometer_0: type=NV_Data_Odometer_0, init-value=fields=Odometer_0:16 x 0
        rom block ROM_NVBlockDescriptor_Odometer_0: sw-calibration-access=READ-WRITE, type=NV_Data_Odometer_0, init-value=fields=Odometer_0:16 x 0
      NVBlockDescriptor_Odometer_1: client-server-ports=role-based-port-assignment={port-prototype=Odometer_1_NvM_JobFinished, role=Odometer_1_NvM_JobFinished}, nv-block-data-mapping{nv-ram-block-element=autosar-variable-in-impl-datatype=Odometer_1, written-read-nv-data=Odometer_1.Value}
        nv block needs NVNeed_NVBlockDescriptor: n-data-sets=2, ram-block-status-control=API, reliability=NO-PROTECTION, restore-at-start=true, store-at-shutdown=false, store-immediate=true, write-verification=false
        ram block RAM_NVBlockDescriptor_Odometer_1: type=NV_Data_Odometer_1, init-value=fields=Odometer_1:16 x 0
        rom block ROM_NVBlockDescriptor_Odometer_1: sw-calibration-access=READ-WRITE, type=NV_Data_Odometer_1, init-value=fields=Odometer_1:16 x 0
      NVBlockDescriptor_Odometer_2: client-server-ports=role-based-port-assignment={port-prototype=Odometer_2_NvM_JobFinished, role=Odometer_2_NvM_JobFinished}, nv-block-data-mapping{nv-ram-block-element=autosar-variable-in-impl-datatype=Odometer_2, written-read-nv-data=Odometer_2.Value}
        nv block needs NVNeed_NVBlockDescriptor: n-data-sets=2, ram-block-status-control=API, reliability=NO-PROTECTION, restore-at-start=true, store-at-shutdown=false, store-immediate=true, write-verification=false
        ram block RAM_NVBlockDescriptor_Odometer_2: type=NV_Data_Odometer_2, init-value=fields=Odometer_2:16 x 0
        rom block ROM_NVBlockDescriptor_Odometer_2: sw-calibration-access=READ-WRITE, type=NV_Data_Odometer_2, init-value=fields=Odometer_2:16 x 0
      NVBlockDescriptor_OperatingTime_VAR: client-server-ports=role-based-port-assignment={port-prototype=OperatingTime_VAR_NvM_JobFinished, role=OperatingTime_VAR_NvM_JobFinished}
        nv-block-data-mappings:
          nv-ram-block-element=autosar-variable-in-impl-datatype=OperatingTimeStoredLSB, written-read-nv-data=OperatingTimeStoredLSB.Value
          nv-ram-block-element=autosar-variable-in-impl-datatype=OperatingTimeStoredMSB, written-read-nv-data=OperatingTimeStoredMSB.Value
          nv-ram-block-element=autosar-variable-in-impl-datatype=zReserved_OperatingTime_VAR, written-read-nv-data=zReserved_OperatingTime_VAR.Value
        nv block needs NVNeed_NVBlockDescriptor: n-data-sets=2, ram-block-status-control=API, reliability=NO-PROTECTION, restore-at-start=true, store-at-shutdown=false, store-immediate=true, write-verification=false
        ram block RAM_NVBlockDescriptor_OperatingTime_VAR: type=NV_Data_OperatingTime_VAR, init-value=fields=[OperatingTimeStoredLSB:0, OperatingTimeStoredMSB:0, zReserved_OperatingTime_VAR:7 x 255]
        rom block ROM_NVBlockDescriptor_OperatingTime_VAR: sw-calibration-access=READ-WRITE, type=NV_Data_OperatingTime_VAR, init-value=fields=[OperatingTimeStoredLSB:0, OperatingTimeStoredMSB:0, zReserved_OperatingTime_VAR:7 x 255]
      NVBlockDescriptor_REFUEL_Logger_VAR: client-server-ports=role-based-port-assignment={port-prototype=REFUEL_Logger_VAR_NvM_JobFinished, role=REFUEL_Logger_VAR_NvM_JobFinished}
        nv-block-data-mappings:
          nv-ram-block-element=autosar-variable-in-impl-datatype=Fuel_Odometer_Log_n, written-read-nv-data=Fuel_Odometer_Log_n.Value
          nv-ram-block-element=autosar-variable-in-impl-datatype=Fuel_Odometer_Log_n{1..3}, written-read-nv-data=Fuel_Odometer_Log_n{1..3}.Value
          nv-ram-block-element=autosar-variable-in-impl-datatype=Fuel_Vol_Display_Old_Log_n, written-read-nv-data=Fuel_Vol_Display_Old_Log_n.Value
          nv-ram-block-element=autosar-variable-in-impl-datatype=Fuel_Vol_Display_Old_Log_n{1..3}, written-read-nv-data=Fuel_Vol_Display_Old_Log_n{1..3}.Value
          nv-ram-block-element=autosar-variable-in-impl-datatype=Fuel_Vol_Ref_Log_n, written-read-nv-data=Fuel_Vol_Ref_Log_n.Value
          nv-ram-block-element=autosar-variable-in-impl-datatype=Fuel_Vol_Ref_Log_n{1..3}, written-read-nv-data=Fuel_Vol_Ref_Log_n{1..3}.Value
          nv-ram-block-element=autosar-variable-in-impl-datatype=Fuel_Vol_RefuelHandling_Log_n, written-read-nv-data=Fuel_Vol_RefuelHandling_Log_n.Value
          nv-ram-block-element=autosar-variable-in-impl-datatype=Fuel_Vol_RefuelHandling_Log_n{1..3}, written-read-nv-data=Fuel_Vol_RefuelHandling_Log_n{1..3}.Value
          nv-ram-block-element=autosar-variable-in-impl-datatype=Fuel_Vol_Sensor_Avrg_RefuelHandling_Log_n, written-read-nv-data=Fuel_Vol_Sensor_Avrg_RefuelHandling_Log_n.Value
          nv-ram-block-element=autosar-variable-in-impl-datatype=Fuel_Vol_Sensor_Avrg_RefuelHandling_Log_n{1..3}, written-read-nv-data=Fuel_Vol_Sensor_Avrg_RefuelHandling_Log_n{1..3}.Value
          nv-ram-block-element=autosar-variable-in-impl-datatype=Fuel_RefuelDetect_Log_Error_n, written-read-nv-data=Fuel_RefuelDetect_Log_Error_n.Value
          nv-ram-block-element=autosar-variable-in-impl-datatype=Fuel_RefuelDetect_Log_Error_n{1..3}, written-read-nv-data=Fuel_RefuelDetect_Log_Error_n{1..3}.Value
          nv-ram-block-element=autosar-variable-in-impl-datatype=zReserved_REFUEL_Logger_VAR, written-read-nv-data=zReserved_REFUEL_Logger_VAR.Value
        nv block needs NVNeed_NVBlockDescriptor: n-data-sets=2, ram-block-status-control=API, reliability=NO-PROTECTION, restore-at-start=true, store-at-shutdown=false, store-immediate=true, write-verification=false
        ram block RAM_NVBlockDescriptor_REFUEL_Logger_VAR: type=NV_Data_REFUEL_Logger_VAR, init-value=fields=[Fuel_Odometer_Log_n:0, Fuel_Odometer_Log_n1:0, Fuel_Odometer_Log_n2:0, Fuel_Odometer_Log_n3:0, Fuel_Vol_Display_Old_Log_n:0, Fuel_Vol_Display_Old_Log_n1:0, Fuel_Vol_Display_Old_Log_n2:0, Fuel_Vol_Display_Old_Log_n3:0, Fuel_Vol_Ref_Log_n:0, Fuel_Vol_Ref_Log_n1:0, Fuel_Vol_Ref_Log_n2:0, Fuel_Vol_Ref_Log_n3:0, Fuel_Vol_RefuelHandling_Log_n:0, Fuel_Vol_RefuelHandling_Log_n1:0, Fuel_Vol_RefuelHandling_Log_n2:0, Fuel_Vol_RefuelHandling_Log_n3:0, Fuel_Vol_Sensor_Avrg_RefuelHandling_Log_n:0, Fuel_Vol_Sensor_Avrg_RefuelHandling_Log_n1:0, Fuel_Vol_Sensor_Avrg_RefuelHandling_Log_n2:0, Fuel_Vol_Sensor_Avrg_RefuelHandling_Log_n3:0, Fuel_RefuelDetect_Log_Error_n:0, Fuel_RefuelDetect_Log_Error_n1:0, Fuel_RefuelDetect_Log_Error_n2:0, Fuel_RefuelDetect_Log_Error_n3:0, zReserved_REFUEL_Logger_VAR:8 x 255]
        rom block ROM_NVBlockDescriptor_REFUEL_Logger_VAR:
          sw-calibration-access=READ-WRITE
          type=NV_Data_REFUEL_Logger_VAR
          init-value=fields=[Fuel_Odometer_Log_n:0, Fuel_Odometer_Log_n1:0, Fuel_Odometer_Log_n2:0, Fuel_Odometer_Log_n3:0, Fuel_Vol_Display_Old_Log_n:0, Fuel_Vol_Display_Old_Log_n1:0, Fuel_Vol_Display_Old_Log_n2:0, Fuel_Vol_Display_Old_Log_n3:0, Fuel_Vol_Ref_Log_n:0, Fuel_Vol_Ref_Log_n1:0, Fuel_Vol_Ref_Log_n2:0, Fuel_Vol_Ref_Log_n3:0, Fuel_Vol_RefuelHandling_Log_n:0, Fuel_Vol_RefuelHandling_Log_n1:0, Fuel_Vol_RefuelHandling_Log_n2:0, Fuel_Vol_RefuelHandling_Log_n3:0, Fuel_Vol_Sensor_Avrg_RefuelHandling_Log_n:0, Fuel_Vol_Sensor_Avrg_RefuelHandling_Log_n1:0, Fuel_Vol_Sensor_Avrg_RefuelHandling_Log_n2:0, Fuel_Vol_Sensor_Avrg_RefuelHandling_Log_n3:0, Fuel_RefuelDetect_Log_Error_n:0, Fuel_RefuelDetect_Log_Error_n1:0, Fuel_RefuelDetect_Log_Error_n2:0, Fuel_RefuelDetect_Log_Error_n3:0, zReserved_REFUEL_Logger_VAR:8 x 255]
      NVBlockDescriptor_RGB_Calibration_VAR: client-server-ports=role-based-port-assignment={port-prototype=RGB_Calibration_VAR_NvM_JobFinished, role=RGB_Calibration_VAR_NvM_JobFinished}
        nv-block-data-mappings:
          nv-ram-block-element=autosar-variable-in-impl-datatype=RGB_Color_Calibration_PWM_AmbientLight_Y_Left, written-read-nv-data=RGB_Color_Calibration_PWM_AmbientLight_Y_Left.Value
          nv-ram-block-element=autosar-variable-in-impl-datatype=RGB_Color_Calibration_PWM_AmbientLight_Y_Right, written-read-nv-data=RGB_Color_Calibration_PWM_AmbientLight_Y_Right.Value
          nv-ram-block-element=autosar-variable-in-impl-datatype=Bargraph_Color_Calibration, written-read-nv-data=Bargraph_Color_Calibration.Value
          nv-ram-block-element=autosar-variable-in-impl-datatype=zReserved_RGB_Calibration_VAR, written-read-nv-data=zReserved_RGB_Calibration_VAR.Value
        nv block needs NVNeed_NVBlockDescriptor: n-data-sets=2, ram-block-status-control=API, reliability=NO-PROTECTION, restore-at-start=true, store-at-shutdown=false, store-immediate=true, write-verification=false
        ram block RAM_NVBlockDescriptor_RGB_Calibration_VAR: type=NV_Data_RGB_Calibration_VAR, init-value=fields=[RGB_Color_Calibration_PWM_AmbientLight_Y_Left:[15, 15, 20, 20, 127, 255, 125, 125, 125, 125, 85, 85, 115, 115, 0, 0, 0, 0, 115, 115, 50, 50, 15, 15, 115, 115, 80, 80, 15, 15, 127, 255, 95, 95, 0, 0, 115, 115, 115, 115, 0, 0, 105, 105, 119, 119, 5, 133, 105, 105, 127, 255, 0, 0, 85, 85, 127, 255, 10, 10, 30, 30, 127, 255, 15, 15, 0, 0, 117, 245, 15, 15, 0, 0, 117, 245, 55, 55, 25, 25, 127, 255, 70, 70, 0, 0, 112, 240, 80, 80, 0, 0, 112, 240, 100, 100, 0, 0, 100, 100, 127, 255, 0, 0, 80, 80, 127, 255, 0, 0, 60, 60, 127, 255, 5, 5, 45, 45, 127, 255, 15, 15, 20, 20, 127, 255, 32, 160, 15, 15, 127, 255, 60, 60, 15, 15, 127, 255, 97, 225, 15, 15, 127, 255, 110, 110, 0, 0, 127, 255, 127, 255, 0, 0, 127, 255, 127, 255, 0, 0, 57, 185, 127, 255, 20, 20, 45, 45, 127, 255, 45, 45, 35, 35, 120, 120, 55, 55, 50, 50], RGB_Color_Calibration_PWM_AmbientLight_Y_Right:[15, 15, 20, 20, 127, 255, 125, 125, 125, 125, 85, 85, 115, 115, 0, 0, 0, 0, 115, 115, 50, 50, 15, 15, 115, 115, 80, 80, 15, 15, 127, 255, 95, 95, 0, 0, 115, 115, 115, 115, 0, 0, 105, 105, 119, 119, 5, 133, 105, 105, 127, 255, 0, 0, 85, 85, 127, 255, 10, 10, 30, 30, 127, 255, 15, 15, 0, 0, 117, 245, 15, 15, 0, 0, 117, 245, 55, 55, 25, 25, 127, 255, 70, 70, 0, 0, 112, 240, 80, 80, 0, 0, 112, 240, 100, 100, 0, 0, 100, 100, 127, 255, 0, 0, 80, 80, 127, 255, 0, 0, 60, 60, 127, 255, 5, 5, 45, 45, 127, 255, 15, 15, 20, 20, 127, 255, 32, 160, 15, 15, 127, 255, 60, 60, 15, 15, 127, 255, 97, 225, 15, 15, 127, 255, 110, 110, 0, 0, 127, 255, 127, 255, 0, 0, 127, 255, 127, 255, 0, 0, 57, 185, 127, 255, 20, 20, 45, 45, 127, 255, 45, 45, 35, 35, 120, 120, 55, 55, 50, 50], Bargraph_Color_Calibration:[3, 232, 3, 232, 3, 232, 3, 232], zReserved_RGB_Calibration_VAR:[0, 0, 255, 255, 255, 255, 255, 255, 255, 255, 255, 255]]
        rom block ROM_NVBlockDescriptor_RGB_Calibration_VAR:
          sw-calibration-access=READ-WRITE
          type=NV_Data_RGB_Calibration_VAR
          init-value=fields=[RGB_Color_Calibration_PWM_AmbientLight_Y_Left:[15, 15, 20, 20, 127, 255, 125, 125, 125, 125, 85, 85, 115, 115, 0, 0, 0, 0, 115, 115, 50, 50, 15, 15, 115, 115, 80, 80, 15, 15, 127, 255, 95, 95, 0, 0, 115, 115, 115, 115, 0, 0, 105, 105, 119, 119, 5, 133, 105, 105, 127, 255, 0, 0, 85, 85, 127, 255, 10, 10, 30, 30, 127, 255, 15, 15, 0, 0, 117, 245, 15, 15, 0, 0, 117, 245, 55, 55, 25, 25, 127, 255, 70, 70, 0, 0, 112, 240, 80, 80, 0, 0, 112, 240, 100, 100, 0, 0, 100, 100, 127, 255, 0, 0, 80, 80, 127, 255, 0, 0, 60, 60, 127, 255, 5, 5, 45, 45, 127, 255, 15, 15, 20, 20, 127, 255, 32, 160, 15, 15, 127, 255, 60, 60, 15, 15, 127, 255, 97, 225, 15, 15, 127, 255, 110, 110, 0, 0, 127, 255, 127, 255, 0, 0, 127, 255, 127, 255, 0, 0, 57, 185, 127, 255, 20, 20, 45, 45, 127, 255, 45, 45, 35, 35, 120, 120, 55, 55, 50, 50], RGB_Color_Calibration_PWM_AmbientLight_Y_Right:[15, 15, 20, 20, 127, 255, 125, 125, 125, 125, 85, 85, 115, 115, 0, 0, 0, 0, 115, 115, 50, 50, 15, 15, 115, 115, 80, 80, 15, 15, 127, 255, 95, 95, 0, 0, 115, 115, 115, 115, 0, 0, 105, 105, 119, 119, 5, 133, 105, 105, 127, 255, 0, 0, 85, 85, 127, 255, 10, 10, 30, 30, 127, 255, 15, 15, 0, 0, 117, 245, 15, 15, 0, 0, 117, 245, 55, 55, 25, 25, 127, 255, 70, 70, 0, 0, 112, 240, 80, 80, 0, 0, 112, 240, 100, 100, 0, 0, 100, 100, 127, 255, 0, 0, 80, 80, 127, 255, 0, 0, 60, 60, 127, 255, 5, 5, 45, 45, 127, 255, 15, 15, 20, 20, 127, 255, 32, 160, 15, 15, 127, 255, 60, 60, 15, 15, 127, 255, 97, 225, 15, 15, 127, 255, 110, 110, 0, 0, 127, 255, 127, 255, 0, 0, 127, 255, 127, 255, 0, 0, 57, 185, 127, 255, 20, 20, 45, 45, 127, 255, 45, 45, 35, 35, 120, 120, 55, 55, 50, 50], Bargraph_Color_Calibration:[3, 232, 3, 232, 3, 232, 3, 232], zReserved_RGB_Calibration_VAR:[0, 0, 255, 255, 255, 255, 255, 255, 255, 255, 255, 255]]
      NVBlockDescriptor_RPM_Gauge_FIR_Coefficients: client-server-ports=role-based-port-assignment={port-prototype=RPM_Gauge_FIR_Coefficients_NvM_JobFinished, role=RPM_Gauge_FIR_Coefficients_NvM_JobFinished}, nv-block-data-mapping{nv-ram-block-element=autosar-variable-in-impl-datatype=RPM_Gauge_FIR_Coefficients, written-read-nv-data=RPM_Gauge_FIR_Coefficients.Value}
        nv block needs NVNeed_NVBlockDescriptor: n-data-sets=2, ram-block-status-control=API, reliability=NO-PROTECTION, restore-at-start=true, store-at-shutdown=false, store-immediate=true, write-verification=false
        ram block RAM_NVBlockDescriptor_RPM_Gauge_FIR_Coefficients: type=NV_Data_RPM_Gauge_FIR_Coefficients, init-value=fields=RPM_Gauge_FIR_Coefficients:[142, 56, 0, 0, 182, 171, 0, 0, 200, 213, 1, 0, 182, 22, 3, 0, 189, 160, 3, 0, 182, 22, 3, 0, 200, 213, 1, 0, 182, 171, 0, 0, 142, 56, 0, 0, 0, 0, 0, 0, 0, 0, 0, 0, 0, 0, 0, 0, 0, 0, 0, 0, 0, 0, 0, 0, 0, 0, 0, 0, 0, 0, 0, 0]
        rom block ROM_NVBlockDescriptor_RPM_Gauge_FIR_Coefficients: sw-calibration-access=READ-WRITE, type=NV_Data_RPM_Gauge_FIR_Coefficients, init-value=fields=RPM_Gauge_FIR_Coefficients:[142, 56, 0, 0, 182, 171, 0, 0, 200, 213, 1, 0, 182, 22, 3, 0, 189, 160, 3, 0, 182, 22, 3, 0, 200, 213, 1, 0, 182, 171, 0, 0, 142, 56, 0, 0, 0, 0, 0, 0, 0, 0, 0, 0, 0, 0, 0, 0, 0, 0, 0, 0, 0, 0, 0, 0, 0, 0, 0, 0, 0, 0, 0, 0]
      NVBlockDescriptor_Recorder_VAR: client-server-ports=role-based-port-assignment={port-prototype=Recorder_VAR_NvM_JobFinished, role=Recorder_VAR_NvM_JobFinished}
        nv-block-data-mappings:
          nv-ram-block-element=autosar-variable-in-impl-datatype=AdcTicks_0xA00044, written-read-nv-data=AdcTicks_0xA00044.Value
          nv-ram-block-element=autosar-variable-in-impl-datatype=AdcTicks_0xA00049, written-read-nv-data=AdcTicks_0xA00049.Value
          nv-ram-block-element=autosar-variable-in-impl-datatype=ClusterState_0xA00000, written-read-nv-data=ClusterState_0xA00000.Value
          nv-ram-block-element=autosar-variable-in-impl-datatype=ClusterState_0xA{00040..00044}, written-read-nv-data=ClusterState_0xA{00040..00044}.Value
          nv-ram-block-element=autosar-variable-in-impl-datatype=ClusterState_0xA00049, written-read-nv-data=ClusterState_0xA00049.Value
          nv-ram-block-element=autosar-variable-in-impl-datatype=HmiZpm_0xA00044, written-read-nv-data=HmiZpm_0xA00044.Value
          nv-ram-block-element=autosar-variable-in-impl-datatype=AcuRequest_0xA00044, written-read-nv-data=AcuRequest_0xA00044.Value
          nv-ram-block-element=autosar-variable-in-impl-datatype=AcuStatus_0xA00044, written-read-nv-data=AcuStatus_0xA00044.Value
          nv-ram-block-element=autosar-variable-in-impl-datatype=BattVoltage_0xA00000, written-read-nv-data=BattVoltage_0xA00000.Value
          nv-ram-block-element=autosar-variable-in-impl-datatype=BattVoltage_0xA{00040..00044}, written-read-nv-data=BattVoltage_0xA{00040..00044}.Value
          nv-ram-block-element=autosar-variable-in-impl-datatype=BattVoltage_0xA00049, written-read-nv-data=BattVoltage_0xA00049.Value
          nv-ram-block-element=autosar-variable-in-impl-datatype=ClusterFunction_0xA00000, written-read-nv-data=ClusterFunction_0xA00000.Value
          nv-ram-block-element=autosar-variable-in-impl-datatype=ClusterFunction_0xA{00040..00044}, written-read-nv-data=ClusterFunction_0xA{00040..00044}.Value
          nv-ram-block-element=autosar-variable-in-impl-datatype=ClusterFunction_0xA00049, written-read-nv-data=ClusterFunction_0xA00049.Value
          nv-ram-block-element=autosar-variable-in-impl-datatype=Counter_RamError, written-read-nv-data=Counter_RamError.Value
          nv-ram-block-element=autosar-variable-in-impl-datatype=ErrorType_0xA00041, written-read-nv-data=ErrorType_0xA00041.Value
          nv-ram-block-element=autosar-variable-in-impl-datatype=ErrorType_0xA00042, written-read-nv-data=ErrorType_0xA00042.Value
          nv-ram-block-element=autosar-variable-in-impl-datatype=ErrorType_0xA00044, written-read-nv-data=ErrorType_0xA00044.Value
          nv-ram-block-element=autosar-variable-in-impl-datatype=MDO_EN_0xA00049, written-read-nv-data=MDO_EN_0xA00049.Value
          nv-ram-block-element=autosar-variable-in-impl-datatype=ResetCounter_ClockMon, written-read-nv-data=ResetCounter_ClockMon.Value
          nv-ram-block-element=autosar-variable-in-impl-datatype=ResetCounter_EcuReset, written-read-nv-data=ResetCounter_EcuReset.Value
          nv-ram-block-element=autosar-variable-in-impl-datatype=ResetCounter_JumpToZero, written-read-nv-data=ResetCounter_JumpToZero.Value
          nv-ram-block-element=autosar-variable-in-impl-datatype=ResetCounter_POR, written-read-nv-data=ResetCounter_POR.Value
          nv-ram-block-element=autosar-variable-in-impl-datatype=ResetCounter_StackMonitor, written-read-nv-data=ResetCounter_StackMonitor.Value
          nv-ram-block-element=autosar-variable-in-impl-datatype=ResetCounter_TimeoutModule, written-read-nv-data=ResetCounter_TimeoutModule.Value
          nv-ram-block-element=autosar-variable-in-impl-datatype=ResetCounter_Trap, written-read-nv-data=ResetCounter_Trap.Value
          nv-ram-block-element=autosar-variable-in-impl-datatype=ResetCounter_Trap_GS, written-read-nv-data=ResetCounter_Trap_GS.Value
          nv-ram-block-element=autosar-variable-in-impl-datatype=ResetCounter_WD, written-read-nv-data=ResetCounter_WD.Value
          nv-ram-block-element=autosar-variable-in-impl-datatype=ResetCounter_WD_GS, written-read-nv-data=ResetCounter_WD_GS.Value
          nv-ram-block-element=autosar-variable-in-impl-datatype=ResetCounter_CTRL_App, written-read-nv-data=ResetCounter_CTRL_App.Value
          nv-ram-block-element=autosar-variable-in-impl-datatype=ResetCounter_CTRL_Warning, written-read-nv-data=ResetCounter_CTRL_Warning.Value
          nv-ram-block-element=autosar-variable-in-impl-datatype=ResetCounter_CXDR_ADC, written-read-nv-data=ResetCounter_CXDR_ADC.Value
          nv-ram-block-element=autosar-variable-in-impl-datatype=ResetCounter_CXDR_IOC, written-read-nv-data=ResetCounter_CXDR_IOC.Value
          nv-ram-block-element=autosar-variable-in-impl-datatype=ResetCounter_CXDR_SafeTTMonitor, written-read-nv-data=ResetCounter_CXDR_SafeTTMonitor.Value
          nv-ram-block-element=autosar-variable-in-impl-datatype=ResetCounter_CXDR_Sound, written-read-nv-data=ResetCounter_CXDR_Sound.Value
          nv-ram-block-element=autosar-variable-in-impl-datatype=ResetCounter_IoHwAb, written-read-nv-data=ResetCounter_IoHwAb.Value
          nv-ram-block-element=autosar-variable-in-impl-datatype=ResetCounter_MDL_BCCT, written-read-nv-data=ResetCounter_MDL_BCCT.Value
          nv-ram-block-element=autosar-variable-in-impl-datatype=ResetCounter_MDL_CarModes, written-read-nv-data=ResetCounter_MDL_CarModes.Value
          nv-ram-block-element=autosar-variable-in-impl-datatype=ResetCounter_SRV_Cfg_Safety, written-read-nv-data=ResetCounter_SRV_Cfg_Safety.Value
          nv-ram-block-element=autosar-variable-in-impl-datatype=ResetCounter_SRV_Power, written-read-nv-data=ResetCounter_SRV_Power.Value
          nv-ram-block-element=autosar-variable-in-impl-datatype=ResetCounter_VIEW_Sound, written-read-nv-data=ResetCounter_VIEW_Sound.Value
          nv-ram-block-element=autosar-variable-in-impl-datatype=ResetCounter_SRV_ComExt_TaskFast, written-read-nv-data=ResetCounter_SRV_ComExt_TaskFast.Value
          nv-ram-block-element=autosar-variable-in-impl-datatype=ResetCounter_BURAMMarkerInvalid, written-read-nv-data=ResetCounter_BURAMMarkerInvalid.Value
          nv-ram-block-element=autosar-variable-in-impl-datatype=ResetCounter_BuramChecksumError, written-read-nv-data=ResetCounter_BuramChecksumError.Value
          nv-ram-block-element=autosar-variable-in-impl-datatype=ResetCounter_RamHashError, written-read-nv-data=ResetCounter_RamHashError.Value
          nv-ram-block-element=autosar-variable-in-impl-datatype=ResetCounter_EcuMErrorHook, written-read-nv-data=ResetCounter_EcuMErrorHook.Value
          nv-ram-block-element=autosar-variable-in-impl-datatype=ResetCounter_DeepStopNotEntered, written-read-nv-data=ResetCounter_DeepStopNotEntered.Value
          nv-ram-block-element=autosar-variable-in-impl-datatype=ResetCounter_EcuM_BswErrorHook, written-read-nv-data=ResetCounter_EcuM_BswErrorHook.Value
          nv-ram-block-element=autosar-variable-in-impl-datatype=ResetCounter_TmrFailure, written-read-nv-data=ResetCounter_TmrFailure.Value
          nv-ram-block-element=autosar-variable-in-impl-datatype=ResetCounter_SRV_ComExt_Task50, written-read-nv-data=ResetCounter_SRV_ComExt_Task50.Value
          nv-ram-block-element=autosar-variable-in-impl-datatype=ResetCounter_CXDR_DisplayMonitor, written-read-nv-data=ResetCounter_CXDR_DisplayMonitor.Value
          nv-ram-block-element=autosar-variable-in-impl-datatype=ResetCounter_SRV_MemTest, written-read-nv-data=ResetCounter_SRV_MemTest.Value
          nv-ram-block-element=autosar-variable-in-impl-datatype=ResetCounter_ECC_Error, written-read-nv-data=ResetCounter_ECC_Error.Value
          nv-ram-block-element=autosar-variable-in-impl-datatype=ResetCounter_MPU_Error, written-read-nv-data=ResetCounter_MPU_Error.Value
          nv-ram-block-element=autosar-variable-in-impl-datatype=ResetCounter_CSV_Error, written-read-nv-data=ResetCounter_CSV_Error.Value
          nv-ram-block-element=autosar-variable-in-impl-datatype=ResetCounter_CXDR_Illum, written-read-nv-data=ResetCounter_CXDR_Illum.Value
          nv-ram-block-element=autosar-variable-in-impl-datatype=ResetCounter_TFT_alive, written-read-nv-data=ResetCounter_TFT_alive.Value
          nv-ram-block-element=autosar-variable-in-impl-datatype=ResetCounter_backlight, written-read-nv-data=ResetCounter_backlight.Value
          nv-ram-block-element=autosar-variable-in-impl-datatype=ResetCounter_CXDR_Sensors, written-read-nv-data=ResetCounter_CXDR_Sensors.Value
          nv-ram-block-element=autosar-variable-in-impl-datatype=SiWalaACT_0xA00049, written-read-nv-data=SiWalaACT_0xA00049.Value
          nv-ram-block-element=autosar-variable-in-impl-datatype=SiWalaActive_0xA00049, written-read-nv-data=SiWalaActive_0xA00049.Value
          nv-ram-block-element=autosar-variable-in-impl-datatype=SiWalaExpState_0xA00049, written-read-nv-data=SiWalaExpState_0xA00049.Value
          nv-ram-block-element=autosar-variable-in-impl-datatype=SiWalaId_0xA00049, written-read-nv-data=SiWalaId_0xA00049.Value
          nv-ram-block-element=autosar-variable-in-impl-datatype=ResetCounter_MDL_Immobilizer, written-read-nv-data=ResetCounter_MDL_Immobilizer.Value
          nv-ram-block-element=autosar-variable-in-impl-datatype=ResetCounter_MDL_SiWaLa, written-read-nv-data=ResetCounter_MDL_SiWaLa.Value
          nv-ram-block-element=autosar-variable-in-impl-datatype=ResetCounter_SRV_Monitor, written-read-nv-data=ResetCounter_SRV_Monitor.Value
          nv-ram-block-element=autosar-variable-in-impl-datatype=BlackScreen_Reason, written-read-nv-data=BlackScreen_Reason.Value
          nv-ram-block-element=autosar-variable-in-impl-datatype=ResetCounter_LastResetReason, written-read-nv-data=ResetCounter_LastResetReason.Value
          nv-ram-block-element=autosar-variable-in-impl-datatype=ResetCounter_RendererTaskError, written-read-nv-data=ResetCounter_RendererTaskError.Value
          nv-ram-block-element=autosar-variable-in-impl-datatype=ResetCounter_HMITaskError, written-read-nv-data=ResetCounter_HMITaskError.Value
          nv-ram-block-element=autosar-variable-in-impl-datatype=ResetCounter_DpMainTaskError, written-read-nv-data=ResetCounter_DpMainTaskError.Value
          nv-ram-block-element=autosar-variable-in-impl-datatype=ResetCounter_GuiQueueError, written-read-nv-data=ResetCounter_GuiQueueError.Value
          nv-ram-block-element=autosar-variable-in-impl-datatype=ResetCounter_DpQueueError, written-read-nv-data=ResetCounter_DpQueueError.Value
          nv-ram-block-element=autosar-variable-in-impl-datatype=ResetCounter_EventQueueError, written-read-nv-data=ResetCounter_EventQueueError.Value
          nv-ram-block-element=autosar-variable-in-impl-datatype=zReserved_Recorder_VAR, written-read-nv-data=zReserved_Recorder_VAR.Value
        nv block needs NVNeed_NVBlockDescriptor: n-data-sets=2, ram-block-status-control=API, reliability=NO-PROTECTION, restore-at-start=true, store-at-shutdown=false, store-immediate=true, write-verification=false
        ram block RAM_NVBlockDescriptor_Recorder_VAR: type=NV_Data_Recorder_VAR, init-value=fields=[AdcTicks_0xA00044:0, AdcTicks_0xA00049:0, ClusterState_0xA00000:0, ClusterState_0xA00040:0, ClusterState_0xA00041:0, ClusterState_0xA00042:0, ClusterState_0xA00043:0, ClusterState_0xA00044:0, ClusterState_0xA00049:0, HmiZpm_0xA00044:0, AcuRequest_0xA00044:0, AcuStatus_0xA00044:0, BattVoltage_0xA00000:0, BattVoltage_0xA00040:0, BattVoltage_0xA00041:0, BattVoltage_0xA00042:0, BattVoltage_0xA00043:0, BattVoltage_0xA00044:0, BattVoltage_0xA00049:0, ClusterFunction_0xA00000:0, ClusterFunction_0xA00040:0, ClusterFunction_0xA00041:0, ClusterFunction_0xA00042:0, ClusterFunction_0xA00043:0, ClusterFunction_0xA00044:0, ClusterFunction_0xA00049:0, Counter_RamError:0, ErrorType_0xA00041:0, ErrorType_0xA00042:0, ErrorType_0xA00044:0, MDO_EN_0xA00049:0, ResetCounter_ClockMon:0, ResetCounter_EcuReset:0, ResetCounter_JumpToZero:0, ResetCounter_POR:0, ResetCounter_StackMonitor:0, ResetCounter_TimeoutModule:0, ResetCounter_Trap:0, ResetCounter_Trap_GS:0, ResetCounter_WD:0, ResetCounter_WD_GS:0, ResetCounter_CTRL_App:0, ResetCounter_CTRL_Warning:0, ResetCounter_CXDR_ADC:0, ResetCounter_CXDR_IOC:0, ResetCounter_CXDR_SafeTTMonitor:0, ResetCounter_CXDR_Sound:0, ResetCounter_IoHwAb:0, ResetCounter_MDL_BCCT:0, ResetCounter_MDL_CarModes:0, ResetCounter_SRV_Cfg_Safety:0, ResetCounter_SRV_Power:0, ResetCounter_VIEW_Sound:0, ResetCounter_SRV_ComExt_TaskFast:0, ResetCounter_BURAMMarkerInvalid:0, ResetCounter_BuramChecksumError:0, ResetCounter_RamHashError:0, ResetCounter_EcuMErrorHook:0, ResetCounter_DeepStopNotEntered:0, ResetCounter_EcuM_BswErrorHook:0, ResetCounter_TmrFailure:0, ResetCounter_SRV_ComExt_Task50:0, ResetCounter_CXDR_DisplayMonitor:0, ResetCounter_SRV_MemTest:0, ResetCounter_ECC_Error:0, ResetCounter_MPU_Error:0, ResetCounter_CSV_Error:0, ResetCounter_CXDR_Illum:0, ResetCounter_TFT_alive:0, ResetCounter_backlight:0, ResetCounter_CXDR_Sensors:0, SiWalaACT_0xA00049:0, SiWalaActive_0xA00049:0, SiWalaExpState_0xA00049:0, SiWalaId_0xA00049:0, ResetCounter_MDL_Immobilizer:0, ResetCounter_MDL_SiWaLa:0, ResetCounter_SRV_Monitor:0, BlackScreen_Reason:0, ResetCounter_LastResetReason:0, ResetCounter_RendererTaskError:0, ResetCounter_HMITaskError:0, ResetCounter_DpMainTaskError:0, ResetCounter_GuiQueueError:0, ResetCounter_DpQueueError:0, ResetCounter_EventQueueError:0, zReserved_Recorder_VAR:255]
        rom block ROM_NVBlockDescriptor_Recorder_VAR:
          sw-calibration-access=READ-WRITE
          type=NV_Data_Recorder_VAR
          init-value=fields=[AdcTicks_0xA00044:0, AdcTicks_0xA00049:0, ClusterState_0xA00000:0, ClusterState_0xA00040:0, ClusterState_0xA00041:0, ClusterState_0xA00042:0, ClusterState_0xA00043:0, ClusterState_0xA00044:0, ClusterState_0xA00049:0, HmiZpm_0xA00044:0, AcuRequest_0xA00044:0, AcuStatus_0xA00044:0, BattVoltage_0xA00000:0, BattVoltage_0xA00040:0, BattVoltage_0xA00041:0, BattVoltage_0xA00042:0, BattVoltage_0xA00043:0, BattVoltage_0xA00044:0, BattVoltage_0xA00049:0, ClusterFunction_0xA00000:0, ClusterFunction_0xA00040:0, ClusterFunction_0xA00041:0, ClusterFunction_0xA00042:0, ClusterFunction_0xA00043:0, ClusterFunction_0xA00044:0, ClusterFunction_0xA00049:0, Counter_RamError:0, ErrorType_0xA00041:0, ErrorType_0xA00042:0, ErrorType_0xA00044:0, MDO_EN_0xA00049:0, ResetCounter_ClockMon:0, ResetCounter_EcuReset:0, ResetCounter_JumpToZero:0, ResetCounter_POR:0, ResetCounter_StackMonitor:0, ResetCounter_TimeoutModule:0, ResetCounter_Trap:0, ResetCounter_Trap_GS:0, ResetCounter_WD:0, ResetCounter_WD_GS:0, ResetCounter_CTRL_App:0, ResetCounter_CTRL_Warning:0, ResetCounter_CXDR_ADC:0, ResetCounter_CXDR_IOC:0, ResetCounter_CXDR_SafeTTMonitor:0, ResetCounter_CXDR_Sound:0, ResetCounter_IoHwAb:0, ResetCounter_MDL_BCCT:0, ResetCounter_MDL_CarModes:0, ResetCounter_SRV_Cfg_Safety:0, ResetCounter_SRV_Power:0, ResetCounter_VIEW_Sound:0, ResetCounter_SRV_ComExt_TaskFast:0, ResetCounter_BURAMMarkerInvalid:0, ResetCounter_BuramChecksumError:0, ResetCounter_RamHashError:0, ResetCounter_EcuMErrorHook:0, ResetCounter_DeepStopNotEntered:0, ResetCounter_EcuM_BswErrorHook:0, ResetCounter_TmrFailure:0, ResetCounter_SRV_ComExt_Task50:0, ResetCounter_CXDR_DisplayMonitor:0, ResetCounter_SRV_MemTest:0, ResetCounter_ECC_Error:0, ResetCounter_MPU_Error:0, ResetCounter_CSV_Error:0, ResetCounter_CXDR_Illum:0, ResetCounter_TFT_alive:0, ResetCounter_backlight:0, ResetCounter_CXDR_Sensors:0, SiWalaACT_0xA00049:0, SiWalaActive_0xA00049:0, SiWalaExpState_0xA00049:0, SiWalaId_0xA00049:0, ResetCounter_MDL_Immobilizer:0, ResetCounter_MDL_SiWaLa:0, ResetCounter_SRV_Monitor:0, BlackScreen_Reason:0, ResetCounter_LastResetReason:0, ResetCounter_RendererTaskError:0, ResetCounter_HMITaskError:0, ResetCounter_DpMainTaskError:0, ResetCounter_GuiQueueError:0, ResetCounter_DpQueueError:0, ResetCounter_EventQueueError:0, zReserved_Recorder_VAR:255]
      NVBlockDescriptor_Recorder_VAR_2: client-server-ports=role-based-port-assignment={port-prototype=Recorder_VAR_2_NvM_JobFinished, role=Recorder_VAR_2_NvM_JobFinished}
        nv-block-data-mappings:
          nv-ram-block-element=autosar-variable-in-impl-datatype=ResetCounter_ProtectionHook, written-read-nv-data=ResetCounter_ProtectionHook.Value
          nv-ram-block-element=autosar-variable-in-impl-datatype=ResetCounter_ErrorHook, written-read-nv-data=ResetCounter_ErrorHook.Value
          nv-ram-block-element=autosar-variable-in-impl-datatype=ResetCounter_ShutdownHook, written-read-nv-data=ResetCounter_ShutdownHook.Value
          nv-ram-block-element=autosar-variable-in-impl-datatype=ResetCounter_Det_ErrorHook, written-read-nv-data=ResetCounter_Det_ErrorHook.Value
          nv-ram-block-element=autosar-variable-in-impl-datatype=TaskListEntry{1..5}, written-read-nv-data=TaskListEntry{1..5}.Value
          nv-ram-block-element=autosar-variable-in-impl-datatype=HookInfo_ProtectionHook, written-read-nv-data=HookInfo_ProtectionHook.Value
          nv-ram-block-element=autosar-variable-in-impl-datatype=HookInfo_ErrorHook, written-read-nv-data=HookInfo_ErrorHook.Value
          nv-ram-block-element=autosar-variable-in-impl-datatype=HookInfo_ShutdownHook, written-read-nv-data=HookInfo_ShutdownHook.Value
          nv-ram-block-element=autosar-variable-in-impl-datatype=HookInfo_BswModuleId_EcuM_BswErrorHook, written-read-nv-data=HookInfo_BswModuleId_EcuM_BswErrorHook.Value
          nv-ram-block-element=autosar-variable-in-impl-datatype=HookInfo_ErrorId_EcuM_BswErrorHook, written-read-nv-data=HookInfo_ErrorId_EcuM_BswErrorHook.Value
          nv-ram-block-element=autosar-variable-in-impl-datatype=HookInfo_EcuM_ErrorHook, written-read-nv-data=HookInfo_EcuM_ErrorHook.Value
          nv-ram-block-element=autosar-variable-in-impl-datatype=HookInfo_ModuleId_Det_ErrorHook, written-read-nv-data=HookInfo_ModuleId_Det_ErrorHook.Value
          nv-ram-block-element=autosar-variable-in-impl-datatype=HookInfo_InstanceId_Det_ErrorHook, written-read-nv-data=HookInfo_InstanceId_Det_ErrorHook.Value
          nv-ram-block-element=autosar-variable-in-impl-datatype=HookInfo_ApiId_Det_ErrorHook, written-read-nv-data=HookInfo_ApiId_Det_ErrorHook.Value
          nv-ram-block-element=autosar-variable-in-impl-datatype=HookInfo_ErrorId_Det_ErrorHook, written-read-nv-data=HookInfo_ErrorId_Det_ErrorHook.Value
          nv-ram-block-element=autosar-variable-in-impl-datatype=VersionListEntry{1..5}, written-read-nv-data=VersionListEntry{1..5}.Value
          nv-ram-block-element=autosar-variable-in-impl-datatype=VersionListIndex, written-read-nv-data=VersionListIndex.Value
          nv-ram-block-element=autosar-variable-in-impl-datatype=VersionListFlash_Counter, written-read-nv-data=VersionListFlash_Counter.Value
          nv-ram-block-element=autosar-variable-in-impl-datatype=zReserved_Recorder_VAR_2, written-read-nv-data=zReserved_Recorder_VAR_2.Value
        nv block needs NVNeed_NVBlockDescriptor: n-data-sets=2, ram-block-status-control=API, reliability=NO-PROTECTION, restore-at-start=true, store-at-shutdown=false, store-immediate=true, write-verification=false
        ram block RAM_NVBlockDescriptor_Recorder_VAR_2: type=NV_Data_Recorder_VAR_2, init-value=fields=[ResetCounter_ProtectionHook:0, ResetCounter_ErrorHook:0, ResetCounter_ShutdownHook:0, ResetCounter_Det_ErrorHook:0, TaskListEntry1:0, TaskListEntry2:0, TaskListEntry3:0, TaskListEntry4:0, TaskListEntry5:0, HookInfo_ProtectionHook:0, HookInfo_ErrorHook:0, HookInfo_ShutdownHook:0, HookInfo_BswModuleId_EcuM_BswErrorHook:0, HookInfo_ErrorId_EcuM_BswErrorHook:0, HookInfo_EcuM_ErrorHook:0, HookInfo_ModuleId_Det_ErrorHook:0, HookInfo_InstanceId_Det_ErrorHook:0, HookInfo_ApiId_Det_ErrorHook:0, HookInfo_ErrorId_Det_ErrorHook:0, VersionListEntry1:[0, 0, 0, 0], VersionListEntry2:[0, 0, 0, 0], VersionListEntry3:[0, 0, 0, 0], VersionListEntry4:[0, 0, 0, 0], VersionListEntry5:[0, 0, 0, 0], VersionListIndex:0, VersionListFlash_Counter:0, zReserved_Recorder_VAR_2:6 x 0]
        rom block ROM_NVBlockDescriptor_Recorder_VAR_2:
          sw-calibration-access=READ-WRITE
          type=NV_Data_Recorder_VAR_2
          init-value=fields=[ResetCounter_ProtectionHook:0, ResetCounter_ErrorHook:0, ResetCounter_ShutdownHook:0, ResetCounter_Det_ErrorHook:0, TaskListEntry1:0, TaskListEntry2:0, TaskListEntry3:0, TaskListEntry4:0, TaskListEntry5:0, HookInfo_ProtectionHook:0, HookInfo_ErrorHook:0, HookInfo_ShutdownHook:0, HookInfo_BswModuleId_EcuM_BswErrorHook:0, HookInfo_ErrorId_EcuM_BswErrorHook:0, HookInfo_EcuM_ErrorHook:0, HookInfo_ModuleId_Det_ErrorHook:0, HookInfo_InstanceId_Det_ErrorHook:0, HookInfo_ApiId_Det_ErrorHook:0, HookInfo_ErrorId_Det_ErrorHook:0, VersionListEntry1:[0, 0, 0, 0], VersionListEntry2:[0, 0, 0, 0], VersionListEntry3:[0, 0, 0, 0], VersionListEntry4:[0, 0, 0, 0], VersionListEntry5:[0, 0, 0, 0], VersionListIndex:0, VersionListFlash_Counter:0, zReserved_Recorder_VAR_2:6 x 0]
