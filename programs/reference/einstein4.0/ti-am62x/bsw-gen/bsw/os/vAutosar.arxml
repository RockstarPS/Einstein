AUTOSAR XML (schema 00050)
standard types defined: boolean, uint8, uint16, uint32, uint64, sint8, sint16, sint32, sint64, float32, float64
package /ActiveEcuC
  module config Os
    35 x OsAlarm, all with OsAlarmCounterRef=SystemTimer:
      Rte_Al_TE2_OsTask_CANFun_0_10ms
        OsAlarmAction
          OsAlarmSetEvent: OsAlarmSetEventRef=Rte_Ev_Cyclic2_OsTask_CANFun_0_10ms, OsAlarmSetEventTaskRef=OsTask_CANFun
      Rte_Al_TE2_OsTask_Diagnostics_0_10ms
        OsAlarmAction
          OsAlarmSetEvent: OsAlarmSetEventRef=Rte_Ev_Cyclic2_OsTask_Diagnostics_0_10ms, OsAlarmSetEventTaskRef=OsTask_Diagnostics
      Rte_Al_TE2_OsTask_Mcal_10msLP_0_10ms
        OsAlarmAction
          OsAlarmActivateTask: OsAlarmActivateTaskRef=OsTask_Mcal
      Rte_Al_TE2_OsTask_MemSer_0_10ms
        OsAlarmAction
          OsAlarmSetEvent: OsAlarmSetEventRef=Rte_Ev_Cyclic2_OsTask_MemSer_0_10ms, OsAlarmSetEventTaskRef=OsTask_MemSer
      Rte_Al_TE2_OsTask_ModeMgt_0_10ms
        OsAlarmAction
          OsAlarmSetEvent: OsAlarmSetEventRef=Rte_Ev_Cyclic2_OsTask_ModeMgt_0_10ms, OsAlarmSetEventTaskRef=OsTask_ModeMgt
      Rte_Al_TE2_OsTask_ModeMgt_5msLP_0_5ms
        OsAlarmAction
          OsAlarmActivateTask: OsAlarmActivateTaskRef=OsTask_ModeMgt
      Rte_Al_TE2_OsTask_SafeBsw_0_10ms
        OsAlarmAction
          OsAlarmSetEvent: OsAlarmSetEventRef=Rte_Ev_Cyclic2_OsTask_SafeBsw_0_10ms, OsAlarmSetEventTaskRef=OsTask_SafeBsw
      Rte_Al_TE_DmnMgr_CDmnMgr_Impl_MainFunction
        OsAlarmAction
          OsAlarmSetEvent: OsAlarmSetEventRef=Rte_Ev_Run_DmnMgr_CDmnMgr_Impl_MainFunction, OsAlarmSetEventTaskRef=OsTask_IpcUclEv
      Rte_Al_TE_Ea_Ea_MainFunction
        OsAlarmAction
          OsAlarmSetEvent: OsAlarmSetEventRef=Rte_Ev_Run_Ea_Ea_MainFunction, OsAlarmSetEventTaskRef=OsTask_MemSer
      Rte_Al_TE_IoHwAb_IoHwAb_OsTask_SafeBsw_WdgM_CheckPoint_20ms
        OsAlarmAction
          OsAlarmSetEvent: OsAlarmSetEventRef=Rte_Ev_Run_IoHwAb_IoHwAb_OsTask_SafeBsw_WdgM_CheckPoint_20ms, OsAlarmSetEventTaskRef=OsTask_SafeBsw
      Rte_Al_TE_NvMExt_NvMExt_SpeedupRunnable
        OsAlarmAction
          OsAlarmSetEvent: OsAlarmSetEventRef=Rte_Ev_Run_NvMExt_NvMExt_SpeedupRunnable, OsAlarmSetEventTaskRef=OsTask_NvmSpeedup
      Rte_Al_TE_OsTask_AppFun_0_10ms
        OsAlarmAction
          OsAlarmActivateTask: OsAlarmActivateTaskRef=OsTask_AppFun
      Rte_Al_TE_OsTask_CANFun_0_10ms
        OsAlarmAction
          OsAlarmSetEvent: OsAlarmSetEventRef=Rte_Ev_Cyclic_OsTask_CANFun_0_10ms, OsAlarmSetEventTaskRef=OsTask_CANFun
      Rte_Al_TE_OsTask_Diagnostics_0_100ms
        OsAlarmAction
          OsAlarmSetEvent: OsAlarmSetEventRef=Rte_Ev_Cyclic_OsTask_Diagnostics_0_100ms, OsAlarmSetEventTaskRef=OsTask_Diagnostics
      Rte_Al_TE_OsTask_Diagnostics_0_10ms
        OsAlarmAction
          OsAlarmSetEvent: OsAlarmSetEventRef=Rte_Ev_Cyclic_OsTask_Diagnostics_0_10ms, OsAlarmSetEventTaskRef=OsTask_Diagnostics
      Rte_Al_TE_OsTask_Diagnostics_0_20ms
        OsAlarmAction
          OsAlarmSetEvent: OsAlarmSetEventRef=Rte_Ev_Cyclic_OsTask_Diagnostics_0_20ms, OsAlarmSetEventTaskRef=OsTask_Diagnostics
      Rte_Al_TE_OsTask_DispFun_0_10ms
        OsAlarmAction
          OsAlarmSetEvent: OsAlarmSetEventRef=Rte_Ev_Cyclic_OsTask_DispFun_0_10ms, OsAlarmSetEventTaskRef=OsTask_DispFun
      Rte_Al_TE_OsTask_DispFun_0_5ms
        OsAlarmAction
          OsAlarmSetEvent: OsAlarmSetEventRef=Rte_Ev_Cyclic_OsTask_DispFun_0_5ms, OsAlarmSetEventTaskRef=OsTask_DispFun
      Rte_Al_TE_OsTask_EthFun_0_10ms
        OsAlarmAction
          OsAlarmActivateTask: OsAlarmActivateTaskRef=OsTask_EthFun
      Rte_Al_TE_OsTask_GaugeFun_0_20ms
        OsAlarmAction
          OsAlarmActivateTask: OsAlarmActivateTaskRef=OsTask_GaugeFun
      Rte_Al_TE_OsTask_IndFun_0_30ms
        OsAlarmAction
          OsAlarmActivateTask: OsAlarmActivateTaskRef=OsTask_IndFun
      Rte_Al_TE_OsTask_LSH_16ms_0_16ms
        OsAlarmAction
          OsAlarmSetEvent: OsAlarmSetEventRef=Rte_Ev_Cyclic_OsTask_LSH_16ms_0_16ms, OsAlarmSetEventTaskRef=OsTask_LSH_16ms
      Rte_Al_TE_OsTask_Mcal_0_10ms
        OsAlarmAction
          OsAlarmActivateTask: OsAlarmActivateTaskRef=OsTask_Mcal
      Rte_Al_TE_OsTask_MemSer_0_10ms
        OsAlarmAction
          OsAlarmSetEvent: OsAlarmSetEventRef=Rte_Ev_Cyclic_OsTask_MemSer_0_10ms, OsAlarmSetEventTaskRef=OsTask_MemSer
      Rte_Al_TE_OsTask_ModeMgt_0_10ms
        OsAlarmAction
          OsAlarmSetEvent: OsAlarmSetEventRef=Rte_Ev_Cyclic_OsTask_ModeMgt_0_10ms, OsAlarmSetEventTaskRef=OsTask_ModeMgt
      Rte_Al_TE_OsTask_SafeApp_0_30ms
        OsAlarmAction
          OsAlarmActivateTask: OsAlarmActivateTaskRef=OsTask_SafeApp
      Rte_Al_TE_OsTask_SafeBsw_0_10ms
        OsAlarmAction
          OsAlarmSetEvent: OsAlarmSetEventRef=Rte_Ev_Cyclic_OsTask_SafeBsw_0_10ms, OsAlarmSetEventTaskRef=OsTask_SafeBsw
      Rte_Al_TE_OsTask_TripFun_0_50ms
        OsAlarmAction
          OsAlarmActivateTask: OsAlarmActivateTaskRef=OsTask_TripFun
      Rte_Al_TE_OsTask_WarnFun_0_32ms
        OsAlarmAction
          OsAlarmActivateTask: OsAlarmActivateTaskRef=OsTask_WarnFun
      Rte_Al_TE_OsTask_WdgMngt_0_10ms
        OsAlarmAction
          OsAlarmActivateTask: OsAlarmActivateTaskRef=OsTask_WdgMngt
      Rte_Al_TE_SlowGaugeAdapter_SlowGaugeAdapter_Task
        OsAlarmAction
          OsAlarmSetEvent: OsAlarmSetEventRef=Rte_Ev_Run_SlowGaugeAdapter_SlowGaugeAdapter_Task, OsAlarmSetEventTaskRef=OsTask_DispFun
      Rte_Al_TE_Test_Comp_AudioTaskStubRunnable
        OsAlarmAction
          OsAlarmActivateTask: OsAlarmActivateTaskRef=OsTask_AudioFun
      Rte_Al_TE_Test_Comp_FotaTaskStubRunnable
        OsAlarmAction
          OsAlarmActivateTask: OsAlarmActivateTaskRef=OsTask_FotaFun
      Rte_Al_TE_Test_Comp_LinTaskStubRunnable
        OsAlarmAction
          OsAlarmActivateTask: OsAlarmActivateTaskRef=OsTask_LinFun
      Rte_Al_TE_UclProxyCdd_CUclProxyCdd_Impl_MainFunction
        OsAlarmAction
          OsAlarmSetEvent: OsAlarmSetEventRef=Rte_Ev_Run_UclProxyCdd_CUclProxyCdd_Impl_MainFunction, OsAlarmSetEventTaskRef=OsTask_IpcUclEv
    OsMpu_TrustedSystem (OsMpu)
      7 x OsMpuRegion, all with OsMpuSubRegion=0:
        OsMpuRegion: OsMpuRegionAccess=S_RW_U_R, OsMpuRegionBaseAddress=0x00000000, OsMpuRegionMemoryOrder=CACHEABLE_WRITEBACK_ALLOCATE, OsMpuRegionNumber=6, OsMpuRegionPermission=EXECUTE_ALLOWED, OsMpuRegionSize=32768
        OsMpuRegion1: OsMpuRegionAccess=S_R_U_R, OsMpuRegionBaseAddress=0x41010400, OsMpuRegionMemoryOrder=CACHEABLE_WRITEBACK_ALLOCATE, OsMpuRegionNumber=5, OsMpuRegionPermission=EXECUTE_ALLOWED, OsMpuRegionSize=32768
        OsMpuRegion2: OsMpuRegionAccess=S_RW_U_RW, OsMpuRegionBaseAddress=0x79120000, OsMpuRegionMemoryOrder=CACHEABLE_WRITEBACK_ALLOCATE, OsMpuRegionNumber=3, OsMpuRegionPermission=EXECUTE_FORBIDDEN, OsMpuRegionSize=131072
        OsMpuRegion3: OsMpuRegionAccess=S_RW_U_R, OsMpuRegionBaseAddress=0x79140000, OsMpuRegionMemoryOrder=CACHEABLE_WRITEBACK_ALLOCATE, OsMpuRegionNumber=10, OsMpuRegionPermission=EXECUTE_FORBIDDEN, OsMpuRegionSize=32768
        OsMpuRegion4: OsMpuRegionAccess=S_R_U_R, OsMpuRegionBaseAddress=0x79120000, OsMpuRegionMemoryOrder=CACHEABLE_WRITEBACK_ALLOCATE, OsMpuRegionNumber=11, OsMpuRegionPermission=EXECUTE_FORBIDDEN, OsMpuRegionSize=65536
        OsMpuRegion5: OsMpuRegionAccess=S_RW_U_RW, OsMpuRegionBaseAddress=0x04000000, OsMpuRegionMemoryOrder=STRONGLY_ORDERED, OsMpuRegionNumber=13, OsMpuRegionPermission=EXECUTE_FORBIDDEN, OsMpuRegionSize=67108864
        OsMpuRegion6: OsMpuRegionAccess=S_RW_U_R, OsMpuRegionBaseAddress=0x07FF0000, OsMpuRegionMemoryOrder=STRONGLY_ORDERED, OsMpuRegionNumber=14, OsMpuRegionPermission=EXECUTE_ALLOWED, OsMpuRegionSize=16384
    TrustedSystem (OsApplication):
      OsTrustedApplicationWithProtection = false
      OsApplicationIsPrivileged = true
      OsAppMpuConfigRef = OsMpu_TrustedSystem
      OsAppTaskRef = OsTask_SafeApp
      OsAppTaskRef = OsTask_WdgMngt
      OsAppTaskRef = OsTask_SafeBsw
      OsAppCoreConfigRef = OsCoreAsr0
      OsAppIsrRef = McuOsGptIsr
      OsAppIsrRef = McuCan0RxTxIsr
      OsAppIsrRef = McuCan1RxTxIsr
      OsAppIsrRef = McuSpi0NvmRxTxIsr
      OsAppIsrRef = McuDss0Isr
      OsAppIsrRef = McuI2c3IoIsr
      OsAppIsrRef = Eth_TxIrqHdlr_0
      OsAppIsrRef = Eth_RxIrqHdlr_0
      OsAppIsrRef = Eth_MdioIrqHdlr
      OsAppIsrRef = FltM_WkupEsmHiInterrupt
      OsAppIsrRef = MCU_IntrISR_UART0
      OsAppIsrRef = McuI2c0PmicIsr
      OsAppIsrRef = Gpt_Ch3Isr
      OsAppIsrRef = Gpt_Ch4Isr
      OsAppIsrRef = Spi_IrqUnitMcspi2TxRx
      OsAppIsrRef = MCU_ISR_6
      OsAppIsrRef = MAIN_ISR_34
      OsAppIsrRef = MAIN_ISR_35
      OsAppIsrRef = MCU_ISR_7
      OsAppIsrRef = FltM_WkupEsmCfgInterrupt
      OsAppIsrRef = FltM_WkupEsmLowInterrupt
      OsAppIsrRef = Spi_IrqUnitMcspi0TxRx
      OsAppIsrRef = MainI2c2RtcIsr
      OsAppIsrRef = MCU_ResetIsolationReq
      OsAppIsrRef = FltM_FwlExceptionInterrupt
      OsAppIsrRef = Cdd_IpcIrqMbxFromWKUP_R5FSS0_0
      OsAppIsrRef = Mcu_Udma_Vintr{64..79}
      OsAppIsrRef = MainI2c1DacIsr
      OsAppTaskRef = InitTask
      OsApplicationHooks: OsAppErrorHook=false, OsAppShutdownHook=false, OsAppStartupHook=false
      10 x OsApplicationTrustedFunction, all with OsTrustedFunctionObjectType=TASK:
        SafeNvM_NvM_WriteCallback_Original: OsTrustedFunctionName=SafeNvM_NvM_WriteCallback_Original, OsTrustedFunctionReturnType=void
          3 x OsTrustedFunctionParam, all with OsTrustedFunctionParamDirection=IN, OsTrustedFunctionParamId=1:
            OsTrustedFunctionParam: OsTrustedFunctionParamDataType=uint8
            OsTrustedFunctionParam1: OsTrustedFunctionParamDataType=uint8
            OsTrustedFunctionParam2: OsTrustedFunctionParamDataType=NvM_RequestResultType
        SafeNvM_NvM_WriteCallback_Copy1: OsTrustedFunctionName=SafeNvM_NvM_WriteCallback_Copy1, OsTrustedFunctionReturnType=void
          3 x OsTrustedFunctionParam, all with OsTrustedFunctionParamDirection=IN, OsTrustedFunctionParamId=1:
            OsTrustedFunctionParam: OsTrustedFunctionParamDataType=uint8
            OsTrustedFunctionParam1: OsTrustedFunctionParamDataType=uint8
            OsTrustedFunctionParam2: OsTrustedFunctionParamDataType=NvM_RequestResultType
        SafeNvM_NvM_WriteCallback_Copy2: OsTrustedFunctionName=SafeNvM_NvM_WriteCallback_Copy2, OsTrustedFunctionReturnType=void
          3 x OsTrustedFunctionParam, all with OsTrustedFunctionParamDirection=IN, OsTrustedFunctionParamId=1:
            OsTrustedFunctionParam: OsTrustedFunctionParamDataType=uint8
            OsTrustedFunctionParam1: OsTrustedFunctionParamDataType=uint8
            OsTrustedFunctionParam2: OsTrustedFunctionParamDataType=NvM_RequestResultType
        SafeNvM_TriggerDataCompare: OsTrustedFunctionName=SafeNvM_TriggerDataCompare, OsTrustedFunctionReturnType=void
        CDD_BswFit_SafeMemUpdate: OsTrustedFunctionName=CDD_BswFit_SafeMemUpdate, OsTrustedFunctionReturnType=void
        CDD_FitManager_SupervisorCallFaultInjectionHandler: OsTrustedFunctionName=CDD_FitManager_SupervisorCallFaultInjectionHandler, OsTrustedFunctionReturnType=Std_ReturnType
          4 x OsTrustedFunctionParam, all with OsTrustedFunctionParamDirection=IN, OsTrustedFunctionParamId=1:
            OsTrustedFunctionParam: OsTrustedFunctionParamDataType=uint8
            OsTrustedFunctionParam1: OsTrustedFunctionParamDataType=uint8
            OsTrustedFunctionParam2: OsTrustedFunctionParamDataType=uint8
            OsTrustedFunctionParam3: OsTrustedFunctionParamDataType=uint8*
        EcuAppM_SafeGroupStateChangeRequestProcessing: OsTrustedFunctionName=EcuAppM_SafeGroupStateChangeRequestProcessing, OsTrustedFunctionReturnType=uint8
          OsTrustedFunctionParam: OsTrustedFunctionParamDataType=uint8, OsTrustedFunctionParamDirection=IN, OsTrustedFunctionParamId=1
          OsTrustedFunctionParam1 (OsTrustedFunctionParam): OsTrustedFunctionParamDataType=uint8, OsTrustedFunctionParamDirection=IN, OsTrustedFunctionParamId=1
        FltM_ReportFault: OsTrustedFunctionName=FltM_ReportFault, OsTrustedFunctionReturnType=Std_ReturnType
          4 x OsTrustedFunctionParam, all with OsTrustedFunctionParamDirection=IN, OsTrustedFunctionParamId=1:
            OsTrustedFunctionParam: OsTrustedFunctionParamDataType=FltM_FaultIdType
            OsTrustedFunctionParam1: OsTrustedFunctionParamDataType=eFltM_FaultStatusType
            OsTrustedFunctionParam2: OsTrustedFunctionParamDataType=uint8*
            OsTrustedFunctionParam3: OsTrustedFunctionParamDataType=uint16
        CComAbsMdlSafeRxCan_SignalMissingProcessingControl: OsTrustedFunctionName=CComAbsMdlSafeRxCan_SignalMissingProcessingControl, OsTrustedFunctionReturnType=void
          OsTrustedFunctionParam: OsTrustedFunctionParamDataType=tRxSafeSignalId, OsTrustedFunctionParamDirection=IN, OsTrustedFunctionParamId=1
          OsTrustedFunctionParam1 (OsTrustedFunctionParam): OsTrustedFunctionParamDataType=boolean, OsTrustedFunctionParamDirection=IN, OsTrustedFunctionParamId=1
        IoHwAb_SetOutputPin: OsTrustedFunctionName=IoHwAb_SetOutputPin, OsTrustedFunctionReturnType=Std_ReturnType
          3 x OsTrustedFunctionParam, all with OsTrustedFunctionParamDirection=IN, OsTrustedFunctionParamId=1:
            OsTrustedFunctionParam: OsTrustedFunctionParamDataType=IoHwAb_DOutSignalIdType
            OsTrustedFunctionParam1: OsTrustedFunctionParamDataType=boolean
            OsTrustedFunctionParam2: OsTrustedFunctionParamDataType=IoHwAb_ErrorType*
    QMSystem (OsApplication):
      OsTrustedApplicationWithProtection = false
      OsApplicationIsPrivileged = false
      OsAppCoreConfigRef = OsCoreAsr0
      OsAppMpuConfigRef = OsMpu_QMSystem
      OsAppTaskRef = OsTask_AppFun
      OsAppTaskRef = OsTask_AudioFun
      OsAppTaskRef = OsTask_Can0DataRxEv
      OsAppTaskRef = OsTask_Can1DataRxEv
      OsAppTaskRef = OsTask_CANFun
      OsAppTaskRef = OsTask_DispFun
      OsAppTaskRef = OsTask_EthFun
      OsAppTaskRef = OsTask_FotaEv
      OsAppTaskRef = OsTask_FotaFun
      OsAppTaskRef = OsTask_GaugeFun
      OsAppTaskRef = OsTask_IdleTask
      OsAppTaskRef = OsTask_IndFun
      OsAppTaskRef = OsTask_LinFun
      OsAppTaskRef = OsTask_Mcal
      OsAppTaskRef = OsTask_ModeMgt
      OsAppTaskRef = OsTask_NvmSpeedup
      OsAppTaskRef = OsTask_TripFun
      OsAppTaskRef = OsTask_WarnFun
      OsAppTaskRef = OsTask_Diagnostics
      OsAppTaskRef = OsTask_LSH_16ms
      OsAppTaskRef = OsTask_MemSer
      OsAppTaskRef = OsTask_IpcUclEv
      OsAppTaskRef = OsTaskRender
      OsApplicationHooks: OsAppErrorHook=false, OsAppShutdownHook=false, OsAppStartupHook=false
    OsOS:
      OsStackMonitoring = false
      OsStatus = EXTENDED
      OsUseGetServiceId = false
      OsUseParameterAccess = false
      OsUseResScheduler = false
      OsScalabilityClass = SC3
      OsNumberOfCores = 1
      OsFpuSupport = true
      OsHooks:
        OsErrorHook = true
        OsPostTaskHook = false
        OsPreTaskHook = false
        OsShutdownHook = true
        OsStartupHook = false
        OsPreIsrHookFunc = UserPreISRHook(x)
        OsPostIsrHookFunc = UserPostISRHook(x)
        OsPostTaskHookFunc = UserPostTaskHook()
        OsPreTaskHookFunc = UserPreTaskHook()
        OsShutdownHookFunc = FltMExt_UserShutdownHook()
        OsErrorHookFunc = FltMExt_UserErrorHook(x)
        OsProtectionHookFunc = FltMExt_UserProtectionHook(x)
    OsCounter_0 (OsCounter): OsCounterMaxAllowedValue=65535, OsCounterType=HARDWARE, OsSecondsPerTick=0.001, OsCounterTicksPerBase=1, OsCounterMinValue=0, OsCounterMinCycle=1
      OsDriver
    OSDEFAULTAPPMODE (OsAppMode)
    15 x OsEvent:
      Rte_Ev_Cyclic2_OsTask_CANFun_0_10ms
      Rte_Ev_Cyclic2_OsTask_Diagnostics_0_10ms
      Rte_Ev_Cyclic2_OsTask_MemSer_0_10ms
      Rte_Ev_Cyclic2_OsTask_ModeMgt_0_10ms
      Rte_Ev_Cyclic2_OsTask_SafeBsw_0_10ms
      Rte_Ev_Cyclic_MemSer_10msLP_0_10ms
      Rte_Ev_Cyclic_OsTask_CANFun_0_10ms
      Rte_Ev_Cyclic_OsTask_Diagnostics_0_100ms
      Rte_Ev_Cyclic_OsTask_Diagnostics_0_10ms
      Rte_Ev_Cyclic_OsTask_Diagnostics_0_20ms
      Rte_Ev_Cyclic_OsTask_DispFun_0_10ms
      Rte_Ev_Cyclic_OsTask_DispFun_0_5ms
      Rte_Ev_Cyclic_OsTask_LSH_16ms_0_16ms
      Rte_Ev_Cyclic_OsTask_MemSer_0_10ms
      Rte_Ev_Cyclic_OsTask_ModeMgt_0_10ms
    27 x OsTask, all with OsTaskMpuPermission=EXECUTE_FORBIDDEN, OsTaskMpuMemoryOrder=CACHEABLE_WRITEBACK_ALLOCATE, OsTaskAccessingApplication=TrustedSystem:
      InitTask: OsTaskActivation=3, OsTaskPriority=26, OsTaskSchedule=NON, OsTaskStackSharing=false, OsTaskStackSize=2048, OsTaskType=BASIC, OsTaskIsAutostart=true, OsTaskAccessingApplication=QMSystem
      OsTask_AppFun: OsTaskActivation=1, OsTaskPriority=5, OsTaskSchedule=NON, OsTaskStackSharing=true, OsTaskStackSize=2048, OsTaskType=BASIC, OsTaskAccessingApplication=QMSystem
      OsTask_AudioFun: OsTaskActivation=1, OsTaskPriority=11, OsTaskSchedule=NON, OsTaskStackSharing=true, OsTaskStackSize=2048, OsTaskType=BASIC, OsTaskAccessingApplication=QMSystem
      OsTask_Can0DataRxEv: OsTaskActivation=1, OsTaskPriority=19, OsTaskSchedule=NON, OsTaskStackSharing=false, OsTaskStackSize=1024, OsTaskType=EXTENDED, OsTaskAccessingApplication=QMSystem
      OsTask_Can1DataRxEv: OsTaskActivation=1, OsTaskPriority=18, OsTaskSchedule=NON, OsTaskStackSharing=false, OsTaskStackSize=1024, OsTaskType=EXTENDED, OsTaskAccessingApplication=QMSystem
      OsTask_CANFun: OsTaskActivation=1, OsTaskPriority=20, OsTaskSchedule=NON, OsTaskStackSharing=false, OsTaskStackSize=1024, OsTaskType=EXTENDED, OsTaskAccessingApplication=QMSystem, OsTaskEventRef=Rte_Ev_Cyclic2_OsTask_CANFun_0_10ms, OsTaskEventRef=Rte_Ev_Cyclic_OsTask_CANFun_0_10ms
      OsTask_DispFun: OsTaskActivation=1, OsTaskPriority=24, OsTaskSchedule=NON, OsTaskStackSharing=false, OsTaskStackSize=1024, OsTaskType=EXTENDED, OsTaskAccessingApplication=QMSystem, OsTaskEventRef=Rte_Ev_Cyclic_OsTask_DispFun_0_10ms, OsTaskEventRef=Rte_Ev_Run_SlowGaugeAdapter_SlowGaugeAdapter_Task, OsTaskEventRef=Rte_Ev_Cyclic_OsTask_DispFun_0_5ms
      OsTask_EthFun: OsTaskActivation=1, OsTaskPriority=17, OsTaskSchedule=NON, OsTaskStackSharing=true, OsTaskStackSize=2048, OsTaskType=BASIC, OsTaskAccessingApplication=QMSystem
      OsTask_FotaEv: OsTaskActivation=1, OsTaskPriority=3, OsTaskSchedule=NON, OsTaskStackSharing=false, OsTaskStackSize=1024, OsTaskType=EXTENDED, OsTaskAccessingApplication=QMSystem
      OsTask_FotaFun: OsTaskActivation=1, OsTaskPriority=4, OsTaskSchedule=NON, OsTaskStackSharing=false, OsTaskStackSize=1024, OsTaskType=BASIC, OsTaskAccessingApplication=QMSystem
      OsTask_GaugeFun: OsTaskActivation=1, OsTaskPriority=14, OsTaskSchedule=NON, OsTaskStackSharing=true, OsTaskStackSize=2048, OsTaskType=BASIC, OsTaskAccessingApplication=QMSystem
      OsTask_IdleTask: OsTaskActivation=1, OsTaskPriority=0, OsTaskSchedule=FULL, OsTaskStackSharing=false, OsTaskStackSize=1024, OsTaskType=BASIC, OsTaskIsAutostart=true, OsTaskAccessingApplication=QMSystem
      OsTask_IndFun: OsTaskActivation=1, OsTaskPriority=10, OsTaskSchedule=NON, OsTaskStackSharing=true, OsTaskStackSize=2048, OsTaskType=BASIC, OsTaskAccessingApplication=QMSystem
      OsTask_LinFun: OsTaskActivation=1, OsTaskPriority=13, OsTaskSchedule=NON, OsTaskStackSharing=true, OsTaskStackSize=2048, OsTaskType=BASIC, OsTaskAccessingApplication=QMSystem
      OsTask_Mcal: OsTaskActivation=1, OsTaskPriority=21, OsTaskSchedule=NON, OsTaskStackSharing=true, OsTaskStackSize=2048, OsTaskType=BASIC, OsTaskAccessingApplication=QMSystem
      OsTask_ModeMgt: OsTaskActivation=1, OsTaskPriority=25, OsTaskSchedule=NON, OsTaskStackSharing=false, OsTaskStackSize=1024, OsTaskType=EXTENDED, OsTaskAccessingApplication=QMSystem, OsTaskEventRef=Rte_Ev_Cyclic2_OsTask_ModeMgt_0_10ms, OsTaskEventRef=Rte_Ev_Cyclic_OsTask_ModeMgt_0_10ms
      OsTask_NvmSpeedup: OsTaskActivation=1, OsTaskPriority=7, OsTaskSchedule=NON, OsTaskStackSharing=false, OsTaskStackSize=1024, OsTaskType=EXTENDED, OsTaskEventRef=Rte_Ev_Run_NvMExt_NvMExt_SpeedupRunnable, OsTaskAccessingApplication=QMSystem
      OsTask_SafeApp: OsTaskActivation=1, OsTaskPriority=15, OsTaskSchedule=NON, OsTaskStackSharing=true, OsTaskStackSize=2048, OsTaskType=BASIC, OsTaskAccessingApplication=QMSystem
      OsTask_TripFun: OsTaskActivation=1, OsTaskPriority=6, OsTaskSchedule=NON, OsTaskStackSharing=true, OsTaskStackSize=2048, OsTaskType=BASIC, OsTaskAccessingApplication=QMSystem
      OsTask_WarnFun: OsTaskActivation=1, OsTaskPriority=9, OsTaskSchedule=NON, OsTaskStackSharing=true, OsTaskStackSize=2048, OsTaskType=BASIC, OsTaskAccessingApplication=QMSystem
      OsTask_WdgMngt: OsTaskActivation=1, OsTaskPriority=23, OsTaskSchedule=NON, OsTaskStackSharing=true, OsTaskStackSize=2048, OsTaskType=BASIC, OsTaskAccessingApplication=QMSystem
      OsTask_Diagnostics: OsTaskActivation=1, OsTaskPriority=12, OsTaskSchedule=NON, OsTaskStackSharing=false, OsTaskStackSize=2048, OsTaskType=EXTENDED, OsTaskEventRef=Rte_Ev_Cyclic2_OsTask_Diagnostics_0_10ms, OsTaskEventRef=Rte_Ev_Cyclic_OsTask_Diagnostics_0_100ms, OsTaskEventRef=Rte_Ev_Cyclic_OsTask_Diagnostics_0_10ms, OsTaskAccessingApplication=QMSystem, OsTaskEventRef=Rte_Ev_Cyclic_OsTask_Diagnostics_0_20ms
      OsTask_LSH_16ms: OsTaskActivation=1, OsTaskPriority=1, OsTaskSchedule=NON, OsTaskStackSharing=false, OsTaskStackSize=2048, OsTaskType=EXTENDED, OsTaskAccessingApplication=QMSystem, OsTaskEventRef=Rte_Ev_Cyclic_OsTask_LSH_16ms_0_16ms
      OsTask_SafeBsw: OsTaskActivation=1, OsTaskPriority=16, OsTaskSchedule=NON, OsTaskStackSharing=false, OsTaskStackSize=2048, OsTaskType=EXTENDED, OsTaskEventRef=Rte_Ev_Cyclic_OsTask_SafeBsw_0_10ms, OsTaskEventRef=Rte_Ev_Run_Mdl_SafetyAdapter_Mdl_SafetyAdapter_OnDataRx_B_EBW2, OsTaskEventRef=Rte_Ev_Run_Mdl_SafetyAdapter_Mdl_SafetyAdapter_OnDataRx_B_PKBLP, OsTaskEventRef=Rte_Ev_Run_Mdl_SafetyAdapter_Mdl_SafetyAdapter_OnDataRx_SCSBZR, OsTaskEventRef=Rte_Ev_Run_Mdl_SafetyAdapter_Mdl_SafetyAdapter_OnDataRx_VSCOFF, OsTaskEventRef=Rte_Ev_Run_IoHwAb_IoHwAb_OsTask_SafeBsw_WdgM_CheckPoint_20ms, OsTaskEventRef=Rte_Ev_Cyclic2_OsTask_SafeBsw_0_10ms, OsTaskEventRef=Rte_Ev_Run_SafeNvM_OnDre_SafeNvM_Illumination
      OsTask_MemSer: OsTaskActivation=1, OsTaskPriority=22, OsTaskSchedule=NON, OsTaskStackSharing=false, OsTaskStackSize=4096, OsTaskType=EXTENDED, OsTaskEventRef=Rte_Ev_Cyclic_MemSer_10msLP_0_10ms, OsTaskEventRef=Rte_Ev_Cyclic2_OsTask_MemSer_0_10ms, OsTaskEventRef=Rte_Ev_Cyclic_OsTask_MemSer_0_10ms, OsTaskEventRef=Rte_Ev_Run_Ea_Ea_MainFunction, OsTaskEventRef=Rte_Ev_Run_NvBlockSwComponentType_NvBlockSwComponentTypeRunnable, OsTaskAccessingApplication=QMSystem
      OsTask_IpcUclEv: OsTaskActivation=1, OsTaskPriority=8, OsTaskSchedule=NON, OsTaskStackSharing=false, OsTaskStackSize=4096, OsTaskType=EXTENDED, OsTaskAccessingApplication=QMSystem, OsTaskEventRef=Rte_Ev_Run_CUpdateCdd_CUpdateCdd_OnDre_UpdateResponse, OsTaskEventRef=Rte_Ev_Run_CWarnMsg_Core_Observer_OnDre_UCL_HudWarnStatus, OsTaskEventRef=Rte_Ev_Run_CWarnMsg_Core_Observer_OnDre_UCL_WarnStatus, OsTaskEventRef=Rte_Ev_Run_DmnMgr_CDmnMgr_Impl_MainFunction, OsTaskEventRef=Rte_Ev_Run_DmnMgr_DmnMgr_MonitorDmnExtendShutdownTime, OsTaskEventRef=Rte_Ev_Run_DmnMgr_DmnMgr_MonitorDmnHealthDumpData, OsTaskEventRef=Rte_Ev_Run_DmnMgr_DmnMgr_MonitorDmnHealthDumpHdrInfo, OsTaskEventRef=Rte_Ev_Run_DmnMgr_DmnMgr_MonitorDmnHealthFatalError, OsTaskEventRef=Rte_Ev_Run_DmnMgr_DmnMgr_MonitorDmnHeartBeat, OsTaskEventRef=Rte_Ev_Run_DmnMgr_DmnMgr_MonitorDmnKeepSystemAwake, OsTaskEventRef=Rte_Ev_Run_DmnMgr_DmnMgr_MonitorDmnPowerSystemState, OsTaskEventRef=Rte_Ev_Run_UclProxyCdd_CUclProxyCdd_Impl_MainFunction, OsTaskEventRef=Rte_Ev_Run_UclProxyCdd_OnDre_DiagDIDRequest, OsTaskEventRef=Rte_Ev_Run_UclProxyCdd_OnDre_DiagIOCtrlRequest, OsTaskEventRef=Rte_Ev_Run_UclProxyCdd_OnDre_DiagRoutineRequest, OsTaskEventRef=Rte_Ev_Run_UclProxyCdd_OnDre_DisplaySetPower, OsTaskEventRef=Rte_Ev_Run_UclProxyCdd_OnDre_FRTT_Status, OsTaskEventRef=Rte_Ev_Run_UclProxyCdd_OnDre_FastGaugeInfo, OsTaskEventRef=Rte_Ev_Run_UclProxyCdd_OnDre_HealthDumpGetData, OsTaskEventRef=Rte_Ev_Run_UclProxyCdd_OnDre_HealthDumpGetHdr, OsTaskEventRef=Rte_Ev_Run_UclProxyCdd_OnDre_IlluminationData, OsTaskEventRef=Rte_Ev_Run_UclProxyCdd_OnDre_PowerSystemStateReqChange, OsTaskEventRef=Rte_Ev_Run_UclProxyCdd_OnDre_RTT_Icon, OsTaskEventRef=Rte_Ev_Run_UclProxyCdd_OnDre_RTT_Status, OsTaskEventRef=Rte_Ev_Run_UclProxyCdd_OnDre_RTT_Toggle, OsTaskEventRef=Rte_Ev_Run_UclProxyCdd_OnDre_ShiftPosIndStatus, OsTaskEventRef=Rte_Ev_Run_UclProxyCdd_OnDre_SlowGaugeInfo, OsTaskEventRef=Rte_Ev_Run_UclProxyCdd_OnDre_TT_Status, OsTaskEventRef=Rte_Ev_Run_UclProxyCdd_OnDre_UpdateLongServiceReq, OsTaskEventRef=Rte_Ev_Run_UclProxyCdd_OnDre_UpdateShortServiceReq, OsTaskEventRef=Rte_Ev_Run_UclProxyCdd_OnDre_WarningDisplay, OsTaskEventRef=Rte_Ev_Run_UclProxyCdd_OnDre_WarningExtDisplay, OsTaskEventRef=Rte_Ev_Run_UclProxyCdd_OnDre_DLTControlMessageReponse, OsTaskEventRef=Rte_Ev_Run_UclProxyCdd_OnDre_DLTMessageReadRequest, OsTaskEventRef=Rte_Ev_Run_DltExt_DltExt_OnDreDLTMessageReadAckData
      OsTaskRender: OsTaskActivation=1, OsTaskPriority=2, OsTaskSchedule=FULL, OsTaskStackSharing=false, OsTaskStackSize=4096, OsTaskType=EXTENDED, OsTaskIsAutostart=true, OsTaskAccessingApplication=QMSystem
    14 x OsEvent:
      Rte_Ev_Cyclic_OsTask_SafeBsw_0_10ms
      Rte_Ev_Run_CUpdateCdd_CUpdateCdd_OnDre_UpdateResponse
      Rte_Ev_Run_CWarnMsg_Core_Observer_OnDre_UCL_HudWarnStatus
      Rte_Ev_Run_CWarnMsg_Core_Observer_OnDre_UCL_WarnStatus
      Rte_Ev_Run_DmnMgr_CDmnMgr_Impl_MainFunction
      Rte_Ev_Run_DmnMgr_DmnMgr_MonitorDmnExtendShutdownTime
      Rte_Ev_Run_DmnMgr_DmnMgr_MonitorDmnHealthDumpData
      Rte_Ev_Run_DmnMgr_DmnMgr_MonitorDmnHealthDumpHdrInfo
      Rte_Ev_Run_DmnMgr_DmnMgr_MonitorDmnHealthFatalError
      Rte_Ev_Run_DmnMgr_DmnMgr_MonitorDmnHeartBeat
      Rte_Ev_Run_DmnMgr_DmnMgr_MonitorDmnKeepSystemAwake
      Rte_Ev_Run_DmnMgr_DmnMgr_MonitorDmnPowerSystemState
      Rte_Ev_Run_Ea_Ea_MainFunction
      Rte_Ev_Run_IoHwAb_IoHwAb_OsTask_SafeBsw_WdgM_CheckPoint_20ms
    43 x OsIsr, all with OsIsrCategory=CATEGORY_2, OsIsrEnableNesting=false, OsIsrEnableSource=false, OsIsrMpuMemoryOrder=CACHEABLE_WRITEBACK_ALLOCATE, OsIsrMpuPermission=EXECUTE_FORBIDDEN, OsIsrStackSize=2048:
      McuOsGptIsr: OsIsrApplicationApi=osTimerInterruptfunc, OsIsrInterruptSource=28, OsIsrPriority=0
      McuCan0RxTxIsr: OsIsrApplicationApi=Can_0_Int0ISRfunc, OsIsrInterruptSource=43, OsIsrPriority=1
      McuCan1RxTxIsr: OsIsrApplicationApi=Can_1_Int0ISRfunc, OsIsrInterruptSource=46, OsIsrPriority=2
      McuSpi0NvmRxTxIsr: OsIsrApplicationApi=Spi_IrqUnitMcuMcspi0TxRxfunc, OsIsrInterruptSource=207, OsIsrPriority=6
      McuDss0Isr: OsIsrApplicationApi=Dss_0_Isrfunc, OsIsrInterruptSource=40, OsIsrPriority=8
      McuI2c3IoIsr: OsIsrApplicationApi=McuI2c3IoIsrfunc, OsIsrInterruptSource=196, OsIsrPriority=12
      Eth_TxIrqHdlr_0: OsIsrApplicationApi=Eth_TxIrqHdlr_0func, OsIsrInterruptSource=66, OsIsrPriority=8
      Eth_RxIrqHdlr_0: OsIsrApplicationApi=Eth_RxIrqHdlr_0func, OsIsrInterruptSource=67, OsIsrPriority=9
      Eth_MdioIrqHdlr: OsIsrApplicationApi=Eth_MdioIrqHdlrfunc, OsIsrInterruptSource=135, OsIsrPriority=12
      FltM_WkupEsmHiInterrupt: OsIsrApplicationApi=FltM_WkupEsmHiInterruptfunc, OsIsrInterruptSource=141, OsIsrPriority=9
      MCU_IntrISR_UART0: OsIsrApplicationApi=MCU_IntrISR_UART0func, OsIsrInterruptSource=217, OsIsrPriority=17
      McuI2c0PmicIsr: OsIsrApplicationApi=McuI2c0PmicIsrfunc, OsIsrInterruptSource=197, OsIsrPriority=13
      Gpt_Ch3Isr: OsIsrApplicationApi=Gpt_Ch3Isrfunc, OsIsrInterruptSource=138, OsIsrPriority=14
      Gpt_Ch4Isr: OsIsrApplicationApi=Gpt_Ch4Isrfunc, OsIsrInterruptSource=139, OsIsrPriority=16
      Spi_IrqUnitMcspi2TxRx: OsIsrApplicationApi=Spi_IrqUnitMcspi2TxRxfunc, OsIsrInterruptSource=206, OsIsrPriority=21
      MCU_ISR_6: OsIsrApplicationApi=MCU_ISR_6func, OsIsrInterruptSource=106, OsIsrPriority=15
      MAIN_ISR_34: OsIsrApplicationApi=MAIN_ISR_34func, OsIsrInterruptSource=32, OsIsrPriority=18
      MAIN_ISR_35: OsIsrApplicationApi=MAIN_ISR_35func, OsIsrInterruptSource=33, OsIsrPriority=19
      MCU_ISR_7: OsIsrApplicationApi=MCU_ISR_7func, OsIsrInterruptSource=107, OsIsrPriority=20
      FltM_WkupEsmCfgInterrupt: OsIsrApplicationApi=FltM_WkupEsmCfgInterruptfunc, OsIsrInterruptSource=140, OsIsrPriority=10
      FltM_WkupEsmLowInterrupt: OsIsrApplicationApi=FltM_WkupEsmLowInterruptfunc, OsIsrInterruptSource=142, OsIsrPriority=11
      Spi_IrqUnitMcspi0TxRx: OsIsrApplicationApi=Spi_IrqUnitMcspi0TxRxfunc, OsIsrInterruptSource=204, OsIsrPriority=22
      MainI2c2RtcIsr: OsIsrApplicationApi=MainI2c2RtcIsrfunc, OsIsrInterruptSource=195, OsIsrPriority=23
      MCU_ResetIsolationReq: OsIsrApplicationApi=MCU_ResetIsolationReqfunc, OsIsrInterruptSource=101, OsIsrPriority=24
      FltM_FwlExceptionInterrupt: OsIsrApplicationApi=FltM_FwlExceptionInterruptfunc, OsIsrInterruptSource=20, OsIsrPriority=25
      Cdd_IpcIrqMbxFromWKUP_R5FSS0_0: OsIsrApplicationApi=Cdd_IpcIrqMbxFromWKUP_R5FSS0_0func, OsIsrInterruptSource=242, OsIsrPriority=26
      Mcu_Udma_Vintr64: OsIsrApplicationApi=Mcu_Udma_Vintr64func, OsIsrInterruptSource=64, OsIsrPriority=27
      Mcu_Udma_Vintr65: OsIsrApplicationApi=Mcu_Udma_Vintr65func, OsIsrInterruptSource=65, OsIsrPriority=28
      Mcu_Udma_Vintr66: OsIsrApplicationApi=Mcu_Udma_Vintr66func, OsIsrInterruptSource=66, OsIsrPriority=29
      Mcu_Udma_Vintr67: OsIsrApplicationApi=Mcu_Udma_Vintr67func, OsIsrInterruptSource=67, OsIsrPriority=30
      Mcu_Udma_Vintr68: OsIsrApplicationApi=Mcu_Udma_Vintr68func, OsIsrInterruptSource=68, OsIsrPriority=31
      Mcu_Udma_Vintr69: OsIsrApplicationApi=Mcu_Udma_Vintr69func, OsIsrInterruptSource=69, OsIsrPriority=32
      Mcu_Udma_Vintr70: OsIsrApplicationApi=Mcu_Udma_Vintr70func, OsIsrInterruptSource=70, OsIsrPriority=33
      Mcu_Udma_Vintr71: OsIsrApplicationApi=Mcu_Udma_Vintr71func, OsIsrInterruptSource=71, OsIsrPriority=34
      Mcu_Udma_Vintr72: OsIsrApplicationApi=Mcu_Udma_Vintr72func, OsIsrInterruptSource=72, OsIsrPriority=35
      Mcu_Udma_Vintr73: OsIsrApplicationApi=Mcu_Udma_Vintr73func, OsIsrInterruptSource=73, OsIsrPriority=36
      Mcu_Udma_Vintr74: OsIsrApplicationApi=Mcu_Udma_Vintr74func, OsIsrInterruptSource=74, OsIsrPriority=37
      Mcu_Udma_Vintr75: OsIsrApplicationApi=Mcu_Udma_Vintr75func, OsIsrInterruptSource=75, OsIsrPriority=38
      Mcu_Udma_Vintr76: OsIsrApplicationApi=Mcu_Udma_Vintr76func, OsIsrInterruptSource=76, OsIsrPriority=39
      Mcu_Udma_Vintr77: OsIsrApplicationApi=Mcu_Udma_Vintr77func, OsIsrInterruptSource=77, OsIsrPriority=40
      Mcu_Udma_Vintr78: OsIsrApplicationApi=Mcu_Udma_Vintr78func, OsIsrInterruptSource=78, OsIsrPriority=41
      Mcu_Udma_Vintr79: OsIsrApplicationApi=Mcu_Udma_Vintr79func, OsIsrInterruptSource=79, OsIsrPriority=42
      MainI2c1DacIsr: OsIsrApplicationApi=MainI2c1DacIsrfunc, OsIsrInterruptSource=194, OsIsrPriority=43
    OsCoreAsr0 (OsCore):
      OsCoreIsAutosar = true
      OsSystemStackMpuMemoryOrder = CACHEABLE_WRITEBACK_ALLOCATE
      OsSystemStackMpuPermission = EXECUTE_ALLOWED
      OsSystemStackSize = 4096
      OsCoreOwnAppRef = TrustedSystem
      OsCoreOwnHookRef = OsHooks
      OsHookConfigList_Core0 (OsCoreHooks)
    OsDerivative: OsTimerReloadValue=4294942294, OsDerivativeIncludeHeader=
      OsCpuCore
        ARMCortexR5: OSCpuCoreDerivative=TIAM62P, OsTimerSelection=MCU_TIMER0
    OsGeneral:
      ExtendedConformanceClassType = ECC1
      MosUseScheduleLog = false
      MosVersionInfoApi = true
      OsCompilerSetttings = CLANG
      OsMpuBackroundRegionRegister = false
      OsMpuSetting = OSAPPLICATIONS_PROTECTION
      OsMpuStackRegionNumber = 12
      OsTestingLocal = false
      OsHooksIncludeHeader = Stubs.h
      OsHooksIncludeHeader = OsError.h
      OsHooksIncludeHeader = OsPrvTypes.h
      OsHooksIncludeHeader = Det.h
      OsHooksIncludeHeader = FltMExt.h
      OsTrustedServiceIncludeHeader = Rte_Type.h
    SystemTimer (OsCounter): OsCounterMaxAllowedValue=65535, OsCounterMinValue=0, OsCounterTicksPerBase=1, OsCounterType=HARDWARE, OsSecondsPerTick=0.001, OsCounterMinCycle=1
    32 x OsEvent:
      Rte_Ev_Run_Mdl_SafetyAdapter_Mdl_SafetyAdapter_OnDataRx_B_EBW2
      Rte_Ev_Run_Mdl_SafetyAdapter_Mdl_SafetyAdapter_OnDataRx_B_PKBLP
      Rte_Ev_Run_Mdl_SafetyAdapter_Mdl_SafetyAdapter_OnDataRx_SCSBZR
      Rte_Ev_Run_Mdl_SafetyAdapter_Mdl_SafetyAdapter_OnDataRx_VSCOFF
      Rte_Ev_Run_NvBlockSwComponentType_NvBlockSwComponentTypeRunnable
      Rte_Ev_Run_NvMExt_NvMExt_SpeedupRunnable
      Rte_Ev_Run_SafeNvM_OnDre_SafeNvM_Illumination
      Rte_Ev_Run_SlowGaugeAdapter_SlowGaugeAdapter_Task
      Rte_Ev_Run_UclProxyCdd_CUclProxyCdd_Impl_MainFunction
      Rte_Ev_Run_UclProxyCdd_OnDre_DLTControlMessageReponse
      Rte_Ev_Run_UclProxyCdd_OnDre_DLTMessageReadRequest
      Rte_Ev_Run_UclProxyCdd_OnDre_DiagDIDRequest
      Rte_Ev_Run_UclProxyCdd_OnDre_DiagIOCtrlRequest
      Rte_Ev_Run_UclProxyCdd_OnDre_DiagRoutineRequest
      Rte_Ev_Run_UclProxyCdd_OnDre_DisplaySetPower
      Rte_Ev_Run_UclProxyCdd_OnDre_FRTT_Status
      Rte_Ev_Run_UclProxyCdd_OnDre_FastGaugeInfo
      Rte_Ev_Run_UclProxyCdd_OnDre_HealthDumpGetData
      Rte_Ev_Run_UclProxyCdd_OnDre_HealthDumpGetHdr
      Rte_Ev_Run_UclProxyCdd_OnDre_IlluminationData
      Rte_Ev_Run_UclProxyCdd_OnDre_PowerSystemStateReqChange
      Rte_Ev_Run_UclProxyCdd_OnDre_RTT_Icon
      Rte_Ev_Run_UclProxyCdd_OnDre_RTT_Status
      Rte_Ev_Run_UclProxyCdd_OnDre_RTT_Toggle
      Rte_Ev_Run_UclProxyCdd_OnDre_ShiftPosIndStatus
      Rte_Ev_Run_UclProxyCdd_OnDre_SlowGaugeInfo
      Rte_Ev_Run_UclProxyCdd_OnDre_TT_Status
      Rte_Ev_Run_UclProxyCdd_OnDre_UpdateLongServiceReq
      Rte_Ev_Run_UclProxyCdd_OnDre_UpdateShortServiceReq
      Rte_Ev_Run_UclProxyCdd_OnDre_WarningDisplay
      Rte_Ev_Run_UclProxyCdd_OnDre_WarningExtDisplay
      Rte_Ev_Run_DltExt_DltExt_OnDreDLTMessageReadAckData
    OsMpu_QMSystem (OsMpu)
      7 x OsMpuRegion, all with OsMpuSubRegion=0:
        OsMpuRegion: OsMpuRegionAccess=S_RW_U_R, OsMpuRegionBaseAddress=0x00000000, OsMpuRegionMemoryOrder=CACHEABLE_WRITEBACK_ALLOCATE, OsMpuRegionNumber=6, OsMpuRegionPermission=EXECUTE_ALLOWED, OsMpuRegionSize=32768
        OsMpuRegion1: OsMpuRegionAccess=S_R_U_R, OsMpuRegionBaseAddress=0x41010400, OsMpuRegionMemoryOrder=CACHEABLE_WRITEBACK_ALLOCATE, OsMpuRegionNumber=5, OsMpuRegionPermission=EXECUTE_ALLOWED, OsMpuRegionSize=32768
        OsMpuRegion2: OsMpuRegionAccess=S_RW_U_RW, OsMpuRegionBaseAddress=0x79120000, OsMpuRegionMemoryOrder=CACHEABLE_WRITEBACK_ALLOCATE, OsMpuRegionNumber=3, OsMpuRegionPermission=EXECUTE_FORBIDDEN, OsMpuRegionSize=131072
        OsMpuRegion3: OsMpuRegionAccess=S_RW_U_R, OsMpuRegionBaseAddress=0x79140000, OsMpuRegionMemoryOrder=CACHEABLE_WRITEBACK_ALLOCATE, OsMpuRegionNumber=10, OsMpuRegionPermission=EXECUTE_FORBIDDEN, OsMpuRegionSize=32768
        OsMpuRegion4: OsMpuRegionAccess=S_R_U_R, OsMpuRegionBaseAddress=0x79120000, OsMpuRegionMemoryOrder=CACHEABLE_WRITEBACK_ALLOCATE, OsMpuRegionNumber=11, OsMpuRegionPermission=EXECUTE_FORBIDDEN, OsMpuRegionSize=65536
        OsMpuRegion5: OsMpuRegionAccess=S_RW_U_RW, OsMpuRegionBaseAddress=0x04000000, OsMpuRegionMemoryOrder=STRONGLY_ORDERED, OsMpuRegionNumber=13, OsMpuRegionPermission=EXECUTE_FORBIDDEN, OsMpuRegionSize=67108864
        OsMpuRegion6: OsMpuRegionAccess=S_RW_U_R, OsMpuRegionBaseAddress=0x07FF0000, OsMpuRegionMemoryOrder=STRONGLY_ORDERED, OsMpuRegionNumber=14, OsMpuRegionPermission=EXECUTE_ALLOWED, OsMpuRegionSize=16384
    6 x OsEvent:
      Gfx_Ev_RdrInit: OsEventMask=1
      Gfx_Ev_RdrInitDone: OsEventMask=2
      Gfx_Ev_RdrDeinit: OsEventMask=4
      Gfx_Ev_RdrDeinitDone: OsEventMask=8
      Gfx_Ev_RdrStart: OsEventMask=16
      Gfx_Ev_VSync: OsEventMask=32
package /PlatformTypes/BaseTypes
  16 x impl type:
    osuint8: category=VALUE, base-type=uint8
    osuint16: category=VALUE, base-type=uint16
    osuint32: category=VALUE, base-type=uint32
    osuint64: category=VALUE, base-type=uint64
    osint8: category=VALUE, base-type=sint8
    osint16: category=VALUE, base-type=sint16
    osint32: category=VALUE, base-type=sint32
    osint64: category=VALUE, base-type=sint64
    osbool: implementation-data-type=osuint8
    osfloat32: category=VALUE, base-type=float32
    osfloat64: category=VALUE, base-type=float64
    osCpuStackType: implementation-data-type=osuint32
    osCpuTaskAddressType: implementation-data-type=osuint32
    osCpuTaskPriorityBitType: implementation-data-type=osuint32
    osCpuIntGlobalType: implementation-data-type=osuint32
    osCpuMemoryAddressType: implementation-data-type=osuint32
