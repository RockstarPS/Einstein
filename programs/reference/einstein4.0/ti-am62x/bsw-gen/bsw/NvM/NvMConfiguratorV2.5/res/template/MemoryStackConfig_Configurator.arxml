AUTOSAR XML (schema 4-2-1)
package /ActiveEcuC
  module config NvM: implementation-config-variant=VARIANT-PRE-COMPILE, module-description=NvM_Impl
    NvMConfigBlock (NvMBlockDescriptor):
      NvMBlockCrcType = NVM_CRC16
      NvMBlockManagementType = NVM_BLOCK_REDUNDANT
      NvMInitBlockCallback = NULL_PTR
      NvMResistantToChangedSw = true
      NvMSelectBlockForReadAll = true
      NvMSelectBlockForWriteAll = true
      NvMUseInitCallback = false
      NvMUseJobendCallback = false
      NvMSingleBlockCallback = NULL_PTR
      NvMBswMBlockStatusInformation = false
      NvMBlockUseCrc = true
      NvMBlockUseSyncMechanism = false
      NvMCalcRamBlockCrc = false
      NvMUseServicePorts = false
      NvMNvramBlockIdentifier = 1
      NvMNvBlockNum = 2
      NvMNvBlockLength = 2
      NvMRomBlockDataAddress = NULL_PTR
      NvMBlockJobPriority = 127
      NvMBlockWriteProt = false
      NvMRamBlockDataAddress = NULL_PTR
      NvMReadRamBlockFromNvCallback = NULL_PTR
      NvMWriteBlockOnce = false
      NvMWriteRamBlockToNvCallback = NULL_PTR
      NvMAutomaticBlockLength = false
      NvMBlockLengthCheck = false
      NvMBlockLengthCheckType = true
      NvMTargetBlockReference
        NvMFeeRef: NvMNameOfFeeBlock=FeeConfigBlock
    NvMCommon:
      NvMDevErrorDetect = true
      NvMVersionInfoApi = false
      NvMApiConfigClass = NVM_API_CONFIG_CLASS_3
      NvMBswMMultiBlockJobStatusInformation = false
      NvMCompiledConfigId = 1
      NvMCrcNumOfBytes = 64
      NvMDatasetSelectionBits = 1
      NvMDrvModeSwitch = flase
      NvMDynamicConfiguration = false
      NvMJobPrioritization = false
      NvMMultiBlockCallback = NvM_MultiBlockJobEndNotification
      NvMPollingMode = false
      NvMSetRamBlockStatusApi = true
      NvMSizeStandardJobQueue = 4
      NvMMaxNoOfWriteRetries = 1
      NvMMainFunctionPeriod = 0.01
      NvMRepairRedundantBlocksApi = true
      NvMUseBlockIdCheck = true
    NvMCommonVendorParams:
      NvMCfgIncludeDem = Dem.h
      NvMSeterror = Dem_ReportErrorStatus
      NvMMultiblockId = MultiBlockRequest
      NvMCrcIntBuffer = true
      NvMKillWriteAllApi = true
      NvMCfgCbkIncludeList = Rte_Cbk.h
      NvMCfgCbkIncludeList = EcuMExt.h
      NvMCfgCbkIncludeList = Rte_Cbk.h
      NvMCfgCbkIncludeList = Dem_Cbk.h
      NvMDevErrorChecks: NvMCfgIncludeDet=Det.h, NvMErrorhook=Det_ReportError, NvMDebugReporting=true
    NvmDemEventParameterRefs:
      NVM_E_INTEGRITY_FAILED = NVM_E_INTEGRITY_FAILED
      NVM_E_LOSS_OF_REDUNDANCY = NVM_E_LOSS_OF_REDUNDANCY
      NVM_E_QUEUE_OVERFLOW = NVM_E_QUEUE_OVERFLOW
      NVM_E_REQ_FAILED = NVM_E_REQ_FAILED
      NVM_E_VERIFY_FAILED = NVM_E_VERIFY_FAILED
      NVM_E_WRITE_PROTECTED = NVM_E_WRITE_PROTECTED
      NVM_E_WRONG_BLOCK_ID = NVM_E_WRONG_BLOCK_ID
    3 x NvMBlockDescriptor, all with NvMBlockCrcType=NVM_CRC16, NvMBlockManagementType=NVM_BLOCK_NATIVE, NvMInitBlockCallback=NULL_PTR, NvMResistantToChangedSw=true, NvMSelectBlockForReadAll=true, NvMSelectBlockForWriteAll=false, NvMUseInitCallback=false, NvMUseJobendCallback=true, NvMBswMBlockStatusInformation=false, NvMBlockUseCrc=true, NvMBlockUseSyncMechanism=true, NvMCalcRamBlockCrc=false, NvMUseServicePorts=true, NvMNvBlockNum=2, NvMBlockWriteProt=false, NvMRamBlockDataAddress=NULL_PTR, NvMWriteBlockOnce=false, NvMAutomaticBlockLength=false, NvMBlockLengthCheck=true, NvMBlockLengthCheckType=true:
      NvBlockSwComponentTypeNVBlockDescriptor_ClusterSettings: NvMSingleBlockCallback=ClusterSettings_NvM_JobFinished, NvMNvramBlockIdentifier=2, NvMNvBlockLength=208, NvMRomBlockDataAddress=Rte_NvBlockSwComponentType_NVBlockDescriptor_ClusterSettings_ROM_NVBlockDescriptor_ClusterSettings, NvMBlockJobPriority=1, NvMReadRamBlockFromNvCallback=Rte_SetMirror_NvBlockSwComponentType_NVBlockDescriptor_ClusterSettings, NvMWriteRamBlockToNvCallback=Rte_GetMirror_NvBlockSwComponentType_NVBlockDescriptor_ClusterSettings
        NvMTargetBlockReference
          NvMFeeRef: NvMNameOfFeeBlock=Fee_ClusterSettings
      NvBlockSwComponentTypeNVBlockDescriptor_Traceability: NvMSingleBlockCallback=Traceability_NvM_JobFinished, NvMNvramBlockIdentifier=3, NvMNvBlockLength=142, NvMRomBlockDataAddress=Rte_NvBlockSwComponentType_NVBlockDescriptor_Traceability_ROM_NVBlockDescriptor_Traceability, NvMBlockJobPriority=2, NvMReadRamBlockFromNvCallback=Rte_SetMirror_NvBlockSwComponentType_NVBlockDescriptor_Traceability, NvMWriteRamBlockToNvCallback=Rte_GetMirror_NvBlockSwComponentType_NVBlockDescriptor_Traceability
        NvMTargetBlockReference
          NvMFeeRef: NvMNameOfFeeBlock=Fee_Traceability
      NvBlockSwComponentTypeNVBlockDescriptor_ConfigSettings: NvMSingleBlockCallback=ConfigSettings_NvM_JobFinished, NvMNvramBlockIdentifier=4, NvMNvBlockLength=77, NvMRomBlockDataAddress=Rte_NvBlockSwComponentType_NVBlockDescriptor_ConfigSettings_ROM_NVBlockDescriptor_ConfigSettings, NvMBlockJobPriority=3, NvMReadRamBlockFromNvCallback=Rte_SetMirror_NvBlockSwComponentType_NVBlockDescriptor_ConfigSettings, NvMWriteRamBlockToNvCallback=Rte_GetMirror_NvBlockSwComponentType_NVBlockDescriptor_ConfigSettings
        NvMTargetBlockReference
          NvMFeeRef: NvMNameOfFeeBlock=Fee_ConfigSettings
  module config Fee: implementation-config-variant=VARIANT-PRE-COMPILE, module-description=Fee_Impl
    FeeGeneral:
      FeeDevErrorDetect = true
      FeeVersionInfoApi = false
      FeePollingMode = false
      FeeSetModeSupported = true
      FeeIndex = 0
      FeeNvmJobEndNotification = NvM_JobEndNotification
      FeeNvmJobErrorNotification = NvM_JobErrorNotification
      FeeInternalBufferSize = 64
      FeeMainFunctionPeriod = 0.01
      FeeNvmCbkIncludeFile = NvM_Cbk.h
      FeeMainFunctionTriggering = FixedCycleTime
      FeeDevErrorChecks: FeeDebugReporting=true, FeeDetErrorhook=Det_ReportError, FeeDetIncludeFile=Det.h
      FeeFlsApi:
        FeeFlsIncludeFile = NvMExt_Stubs.h
        FeeFlsSetMode = Fls_SetMode
        FeeFlsRead = NvmExt_Stubs_FlsRead
        FeeFlsWrite = NvmExt_Stubs_FlsWrite
        FeeFlsCancel = Fls_Cancel
        FeeFlsGetStatus = Fls_GetStatus
        FeeFlsGetJobResult = Fls_GetJobResult
        FeeFlsErase = Fls_Erase
        FeeFlsCompare = Fls_Compare
        FeeFlsDeviceIndex = FlsGeneral
    FeeSpecificFeatures:
      FeeApplErrorCallbackFunction = Appl_FeeCriticalErrorCallback
      FeeApplErrorCallbackIncludeFile = ApplMain.h
      FeeGetEraseCycleApi = false
      FeeGetWriteCycleApi = false
      FeeUseApplErrorCallback = false
      FeeUseJobCache = false
      FeeForceSectorSwitchApi = false
      FeeDataConversionApi = false
      FeeFblConfig = false
      FeeMaxLinkTableSize = 4095
      FeeFssControlApi = false
    FeePublishedInformation: FeeBlockOverhead=2, FeeMaximumBlockingTime=1, FeePageOverhead=0, FeeChunkHeader=16, FeeChunkLink=8, FeeSectorHeader=8
    4 x FeePartitionConfiguration, all with FeeBssThresholdReserved=3072, FeeFssThresholdReserved=1024, FeeAddressAlignment=8, FeeWriteAlignment=8, FeeUpperSectorSize=8192, FeeLowerSectorSize=8192, FeePartitionDevice=FlsConfigSet_0:
      FeePartitionConfiguration_DIAG: FeeLowerSectorAddress=8192, FeeUpperSectorAddress=65536
      FeePartitionConfiguration_ODO: FeeLowerSectorAddress=24576, FeeUpperSectorAddress=81920
      FeePartitionConfiguration_SIGMA_FEE_BLK_1: FeeLowerSectorAddress=32768, FeeUpperSectorAddress=90112
      FeePartitionConfiguration_SIGMA_FEE_BLK_2: FeeLowerSectorAddress=49152, FeeUpperSectorAddress=106496
    4 x FeeBlockConfiguration, all with FeeBlockIdFixed=false, FeeBlockIsCritical=false, FeeNumberOfChunkInstances=1, FeeDeviceIndex=FlsGeneral:
      FeeConfigBlock: FeeImmediateData=false, FeeBlockNumber=42, FeeBlockSize=4, FeeNumberOfWriteCycles=10000, FeeNumberOfDatasets=2, FeeBlockId=2, FeePartition=FeePartitionConfiguration_DIAG
      Fee_ClusterSettings: FeeImmediateData=true, FeeBlockNumber=1, FeeBlockSize=216, FeeNumberOfWriteCycles=10000, FeeNumberOfDatasets=1, FeeBlockId=1, FeePartition=FeePartitionConfiguration_CALIB
      Fee_Traceability: FeeImmediateData=true, FeeBlockNumber=2, FeeBlockSize=144, FeeNumberOfWriteCycles=10000, FeeNumberOfDatasets=1, FeeBlockId=1, FeePartition=FeePartitionConfiguration_DIAG
      Fee_ConfigSettings: FeeImmediateData=true, FeeBlockNumber=3, FeeBlockSize=80, FeeNumberOfWriteCycles=40000, FeeNumberOfDatasets=1, FeeBlockId=1, FeePartition=FeePartitionConfiguration_CUSTOM
