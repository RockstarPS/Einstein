AUTOSAR XML (schema 00050)
package /VT
  module config WdgM
    WdgMConfigSet: WdgMEnterCriticalSection=SuspendAllInterrupts(), WdgMExitCriticalSection=ResumeAllInterrupts(), WdgMInitialMode=WdgMMode
      WdgMMode: WdgMExpiredSupervisionCycleTol=0, WdgMModeId=0, WdgMSupervisionCycle=10.0
        WdgMAliveSupervision:
          WdgMExpectedAliveIndications = 10
          WdgMMaxMargin = 12
          WdgMMinMargin = 8
          WdgMSupervisionReferenceCycle = 10
          WdgMAliveSupervisionCheckpointRef = WdgMCheckpoint
        WdgMDeadlineSupervision: WdgMDeadlineMax=65535.0, WdgMDeadlineMin=255.0, WdgMDeadlineStartRef=WdgMCheckpoint, WdgMDeadlineStopRef=WdgMCheckpoint
        WdgMDeadlineTransition: WdgMDeadlineTransitionIndex=0, WdgMDealineTransitionCount=0
        WdgMExternalLogicalSupervision: WdgMExternalCheckpointFinalRef=WdgMCheckpoint, WdgMExternalCheckpointInitialRef=WdgMCheckpoint
        WdgMLocalStatusParams: WdgMFailedAliveSupervisionRefCycleTol=0, WdgMFailedDeadlineSupervisionRefCycleTol=0, WdgMLocalStatusSupervisedEntityRef=WdgMSupervisedEntity
        WdgMVariantConfig:
          WdgMNumOfSupervisedEntity = 1
          WdgMNumOfWdgDevices = 1
          WdgMVariantConfExpiredSupervisionCycleTol = 0
          WdgMVariantConfSupervisedEntityRef = WdgMSupervisedEntity
          WdgVariantConfTriggerRef = WdgMTrigger
        3 x WdgMAliveSupervision, all with WdgMExpectedAliveIndications=10, WdgMMaxMargin=12, WdgMMinMargin=8, WdgMAliveSupervisionCheckpointRef=WdgMCheckpoint:
          WdgMAliveSupervision1: WdgMSupervisionReferenceCycle=20
          WdgMAliveSupervision2: WdgMSupervisionReferenceCycle=30
          WdgMAliveSupervision3: WdgMSupervisionReferenceCycle=10
        WdgMTrigger: WdgMTriggerConditionValue=75, WdgMWatchdogMode=WDGIF_SLOW_MODE
    WdgMGeneral:
      WdgMDemStoppedSupervisionReport = false
      WdgMDevErrorDetect = true
      WdgMImmediateReset = true
      WdgMOffModeEnabled = true
      WdgMPostBuildVariantSupport = false
      WdgMVersionInfoApi = false
      WdgMHeaderFileInclusion = WdgIf_Cfg.h
      WdgMHeaderFileInclusion = Stubs.h
      WdgMHeaderFileInclusion = Std_Types.h
      WdgMHeaderFileInclusion = Os.h
      WdgMHeaderFileInclusion = Wdg.h
      WdgMTimeoutConfig: WdgMTimeoutValue=512
      WdgMSupervisedEntity:
        WdgMAliveSupervisionIndex = 0
        WdgMDeadlineSupervisionIndex = 0
        WdgMLocalStateChangeCbk = 0
        WdgMNumOfAliveSupervision = 4
        WdgMNumOfDeadlineSupervision = 0
        WdgMSupervisedEntityId = 0
        WdgMWatchdogMode = WDGM_SLOW_MODE
        WdgMInternalCheckpointInitialRef = WdgMCheckpoint
        WdgMInternallCheckpointFinalRef = WdgMCheckpoint
        WdgMCheckpoint: WdgMCheckpointId=0
