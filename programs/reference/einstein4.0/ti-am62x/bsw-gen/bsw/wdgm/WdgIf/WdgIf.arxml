AUTOSAR XML (schema 00050)
package /VT
  module config WdgIf
    WdgIfDevice: WdgIfDeviceIndex=0, WdgIfDeviceSetMode=WdgmExt_SetMode, WdgIfDeviceSetTriggerCondition=WdgmExt_SetTriggerCondition, WdgIfDriverRef=WdgGeneral
    WdgIfGeneral:
      WdgIfDevErrorDetect = true
      WdgIfVersionInfoApi = false
      WdgIfHeaderFileInclusion = WdgIf_Types.h
      WdgIfHeaderFileInclusion = Std_Types.h
      WdgIfHeaderFileInclusion = WdgIf.h
      WdgIfHeaderFileInclusion = PmicCdd.h
      WdgIfHeaderFileInclusion = WdgMExt.h
