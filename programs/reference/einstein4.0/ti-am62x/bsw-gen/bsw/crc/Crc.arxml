AUTOSAR XML (schema 00050)
package /VT
  module config Crc
    CrcGeneral:
      Crc16Mode = CRC_16_RUNTIME
      Crc32Mode = CRC_32_RUNTIME
      Crc32P4Mode = CRC_32P4_TABLE
      Crc64Mode = CRC_64_RUNTIME
      Crc8H2FMode = CRC_8H2F_RUNTIME
      Crc8Mode = CRC_8_RUNTIME
