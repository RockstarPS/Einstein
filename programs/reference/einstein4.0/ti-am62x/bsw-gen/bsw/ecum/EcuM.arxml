AUTOSAR XML (schema 00050)
package /PlatformTypes/BaseTypes
  module config EcuM
    EcuMConfiguration
      EcuMCommonConfiguration:
        EcuMEnterCriticalSection = SuspendAllInterrupts()
        EcuMExitCriticalSection = ResumeAllInterrupts()
        EcuMGlobalInterruptsEnable = EnableAllInterrupts()
        EcuMGlobalInterruptsDisable = DisableAllInterrupts()
        EcuMEnableSleepModeList = true
        EcuMOSResource = RES_SCHEDULER
        EcuMDefaultAppMode = OSDEFAULTAPPMODE
        7 x EcuMWakeupSource:
          ECUM_WKSOURCE_POWER: EcuMWakeupSourceId=1, EcuMWakeupSourcePolling=true, EcuMCheckWakeupTimeout=0.0
          ECUM_WKSOURCE_RESET: EcuMWakeupSourceId=2, EcuMWakeupSourcePolling=true
          ECUM_WKSOURCE_INTERNAL_RESET: EcuMWakeupSourceId=4, EcuMWakeupSourcePolling=false
          ECUM_WKSOURCE_INTERNAL_WDG: EcuMWakeupSourceId=8, EcuMWakeupSourcePolling=false
          ECUM_WKSOURCE_EXTERNAL_WDG: EcuMWakeupSourceId=16, EcuMWakeupSourcePolling=false
          ECUM_WKSOURCE_WAKEUP_RESET: EcuMWakeupSourceId=0, EcuMWakeupSourcePolling=false
          ECUM_WKSOURCE_CAN: EcuMWakeupSourceId=0, EcuMWakeupSourcePolling=false
        EcuMDefaultShutdownTarget:
          EcuMMaxResetMode = 4
          EcuMDefaultShutdownTarget = EcuMShutdownTargetSleep
          EcuMDefaultState = EcuMStateOff
          EcuMDefaultSleepModeRef = HALT
          EcuMDefaultResetModeRef = ECUM_CFG_WKSOURCE_ECUM_WKSOURCE_POWER
        HALT (EcuMSleepMode):
          EcuMSleepModeMcuModeRef = ECUM_DEFAULT_SLEEP_MODE_REF
          EcuMWakeupSourceMask = ECUM_WKSOURCE_WAKEUP_RESET
          EcuMWakeupSourceMask = ECUM_WKSOURCE_INTERNAL_WDG
          EcuMWakeupSourceMask = ECUM_WKSOURCE_POWER
          EcuMWakeupSourceMask = ECUM_WKSOURCE_RESET
          EcuMWakeupSourceMask = ECUM_WKSOURCE_INTERNAL_RESET
          EcuMWakeupSourceMask = ECUM_WKSOURCE_EXTERNAL_WDG
          EcuMWakeupSourceMask = ECUM_WKSOURCE_CAN
          EcuMWakeupSourceMask = ECUM_WKSOURCE_WAKEUP_RESET
          EcuMWakeupSourceMask = ECUM_WKSOURCE_IGN
        POLLING (EcuMSleepMode):
          EcuMSleepModeId = 1
          EcuMSleepModeSuspend = false
          EcuMSleepModeMcuModeRef = ECUM_DEFAULT_SLEEP_MODE_REF
          EcuMWakeupSourceMask = ECUM_WKSOURCE_POWER
          EcuMWakeupSourceMask = ECUM_WKSOURCE_RESET
          EcuMWakeupSourceMask = ECUM_WKSOURCE_INTERNAL_RESET
          EcuMWakeupSourceMask = ECUM_WKSOURCE_INTERNAL_WDG
          EcuMWakeupSourceMask = ECUM_WKSOURCE_EXTERNAL_WDG
        ECUM_WKSOURCE_IGN (EcuMWakeupSource): EcuMWakeupSourceId=0, EcuMWakeupSourcePolling=false
        ECUM_WKSOURCE_RTC (EcuMWakeupSource): EcuMWakeupSourceId=0, EcuMWakeupSourcePolling=false
      EcuMFixedConfiguration:
        EcuMNvramReadallTimeout = 0.0
        EcuMNvramWriteallTimeout = 10000.0
        EcuMRunMinimumDuration = 500.0
        EcuMNormalMcuModeRef = 0xFF
        EcuMComMCommunicationAllowedList = ECUM_NO_COMM_CHANNEL
        EcuMDriverInitListThree
          EcuMDriverInitItem: EcuMModuleParameter=NULL_PTR, EcuMModuleRef=EcuM
        EcuMDriverInitListTwo
          EcuMDriverInitItem: EcuMModuleParameter=NULL_PTR, EcuMModuleRef=EcuM
        EcuMFixedUserConfig: EcuMFixedUser=0
      EcuMFlexConfiguration
        EcuMFlexUserConfig: EcuMFlexUser=0
        ECUM_CFG_WKSOURCE_ECUM_WKSOURCE_POWER (EcuMResetMode): EcuMResetModeId=0
        EcuMShutdownCause: EcuMShutdownCauseId=0
    EcuMGeneral:
      EcuMHeaderFileInclusion = Os.h
      EcuMHeaderFileInclusion = EcuM_Types.h
      EcuMHeaderFileInclusion = BswM.h
      EcuMHeaderFileInclusion = Mcu.h
      EcuMHeaderFileInclusion = ComM.h
      EcuMHeaderFileInclusion = Det.h
      EcuMHeaderFileInclusion = Rte_Main.h
      EcuMHeaderFileInclusion = SchM_EcuM.h
      EcuMExcludeNonfunctional = true
      EcuMStartOS = false
      EcuMEnableRAMHash = false
      EcuMVersionInfoApi = false
      EcuMIncludeDet = false
      EcuMDevErrorDetect = true
      EcuMIncludeNvmWriteAll = false
      EcuMIncludeNvmReadAll = true
      EcuMIncludeBswM = true
      EcuMMainFunctionPeriod = 10.0
    EcuMFixedGeneral: EcuMIncludeComM=false
