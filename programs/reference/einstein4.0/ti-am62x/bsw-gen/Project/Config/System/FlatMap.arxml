AUTOSAR XML (schema 4-2-1)
package /COM/VECTOR/CFG/WORKFLOW/SYSDESC/SYNC
  flat map FLATMAP
    252 x flat instance descriptor:
      UclProxyCdd: upstream-reference=SoftwareArchitecture.UclProxyCdd, ecu-extract-reference=COMPOSITIONTYPE.UclProxyCdd
      Test_Comp: upstream-reference=SoftwareArchitecture.Test_Comp, ecu-extract-reference=COMPOSITIONTYPE.Test_Comp
      NvBlockSwComponentType: upstream-reference=SoftwareArchitecture.NvBlockSwComponentType, ecu-extract-reference=COMPOSITIONTYPE.NvBlockSwComponentType
      NvMExt: upstream-reference=SoftwareArchitecture.NvMExt, ecu-extract-reference=COMPOSITIONTYPE.NvMExt
      EcuMExt: upstream-reference=SoftwareArchitecture.EcuMExt, ecu-extract-reference=COMPOSITIONTYPE.EcuMExt
      TmExt: upstream-reference=SoftwareArchitecture.TmExt, ecu-extract-reference=COMPOSITIONTYPE.TmExt
      IoHwAb: upstream-reference=SoftwareArchitecture.IoHwAb, ecu-extract-reference=COMPOSITIONTYPE.IoHwAb
      MemAbstractStub: upstream-reference=SoftwareArchitecture.MemAbstractStub, ecu-extract-reference=COMPOSITIONTYPE.MemAbstractStub
      EcuAppM: upstream-reference=SoftwareArchitecture.EcuAppM, ecu-extract-reference=COMPOSITIONTYPE.EcuAppM
      NvBlockSwComponentTypeNVBlockDescriptor_BsConst_Audio: upstream-reference=COMPOSITIONTYPE.NvBlockSwComponentType.NVBlockDescriptor_BsConst_Audio
      NvBlockSwComponentTypeNVBlockDescriptor_BsConst_Communication: upstream-reference=COMPOSITIONTYPE.NvBlockSwComponentType.NVBlockDescriptor_BsConst_Communication
      NvBlockSwComponentTypeNVBlockDescriptor_BsConst_EngOffTimer: upstream-reference=COMPOSITIONTYPE.NvBlockSwComponentType.NVBlockDescriptor_BsConst_EngOffTimer
      NvBlockSwComponentTypeNVBlockDescriptor_BsConst_FuelGauge: upstream-reference=COMPOSITIONTYPE.NvBlockSwComponentType.NVBlockDescriptor_BsConst_FuelGauge
      NvBlockSwComponentTypeNVBlockDescriptor_BsConst_OilGauge: upstream-reference=COMPOSITIONTYPE.NvBlockSwComponentType.NVBlockDescriptor_BsConst_OilGauge
      NvBlockSwComponentTypeNVBlockDescriptor_BsConst_Power: upstream-reference=COMPOSITIONTYPE.NvBlockSwComponentType.NVBlockDescriptor_BsConst_Power
      NvBlockSwComponentTypeNVBlockDescriptor_BsConst_PowerGauge: upstream-reference=COMPOSITIONTYPE.NvBlockSwComponentType.NVBlockDescriptor_BsConst_PowerGauge
      NvBlockSwComponentTypeNVBlockDescriptor_BsConst_RealTimeClock: upstream-reference=COMPOSITIONTYPE.NvBlockSwComponentType.NVBlockDescriptor_BsConst_RealTimeClock
      NvBlockSwComponentTypeNVBlockDescriptor_BsConst_ServiceReminder: upstream-reference=COMPOSITIONTYPE.NvBlockSwComponentType.NVBlockDescriptor_BsConst_ServiceReminder
      NvBlockSwComponentTypeNVBlockDescriptor_BsConst_SpeedoGauge: upstream-reference=COMPOSITIONTYPE.NvBlockSwComponentType.NVBlockDescriptor_BsConst_SpeedoGauge
      NvBlockSwComponentTypeNVBlockDescriptor_BsConst_TachoGauge: upstream-reference=COMPOSITIONTYPE.NvBlockSwComponentType.NVBlockDescriptor_BsConst_TachoGauge
      NvBlockSwComponentTypeNVBlockDescriptor_BsConst_TempGauge: upstream-reference=COMPOSITIONTYPE.NvBlockSwComponentType.NVBlockDescriptor_BsConst_TempGauge
      NvBlockSwComponentTypeNVBlockDescriptor_BsConst_TripComputer: upstream-reference=COMPOSITIONTYPE.NvBlockSwComponentType.NVBlockDescriptor_BsConst_TripComputer
      NvBlockSwComponentTypeNVBlockDescriptor_BsConst_Warning: upstream-reference=COMPOSITIONTYPE.NvBlockSwComponentType.NVBlockDescriptor_BsConst_Warning
      NvBlockSwComponentTypeNVBlockDescriptor_BsCys_Certicificate: upstream-reference=COMPOSITIONTYPE.NvBlockSwComponentType.NVBlockDescriptor_BsCys_Certicificate
      NvBlockSwComponentTypeNVBlockDescriptor_BsDiag_Dtc: upstream-reference=COMPOSITIONTYPE.NvBlockSwComponentType.NVBlockDescriptor_BsDiag_Dtc
      NvBlockSwComponentTypeNVBlockDescriptor_BsDiag_ErrorRecord: upstream-reference=COMPOSITIONTYPE.NvBlockSwComponentType.NVBlockDescriptor_BsDiag_ErrorRecord
      NvBlockSwComponentTypeNVBlockDescriptor_BsReten_Audio: upstream-reference=COMPOSITIONTYPE.NvBlockSwComponentType.NVBlockDescriptor_BsReten_Audio
      NvBlockSwComponentTypeNVBlockDescriptor_BsReten_Communication: upstream-reference=COMPOSITIONTYPE.NvBlockSwComponentType.NVBlockDescriptor_BsReten_Communication
      NvBlockSwComponentTypeNVBlockDescriptor_BsReten_Display: upstream-reference=COMPOSITIONTYPE.NvBlockSwComponentType.NVBlockDescriptor_BsReten_Display
      NvBlockSwComponentTypeNVBlockDescriptor_BsReten_Gauges: upstream-reference=COMPOSITIONTYPE.NvBlockSwComponentType.NVBlockDescriptor_BsReten_Gauges
      NvBlockSwComponentTypeNVBlockDescriptor_BsReten_Illumination: upstream-reference=COMPOSITIONTYPE.NvBlockSwComponentType.NVBlockDescriptor_BsReten_Illumination
      NvBlockSwComponentTypeNVBlockDescriptor_BsReten_Odometer: upstream-reference=COMPOSITIONTYPE.NvBlockSwComponentType.NVBlockDescriptor_BsReten_Odometer
      NvBlockSwComponentTypeNVBlockDescriptor_BsReten_Personalization: upstream-reference=COMPOSITIONTYPE.NvBlockSwComponentType.NVBlockDescriptor_BsReten_Personalization
      NvBlockSwComponentTypeNVBlockDescriptor_BsReten_Power: upstream-reference=COMPOSITIONTYPE.NvBlockSwComponentType.NVBlockDescriptor_BsReten_Power
      NvBlockSwComponentTypeNVBlockDescriptor_BsReten_RealTimeClock: upstream-reference=COMPOSITIONTYPE.NvBlockSwComponentType.NVBlockDescriptor_BsReten_RealTimeClock
      NvBlockSwComponentTypeNVBlockDescriptor_BsReten_Tripcomputer: upstream-reference=COMPOSITIONTYPE.NvBlockSwComponentType.NVBlockDescriptor_BsReten_Tripcomputer
      NvBlockSwComponentTypeNVBlockDescriptor_BsReten_Warning: upstream-reference=COMPOSITIONTYPE.NvBlockSwComponentType.NVBlockDescriptor_BsReten_Warning
      NvBlockSwComponentTypeNVBlockDescriptor_BsRt_CusDlt: upstream-reference=COMPOSITIONTYPE.NvBlockSwComponentType.NVBlockDescriptor_BsRt_CusDlt
      NvBlockSwComponentTypeNVBlockDescriptor_BsRt_FuelGauge: upstream-reference=COMPOSITIONTYPE.NvBlockSwComponentType.NVBlockDescriptor_BsRt_FuelGauge
      NvBlockSwComponentTypeNVBlockDescriptor_BsRt_Illumination: upstream-reference=COMPOSITIONTYPE.NvBlockSwComponentType.NVBlockDescriptor_BsRt_Illumination
      NvBlockSwComponentTypeNVBlockDescriptor_BsRt_Odometer: upstream-reference=COMPOSITIONTYPE.NvBlockSwComponentType.NVBlockDescriptor_BsRt_Odometer
      NvBlockSwComponentTypeNVBlockDescriptor_BsRt_OilGauge: upstream-reference=COMPOSITIONTYPE.NvBlockSwComponentType.NVBlockDescriptor_BsRt_OilGauge
      NvBlockSwComponentTypeNVBlockDescriptor_BsRt_Personalization: upstream-reference=COMPOSITIONTYPE.NvBlockSwComponentType.NVBlockDescriptor_BsRt_Personalization
      NvBlockSwComponentTypeNVBlockDescriptor_BsRt_PowerGauge: upstream-reference=COMPOSITIONTYPE.NvBlockSwComponentType.NVBlockDescriptor_BsRt_PowerGauge
      NvBlockSwComponentTypeNVBlockDescriptor_BsRt_RealTimeClock: upstream-reference=COMPOSITIONTYPE.NvBlockSwComponentType.NVBlockDescriptor_BsRt_RealTimeClock
      NvBlockSwComponentTypeNVBlockDescriptor_BsRt_SpeedoGauge: upstream-reference=COMPOSITIONTYPE.NvBlockSwComponentType.NVBlockDescriptor_BsRt_SpeedoGauge
      NvBlockSwComponentTypeNVBlockDescriptor_BsRt_TachoGauge: upstream-reference=COMPOSITIONTYPE.NvBlockSwComponentType.NVBlockDescriptor_BsRt_TachoGauge
      NvBlockSwComponentTypeNVBlockDescriptor_BsRt_TempGauge: upstream-reference=COMPOSITIONTYPE.NvBlockSwComponentType.NVBlockDescriptor_BsRt_TempGauge
      NvBlockSwComponentTypeNVBlockDescriptor_BsRt_TripComputer: upstream-reference=COMPOSITIONTYPE.NvBlockSwComponentType.NVBlockDescriptor_BsRt_TripComputer
      NvBlockSwComponentTypeNVBlockDescriptor_BsRt_Warning: upstream-reference=COMPOSITIONTYPE.NvBlockSwComponentType.NVBlockDescriptor_BsRt_Warning
      NvBlockSwComponentTypeNVBlockDescriptor_BsShare_EcuPartNumber: upstream-reference=COMPOSITIONTYPE.NvBlockSwComponentType.NVBlockDescriptor_BsShare_EcuPartNumber
      NvBlockSwComponentTypeNVBlockDescriptor_BsShare_SwUpdFotaFinPrint: upstream-reference=COMPOSITIONTYPE.NvBlockSwComponentType.NVBlockDescriptor_BsShare_SwUpdFotaFinPrint
      NvBlockSwComponentTypeNVBlockDescriptor_BsShare_SwUpdFotaMode: upstream-reference=COMPOSITIONTYPE.NvBlockSwComponentType.NVBlockDescriptor_BsShare_SwUpdFotaMode
      NvBlockSwComponentTypeNVBlockDescriptor_BsShare_SwUpdFotaStatus: upstream-reference=COMPOSITIONTYPE.NvBlockSwComponentType.NVBlockDescriptor_BsShare_SwUpdFotaStatus
      NvBlockSwComponentTypeNVBlockDescriptor_BsShare_SwUpdFotadecrypt: upstream-reference=COMPOSITIONTYPE.NvBlockSwComponentType.NVBlockDescriptor_BsShare_SwUpdFotadecrypt
      NvBlockSwComponentTypeNVBlockDescriptor_BsShare_SwUpdReflash: upstream-reference=COMPOSITIONTYPE.NvBlockSwComponentType.NVBlockDescriptor_BsShare_SwUpdReflash
      NvBlockSwComponentTypeNVBlockDescriptor_BsShare_VehicleConfig: upstream-reference=COMPOSITIONTYPE.NvBlockSwComponentType.NVBlockDescriptor_BsShare_VehicleConfig
      NvBlockSwComponentTypeNVBlockDescriptor_BsShare_VisMeet: upstream-reference=COMPOSITIONTYPE.NvBlockSwComponentType.NVBlockDescriptor_BsShare_VisMeet
      NvBlockSwComponentTypeNVBlockDescriptor_RefCys_Certicificate: upstream-reference=COMPOSITIONTYPE.NvBlockSwComponentType.NVBlockDescriptor_RefCys_Certicificate
      NvBlockSwComponentTypeNVBlockDescriptor_RefCys_Certicificate1: upstream-reference=COMPOSITIONTYPE.NvBlockSwComponentType.NVBlockDescriptor_RefCys_Certicificate1
      MemAbstractMdl: upstream-reference=SoftwareArchitecture.MemAbstractMdl, ecu-extract-reference=COMPOSITIONTYPE.MemAbstractMdl
      DmnMgr: upstream-reference=SoftwareArchitecture.DmnMgr, ecu-extract-reference=COMPOSITIONTYPE.DmnMgr
      SciDrv: upstream-reference=SoftwareArchitecture.SciDrv, ecu-extract-reference=COMPOSITIONTYPE.SciDrv
      CBacklightCdd: upstream-reference=SoftwareArchitecture.CBacklightCdd, ecu-extract-reference=COMPOSITIONTYPE.CBacklightCdd
      CDisplayCdd: upstream-reference=SoftwareArchitecture.CDisplayCdd, ecu-extract-reference=COMPOSITIONTYPE.CDisplayCdd
      CCDD_EcuPowerM: upstream-reference=SoftwareArchitecture.CCDD_EcuPowerM, ecu-extract-reference=COMPOSITIONTYPE.CCDD_EcuPowerM
      Dlt: upstream-reference=SoftwareArchitecture.Dlt, ecu-extract-reference=COMPOSITIONTYPE.Dlt
      DltExt: upstream-reference=SoftwareArchitecture.DltExt, ecu-extract-reference=COMPOSITIONTYPE.DltExt
      RtcCdd: upstream-reference=SoftwareArchitecture.RtcCdd, ecu-extract-reference=COMPOSITIONTYPE.RtcCdd
      DcmExt: upstream-reference=SoftwareArchitecture.DcmExt, ecu-extract-reference=COMPOSITIONTYPE.DcmExt
      DemExt: upstream-reference=SoftwareArchitecture.DemExt, ecu-extract-reference=COMPOSITIONTYPE.DemExt
      CMeetCdd: upstream-reference=SoftwareArchitecture.CMeetCdd, ecu-extract-reference=COMPOSITIONTYPE.CMeetCdd
      GdtCdd: upstream-reference=SoftwareArchitecture.GdtCdd, ecu-extract-reference=COMPOSITIONTYPE.GdtCdd
      WdgM: upstream-reference=SoftwareArchitecture.WdgM, ecu-extract-reference=COMPOSITIONTYPE.WdgM
      DcmApp: upstream-reference=SoftwareArchitecture.DcmApp, ecu-extract-reference=COMPOSITIONTYPE.DcmApp
      DemApp: upstream-reference=SoftwareArchitecture.DemApp, ecu-extract-reference=COMPOSITIONTYPE.DemApp
      SafeBsw: upstream-reference=SoftwareArchitecture.SafeBsw, ecu-extract-reference=COMPOSITIONTYPE.SafeBsw
      CPmicCdd: upstream-reference=SoftwareArchitecture.CPmicCdd, ecu-extract-reference=COMPOSITIONTYPE.CPmicCdd
      CIoExp: upstream-reference=SoftwareArchitecture.CIoExp, ecu-extract-reference=COMPOSITIONTYPE.CIoExp
      CComAbsCtrl: upstream-reference=SoftwareArchitecture.CComAbsCtrl, ecu-extract-reference=COMPOSITIONTYPE.CComAbsCtrl
      CComAbsMdl: upstream-reference=SoftwareArchitecture.CComAbsMdl, ecu-extract-reference=COMPOSITIONTYPE.CComAbsMdl
      CCtrl_Telltale: upstream-reference=SoftwareArchitecture.CCtrl_Telltale, ecu-extract-reference=COMPOSITIONTYPE.CCtrl_Telltale
      Ctrl_Dim: upstream-reference=SoftwareArchitecture.Ctrl_Dim, ecu-extract-reference=COMPOSITIONTYPE.Ctrl_Dim
      Ctrl_warning: upstream-reference=SoftwareArchitecture.Ctrl_warning, ecu-extract-reference=COMPOSITIONTYPE.Ctrl_warning
      Ctrl_WSS: upstream-reference=SoftwareArchitecture.Ctrl_WSS, ecu-extract-reference=COMPOSITIONTYPE.Ctrl_WSS
      CView_Telltale: upstream-reference=SoftwareArchitecture.CView_Telltale, ecu-extract-reference=COMPOSITIONTYPE.CView_Telltale
      CWarnMsg_Core_Observer: upstream-reference=SoftwareArchitecture.CWarnMsg_Core_Observer, ecu-extract-reference=COMPOSITIONTYPE.CWarnMsg_Core_Observer
      FastGaugeAdapter: upstream-reference=SoftwareArchitecture.FastGaugeAdapter, ecu-extract-reference=COMPOSITIONTYPE.FastGaugeAdapter
      Mdl_Airbag: upstream-reference=SoftwareArchitecture.Mdl_Airbag, ecu-extract-reference=COMPOSITIONTYPE.Mdl_Airbag
      Mdl_Dim: upstream-reference=SoftwareArchitecture.Mdl_Dim, ecu-extract-reference=COMPOSITIONTYPE.Mdl_Dim
      Mdl_Gear: upstream-reference=SoftwareArchitecture.Mdl_Gear, ecu-extract-reference=COMPOSITIONTYPE.Mdl_Gear
      Mdl_Linear_Interpolation: upstream-reference=SoftwareArchitecture.Mdl_Linear_Interpolation, ecu-extract-reference=COMPOSITIONTYPE.Mdl_Linear_Interpolation
      Mdl_SafetyAdapter: upstream-reference=SoftwareArchitecture.Mdl_SafetyAdapter, ecu-extract-reference=COMPOSITIONTYPE.Mdl_SafetyAdapter
      Mdl_Speed: upstream-reference=SoftwareArchitecture.Mdl_Speed, ecu-extract-reference=COMPOSITIONTYPE.Mdl_Speed
      Mdl_Tacho: upstream-reference=SoftwareArchitecture.Mdl_Tacho, ecu-extract-reference=COMPOSITIONTYPE.Mdl_Tacho
      Mdl_TurnHazard: upstream-reference=SoftwareArchitecture.Mdl_TurnHazard, ecu-extract-reference=COMPOSITIONTYPE.Mdl_TurnHazard
      Mdl_wFuelLidOpen: upstream-reference=SoftwareArchitecture.Mdl_wFuelLidOpen, ecu-extract-reference=COMPOSITIONTYPE.Mdl_wFuelLidOpen
      Mdl_wAirbag: upstream-reference=SoftwareArchitecture.Mdl_wAirbag, ecu-extract-reference=COMPOSITIONTYPE.Mdl_wAirbag
      View_Speed: upstream-reference=SoftwareArchitecture.View_Speed, ecu-extract-reference=COMPOSITIONTYPE.View_Speed
      SlowGaugeAdapter: upstream-reference=SoftwareArchitecture.SlowGaugeAdapter, ecu-extract-reference=COMPOSITIONTYPE.SlowGaugeAdapter
      WarnMsg_Core_TmrSupport: upstream-reference=SoftwareArchitecture.WarnMsg_Core_TmrSupport, ecu-extract-reference=COMPOSITIONTYPE.WarnMsg_Core_TmrSupport
      ComMExt: upstream-reference=SoftwareArchitecture.ComMExt, ecu-extract-reference=COMPOSITIONTYPE.ComMExt
      CorTst: upstream-reference=SoftwareArchitecture.CorTst, ecu-extract-reference=COMPOSITIONTYPE.CorTst
      FlsTst: upstream-reference=SoftwareArchitecture.FlsTst, ecu-extract-reference=COMPOSITIONTYPE.FlsTst
      NvMExtSf: upstream-reference=SoftwareArchitecture.NvMExtSf, ecu-extract-reference=COMPOSITIONTYPE.NvMExtSf
      RamTst: upstream-reference=SoftwareArchitecture.RamTst, ecu-extract-reference=COMPOSITIONTYPE.RamTst
      SysTst: upstream-reference=SoftwareArchitecture.SysTst, ecu-extract-reference=COMPOSITIONTYPE.SysTst
      CFltM: upstream-reference=SoftwareArchitecture.CFltM, ecu-extract-reference=COMPOSITIONTYPE.CFltM
      CUpdateCdd: upstream-reference=SoftwareArchitecture.CUpdateCdd, ecu-extract-reference=COMPOSITIONTYPE.CUpdateCdd
      SafeNvM: upstream-reference=SoftwareArchitecture.SafeNvM, ecu-extract-reference=COMPOSITIONTYPE.SafeNvM
      NvBlockSwComponentTypeNVBlockDescriptor_BsConst_Illumination: upstream-reference=COMPOSITIONTYPE.NvBlockSwComponentType.NVBlockDescriptor_BsConst_Illumination
      NvBlockSwComponentTypeNVBlockDescriptor_BsConst_Illumination_Copy1: upstream-reference=COMPOSITIONTYPE.NvBlockSwComponentType.NVBlockDescriptor_BsConst_Illumination_Copy1
      NvBlockSwComponentTypeNVBlockDescriptor_BsConst_Illumination_Copy2: upstream-reference=COMPOSITIONTYPE.NvBlockSwComponentType.NVBlockDescriptor_BsConst_Illumination_Copy2
      MemAbstract_Stub_Safe: upstream-reference=SoftwareArchitecture.MemAbstract_Stub_Safe, ecu-extract-reference=COMPOSITIONTYPE.MemAbstract_Stub_Safe
      ComCallout: upstream-reference=SoftwareArchitecture.ComCallout, ecu-extract-reference=COMPOSITIONTYPE.ComCallout
      CFltMExt: upstream-reference=SoftwareArchitecture.CFltMExt, ecu-extract-reference=COMPOSITIONTYPE.CFltMExt
      CCDD_BswFit: upstream-reference=SoftwareArchitecture.CCDD_BswFit, ecu-extract-reference=COMPOSITIONTYPE.CCDD_BswFit
      CCDD_FitManager: upstream-reference=SoftwareArchitecture.CCDD_FitManager, ecu-extract-reference=COMPOSITIONTYPE.CCDD_FitManager
      CCDD_McuFit: upstream-reference=SoftwareArchitecture.CCDD_McuFit, ecu-extract-reference=COMPOSITIONTYPE.CCDD_McuFit
      Ctrl_Illumination: upstream-reference=SoftwareArchitecture.Ctrl_Illumination, ecu-extract-reference=COMPOSITIONTYPE.Ctrl_Illumination
      View_Illumination: upstream-reference=SoftwareArchitecture.View_Illumination, ecu-extract-reference=COMPOSITIONTYPE.View_Illumination
      CComAbsMdl_stubs: upstream-reference=SoftwareArchitecture.CComAbsMdl_stubs, ecu-extract-reference=COMPOSITIONTYPE.CComAbsMdl_stubs
      CComAbsMdlSafe: upstream-reference=SoftwareArchitecture.CComAbsMdlSafe, ecu-extract-reference=COMPOSITIONTYPE.CComAbsMdlSafe
      TrustecSWC: upstream-reference=SoftwareArchitecture.TrustecSWC, ecu-extract-reference=COMPOSITIONTYPE.TrustecSWC
      SG_COM_HS: upstream-reference=SoftwareArchitecture.PP_TX_SG_COM_HSSG_COM_HS.SG_COM_HS, ecu-extract-reference=COMPOSITIONTYPE.PP_TX_SG_COM_HSSG_COM_HS.SG_COM_HS
      PP_TX_SG_COM_HSSG_COM_HS: upstream-reference=SoftwareArchitecture.PP_TX_SG_COM_HSSG_COM_HS, ecu-extract-reference=COMPOSITIONTYPE.PP_TX_SG_COM_HSSG_COM_HS
      Ambient_Light_level: upstream-reference=SoftwareArchitecture.rp_SR_RxAmbient_Light_level.Ambient_Light_level, ecu-extract-reference=COMPOSITIONTYPE.rp_SR_RxAmbient_Light_level.Ambient_Light_level
      rp_SR_RxAmbient_Light_level: upstream-reference=SoftwareArchitecture.rp_SR_RxAmbient_Light_level, ecu-extract-reference=COMPOSITIONTYPE.rp_SR_RxAmbient_Light_level
      DayNightMode: upstream-reference=SoftwareArchitecture.rp_SR_RxDayNightMode.DayNightMode, ecu-extract-reference=COMPOSITIONTYPE.rp_SR_RxDayNightMode.DayNightMode
      rp_SR_RxDayNightMode: upstream-reference=SoftwareArchitecture.rp_SR_RxDayNightMode, ecu-extract-reference=COMPOSITIONTYPE.rp_SR_RxDayNightMode
      Gear: upstream-reference=SoftwareArchitecture.rp_SR_RxGear.Gear, ecu-extract-reference=COMPOSITIONTYPE.rp_SR_RxGear.Gear
      rp_SR_RxGear: upstream-reference=SoftwareArchitecture.rp_SR_RxGear, ecu-extract-reference=COMPOSITIONTYPE.rp_SR_RxGear
      GearMode: upstream-reference=SoftwareArchitecture.rp_SR_RxGearMode.GearMode, ecu-extract-reference=COMPOSITIONTYPE.rp_SR_RxGearMode.GearMode
      rp_SR_RxGearMode: upstream-reference=SoftwareArchitecture.rp_SR_RxGearMode, ecu-extract-reference=COMPOSITIONTYPE.rp_SR_RxGearMode
      GearRecommendation: upstream-reference=SoftwareArchitecture.rp_SR_RxGearRecommendation.GearRecommendation, ecu-extract-reference=COMPOSITIONTYPE.rp_SR_RxGearRecommendation.GearRecommendation
      rp_SR_RxGearRecommendation: upstream-reference=SoftwareArchitecture.rp_SR_RxGearRecommendation, ecu-extract-reference=COMPOSITIONTYPE.rp_SR_RxGearRecommendation
      GearStatus: upstream-reference=SoftwareArchitecture.rp_SR_RxGearStatus.GearStatus, ecu-extract-reference=COMPOSITIONTYPE.rp_SR_RxGearStatus.GearStatus
      rp_SR_RxGearStatus: upstream-reference=SoftwareArchitecture.rp_SR_RxGearStatus, ecu-extract-reference=COMPOSITIONTYPE.rp_SR_RxGearStatus
      Illumination_level: upstream-reference=SoftwareArchitecture.rp_SR_RxIllumination_level.Illumination_level, ecu-extract-reference=COMPOSITIONTYPE.rp_SR_RxIllumination_level.Illumination_level
      rp_SR_RxIllumination_level: upstream-reference=SoftwareArchitecture.rp_SR_RxIllumination_level, ecu-extract-reference=COMPOSITIONTYPE.rp_SR_RxIllumination_level
      PowerMode: upstream-reference=SoftwareArchitecture.rp_SR_RxPowerMode.PowerMode, ecu-extract-reference=COMPOSITIONTYPE.rp_SR_RxPowerMode.PowerMode
      rp_SR_RxPowerMode: upstream-reference=SoftwareArchitecture.rp_SR_RxPowerMode, ecu-extract-reference=COMPOSITIONTYPE.rp_SR_RxPowerMode
      TransportMode: upstream-reference=SoftwareArchitecture.rp_SR_RxTransportMode.TransportMode, ecu-extract-reference=COMPOSITIONTYPE.rp_SR_RxTransportMode.TransportMode
      rp_SR_RxTransportMode: upstream-reference=SoftwareArchitecture.rp_SR_RxTransportMode, ecu-extract-reference=COMPOSITIONTYPE.rp_SR_RxTransportMode
      Warning: upstream-reference=SoftwareArchitecture.rp_SR_RxWarning.Warning, ecu-extract-reference=COMPOSITIONTYPE.rp_SR_RxWarning.Warning
      rp_SR_RxWarning: upstream-reference=SoftwareArchitecture.rp_SR_RxWarning, ecu-extract-reference=COMPOSITIONTYPE.rp_SR_RxWarning
      Debug1_Byte0: upstream-reference=SoftwareArchitecture.pp_SR_TxDebug1_Byte0.Debug1_Byte0, ecu-extract-reference=COMPOSITIONTYPE.pp_SR_TxDebug1_Byte0.Debug1_Byte0
      pp_SR_TxDebug1_Byte0: upstream-reference=SoftwareArchitecture.pp_SR_TxDebug1_Byte0, ecu-extract-reference=COMPOSITIONTYPE.pp_SR_TxDebug1_Byte0
      Debug1_Byte1: upstream-reference=SoftwareArchitecture.pp_SR_TxDebug1_Byte1.Debug1_Byte1, ecu-extract-reference=COMPOSITIONTYPE.pp_SR_TxDebug1_Byte1.Debug1_Byte1
      pp_SR_TxDebug1_Byte1: upstream-reference=SoftwareArchitecture.pp_SR_TxDebug1_Byte1, ecu-extract-reference=COMPOSITIONTYPE.pp_SR_TxDebug1_Byte1
      Debug1_Byte2: upstream-reference=SoftwareArchitecture.pp_SR_TxDebug1_Byte2.Debug1_Byte2, ecu-extract-reference=COMPOSITIONTYPE.pp_SR_TxDebug1_Byte2.Debug1_Byte2
      pp_SR_TxDebug1_Byte2: upstream-reference=SoftwareArchitecture.pp_SR_TxDebug1_Byte2, ecu-extract-reference=COMPOSITIONTYPE.pp_SR_TxDebug1_Byte2
      Debug1_Byte3: upstream-reference=SoftwareArchitecture.pp_SR_TxDebug1_Byte3.Debug1_Byte3, ecu-extract-reference=COMPOSITIONTYPE.pp_SR_TxDebug1_Byte3.Debug1_Byte3
      pp_SR_TxDebug1_Byte3: upstream-reference=SoftwareArchitecture.pp_SR_TxDebug1_Byte3, ecu-extract-reference=COMPOSITIONTYPE.pp_SR_TxDebug1_Byte3
      Debug1_Byte4: upstream-reference=SoftwareArchitecture.pp_SR_TxDebug1_Byte4.Debug1_Byte4, ecu-extract-reference=COMPOSITIONTYPE.pp_SR_TxDebug1_Byte4.Debug1_Byte4
      pp_SR_TxDebug1_Byte4: upstream-reference=SoftwareArchitecture.pp_SR_TxDebug1_Byte4, ecu-extract-reference=COMPOSITIONTYPE.pp_SR_TxDebug1_Byte4
      Debug1_Byte5: upstream-reference=SoftwareArchitecture.pp_SR_TxDebug1_Byte5.Debug1_Byte5, ecu-extract-reference=COMPOSITIONTYPE.pp_SR_TxDebug1_Byte5.Debug1_Byte5
      pp_SR_TxDebug1_Byte5: upstream-reference=SoftwareArchitecture.pp_SR_TxDebug1_Byte5, ecu-extract-reference=COMPOSITIONTYPE.pp_SR_TxDebug1_Byte5
      Debug1_Byte6: upstream-reference=SoftwareArchitecture.pp_SR_TxDebug1_Byte6.Debug1_Byte6, ecu-extract-reference=COMPOSITIONTYPE.pp_SR_TxDebug1_Byte6.Debug1_Byte6
      pp_SR_TxDebug1_Byte6: upstream-reference=SoftwareArchitecture.pp_SR_TxDebug1_Byte6, ecu-extract-reference=COMPOSITIONTYPE.pp_SR_TxDebug1_Byte6
      Debug1_Byte7: upstream-reference=SoftwareArchitecture.pp_SR_TxDebug1_Byte7.Debug1_Byte7, ecu-extract-reference=COMPOSITIONTYPE.pp_SR_TxDebug1_Byte7.Debug1_Byte7
      pp_SR_TxDebug1_Byte7: upstream-reference=SoftwareArchitecture.pp_SR_TxDebug1_Byte7, ecu-extract-reference=COMPOSITIONTYPE.pp_SR_TxDebug1_Byte7
      Debug2_Byte0: upstream-reference=SoftwareArchitecture.pp_SR_TxDebug2_Byte0.Debug2_Byte0, ecu-extract-reference=COMPOSITIONTYPE.pp_SR_TxDebug2_Byte0.Debug2_Byte0
      pp_SR_TxDebug2_Byte0: upstream-reference=SoftwareArchitecture.pp_SR_TxDebug2_Byte0, ecu-extract-reference=COMPOSITIONTYPE.pp_SR_TxDebug2_Byte0
      Debug2_Byte1: upstream-reference=SoftwareArchitecture.pp_SR_TxDebug2_Byte1.Debug2_Byte1, ecu-extract-reference=COMPOSITIONTYPE.pp_SR_TxDebug2_Byte1.Debug2_Byte1
      pp_SR_TxDebug2_Byte1: upstream-reference=SoftwareArchitecture.pp_SR_TxDebug2_Byte1, ecu-extract-reference=COMPOSITIONTYPE.pp_SR_TxDebug2_Byte1
      Debug2_Byte2: upstream-reference=SoftwareArchitecture.pp_SR_TxDebug2_Byte2.Debug2_Byte2, ecu-extract-reference=COMPOSITIONTYPE.pp_SR_TxDebug2_Byte2.Debug2_Byte2
      pp_SR_TxDebug2_Byte2: upstream-reference=SoftwareArchitecture.pp_SR_TxDebug2_Byte2, ecu-extract-reference=COMPOSITIONTYPE.pp_SR_TxDebug2_Byte2
      Debug2_Byte3: upstream-reference=SoftwareArchitecture.pp_SR_TxDebug2_Byte3.Debug2_Byte3, ecu-extract-reference=COMPOSITIONTYPE.pp_SR_TxDebug2_Byte3.Debug2_Byte3
      pp_SR_TxDebug2_Byte3: upstream-reference=SoftwareArchitecture.pp_SR_TxDebug2_Byte3, ecu-extract-reference=COMPOSITIONTYPE.pp_SR_TxDebug2_Byte3
      Debug2_Byte4: upstream-reference=SoftwareArchitecture.pp_SR_TxDebug2_Byte4.Debug2_Byte4, ecu-extract-reference=COMPOSITIONTYPE.pp_SR_TxDebug2_Byte4.Debug2_Byte4
      pp_SR_TxDebug2_Byte4: upstream-reference=SoftwareArchitecture.pp_SR_TxDebug2_Byte4, ecu-extract-reference=COMPOSITIONTYPE.pp_SR_TxDebug2_Byte4
      Debug2_Byte5: upstream-reference=SoftwareArchitecture.pp_SR_TxDebug2_Byte5.Debug2_Byte5, ecu-extract-reference=COMPOSITIONTYPE.pp_SR_TxDebug2_Byte5.Debug2_Byte5
      pp_SR_TxDebug2_Byte5: upstream-reference=SoftwareArchitecture.pp_SR_TxDebug2_Byte5, ecu-extract-reference=COMPOSITIONTYPE.pp_SR_TxDebug2_Byte5
      Debug2_Byte6: upstream-reference=SoftwareArchitecture.pp_SR_TxDebug2_Byte6.Debug2_Byte6, ecu-extract-reference=COMPOSITIONTYPE.pp_SR_TxDebug2_Byte6.Debug2_Byte6
      pp_SR_TxDebug2_Byte6: upstream-reference=SoftwareArchitecture.pp_SR_TxDebug2_Byte6, ecu-extract-reference=COMPOSITIONTYPE.pp_SR_TxDebug2_Byte6
      Debug2_Byte7: upstream-reference=SoftwareArchitecture.pp_SR_TxDebug2_Byte7.Debug2_Byte7, ecu-extract-reference=COMPOSITIONTYPE.pp_SR_TxDebug2_Byte7.Debug2_Byte7
      pp_SR_TxDebug2_Byte7: upstream-reference=SoftwareArchitecture.pp_SR_TxDebug2_Byte7, ecu-extract-reference=COMPOSITIONTYPE.pp_SR_TxDebug2_Byte7
      Debug3_Byte0: upstream-reference=SoftwareArchitecture.pp_SR_TxDebug3_Byte0.Debug3_Byte0, ecu-extract-reference=COMPOSITIONTYPE.pp_SR_TxDebug3_Byte0.Debug3_Byte0
      pp_SR_TxDebug3_Byte0: upstream-reference=SoftwareArchitecture.pp_SR_TxDebug3_Byte0, ecu-extract-reference=COMPOSITIONTYPE.pp_SR_TxDebug3_Byte0
      Debug3_Byte1: upstream-reference=SoftwareArchitecture.pp_SR_TxDebug3_Byte1.Debug3_Byte1, ecu-extract-reference=COMPOSITIONTYPE.pp_SR_TxDebug3_Byte1.Debug3_Byte1
      pp_SR_TxDebug3_Byte1: upstream-reference=SoftwareArchitecture.pp_SR_TxDebug3_Byte1, ecu-extract-reference=COMPOSITIONTYPE.pp_SR_TxDebug3_Byte1
      Debug3_Byte2: upstream-reference=SoftwareArchitecture.pp_SR_TxDebug3_Byte2.Debug3_Byte2, ecu-extract-reference=COMPOSITIONTYPE.pp_SR_TxDebug3_Byte2.Debug3_Byte2
      pp_SR_TxDebug3_Byte2: upstream-reference=SoftwareArchitecture.pp_SR_TxDebug3_Byte2, ecu-extract-reference=COMPOSITIONTYPE.pp_SR_TxDebug3_Byte2
      Debug3_Byte3: upstream-reference=SoftwareArchitecture.pp_SR_TxDebug3_Byte3.Debug3_Byte3, ecu-extract-reference=COMPOSITIONTYPE.pp_SR_TxDebug3_Byte3.Debug3_Byte3
      pp_SR_TxDebug3_Byte3: upstream-reference=SoftwareArchitecture.pp_SR_TxDebug3_Byte3, ecu-extract-reference=COMPOSITIONTYPE.pp_SR_TxDebug3_Byte3
      Debug3_Byte4: upstream-reference=SoftwareArchitecture.pp_SR_TxDebug3_Byte4.Debug3_Byte4, ecu-extract-reference=COMPOSITIONTYPE.pp_SR_TxDebug3_Byte4.Debug3_Byte4
      pp_SR_TxDebug3_Byte4: upstream-reference=SoftwareArchitecture.pp_SR_TxDebug3_Byte4, ecu-extract-reference=COMPOSITIONTYPE.pp_SR_TxDebug3_Byte4
      Debug3_Byte5: upstream-reference=SoftwareArchitecture.pp_SR_TxDebug3_Byte5.Debug3_Byte5, ecu-extract-reference=COMPOSITIONTYPE.pp_SR_TxDebug3_Byte5.Debug3_Byte5
      pp_SR_TxDebug3_Byte5: upstream-reference=SoftwareArchitecture.pp_SR_TxDebug3_Byte5, ecu-extract-reference=COMPOSITIONTYPE.pp_SR_TxDebug3_Byte5
      Debug3_Byte6: upstream-reference=SoftwareArchitecture.pp_SR_TxDebug3_Byte6.Debug3_Byte6, ecu-extract-reference=COMPOSITIONTYPE.pp_SR_TxDebug3_Byte6.Debug3_Byte6
      pp_SR_TxDebug3_Byte6: upstream-reference=SoftwareArchitecture.pp_SR_TxDebug3_Byte6, ecu-extract-reference=COMPOSITIONTYPE.pp_SR_TxDebug3_Byte6
      Debug3_Byte7: upstream-reference=SoftwareArchitecture.pp_SR_TxDebug3_Byte7.Debug3_Byte7, ecu-extract-reference=COMPOSITIONTYPE.pp_SR_TxDebug3_Byte7.Debug3_Byte7
      pp_SR_TxDebug3_Byte7: upstream-reference=SoftwareArchitecture.pp_SR_TxDebug3_Byte7, ecu-extract-reference=COMPOSITIONTYPE.pp_SR_TxDebug3_Byte7
      Debug4_Byte0: upstream-reference=SoftwareArchitecture.pp_SR_TxDebug4_Byte0.Debug4_Byte0, ecu-extract-reference=COMPOSITIONTYPE.pp_SR_TxDebug4_Byte0.Debug4_Byte0
      pp_SR_TxDebug4_Byte0: upstream-reference=SoftwareArchitecture.pp_SR_TxDebug4_Byte0, ecu-extract-reference=COMPOSITIONTYPE.pp_SR_TxDebug4_Byte0
      Debug4_Byte1: upstream-reference=SoftwareArchitecture.pp_SR_TxDebug4_Byte1.Debug4_Byte1, ecu-extract-reference=COMPOSITIONTYPE.pp_SR_TxDebug4_Byte1.Debug4_Byte1
      pp_SR_TxDebug4_Byte1: upstream-reference=SoftwareArchitecture.pp_SR_TxDebug4_Byte1, ecu-extract-reference=COMPOSITIONTYPE.pp_SR_TxDebug4_Byte1
      Debug4_Byte2: upstream-reference=SoftwareArchitecture.pp_SR_TxDebug4_Byte2.Debug4_Byte2, ecu-extract-reference=COMPOSITIONTYPE.pp_SR_TxDebug4_Byte2.Debug4_Byte2
      pp_SR_TxDebug4_Byte2: upstream-reference=SoftwareArchitecture.pp_SR_TxDebug4_Byte2, ecu-extract-reference=COMPOSITIONTYPE.pp_SR_TxDebug4_Byte2
      Debug4_Byte3: upstream-reference=SoftwareArchitecture.pp_SR_TxDebug4_Byte3.Debug4_Byte3, ecu-extract-reference=COMPOSITIONTYPE.pp_SR_TxDebug4_Byte3.Debug4_Byte3
      pp_SR_TxDebug4_Byte3: upstream-reference=SoftwareArchitecture.pp_SR_TxDebug4_Byte3, ecu-extract-reference=COMPOSITIONTYPE.pp_SR_TxDebug4_Byte3
      Debug4_Byte4: upstream-reference=SoftwareArchitecture.pp_SR_TxDebug4_Byte4.Debug4_Byte4, ecu-extract-reference=COMPOSITIONTYPE.pp_SR_TxDebug4_Byte4.Debug4_Byte4
      pp_SR_TxDebug4_Byte4: upstream-reference=SoftwareArchitecture.pp_SR_TxDebug4_Byte4, ecu-extract-reference=COMPOSITIONTYPE.pp_SR_TxDebug4_Byte4
      Debug4_Byte5: upstream-reference=SoftwareArchitecture.pp_SR_TxDebug4_Byte5.Debug4_Byte5, ecu-extract-reference=COMPOSITIONTYPE.pp_SR_TxDebug4_Byte5.Debug4_Byte5
      pp_SR_TxDebug4_Byte5: upstream-reference=SoftwareArchitecture.pp_SR_TxDebug4_Byte5, ecu-extract-reference=COMPOSITIONTYPE.pp_SR_TxDebug4_Byte5
      Debug4_Byte6: upstream-reference=SoftwareArchitecture.pp_SR_TxDebug4_Byte6.Debug4_Byte6, ecu-extract-reference=COMPOSITIONTYPE.pp_SR_TxDebug4_Byte6.Debug4_Byte6
      pp_SR_TxDebug4_Byte6: upstream-reference=SoftwareArchitecture.pp_SR_TxDebug4_Byte6, ecu-extract-reference=COMPOSITIONTYPE.pp_SR_TxDebug4_Byte6
      Debug4_Byte7: upstream-reference=SoftwareArchitecture.pp_SR_TxDebug4_Byte7.Debug4_Byte7, ecu-extract-reference=COMPOSITIONTYPE.pp_SR_TxDebug4_Byte7.Debug4_Byte7
      pp_SR_TxDebug4_Byte7: upstream-reference=SoftwareArchitecture.pp_SR_TxDebug4_Byte7, ecu-extract-reference=COMPOSITIONTYPE.pp_SR_TxDebug4_Byte7
      Debug5_Byte0: upstream-reference=SoftwareArchitecture.pp_SR_TxDebug5_Byte0.Debug5_Byte0, ecu-extract-reference=COMPOSITIONTYPE.pp_SR_TxDebug5_Byte0.Debug5_Byte0
      pp_SR_TxDebug5_Byte0: upstream-reference=SoftwareArchitecture.pp_SR_TxDebug5_Byte0, ecu-extract-reference=COMPOSITIONTYPE.pp_SR_TxDebug5_Byte0
      Debug5_Byte1: upstream-reference=SoftwareArchitecture.pp_SR_TxDebug5_Byte1.Debug5_Byte1, ecu-extract-reference=COMPOSITIONTYPE.pp_SR_TxDebug5_Byte1.Debug5_Byte1
      pp_SR_TxDebug5_Byte1: upstream-reference=SoftwareArchitecture.pp_SR_TxDebug5_Byte1, ecu-extract-reference=COMPOSITIONTYPE.pp_SR_TxDebug5_Byte1
      Debug5_Byte2: upstream-reference=SoftwareArchitecture.pp_SR_TxDebug5_Byte2.Debug5_Byte2, ecu-extract-reference=COMPOSITIONTYPE.pp_SR_TxDebug5_Byte2.Debug5_Byte2
      pp_SR_TxDebug5_Byte2: upstream-reference=SoftwareArchitecture.pp_SR_TxDebug5_Byte2, ecu-extract-reference=COMPOSITIONTYPE.pp_SR_TxDebug5_Byte2
      Debug5_Byte3: upstream-reference=SoftwareArchitecture.pp_SR_TxDebug5_Byte3.Debug5_Byte3, ecu-extract-reference=COMPOSITIONTYPE.pp_SR_TxDebug5_Byte3.Debug5_Byte3
      pp_SR_TxDebug5_Byte3: upstream-reference=SoftwareArchitecture.pp_SR_TxDebug5_Byte3, ecu-extract-reference=COMPOSITIONTYPE.pp_SR_TxDebug5_Byte3
      Debug5_Byte4: upstream-reference=SoftwareArchitecture.pp_SR_TxDebug5_Byte4.Debug5_Byte4, ecu-extract-reference=COMPOSITIONTYPE.pp_SR_TxDebug5_Byte4.Debug5_Byte4
      pp_SR_TxDebug5_Byte4: upstream-reference=SoftwareArchitecture.pp_SR_TxDebug5_Byte4, ecu-extract-reference=COMPOSITIONTYPE.pp_SR_TxDebug5_Byte4
      Debug5_Byte5: upstream-reference=SoftwareArchitecture.pp_SR_TxDebug5_Byte5.Debug5_Byte5, ecu-extract-reference=COMPOSITIONTYPE.pp_SR_TxDebug5_Byte5.Debug5_Byte5
      pp_SR_TxDebug5_Byte5: upstream-reference=SoftwareArchitecture.pp_SR_TxDebug5_Byte5, ecu-extract-reference=COMPOSITIONTYPE.pp_SR_TxDebug5_Byte5
      Debug5_Byte6: upstream-reference=SoftwareArchitecture.pp_SR_TxDebug5_Byte6.Debug5_Byte6, ecu-extract-reference=COMPOSITIONTYPE.pp_SR_TxDebug5_Byte6.Debug5_Byte6
      pp_SR_TxDebug5_Byte6: upstream-reference=SoftwareArchitecture.pp_SR_TxDebug5_Byte6, ecu-extract-reference=COMPOSITIONTYPE.pp_SR_TxDebug5_Byte6
      Debug5_Byte7: upstream-reference=SoftwareArchitecture.pp_SR_TxDebug5_Byte7.Debug5_Byte7, ecu-extract-reference=COMPOSITIONTYPE.pp_SR_TxDebug5_Byte7.Debug5_Byte7
      pp_SR_TxDebug5_Byte7: upstream-reference=SoftwareArchitecture.pp_SR_TxDebug5_Byte7, ecu-extract-reference=COMPOSITIONTYPE.pp_SR_TxDebug5_Byte7
      FV_Tx: upstream-reference=SoftwareArchitecture.pp_SR_TxFV_Tx.FV_Tx, ecu-extract-reference=COMPOSITIONTYPE.pp_SR_TxFV_Tx.FV_Tx
      pp_SR_TxFV_Tx: upstream-reference=SoftwareArchitecture.pp_SR_TxFV_Tx, ecu-extract-reference=COMPOSITIONTYPE.pp_SR_TxFV_Tx
      Illumination_PWM: upstream-reference=SoftwareArchitecture.pp_SR_TxIllumination_PWM.Illumination_PWM, ecu-extract-reference=COMPOSITIONTYPE.pp_SR_TxIllumination_PWM.Illumination_PWM
      pp_SR_TxIllumination_PWM: upstream-reference=SoftwareArchitecture.pp_SR_TxIllumination_PWM, ecu-extract-reference=COMPOSITIONTYPE.pp_SR_TxIllumination_PWM
      MAC_Tx: upstream-reference=SoftwareArchitecture.pp_SR_TxMAC_Tx.MAC_Tx, ecu-extract-reference=COMPOSITIONTYPE.pp_SR_TxMAC_Tx.MAC_Tx
      pp_SR_TxMAC_Tx: upstream-reference=SoftwareArchitecture.pp_SR_TxMAC_Tx, ecu-extract-reference=COMPOSITIONTYPE.pp_SR_TxMAC_Tx
      Odometer: upstream-reference=SoftwareArchitecture.pp_SR_TxOdometer.Odometer, ecu-extract-reference=COMPOSITIONTYPE.pp_SR_TxOdometer.Odometer
      pp_SR_TxOdometer: upstream-reference=SoftwareArchitecture.pp_SR_TxOdometer, ecu-extract-reference=COMPOSITIONTYPE.pp_SR_TxOdometer
      SecureTxByte0: upstream-reference=SoftwareArchitecture.pp_SR_TxSecureTxByte0.SecureTxByte0, ecu-extract-reference=COMPOSITIONTYPE.pp_SR_TxSecureTxByte0.SecureTxByte0
      pp_SR_TxSecureTxByte0: upstream-reference=SoftwareArchitecture.pp_SR_TxSecureTxByte0, ecu-extract-reference=COMPOSITIONTYPE.pp_SR_TxSecureTxByte0
      SecureTxByte1: upstream-reference=SoftwareArchitecture.pp_SR_TxSecureTxByte1.SecureTxByte1, ecu-extract-reference=COMPOSITIONTYPE.pp_SR_TxSecureTxByte1.SecureTxByte1
      pp_SR_TxSecureTxByte1: upstream-reference=SoftwareArchitecture.pp_SR_TxSecureTxByte1, ecu-extract-reference=COMPOSITIONTYPE.pp_SR_TxSecureTxByte1
      SecureTxByte2: upstream-reference=SoftwareArchitecture.pp_SR_TxSecureTxByte2.SecureTxByte2, ecu-extract-reference=COMPOSITIONTYPE.pp_SR_TxSecureTxByte2.SecureTxByte2
      pp_SR_TxSecureTxByte2: upstream-reference=SoftwareArchitecture.pp_SR_TxSecureTxByte2, ecu-extract-reference=COMPOSITIONTYPE.pp_SR_TxSecureTxByte2
      SecureTxByte3: upstream-reference=SoftwareArchitecture.pp_SR_TxSecureTxByte3.SecureTxByte3, ecu-extract-reference=COMPOSITIONTYPE.pp_SR_TxSecureTxByte3.SecureTxByte3
      pp_SR_TxSecureTxByte3: upstream-reference=SoftwareArchitecture.pp_SR_TxSecureTxByte3, ecu-extract-reference=COMPOSITIONTYPE.pp_SR_TxSecureTxByte3
      VehicleSpeedIC: upstream-reference=SoftwareArchitecture.pp_SR_TxVehicleSpeedIC.VehicleSpeedIC, ecu-extract-reference=COMPOSITIONTYPE.pp_SR_TxVehicleSpeedIC.VehicleSpeedIC
      pp_SR_TxVehicleSpeedIC: upstream-reference=SoftwareArchitecture.pp_SR_TxVehicleSpeedIC, ecu-extract-reference=COMPOSITIONTYPE.pp_SR_TxVehicleSpeedIC
      CRstM: upstream-reference=SoftwareArchitecture.CRstM, ecu-extract-reference=COMPOSITIONTYPE.CRstM
      EngineSpeed: upstream-reference=SoftwareArchitecture.rp_SR_RxEngineSpeed.EngineSpeed, ecu-extract-reference=COMPOSITIONTYPE.rp_SR_RxEngineSpeed.EngineSpeed
      rp_SR_RxEngineSpeed: upstream-reference=SoftwareArchitecture.rp_SR_RxEngineSpeed, ecu-extract-reference=COMPOSITIONTYPE.rp_SR_RxEngineSpeed
      Turn_Indicator_Control: upstream-reference=SoftwareArchitecture.rp_SR_RxTurn_Indicator_Control.Turn_Indicator_Control, ecu-extract-reference=COMPOSITIONTYPE.rp_SR_RxTurn_Indicator_Control.Turn_Indicator_Control
      rp_SR_RxTurn_Indicator_Control: upstream-reference=SoftwareArchitecture.rp_SR_RxTurn_Indicator_Control, ecu-extract-reference=COMPOSITIONTYPE.rp_SR_RxTurn_Indicator_Control
      CSigCdd: upstream-reference=SoftwareArchitecture.CSigCdd, ecu-extract-reference=COMPOSITIONTYPE.CSigCdd
      CSwcDispMonSf: upstream-reference=SoftwareArchitecture.CSwcDispMonSf, ecu-extract-reference=COMPOSITIONTYPE.CSwcDispMonSf
      CCDD_EcuBatteryM: upstream-reference=SoftwareArchitecture.CCDD_EcuBatteryM, ecu-extract-reference=COMPOSITIONTYPE.CCDD_EcuBatteryM
