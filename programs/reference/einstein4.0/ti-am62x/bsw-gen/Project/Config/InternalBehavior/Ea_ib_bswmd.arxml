AUTOSAR XML (schema 4-0-3)
package /MICROSAR/Ea_ib_bswmd/BswModuleDescriptions
  bsw module description Ea: provided-entrys=Ea_MainFunction
    bsw internal behavior EaBehavior
      bsw schedulable entity Ea_MainFunction: implemented-entry=Ea_MainFunction
      bsw timing event Ea_MainFunctionTimingEvent0: starts-on-event=Ea_MainFunction, period=0.005
  bsw module entry Ea_MainFunction: call-type=SCHEDULED, execution-context=TASK
