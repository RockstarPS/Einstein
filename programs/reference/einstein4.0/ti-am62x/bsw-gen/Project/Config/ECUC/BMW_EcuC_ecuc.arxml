AUTOSAR XML (schema 4-2-1)
package /ActiveEcuC
  module config EcuC: implementation-config-variant=VARIANT-PRE-COMPILE, module-description=EcuC_Impl
    EcucGeneral:
      CPUType = CPU32Bit
      SizeOfInt = Size32Bit
      ByteOrder = LITTLE_ENDIAN
      BitOrder = LSB_to_MSB
      AtomicBitAccessInBitfield = false
      AtomicVariableAccess = Atomic32BitAccess
      SizeOfEnum = Size32Bit
      SizeOfROMPointer = Size32Bit
      SizeOfRAMPointer = Size32Bit
      BitFieldDataType = INT
      StructAlignment = Auto
      ArrayAlignment = Auto
      StructInArrayAlignment = Auto
      DummyFunction = false
      EcuCSafeBswChecks = false
      DummyStatement = true
      DummyStatementKind = SelfAssignment
      ConditionalGenerating = true
      EcucBswImplementationCodeType = EcuCSourceCode
      EcuCUseStdReturnTypeForRte = false
      BswInitialization
        28 x InitFunction:
          SchM_Init: Header=Rte_Main.h, InitPhase=NO_INIT, ModuleRef=Rte
          Rte_InitMemory: Header=Rte_Main.h, InitPhase=INIT_MEMORY, ModuleRef=Rte
          Dcm_InitMemory: Header=Dcm.h, InitPhase=INIT_MEMORY, ModuleRef=Dcm
          Dcm_Init: Header=Dcm.h, InitPhase=INIT_TWO_POST_NVMREADALL, ConfigType=Dcm_ConfigType, ConfigPtrName=NULL_PTR, ConfigPtrClass=DCM_CONST, ModuleRef=Dcm
          Dem_PreInit: Header=Dem.h, InitPhase=INIT_ZERO, ConfigType=Dem_ConfigType, ConfigPtrName=Dem_Config_Ptr, ConfigPtrClass=DEM_INIT_DATA, ModuleRef=Dem
          Dem_Init: Header=Dem.h, InitPhase=INIT_TWO_POST_NVMREADALL, ConfigType=Dem_ConfigType, ConfigPtrName=Dem_Config_Ptr, ConfigPtrClass=DEM_INIT_DATA, ModuleRef=Dem
          Dem_InitMemory: Header=Dem.h, InitPhase=INIT_MEMORY, ModuleRef=Dem
          NvM_Init: Header=NvM.h, InitPhase=INIT_TWO_SYS, ModuleRef=NvM
          Ea_Init: Header=Ea.h, InitPhase=INIT_TWO_IF, ModuleRef=Ea
          BswM_Init: Header=BswM.h, InitPhase=NO_INIT, ConfigType=BswM_ConfigType, ConfigPtrName=BswM_Config_Ptr, ConfigPtrClass=BSWM_INIT_DATA, ModuleRef=BswM
          BswM_InitMemory: Header=BswM.h, InitPhase=INIT_MEMORY, ModuleRef=BswM
          CanIf_Init: Header=CanIf.h, InitPhase=INIT_TWO_IF, ConfigType=CanIf_ConfigType, ConfigPtrName=CanIf_Config_Ptr, ConfigPtrClass=CANIF_INIT_DATA, ModuleRef=CanIf
          CanIf_InitMemory: Header=CanIf.h, InitPhase=INIT_MEMORY, ModuleRef=CanIf
          CanSM_InitMemory: Header=CanSM_EcuM.h, InitPhase=INIT_MEMORY, ModuleRef=CanSM
          CanSM_Init: Header=CanSM_EcuM.h, InitPhase=INIT_TWO_SM, ConfigType=CanSM_ConfigType, ConfigPtrName=CanSM_Config_Ptr, ConfigPtrClass=CANSM_INIT_DATA, ModuleRef=CanSM
          Can_Init: Header=Can.h, InitPhase=INIT_TWO_DRV, ConfigType=Can_ConfigType, ConfigPtrName=Can_Config_Ptr, ConfigPtrClass=CAN_INIT_DATA, ModuleRef=Can
          Can_InitMemory: Header=Can.h, InitPhase=INIT_MEMORY, ModuleRef=Can
          ComM_Init: Header=ComM.h, InitPhase=INIT_TWO_POST_NVMREADALL, ModuleRef=ComM
          ComM_InitMemory: Header=ComM.h, InitPhase=INIT_MEMORY, ModuleRef=ComM
          Com_Init: Header=Com.h, InitPhase=INIT_TWO_COM, ConfigType=Com_ConfigType, ConfigPtrName=Com_Config_Ptr, ConfigPtrClass=COM_INIT_DATA, ModuleRef=Com
          Com_InitMemory: Header=Com.h, InitPhase=INIT_MEMORY, ModuleRef=Com
          EcuM_Init: Header=EcuM.h, InitPhase=NO_INIT, ConfigType=EcuM_PbConfigType, ConfigPtrName=EcuM_Config_Ptr, ConfigPtrClass=ECUM_INIT_DATA, ModuleRef=EcuM
          Mcu_Init: Header=Mcu.h, InitPhase=INIT_ONE, ConfigType=Mcu_ConfigType, ConfigPtrName=Mcu_ConfigPtr, ConfigPtrClass=MCU_APPL_CONST, ModuleRef=Mcu
          Mcu_InitMemory: Header=Mcu.h, InitPhase=INIT_MEMORY, ModuleRef=Mcu
          Nm_Init: Header=Nm.h, InitPhase=INIT_TWO_NM, ModuleRef=Nm
          Nm_InitMemory: Header=Nm.h, InitPhase=INIT_MEMORY, ModuleRef=Nm
          PduR_Init: Header=PduR.h, InitPhase=INIT_TWO_COM, ConfigType=PduR_PBConfigType, ConfigPtrName=PduR_Config_Ptr, ConfigPtrClass=PDUR_INIT_DATA, ModuleRef=PduR
          PduR_InitMemory: Header=PduR.h, InitPhase=INIT_MEMORY, ModuleRef=PduR
    EcucHardware
      EcucCoreDefinition: EcucCoreId=0
    EcucPartitionCollection
      EcucPartition_OsApplication_NonTrusted (EcucPartition): EcucPartitionBswModuleExecution=false, PartitionCanBeRestarted=false, ASIL=QM, EcucPartitionSoftwareComponentInstanceRef=Test_Comp
    EcucPduCollection: PduIdTypeEnum=UINT8, PduLengthTypeEnum=UINT8
      33 x Pdu, all with J1939Requestable=false:
        Diag_Resp_UUDT_oCAN00_06d3a8a3_Tx: PduLength=8
        Cluster_Secure_Tx_oCAN00_7e3ab6a5_Tx: PduLength=8
        Debug_Frame5_oCAN00_5ddbad41_Tx: PduLength=8
        Diag_Resp_UUDT_oCAN00_7f69f30b_Tx: PduLength=8, SysTPduToFrameMappingRef=Diag_Resp_UUDT
        NM_CoOrd_NMPDU_oCAN00_1fc35b6d_Rx: PduLength=8, SysTPduToFrameMappingRef=NM_CoOrd_NMPDU
        Cluster_Tx_Normal_COM_LS_oCAN00_5c979685_Tx: PduLength=4
        Debug_Frame1_oCAN00_48431553_Tx: PduLength=8, SysTPduToFrameMappingRef=Debug_Frame1
        Debug_Frame3_oCAN00_9bb4a4c6_Tx: PduLength=8
        Debug_Frame1_oCAN00_d991a3bb_Tx: PduLength=8
        Cluster_Tx_Normal_COM_HS_oCAN00_7765df5c_Tx: PduLength=3, SysTPduToFrameMappingRef=Cluster_Tx_Normal_COM_HS
        Cluster_Tx_Normal_COM_MS_oCAN00_4bec82c6_Tx: PduLength=2
        Illum_control_oCAN00_e09f90e5_Rx: PduLength=3
        Cluster_Tx_Normal_COM_HS_oCAN00_017bc789_Tx: PduLength=3
        Cluster_Tx_Normal_COM_MS_oCAN00_9f462424_Tx: PduLength=2, SysTPduToFrameMappingRef=Cluster_Tx_Normal_COM_MS
        Debug_Frame3_oCAN00_a5d5c6ba_Tx: PduLength=8, SysTPduToFrameMappingRef=Debug_Frame3
        Debug_Frame2_oCAN00_3ea62c6e_Tx: PduLength=8, SysTPduToFrameMappingRef=Debug_Frame2
        Debug_Frame4_oCAN00_9171addf_Tx: PduLength=8
        VehicleControl_oCAN00_cbe9282b_Rx: PduLength=8
        Cluster_Tx_Reduced_Com_oCAN00_4e2ce421_Tx: PduLength=1, SysTPduToFrameMappingRef=Cluster_Tx_Reduced_Com
        Cluster_Tx_Normal_COM_LS_oCAN00_1e634103_Tx: PduLength=4, SysTPduToFrameMappingRef=Cluster_Tx_Normal_COM_LS
        Debug_Frame4_oCAN00_d36c5e14_Tx: PduLength=8, SysTPduToFrameMappingRef=Debug_Frame4
        IC_NMPDU_oCAN00_7e631dbf_Tx: PduLength=(unset)
        VehicleControl_oCAN00_8e397222_Rx: PduLength=8, SysTPduToFrameMappingRef=VehicleControl
        Debug_Frame5_oCAN00_481fb4c0_Tx: PduLength=8, SysTPduToFrameMappingRef=Debug_Frame5
        Cluster_Secure_Tx_oCAN00_fbf04cbe_Tx: PduLength=8, SysTPduToFrameMappingRef=Cluster_Secure_Tx
        IC_NMPDU_oCAN00_57ad3fa9_Tx: PduLength=8, SysTPduToFrameMappingRef=IC_NMPDU
        Debug_Frame2_oCAN00_571ea458_Tx: PduLength=8
        Diag_Resp_USDT_oCAN00_0bcdd8e4_Tx: PduLength=8
        Diag_Resp_USDT_oCAN00_14b29fad_Tx: PduLength=8, SysTPduToFrameMappingRef=Diag_Resp_USDT
        Illum_control_oCAN00_8f78885e_Rx: PduLength=3, SysTPduToFrameMappingRef=Illum_control
        Cluster_Tx_Reduced_Com_oCAN00_8ca7c169_Tx: PduLength=1
        ABS_oCAN00_97526119_Rx: PduLength=7, SysTPduToFrameMappingRef=ABS
        ABS_oCAN00_29f7b4f6_Rx: PduLength=7
