AUTOSAR XML (schema 4-2-1)
package /ActiveEcuC
  module config Ea: implementation-config-variant=VARIANT-PRE-COMPILE, module-description=Ea_Impl
    EaGeneral:
      EaSetModeSupported = true
      EaDevErrorDetect = true
      EaIndex = 0
      EaPollingMode = true
      EaVersionInfoApi = false
      EaVirtualPageSize = 8
      EaNvMCallbackIncludeFile = NvM_Cbk.h
      EaCorrectSingleBitFlips = true
      EaMainFunctionPeriod = 0.005
      EaMainFunctionTriggering = FixedCycleTime
      EaSafeBswChecks = false
    EaBlockConfiguration:
      EaBlockNumber = 2
      EaBlockSize = 8
      EaImmediateData = false
      EaNumberOfWriteCycles = 10000
      EaNumberOfDatasets = 1
      EaNumberOfInstances = 1
      EaVerifyWrittenData = false
      EaBlockId = 0
      EaPartition = (unset)
    EaPublishedInformation: EaBlockOverhead=2, EaMaximumBlockingTime=0, EaPageOverhead=0
    EaPartitionConfiguration: EaPartitionStartAddress=0, EaPartitionSize=256, EaPartitionAddressAlignment=1, EaPartitionWriteAlignment=1, EaPartitionDevice=(unset)
    6 x EaBlockConfiguration, all with EaImmediateData=false, EaNumberOfWriteCycles=10000, EaNumberOfDatasets=2, EaNumberOfInstances=1, EaVerifyWrittenData=false, EaBlockId=0, EaPartition=(unset):
      EaNvBlockSwComponentTypeNVBlockDescriptor_NvMSampleBlock1: EaBlockNumber=4, EaBlockSize=8
      EaNvBlockSwComponentTypeNVBlockDescriptor_SampleBlock2: EaBlockNumber=6, EaBlockSize=16
      EaNvBlockSwComponentTypeNVBlockDescriptor_BsFuSa_FeatureData: EaBlockNumber=8, EaBlockSize=1
      EaNvBlockSwComponentTypeNVBlockDescriptor_BsConst_Illumination: EaBlockNumber=10, EaBlockSize=1
      EaNvBlockSwComponentTypeNVBlockDescriptor_BsConst_Illumination_Copy1: EaBlockNumber=12, EaBlockSize=1
      EaNvBlockSwComponentTypeNVBlockDescriptor_BsConst_Illumination_Copy2: EaBlockNumber=14, EaBlockSize=1
