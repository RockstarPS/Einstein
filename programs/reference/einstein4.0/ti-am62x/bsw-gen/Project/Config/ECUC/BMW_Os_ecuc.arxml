AUTOSAR XML (schema 4-2-1)
package /ActiveEcuC
  module config Os: implementation-config-variant=VARIANT-PRE-COMPILE, module-description=Os_Impl
    SystemTimer (OsCounter):
      OsCounterMaxAllowedValue = 2147483647
      OsCounterMinCycle = 1
      OsCounterType = HARDWARE
      OsSecondsPerTick = 0.001
      OsCounterTicksPerBase = 1
      OsCounterAccessingApplication = OsApplication_NonTrusted
      OsCounterAccessingApplication = OsApplication_Trusted
      OsDriver: OsDriverHighResolution=false, OsDriverIsrRef=OsIsr, OsDriverHardwareTimerChannelRef=FRT_1_Ch0
    OsOS:
      OsGenerateMemMapForNearAddressing = false
      OsStackMonitoring = true
      OsStatus = EXTENDED
      OsUseGetServiceId = false
      OsUseParameterAccess = false
      OsUseResScheduler = false
      OsForcibleTermination = false
      OsGenerateCalloutStubs = true
      OsGenerateMemMap = COMPLETE
      OsGenerateMemMapForThreads = false
      OsServiceProtection = false
      OsStackUsageMeasurement = false
      OsUseXSignalAsyncApiCalls = false
      OsFpuUsage = NONE
      OsScalabilityClass = SC3
      OsNumberOfCores = 1
      OsMasterCore = OsCore0
      OsSystemTimer = SystemTimer
      OsHooks: OsErrorHook=true, OsPostTaskHook=false, OsPreTaskHook=false, OsShutdownHook=false, OsStartupHook=false
      OsStackSummary
        32 x OsStack, all with OsStackCore=OsCore0:
          OsCore0_Error: OsStackSize=1024, OsStackType=CORE_ERROR_STACK, OsStackUser=OsCore0
          OsCore0_Init: OsStackSize=1024, OsStackType=CORE_INIT_STACK, OsStackUser=OsCore0
          OsCore0_Kernel: OsStackSize=1024, OsStackType=CORE_KERNEL_STACK, OsStackUser=OsCore0
          OsTask_NvmSpeedup: OsStackSize=1024, OsStackType=TASK_SHARED_PRIORITY_STACK, OsStackUser=Os/OsTask_NvmSpeedup
          OsCore0_Isr_Core: OsStackSize=1024, OsStackType=ISR_SHARED_CORE_STACK, OsStackUser=OsIsr
          OsCore0_Task_Prio0: OsStackSize=1024, OsStackType=TASK_SHARED_PRIORITY_STACK, OsStackUser=OsTask_IdleTask, OsStackUser=IdleTask_OsCore0
          OsCore0_Task_Prio11: OsStackSize=1024, OsStackType=TASK_SHARED_PRIORITY_STACK, OsStackUser=OsTask_AudioFun
          OsTask_Diagnostics: OsStackSize=2048, OsStackType=TASK_SHARED_PRIORITY_STACK, OsStackUser=Os/OsTask_Diagnostics
          OsCore0_Task_Prio13: OsStackSize=1024, OsStackType=TASK_SHARED_PRIORITY_STACK, OsStackUser=OsTask_LinFun
          OsTask_SafeBsw: OsStackSize=1024, OsStackType=TASK_SHARED_PRIORITY_STACK, OsStackUser=Os/OsTask_SafeBsw
          OsCore0_Task_Prio26: OsStackSize=512, OsStackType=TASK_SHARED_PRIORITY_STACK, OsStackUser=InitTask
          OsCore0_Task_Prio23: OsStackSize=1024, OsStackType=TASK_SHARED_PRIORITY_STACK, OsStackUser=OsTask_WdgMngt
          OsTask_DispFun: OsStackSize=1024, OsStackType=TASK_SHARED_PRIORITY_STACK, OsStackUser=Os/OsTask_DispFun
          OsCore0_Task_Prio17: OsStackSize=1024, OsStackType=TASK_SHARED_PRIORITY_STACK, OsStackUser=OsTask_EthFun
          OsCore0_Task_Prio4: OsStackSize=1024, OsStackType=TASK_SHARED_PRIORITY_STACK, OsStackUser=OsTask_FotaFun
          OsTask_IpcUclEv: OsStackSize=4096, OsStackType=TASK_SHARED_PRIORITY_STACK, OsStackUser=Os/OsTask_IpcUclEv
          OsTask_LSH_16ms: OsStackSize=2048, OsStackType=TASK_SHARED_PRIORITY_STACK, OsStackUser=Os/OsTask_LSH_16ms
          OsCore0_Task_Prio21: OsStackSize=1024, OsStackType=TASK_SHARED_PRIORITY_STACK, OsStackUser=OsTask_Mcal
          OsTask_MemSer: OsStackSize=1024, OsStackType=TASK_SHARED_PRIORITY_STACK, OsStackUser=Os/OsTask_MemSer
          OsTask_ModeMgt: OsStackSize=1024, OsStackType=TASK_SHARED_PRIORITY_STACK, OsStackUser=Os/OsTask_ModeMgt
          OsCore0_Task_Prio6: OsStackSize=1024, OsStackType=TASK_SHARED_PRIORITY_STACK, OsStackUser=OsTask_TripFun
          OsCore0_Task_Prio9: OsStackSize=1024, OsStackType=TASK_SHARED_PRIORITY_STACK, OsStackUser=OsTask_WarnFun
          OsCore0_Task_Prio3: OsStackSize=1024, OsStackType=TASK_SHARED_PRIORITY_STACK, OsStackUser=OsTask_FotaEv
          OsCore0_Task_Prio1: OsStackSize=4096, OsStackType=TASK_SHARED_PRIORITY_STACK, OsStackUser=OsTaskRender
          OsCore0_Task_Prio18: OsStackSize=1024, OsStackType=TASK_SHARED_PRIORITY_STACK, OsStackUser=OsTask_Can1DataRxEv
          OsCore0_Task_Prio19: OsStackSize=1024, OsStackType=TASK_SHARED_PRIORITY_STACK, OsStackUser=OsTask_Can0DataRxEv
          OsTask_CANFun: OsStackSize=1024, OsStackType=TASK_SHARED_PRIORITY_STACK, OsStackUser=Os/OsTask_CANFun
          OsCore0_Task_Prio2: OsStackSize=1024, OsStackType=TASK_SHARED_PRIORITY_STACK, OsStackUser=OsTask_Graphics
          OsCore0_Task_Prio5: OsStackSize=1024, OsStackType=TASK_SHARED_PRIORITY_STACK, OsStackUser=OsTask_AppFun
          OsCore0_Task_Prio14: OsStackSize=1024, OsStackType=TASK_SHARED_PRIORITY_STACK, OsStackUser=OsTask_GaugeFun
          OsCore0_Task_Prio15: OsStackSize=1024, OsStackType=TASK_SHARED_PRIORITY_STACK, OsStackUser=OsTask_SafeApp
          OsCore0_Task_Prio10: OsStackSize=1024, OsStackType=TASK_SHARED_PRIORITY_STACK, OsStackUser=OsTask_IndFun
    OsMemoryProtection
      4 x OsMemoryRegion, all with OsMemoryRegionProtectionUnit=Core0_MPU, OsMemoryRegionFlags=TYPE_CACHEABLE_WRITEBACK_ALLOCATE:
        Core0_FullAccessSupervisor: OsMemoryRegionStartAddress=0, OsMemoryRegionEndAddress=0x100000000, OsMemoryRegionProtectionUnitSlot=0, OsMemoryRegionAccessRights=SUPERVISOR_RWX, OsMemoryRegionAccessRights=USER_RX
        Core0_StackProtection: OsMemoryRegionStartAddress=_OS_CORE0_STACKS_START, OsMemoryRegionProtectionUnitSlot=1, OsMemoryRegionEndAddress=1024, OsMemoryRegionAccessRights=SUPERVISOR_R, OsMemoryRegionAccessRights=USER_R
        MemoryRegion_App_OsApplication_NonTrusted: OsMemoryRegionStartAddress=_OS_OsApplication_NonTrusted_VAR_ALL_START, OsMemoryRegionEndAddress=1024, OsMemoryRegionIdentifier=1, OsMemoryRegionProtectionUnitSlot=14, OsMemoryRegionAccessRights=SUPERVISOR_RW, OsMemoryRegionOwner=OsApplication_NonTrusted, OsMemoryRegionAccessRights=USER_RW
        MemoryRegion_App_OsApplication_Trusted: OsMemoryRegionStartAddress=_OS_OsApplication_Trusted_VAR_ALL_START, OsMemoryRegionEndAddress=1024, OsMemoryRegionIdentifier=1, OsMemoryRegionProtectionUnitSlot=14, OsMemoryRegionAccessRights=SUPERVISOR_RW, OsMemoryRegionOwner=OsApplication_Trusted, OsMemoryRegionAccessRights=USER_R
    OSDEFAULTAPPMODE (OsAppMode)
    OS_APPMODE_ANY (OsAppMode)
    OsPublishedInformation: OsKernelVersion=7, OsPlatformName=Arm
      S6J32xx (OsDerivativeInformation):
        OsMpuAlignment = SIZE
        OsStackAlignment = 0
        OsExceptionVectorTableAlignment = 0
        OsInterruptVectorTableAlignment = 0
        OsHardwareManuals = ARM Architecture Reference Manual ARMv7-A and ARMv7-R edition: ARM DDI 0406C.c (ID051414), 20 May 2014 Spansion Traveo Family Hardware Manual Platform Part: Doc. No. 002-04854 Rev. *A, 26 July 2015 S6J3200 Series Spansion Traveo Family Hardware Manual: Doc. No. 002-04852 Rev. *A, 13 October 2015
        Core0 (OsPhysicalCore):
          OsPhysicalCoreId = 0
          OsPhysicalCoreType = Cortex-R_Traveo
          OsPhysicalCoreExceptionSources = 8
          OsPhysicalCoreIsAutostart = true
          OsPhysicalCoreMasterStartAllowed = true
          OsPhysicalCorePrivelegedHwAccess = true
          OsPhysicalCoreStackProtectionUnit = Core0_MPU
          Core0_MPU (OsPhysicalCoreMpu): OsPhysicalCoreMpuMaxRegions=16, OsPhysicalCoreMpuId=0, OsPhysicalCoreMpuType=CoreMpu
        FRT_1 (OsHardwareTimer): OsHardwareTimerSize=32, OsHardwareTimerUnit=FRT, OsHardwareTimerBaseAddress=3028418564, OsHardwareTimerId=0, OsHardwareTimerType=FRT
          8 x OsHardwareTimerChannel:
            FRT_1_Ch0: OsHardwareTimerChannelOffset=0, OsHardwareTimerChannelIntSource=208, OsHardwareTimerChannelId=0
            FRT_1_Ch1: OsHardwareTimerChannelOffset=1024, OsHardwareTimerChannelIntSource=209, OsHardwareTimerChannelId=1
            FRT_1_Ch2: OsHardwareTimerChannelOffset=2048, OsHardwareTimerChannelIntSource=210, OsHardwareTimerChannelId=2
            FRT_1_Ch3: OsHardwareTimerChannelOffset=3072, OsHardwareTimerChannelIntSource=211, OsHardwareTimerChannelId=3
            FRT_1_Ch4: OsHardwareTimerChannelOffset=4096, OsHardwareTimerChannelIntSource=212, OsHardwareTimerChannelId=4
            FRT_1_Ch5: OsHardwareTimerChannelOffset=5120, OsHardwareTimerChannelIntSource=213, OsHardwareTimerChannelId=5
            FRT_1_Ch6: OsHardwareTimerChannelOffset=6144, OsHardwareTimerChannelIntSource=214, OsHardwareTimerChannelId=6
            FRT_1_Ch7: OsHardwareTimerChannelOffset=7168, OsHardwareTimerChannelIntSource=215, OsHardwareTimerChannelId=7
          FRTCompareBaseAddress (OsHardwareTimerAddress): OsHardwareTimerAddressValue=3028484096
        INTC (OsSystemIntCtrl):
          OsSystemIntCtrlMaxPrios = 32
          OsSystemIntCtrlMaxSources = 512
          OsSystemIntCtrlPrioOrder = DESC
          OsSystemIntCtrlBaseAddress = 2956984320
          OsSystemIntCtrlType = Traveo
        FRT_2 (OsHardwareTimer): OsHardwareTimerSize=32, OsHardwareTimerUnit=FRT, OsHardwareTimerBaseAddress=3028942852, OsHardwareTimerId=0, OsHardwareTimerType=FRT
          4 x OsHardwareTimerChannel:
            FRT_2_Ch8: OsHardwareTimerChannelOffset=0, OsHardwareTimerChannelIntSource=216, OsHardwareTimerChannelId=8
            FRT_2_Ch9: OsHardwareTimerChannelOffset=1024, OsHardwareTimerChannelIntSource=217, OsHardwareTimerChannelId=9
            FRT_2_Ch10: OsHardwareTimerChannelOffset=2048, OsHardwareTimerChannelIntSource=218, OsHardwareTimerChannelId=10
            FRT_2_Ch11: OsHardwareTimerChannelOffset=3072, OsHardwareTimerChannelIntSource=219, OsHardwareTimerChannelId=11
          FRTCompareBaseAddress (OsHardwareTimerAddress): OsHardwareTimerAddressValue=3029008384
        OsMemoryRegionSpecifics
          10 x OsMemoryRegionAccess:
            SUPERVISOR_R: OsMemoryRegionAccessRights=R, OsMemoryRegionAccessType=SUPERVISOR
            SUPERVISOR_RW: OsMemoryRegionAccessRights=RW, OsMemoryRegionAccessType=SUPERVISOR
            USER_R: OsMemoryRegionAccessRights=R, OsMemoryRegionAccessType=USER
            USER_RW: OsMemoryRegionAccessRights=RW, OsMemoryRegionAccessType=USER
            SUPERVISOR_NONE: OsMemoryRegionAccessRights=NONE, OsMemoryRegionAccessType=SUPERVISOR
            USER_NONE: OsMemoryRegionAccessRights=NONE, OsMemoryRegionAccessType=USER
            SUPERVISOR_RX: OsMemoryRegionAccessRights=RX, OsMemoryRegionAccessType=SUPERVISOR
            SUPERVISOR_RWX: OsMemoryRegionAccessRights=RWX, OsMemoryRegionAccessType=SUPERVISOR
            USER_RX: OsMemoryRegionAccessRights=RX, OsMemoryRegionAccessType=USER
            USER_RWX: OsMemoryRegionAccessRights=RWX, OsMemoryRegionAccessType=USER
          8 x OsMemoryRegionFlag:
            SHAREABLE
            TYPE_STRONGLY_ORDERED
            TYPE_NON_CACHEABLE
            TYPE_CACHEABLE_WRITEBACK_ALLOCATE
            TYPE_SHAREABLE_DEVICE
            TYPE_NON_SHAREABLE_DEVICE
            TYPE_CACHEABLE_WRITETHROUGH_NO_ALLOCATE
            TYPE_CACHEABLE_WRITEBACK_NO_ALLOCATE
        ReloadTimer_1 (OsHardwareTimer): OsHardwareTimerUnit=PIT, OsHardwareTimerSize=32, OsHardwareTimerBaseAddress=3028353024, OsHardwareTimerId=0, OsHardwareTimerType=ReloadTimer
          4 x OsHardwareTimerChannel:
            ReloadTimer_1_Ch0: OsHardwareTimerChannelIntSource=152, OsHardwareTimerChannelOffset=0, OsHardwareTimerChannelId=0
            ReloadTimer_1_Ch1: OsHardwareTimerChannelIntSource=153, OsHardwareTimerChannelOffset=1024, OsHardwareTimerChannelId=1
            ReloadTimer_1_Ch2: OsHardwareTimerChannelIntSource=154, OsHardwareTimerChannelOffset=2048, OsHardwareTimerChannelId=2
            ReloadTimer_1_Ch3: OsHardwareTimerChannelIntSource=155, OsHardwareTimerChannelOffset=3072, OsHardwareTimerChannelId=3
        OsMemoryRegionDefaults_AppT (OsMemoryRegionDefaults):
          OsMemoryRegionDefIdentifier = 1
          OsMemoryRegionDefType = APPLICATION_TRUSTED
          OsMemoryRegionDefProtectionUnitSlot = 14
          OsMemoryRegionDefAccessRights = SUPERVISOR_RW
          OsMemoryRegionDefAccessRights = USER_R
          OsMemoryRegionDefFlags = TYPE_CACHEABLE_WRITEBACK_ALLOCATE
        OsMemoryRegionDefaults_AppNT (OsMemoryRegionDefaults):
          OsMemoryRegionDefIdentifier = 1
          OsMemoryRegionDefType = APPLICATION_NONTRUSTED
          OsMemoryRegionDefProtectionUnitSlot = 14
          OsMemoryRegionDefAccessRights = SUPERVISOR_RW
          OsMemoryRegionDefAccessRights = USER_RW
          OsMemoryRegionDefFlags = TYPE_CACHEABLE_WRITEBACK_ALLOCATE
        FIQ (OsInterruptSupportedType): OsInterruptSupportedTypeSeparateSources=true
        DEFAULT (OsInterruptSupportedType): OsInterruptSupportedTypeSeparateSources=true
    OsCore0 (OsCore):
      OsCoreIsAutostart = true
      OsCoreIsAutosar = true
      OsCorePhysicalCoreRef = Core0
      OsCoreIdleTask = IdleTask_OsCore0
      OsCoreEcucCoreRef = EcucCoreDefinition
      OsCoreSystemApplication = OsApplication_Trusted
      OsCoreStacks:
        OsCoreKernelStackSize = 1024
        OsCoreStartupStackSize = 1024
        OsCoreShutdownStackSize = 1024
        OsCoreErrorStackSize = 1024
        OsCoreProtectionStackSize = 1024
        OsCoreInitStackSize = 1024
    IdleTask_OsCore0 (OsTask):
      OsTaskActivation = 1
      OsTaskSchedule = FULL
      OsTaskStackSharing = false
      OsTaskStackSize = 1024
      OsTaskType = BASIC
      OsTaskUsesFpu = false
      OsTaskPriority = 0
      OsTaskAccessingApplication = OsApplication_NonTrusted
      OsTaskAccessingApplication = OsApplication_Trusted
      OsTaskAutostart: OsTaskAppModeRef=OS_APPMODE_ANY
    OsApplication_Trusted (OsApplication):
      OsTrusted = true
      OsTrustedApplicationDelayTimingViolationCall = false
      OsTrustedApplicationWithProtection = false
      OsApplicationIsPrivileged = true
      OsAppUseTrustedFunctionStubs = true
      OsApplicationCoreRef = EcucCoreDefinition
      OsAppTaskRef = Os/OsTask_SafeBsw
      OsAppTaskRef = OsTask_SafeApp
      OsAppTaskRef = InitTask
      OsAppTaskRef = OsTask_WdgMngt
      OsAppAlarmRef = Rte_Al_TE_OsTask_WdgMngt_0_10ms
      OsAppCounterRef = SystemTimer
      OsAppIsrRef = OsIsr
      OsAppTaskRef = IdleTask_OsCore0
      OsAppAlarmRef = Rte_Al_TE_OsTask_SafeBsw_0_10ms
      OsAppAlarmRef = Rte_Al_TE_IoHwAb_IoHwAb_OsTask_SafeBsw_WdgM_CheckPoint_20ms
      OsAppAlarmRef = Rte_Al_TE2_OsTask_SafeBsw_0_10ms
      OsAppAlarmRef = Rte_Al_TE_OsTask_SafeApp_0_30ms
      OsApplicationHooks: OsAppErrorHook=false, OsAppShutdownHook=false, OsAppStartupHook=false
    OsIsr:
      OsIsrCategory = CATEGORY_2
      OsIsrInterruptType = EXTERNAL
      OsIsrInterruptSource = 208
      OsIsrInterruptPriority = 0
      OsIsrStackSize = 1024
      OsIsrEnableNesting = false
      OsIsrUsesFpu = false
      OsIsrInitialEnableInterruptSource = false
      OsIsrSpecialFunctionName = Os_TimerPfrtIsr
      OsIsrInterruptMapping = DEFAULT
    Rte_Al_TE_UclProxyCdd_CUclProxyCdd_Impl_MainFunction (OsAlarm): OsAlarmCounterRef=SystemTimer, OsAlarmAccessingApplication=OsApplication_NonTrusted, OsAlarmAccessingApplication=OsApplication_Trusted
      OsAlarmAction
        OsAlarmSetEvent: OsAlarmSetEventRef=Rte_Ev_Run_UclProxyCdd_CUclProxyCdd_Impl_MainFunction, OsAlarmSetEventTaskRef=Os/OsTask_IpcUclEv
    4 x OsEvent:
      Rte_Ev_Run_UclProxyCdd_CUclProxyCdd_Impl_MainFunction
      Rte_Ev_Run_UclProxyCdd_OnDre_HealthDumpGetData
      Rte_Ev_Run_UclProxyCdd_OnDre_HealthDumpGetHdr
      Rte_Ev_Run_UclProxyCdd_OnDre_PowerSystemStateReqChange
    Rte_Al_TE_Ea_Ea_MainFunction (OsAlarm): OsAlarmCounterRef=SystemTimer, OsAlarmAccessingApplication=OsApplication_NonTrusted, OsAlarmAccessingApplication=OsApplication_Trusted
      OsAlarmAction
        OsAlarmSetEvent: OsAlarmSetEventRef=Rte_Ev_Run_Ea_Ea_MainFunction, OsAlarmSetEventTaskRef=Os/OsTask_MemSer
    3 x OsEvent:
      Rte_Ev_Run_Ea_Ea_MainFunction
      Rte_Ev_Run_NvBlockSwComponentType_NvBlockSwComponentTypeRunnable
      Rte_Ev_Cyclic_MemSer_10msLP_0_10ms
    16 x OsTask, all with OsTaskActivation=1, OsTaskStackSharing=false, OsTaskUsesFpu=false, OsTaskAccessingApplication=OsApplication_NonTrusted, OsTaskAccessingApplication=OsApplication_Trusted:
      OsTask_ModeMgt: OsTaskPriority=25, OsTaskSchedule=NON, OsTaskStackSize=1024, OsTaskType=EXTENDED, OsTaskEventRef=Rte_Ev_Cyclic2_OsTask_ModeMgt_0_10ms, OsTaskEventRef=Rte_Ev_Cyclic_OsTask_ModeMgt_0_10ms
      OsTask_DispFun: OsTaskPriority=24, OsTaskSchedule=NON, OsTaskStackSize=1024, OsTaskType=EXTENDED, OsTaskEventRef=Rte_Ev_Cyclic_OsTask_DispFun_0_10ms, OsTaskEventRef=Rte_Ev_Run_SlowGaugeAdapter_SlowGaugeAdapter_Task, OsTaskEventRef=Rte_Ev_Cyclic_OsTask_DispFun_0_5ms
      OsTask_WdgMngt: OsTaskPriority=23, OsTaskSchedule=NON, OsTaskStackSize=1024, OsTaskType=BASIC
      OsTask_MemSer: OsTaskPriority=22, OsTaskSchedule=NON, OsTaskStackSize=1024, OsTaskType=EXTENDED, OsTaskEventRef=Rte_Ev_Cyclic_MemSer_10msLP_0_10ms, OsTaskEventRef=Rte_Ev_Cyclic2_OsTask_MemSer_0_10ms, OsTaskEventRef=Rte_Ev_Cyclic_OsTask_MemSer_0_10ms, OsTaskEventRef=Rte_Ev_Run_Ea_Ea_MainFunction, OsTaskEventRef=Rte_Ev_Run_NvBlockSwComponentType_NvBlockSwComponentTypeRunnable
      OsTask_Mcal: OsTaskPriority=21, OsTaskSchedule=NON, OsTaskStackSize=1024, OsTaskType=BASIC
      OsTask_CANFun: OsTaskPriority=2, OsTaskSchedule=NON, OsTaskStackSize=1024, OsTaskType=EXTENDED, OsTaskEventRef=Rte_Ev_Cyclic2_OsTask_CANFun_0_10ms, OsTaskEventRef=Rte_Ev_Cyclic_OsTask_CANFun_0_10ms
      OsTask_EthFun: OsTaskPriority=17, OsTaskSchedule=NON, OsTaskStackSize=1024, OsTaskType=BASIC
      OsTask_GaugeFun: OsTaskPriority=14, OsTaskSchedule=NON, OsTaskStackSize=1024, OsTaskType=BASIC
      OsTask_LinFun: OsTaskPriority=13, OsTaskSchedule=NON, OsTaskStackSize=1024, OsTaskType=BASIC
      OsTask_AudioFun: OsTaskPriority=11, OsTaskSchedule=NON, OsTaskStackSize=1024, OsTaskType=BASIC
      OsTask_IndFun: OsTaskPriority=10, OsTaskSchedule=NON, OsTaskStackSize=1024, OsTaskType=BASIC
      OsTask_WarnFun: OsTaskPriority=9, OsTaskSchedule=NON, OsTaskStackSize=1024, OsTaskType=BASIC
      OsTask_TripFun: OsTaskPriority=6, OsTaskSchedule=NON, OsTaskStackSize=1024, OsTaskType=BASIC
      OsTask_AppFun: OsTaskPriority=5, OsTaskSchedule=NON, OsTaskStackSize=1024, OsTaskType=BASIC
      OsTask_FotaFun: OsTaskPriority=4, OsTaskSchedule=FULL, OsTaskStackSize=1024, OsTaskType=BASIC
      OsTask_Diagnostics: OsTaskPriority=12, OsTaskSchedule=NON, OsTaskStackSize=2048, OsTaskType=EXTENDED, OsTaskEventRef=Rte_Ev_Cyclic2_OsTask_Diagnostics_0_10ms, OsTaskEventRef=Rte_Ev_Cyclic_OsTask_Diagnostics_0_100ms, OsTaskEventRef=Rte_Ev_Cyclic_OsTask_Diagnostics_0_10ms, OsTaskEventRef=Rte_Ev_Cyclic_OsTask_Diagnostics_0_20ms
    5 x OsAlarm, all with OsAlarmCounterRef=SystemTimer, OsAlarmAccessingApplication=OsApplication_NonTrusted, OsAlarmAccessingApplication=OsApplication_Trusted:
      Rte_Al_TE2_OsTask_ModeMgt_5msLP_0_5ms
        OsAlarmAction
          OsAlarmActivateTask: OsAlarmActivateTaskRef=Os/OsTask_ModeMgt
      Rte_Al_TE2_OsTask_Mcal_10msLP_0_10ms
        OsAlarmAction
          OsAlarmActivateTask: OsAlarmActivateTaskRef=OsTask_Mcal
      Rte_Al_TE_OsTask_Mcal_0_10ms
        OsAlarmAction
          OsAlarmActivateTask: OsAlarmActivateTaskRef=OsTask_Mcal
      Rte_Al_TE2_OsTask_MemSer_0_10ms
        OsAlarmAction
          OsAlarmSetEvent: OsAlarmSetEventRef=Rte_Ev_Cyclic2_OsTask_MemSer_0_10ms, OsAlarmSetEventTaskRef=Os/OsTask_MemSer
      Rte_Al_TE_OsTask_MemSer_0_10ms
        OsAlarmAction
          OsAlarmSetEvent: OsAlarmSetEventRef=Rte_Ev_Cyclic_OsTask_MemSer_0_10ms, OsAlarmSetEventTaskRef=Os/OsTask_MemSer
    Rte_Ev_Cyclic2_OsTask_MemSer_0_10ms (OsEvent)
    Rte_Ev_Cyclic_OsTask_MemSer_0_10ms (OsEvent)
    OsTask_NvmSpeedup (OsTask):
      OsTaskActivation = 1
      OsTaskPriority = 7
      OsTaskSchedule = FULL
      OsTaskStackSharing = false
      OsTaskStackSize = 1024
      OsTaskType = EXTENDED
      OsTaskUsesFpu = false
      OsTaskEventRef = Rte_Ev_Run_NvMExt_NvMExt_SpeedupRunnable
      OsTaskAccessingApplication = OsApplication_NonTrusted
      OsTaskAccessingApplication = OsApplication_Trusted
    Rte_Ev_Run_NvMExt_NvMExt_SpeedupRunnable (OsEvent)
    5 x OsAlarm, all with OsAlarmCounterRef=SystemTimer, OsAlarmAccessingApplication=OsApplication_NonTrusted, OsAlarmAccessingApplication=OsApplication_Trusted:
      Rte_Al_TE_Test_Comp_AudioTaskStubRunnable
        OsAlarmAction
          OsAlarmActivateTask: OsAlarmActivateTaskRef=OsTask_AudioFun
      Rte_Al_TE_OsTask_CANFun_0_10ms
        OsAlarmAction
          OsAlarmSetEvent: OsAlarmSetEventRef=Rte_Ev_Cyclic_OsTask_CANFun_0_10ms, OsAlarmSetEventTaskRef=Os/OsTask_CANFun
      Rte_Al_TE_Test_Comp_FotaTaskStubRunnable
        OsAlarmAction
          OsAlarmActivateTask: OsAlarmActivateTaskRef=OsTask_FotaFun
      Rte_Al_TE_Test_Comp_LinTaskStubRunnable
        OsAlarmAction
          OsAlarmActivateTask: OsAlarmActivateTaskRef=OsTask_LinFun
      Rte_Al_TE_NvMExt_NvMExt_SpeedupRunnable
        OsAlarmAction
          OsAlarmSetEvent: OsAlarmSetEventRef=Rte_Ev_Run_NvMExt_NvMExt_SpeedupRunnable, OsAlarmSetEventTaskRef=Os/OsTask_NvmSpeedup
    7 x OsEvent:
      Rte_Ev_Run_DmnMgr_DmnMgr_MonitorDmnExtendShutdownTime
      Rte_Ev_Run_DmnMgr_DmnMgr_MonitorDmnHealthDumpData
      Rte_Ev_Run_DmnMgr_DmnMgr_MonitorDmnHealthDumpHdrInfo
      Rte_Ev_Run_DmnMgr_DmnMgr_MonitorDmnHealthFatalError
      Rte_Ev_Run_DmnMgr_DmnMgr_MonitorDmnHeartBeat
      Rte_Ev_Run_DmnMgr_DmnMgr_MonitorDmnKeepSystemAwake
      Rte_Ev_Run_DmnMgr_DmnMgr_MonitorDmnPowerSystemState
    Rte_Al_TE2_OsTask_Diagnostics_0_10ms (OsAlarm): OsAlarmCounterRef=SystemTimer, OsAlarmAccessingApplication=OsApplication_NonTrusted, OsAlarmAccessingApplication=OsApplication_Trusted
      OsAlarmAction
        OsAlarmSetEvent: OsAlarmSetEventRef=Rte_Ev_Cyclic2_OsTask_Diagnostics_0_10ms, OsAlarmSetEventTaskRef=Os/OsTask_Diagnostics
    Rte_Al_TE_OsTask_Diagnostics_0_100ms (OsAlarm): OsAlarmCounterRef=SystemTimer, OsAlarmAccessingApplication=OsApplication_NonTrusted, OsAlarmAccessingApplication=OsApplication_Trusted
      OsAlarmAction
        OsAlarmSetEvent: OsAlarmSetEventRef=Rte_Ev_Cyclic_OsTask_Diagnostics_0_100ms, OsAlarmSetEventTaskRef=Os/OsTask_Diagnostics
    Rte_Ev_Cyclic2_OsTask_Diagnostics_0_10ms (OsEvent)
    Rte_Ev_Cyclic_OsTask_Diagnostics_0_100ms (OsEvent)
    Rte_Al_TE_OsTask_Diagnostics_0_10ms (OsAlarm): OsAlarmCounterRef=SystemTimer, OsAlarmAccessingApplication=OsApplication_NonTrusted, OsAlarmAccessingApplication=OsApplication_Trusted
      OsAlarmAction
        OsAlarmSetEvent: OsAlarmSetEventRef=Rte_Ev_Cyclic_OsTask_Diagnostics_0_10ms, OsAlarmSetEventTaskRef=Os/OsTask_Diagnostics
    Rte_Ev_Cyclic_OsTask_Diagnostics_0_10ms (OsEvent)
    Rte_Ev_Run_UclProxyCdd_OnDre_DisplaySetPower (OsEvent)
    OsTask_LSH_16ms (OsTask):
      OsTaskActivation = 1
      OsTaskPriority = 20
      OsTaskSchedule = NON
      OsTaskStackSharing = false
      OsTaskStackSize = 2048
      OsTaskType = EXTENDED
      OsTaskUsesFpu = false
      OsTaskAccessingApplication = OsApplication_NonTrusted
      OsTaskAccessingApplication = OsApplication_Trusted
      OsTaskEventRef = Rte_Ev_Cyclic_OsTask_LSH_16ms_0_16ms
    OsTaskRender (OsTask):
      OsTaskActivation = 1
      OsTaskPriority = 1
      OsTaskSchedule = FULL
      OsTaskStackSharing = false
      OsTaskStackSize = 4096
      OsTaskType = BASIC
      OsTaskUsesFpu = false
      OsTaskAccessingApplication = OsApplication_NonTrusted
      OsTaskAccessingApplication = OsApplication_Trusted
      OsTaskAutostart: OsTaskAppModeRef=OS_APPMODE_ANY
    OsApplication_NonTrusted (OsApplication):
      OsTrusted = false
      OsTrustedApplicationDelayTimingViolationCall = false
      OsTrustedApplicationWithProtection = false
      OsApplicationIsPrivileged = false
      OsAppUseTrustedFunctionStubs = false
      OsApplicationCoreRef = EcucCoreDefinition
      OsAppEcucPartitionRef = EcucPartition_OsApplication_NonTrusted
      OsAppAlarmRef = Rte_Al_TE2_OsTask_Diagnostics_0_10ms
      OsAppAlarmRef = Rte_Al_TE2_OsTask_Mcal_10msLP_0_10ms
      OsAppAlarmRef = Rte_Al_TE2_OsTask_MemSer_0_10ms
      OsAppAlarmRef = Rte_Al_TE2_OsTask_ModeMgt_5msLP_0_5ms
      OsAppAlarmRef = Rte_Al_TE_Ea_Ea_MainFunction
      OsAppAlarmRef = Rte_Al_TE_NvMExt_NvMExt_SpeedupRunnable
      OsAppAlarmRef = Rte_Al_TE_OsTask_CANFun_0_10ms
      OsAppAlarmRef = Rte_Al_TE_OsTask_Diagnostics_0_10ms
      OsAppAlarmRef = Rte_Al_TE_OsTask_Diagnostics_0_100ms
      OsAppAlarmRef = Rte_Al_TE_OsTask_Mcal_0_10ms
      OsAppAlarmRef = Rte_Al_TE_OsTask_MemSer_0_10ms
      OsAppAlarmRef = Rte_Al_TE_Test_Comp_AudioTaskStubRunnable
      OsAppAlarmRef = Rte_Al_TE_Test_Comp_FotaTaskStubRunnable
      OsAppAlarmRef = Rte_Al_TE_Test_Comp_LinTaskStubRunnable
      OsAppAlarmRef = Rte_Al_TE_UclProxyCdd_CUclProxyCdd_Impl_MainFunction
      OsAppTaskRef = OsTask_AppFun
      OsAppTaskRef = OsTask_AudioFun
      OsAppTaskRef = Os/OsTask_CANFun
      OsAppTaskRef = Os/OsTask_DispFun
      OsAppTaskRef = Os/OsTask_Diagnostics
      OsAppTaskRef = OsTask_EthFun
      OsAppTaskRef = OsTask_FotaFun
      OsAppTaskRef = OsTask_GaugeFun
      OsAppTaskRef = OsTask_IndFun
      OsAppTaskRef = OsTask_LinFun
      OsAppTaskRef = Os/OsTask_LSH_16ms
      OsAppTaskRef = OsTask_Mcal
      OsAppTaskRef = Os/OsTask_MemSer
      OsAppTaskRef = Os/OsTask_ModeMgt
      OsAppTaskRef = Os/OsTask_NvmSpeedup
      OsAppTaskRef = OsTask_TripFun
      OsAppTaskRef = OsTask_WarnFun
      OsAppTaskRef = OsTaskRender
      OsAppAlarmRef = Rte_Al_TE_OsTask_TripFun_0_50ms
      OsAppAlarmRef = Rte_Al_TE_OsTask_DispFun_0_10ms
      OsAppTaskRef = OsTask_Can1DataRxEv
      OsAppTaskRef = OsTask_Can0DataRxEv
      OsAppTaskRef = Os/OsTask_IpcUclEv
      OsAppTaskRef = OsTask_FotaEv
      OsAppTaskRef = OsTask_IdleTask
      OsAppTaskRef = OsTask_Graphics
      OsAppAlarmRef = Rte_Al_TE2_OsTask_CANFun_0_10ms
      OsAppAlarmRef = Rte_Al_TE_OsTask_AppFun_0_10ms
      OsAppAlarmRef = Rte_Al_TE_SlowGaugeAdapter_SlowGaugeAdapter_Task
      OsAppAlarmRef = Rte_Al_TE_OsTask_GaugeFun_0_20ms
      OsAppAlarmRef = Rte_Al_TE_OsTask_WarnFun_0_32ms
      OsAppAlarmRef = Rte_Al_TE_OsTask_EthFun_0_10ms
      OsAppAlarmRef = Rte_Al_TE_OsTask_IndFun_0_30ms
      OsAppAlarmRef = Rte_Al_TE_OsTask_Diagnostics_0_20ms
      OsAppAlarmRef = Rte_Al_TE_OsTask_DispFun_0_5ms
      OsAppAlarmRef = Rte_Al_TE_DmnMgr_CDmnMgr_Impl_MainFunction
      OsAppAlarmRef = Rte_Al_TE2_OsTask_ModeMgt_0_10ms
      OsAppAlarmRef = Rte_Al_TE_OsTask_ModeMgt_0_10ms
      OsAppAlarmRef = Rte_Al_TE_OsTask_LSH_16ms_0_16ms
      OsApplicationHooks: OsAppErrorHook=false, OsAppShutdownHook=false, OsAppStartupHook=false
    3 x OsTask, all with OsTaskStackSharing=false, OsTaskUsesFpu=false, OsTaskAccessingApplication=OsApplication_Trusted:
      OsTask_SafeBsw: OsTaskActivation=1, OsTaskPriority=16, OsTaskSchedule=NON, OsTaskStackSize=1024, OsTaskType=EXTENDED, OsTaskEventRef=Rte_Ev_Cyclic_OsTask_SafeBsw_0_10ms, OsTaskEventRef=Rte_Ev_Run_Mdl_SafetyAdapter_Mdl_SafetyAdapter_OnDataRx_B_EBW2, OsTaskEventRef=Rte_Ev_Run_Mdl_SafetyAdapter_Mdl_SafetyAdapter_OnDataRx_B_PKBLP, OsTaskEventRef=Rte_Ev_Run_Mdl_SafetyAdapter_Mdl_SafetyAdapter_OnDataRx_SCSBZR, OsTaskEventRef=Rte_Ev_Run_Mdl_SafetyAdapter_Mdl_SafetyAdapter_OnDataRx_VSCOFF, OsTaskEventRef=Rte_Ev_Run_IoHwAb_IoHwAb_OsTask_SafeBsw_WdgM_CheckPoint_20ms, OsTaskEventRef=Rte_Ev_Cyclic2_OsTask_SafeBsw_0_10ms, OsTaskEventRef=Rte_Ev_Run_SafeNvM_OnDre_SafeNvM_Illumination
      OsTask_SafeApp: OsTaskActivation=1, OsTaskPriority=15, OsTaskSchedule=NON, OsTaskStackSize=1024, OsTaskType=BASIC, OsTaskAccessingApplication=OsApplication_NonTrusted
      InitTask: OsTaskActivation=3, OsTaskPriority=26, OsTaskSchedule=FULL, OsTaskStackSize=512, OsTaskType=BASIC, OsTaskAccessingApplication=OsApplication_NonTrusted
        OsTaskAutostart: OsTaskAppModeRef=OSDEFAULTAPPMODE
    Rte_Al_TE_OsTask_TripFun_0_50ms (OsAlarm): OsAlarmCounterRef=SystemTimer, OsAlarmAccessingApplication=OsApplication_NonTrusted, OsAlarmAccessingApplication=OsApplication_Trusted
      OsAlarmAction
        OsAlarmActivateTask: OsAlarmActivateTaskRef=OsTask_TripFun
    Rte_Al_TE_OsTask_DispFun_0_10ms (OsAlarm): OsAlarmCounterRef=SystemTimer, OsAlarmAccessingApplication=OsApplication_NonTrusted, OsAlarmAccessingApplication=OsApplication_Trusted
      OsAlarmAction
        OsAlarmSetEvent: OsAlarmSetEventRef=Rte_Ev_Cyclic_OsTask_DispFun_0_10ms, OsAlarmSetEventTaskRef=Os/OsTask_DispFun
    Rte_Ev_Cyclic_OsTask_DispFun_0_10ms (OsEvent)
    5 x OsTask, all with OsTaskActivation=1, OsTaskStackSharing=false, OsTaskUsesFpu=false, OsTaskAccessingApplication=OsApplication_NonTrusted, OsTaskAccessingApplication=OsApplication_Trusted:
      OsTask_Can1DataRxEv: OsTaskPriority=18, OsTaskSchedule=NON, OsTaskStackSize=1024, OsTaskType=BASIC
      OsTask_Can0DataRxEv: OsTaskPriority=19, OsTaskSchedule=NON, OsTaskStackSize=1024, OsTaskType=BASIC
      OsTask_IpcUclEv: OsTaskPriority=8, OsTaskSchedule=NON, OsTaskStackSize=4096, OsTaskType=EXTENDED, OsTaskEventRef=Rte_Ev_Run_CUpdateCdd_CUpdateCdd_OnDre_UpdateResponse, OsTaskEventRef=Rte_Ev_Run_CWarnMsg_Core_Observer_OnDre_UCL_HudWarnStatus, OsTaskEventRef=Rte_Ev_Run_CWarnMsg_Core_Observer_OnDre_UCL_WarnStatus, OsTaskEventRef=Rte_Ev_Run_DmnMgr_CDmnMgr_Impl_MainFunction, OsTaskEventRef=Rte_Ev_Run_DmnMgr_DmnMgr_MonitorDmnExtendShutdownTime, OsTaskEventRef=Rte_Ev_Run_DmnMgr_DmnMgr_MonitorDmnHealthDumpData, OsTaskEventRef=Rte_Ev_Run_DmnMgr_DmnMgr_MonitorDmnHealthDumpHdrInfo, OsTaskEventRef=Rte_Ev_Run_DmnMgr_DmnMgr_MonitorDmnHealthFatalError, OsTaskEventRef=Rte_Ev_Run_DmnMgr_DmnMgr_MonitorDmnHeartBeat, OsTaskEventRef=Rte_Ev_Run_DmnMgr_DmnMgr_MonitorDmnKeepSystemAwake, OsTaskEventRef=Rte_Ev_Run_DmnMgr_DmnMgr_MonitorDmnPowerSystemState, OsTaskEventRef=Rte_Ev_Run_UclProxyCdd_CUclProxyCdd_Impl_MainFunction, OsTaskEventRef=Rte_Ev_Run_UclProxyCdd_OnDre_DiagDIDRequest, OsTaskEventRef=Rte_Ev_Run_UclProxyCdd_OnDre_DiagIOCtrlRequest, OsTaskEventRef=Rte_Ev_Run_UclProxyCdd_OnDre_DiagRoutineRequest, OsTaskEventRef=Rte_Ev_Run_UclProxyCdd_OnDre_DisplaySetPower, OsTaskEventRef=Rte_Ev_Run_UclProxyCdd_OnDre_FRTT_Status, OsTaskEventRef=Rte_Ev_Run_UclProxyCdd_OnDre_FastGaugeInfo, OsTaskEventRef=Rte_Ev_Run_UclProxyCdd_OnDre_HealthDumpGetData, OsTaskEventRef=Rte_Ev_Run_UclProxyCdd_OnDre_HealthDumpGetHdr, OsTaskEventRef=Rte_Ev_Run_UclProxyCdd_OnDre_IlluminationData, OsTaskEventRef=Rte_Ev_Run_UclProxyCdd_OnDre_PowerSystemStateReqChange, OsTaskEventRef=Rte_Ev_Run_UclProxyCdd_OnDre_RTT_Icon, OsTaskEventRef=Rte_Ev_Run_UclProxyCdd_OnDre_RTT_Status, OsTaskEventRef=Rte_Ev_Run_UclProxyCdd_OnDre_RTT_Toggle, OsTaskEventRef=Rte_Ev_Run_UclProxyCdd_OnDre_ShiftPosIndStatus, OsTaskEventRef=Rte_Ev_Run_UclProxyCdd_OnDre_SlowGaugeInfo, OsTaskEventRef=Rte_Ev_Run_UclProxyCdd_OnDre_TT_Status, OsTaskEventRef=Rte_Ev_Run_UclProxyCdd_OnDre_UpdateLongServiceReq, OsTaskEventRef=Rte_Ev_Run_UclProxyCdd_OnDre_UpdateShortServiceReq, OsTaskEventRef=Rte_Ev_Run_UclProxyCdd_OnDre_WarningDisplay, OsTaskEventRef=Rte_Ev_Run_UclProxyCdd_OnDre_WarningExtDisplay, OsTaskEventRef=Rte_Ev_Run_UclProxyCdd_OnDre_DLTControlMessageReponse, OsTaskEventRef=Rte_Ev_Run_UclProxyCdd_OnDre_DLTMessageReadRequest, OsTaskEventRef=Rte_Ev_Run_DltExt_DltExt_OnDreDLTMessageReadAckData
      OsTask_FotaEv: OsTaskPriority=3, OsTaskSchedule=FULL, OsTaskStackSize=1024, OsTaskType=BASIC
      OsTask_IdleTask: OsTaskPriority=0, OsTaskSchedule=FULL, OsTaskStackSize=1024, OsTaskType=BASIC
    Rte_Al_TE_OsTask_WdgMngt_0_10ms (OsAlarm): OsAlarmCounterRef=SystemTimer, OsAlarmAccessingApplication=OsApplication_NonTrusted, OsAlarmAccessingApplication=OsApplication_Trusted
      OsAlarmAction
        OsAlarmActivateTask: OsAlarmActivateTaskRef=OsTask_WdgMngt
    OsTask_Graphics (OsTask):
      OsTaskActivation = 1
      OsTaskPriority = 2
      OsTaskSchedule = FULL
      OsTaskStackSharing = false
      OsTaskStackSize = 1024
      OsTaskType = BASIC
      OsTaskUsesFpu = false
      OsTaskAccessingApplication = OsApplication_Trusted
    Rte_Al_TE_OsTask_SafeBsw_0_10ms (OsAlarm): OsAlarmCounterRef=SystemTimer, OsAlarmAccessingApplication=OsApplication_NonTrusted, OsAlarmAccessingApplication=OsApplication_Trusted
      OsAlarmAction
        OsAlarmSetEvent: OsAlarmSetEventRef=Rte_Ev_Cyclic_OsTask_SafeBsw_0_10ms, OsAlarmSetEventTaskRef=Os/OsTask_SafeBsw
    Rte_Ev_Cyclic_OsTask_SafeBsw_0_10ms (OsEvent)
    Rte_Al_TE2_OsTask_CANFun_0_10ms (OsAlarm): OsAlarmCounterRef=SystemTimer, OsAlarmAccessingApplication=OsApplication_Trusted
      OsAlarmAction
        OsAlarmSetEvent: OsAlarmSetEventRef=Rte_Ev_Cyclic2_OsTask_CANFun_0_10ms, OsAlarmSetEventTaskRef=Os/OsTask_CANFun
    8 x OsEvent:
      Rte_Ev_Cyclic2_OsTask_CANFun_0_10ms
      Rte_Ev_Cyclic_OsTask_CANFun_0_10ms
      Rte_Ev_Run_CWarnMsg_Core_Observer_OnDre_UCL_HudWarnStatus
      Rte_Ev_Run_CWarnMsg_Core_Observer_OnDre_UCL_WarnStatus
      Rte_Ev_Run_Mdl_SafetyAdapter_Mdl_SafetyAdapter_OnDataRx_B_EBW2
      Rte_Ev_Run_Mdl_SafetyAdapter_Mdl_SafetyAdapter_OnDataRx_B_PKBLP
      Rte_Ev_Run_Mdl_SafetyAdapter_Mdl_SafetyAdapter_OnDataRx_SCSBZR
      Rte_Ev_Run_Mdl_SafetyAdapter_Mdl_SafetyAdapter_OnDataRx_VSCOFF
    4 x OsAlarm, all with OsAlarmCounterRef=SystemTimer, OsAlarmAccessingApplication=OsApplication_Trusted:
      Rte_Al_TE_OsTask_AppFun_0_10ms
        OsAlarmAction
          OsAlarmActivateTask: OsAlarmActivateTaskRef=OsTask_AppFun
      Rte_Al_TE_SlowGaugeAdapter_SlowGaugeAdapter_Task
        OsAlarmAction
          OsAlarmSetEvent: OsAlarmSetEventRef=Rte_Ev_Run_SlowGaugeAdapter_SlowGaugeAdapter_Task, OsAlarmSetEventTaskRef=Os/OsTask_DispFun
      Rte_Al_TE_OsTask_GaugeFun_0_20ms
        OsAlarmAction
          OsAlarmActivateTask: OsAlarmActivateTaskRef=OsTask_GaugeFun
      Rte_Al_TE_OsTask_WarnFun_0_32ms
        OsAlarmAction
          OsAlarmActivateTask: OsAlarmActivateTaskRef=OsTask_WarnFun
    Rte_Ev_Run_SlowGaugeAdapter_SlowGaugeAdapter_Task (OsEvent)
    3 x OsAlarm, all with OsAlarmCounterRef=SystemTimer, OsAlarmAccessingApplication=OsApplication_Trusted:
      Rte_Al_TE_OsTask_EthFun_0_10ms
        OsAlarmAction
          OsAlarmActivateTask: OsAlarmActivateTaskRef=OsTask_EthFun
      Rte_Al_TE_OsTask_IndFun_0_30ms
        OsAlarmAction
          OsAlarmActivateTask: OsAlarmActivateTaskRef=OsTask_IndFun
      Rte_Al_TE_IoHwAb_IoHwAb_OsTask_SafeBsw_WdgM_CheckPoint_20ms: OsAlarmAccessingApplication=OsApplication_NonTrusted
        OsAlarmAction
          OsAlarmSetEvent: OsAlarmSetEventRef=Rte_Ev_Run_IoHwAb_IoHwAb_OsTask_SafeBsw_WdgM_CheckPoint_20ms, OsAlarmSetEventTaskRef=Os/OsTask_SafeBsw
    14 x OsEvent:
      Rte_Ev_Run_IoHwAb_IoHwAb_OsTask_SafeBsw_WdgM_CheckPoint_20ms
      Rte_Ev_Run_UclProxyCdd_OnDre_FRTT_Status
      Rte_Ev_Run_UclProxyCdd_OnDre_FastGaugeInfo
      Rte_Ev_Run_UclProxyCdd_OnDre_IlluminationData
      Rte_Ev_Run_UclProxyCdd_OnDre_RTT_Icon
      Rte_Ev_Run_UclProxyCdd_OnDre_RTT_Status
      Rte_Ev_Run_UclProxyCdd_OnDre_RTT_Toggle
      Rte_Ev_Run_UclProxyCdd_OnDre_ShiftPosIndStatus
      Rte_Ev_Run_UclProxyCdd_OnDre_SlowGaugeInfo
      Rte_Ev_Run_UclProxyCdd_OnDre_TT_Status
      Rte_Ev_Run_UclProxyCdd_OnDre_UpdateLongServiceReq
      Rte_Ev_Run_UclProxyCdd_OnDre_UpdateShortServiceReq
      Rte_Ev_Run_UclProxyCdd_OnDre_WarningDisplay
      Rte_Ev_Run_UclProxyCdd_OnDre_WarningExtDisplay
    Rte_Al_TE2_OsTask_SafeBsw_0_10ms (OsAlarm): OsAlarmCounterRef=SystemTimer, OsAlarmAccessingApplication=OsApplication_NonTrusted, OsAlarmAccessingApplication=OsApplication_Trusted
      OsAlarmAction
        OsAlarmSetEvent: OsAlarmSetEventRef=Rte_Ev_Cyclic2_OsTask_SafeBsw_0_10ms, OsAlarmSetEventTaskRef=Os/OsTask_SafeBsw
    Rte_Ev_Cyclic2_OsTask_SafeBsw_0_10ms (OsEvent)
    Rte_Al_TE_OsTask_Diagnostics_0_20ms (OsAlarm): OsAlarmCounterRef=SystemTimer, OsAlarmAccessingApplication=OsApplication_Trusted
      OsAlarmAction
        OsAlarmSetEvent: OsAlarmSetEventRef=Rte_Ev_Cyclic_OsTask_Diagnostics_0_20ms, OsAlarmSetEventTaskRef=Os/OsTask_Diagnostics
    5 x OsEvent:
      Rte_Ev_Cyclic_OsTask_Diagnostics_0_20ms
      Rte_Ev_Run_CUpdateCdd_CUpdateCdd_OnDre_UpdateResponse
      Rte_Ev_Run_UclProxyCdd_OnDre_DiagDIDRequest
      Rte_Ev_Run_UclProxyCdd_OnDre_DiagIOCtrlRequest
      Rte_Ev_Run_UclProxyCdd_OnDre_DiagRoutineRequest
    Rte_Al_TE_OsTask_DispFun_0_5ms (OsAlarm): OsAlarmCounterRef=SystemTimer, OsAlarmAccessingApplication=OsApplication_Trusted
      OsAlarmAction
        OsAlarmSetEvent: OsAlarmSetEventRef=Rte_Ev_Cyclic_OsTask_DispFun_0_5ms, OsAlarmSetEventTaskRef=Os/OsTask_DispFun
    Rte_Ev_Cyclic_OsTask_DispFun_0_5ms (OsEvent)
    4 x OsAlarm, all with OsAlarmCounterRef=SystemTimer, OsAlarmAccessingApplication=OsApplication_Trusted:
      Rte_Al_TE_DmnMgr_CDmnMgr_Impl_MainFunction
        OsAlarmAction
          OsAlarmSetEvent: OsAlarmSetEventRef=Rte_Ev_Run_DmnMgr_CDmnMgr_Impl_MainFunction, OsAlarmSetEventTaskRef=Os/OsTask_IpcUclEv
      Rte_Al_TE2_OsTask_ModeMgt_0_10ms
        OsAlarmAction
          OsAlarmSetEvent: OsAlarmSetEventRef=Rte_Ev_Cyclic2_OsTask_ModeMgt_0_10ms, OsAlarmSetEventTaskRef=Os/OsTask_ModeMgt
      Rte_Al_TE_OsTask_ModeMgt_0_10ms
        OsAlarmAction
          OsAlarmSetEvent: OsAlarmSetEventRef=Rte_Ev_Cyclic_OsTask_ModeMgt_0_10ms, OsAlarmSetEventTaskRef=Os/OsTask_ModeMgt
      Rte_Al_TE_OsTask_SafeApp_0_30ms: OsAlarmAccessingApplication=OsApplication_NonTrusted
        OsAlarmAction
          OsAlarmActivateTask: OsAlarmActivateTaskRef=OsTask_SafeApp
    6 x OsEvent:
      Rte_Ev_Cyclic2_OsTask_ModeMgt_0_10ms
      Rte_Ev_Cyclic_OsTask_ModeMgt_0_10ms
      Rte_Ev_Run_DmnMgr_CDmnMgr_Impl_MainFunction
      Rte_Ev_Run_SafeNvM_OnDre_SafeNvM_Illumination
      Rte_Ev_Run_UclProxyCdd_OnDre_DLTControlMessageReponse
      Rte_Ev_Run_UclProxyCdd_OnDre_DLTMessageReadRequest
    Rte_Al_TE_OsTask_LSH_16ms_0_16ms (OsAlarm): OsAlarmCounterRef=SystemTimer, OsAlarmAccessingApplication=OsApplication_Trusted
      OsAlarmAction
        OsAlarmSetEvent: OsAlarmSetEventRef=Rte_Ev_Cyclic_OsTask_LSH_16ms_0_16ms, OsAlarmSetEventTaskRef=Os/OsTask_LSH_16ms
    Rte_Ev_Cyclic_OsTask_LSH_16ms_0_16ms (OsEvent)
    Rte_Ev_Run_DltExt_DltExt_OnDreDLTMessageReadAckData (OsEvent)
