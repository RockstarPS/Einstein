AUTOSAR XML (schema 4-2-1)
package /ActiveEcuC
  module config Dcm: implementation-config-variant=VARIANT-PRE-COMPILE, module-description=Dcm_Impl
    DcmConfigSet
      DcmDsd
        DcmDsdServiceTable
          DcmDsdService: DcmDsdSidTabServiceId=(unset), DcmDsdSidTabSubfuncAvail=(unset)
      DcmDsl
        DcmDslBuffer: DcmDslBufferSize=50
        DcmDslDiagResp: DcmDslDiagRespMaxNumRespPend=0, DcmDslDiagRespOnSecondDeclinedRequest=false, DcmDslDiagRespMaxNumOfDeclinedRequests=3
        DcmDslProtocol
          DcmDslProtocolRow:
            DcmDslProtocolEndiannessConvEnabled = false
            DcmDslProtocolID = DCM_UDS_ON_CAN
            DcmDslProtocolIsParallelExecutab = false
            DcmDslProtocolPreemptTimeout = 0
            DcmDslProtocolPriority = 0
            DcmSendRespPendOnTransToBoot = true
            DcmTimStrP2ServerAdjust = 0
            DcmTimStrP2StarServerAdjust = 0
            DcmDslProtocolRxBufferID = (unset)
            DcmDslProtocolSIDTable = (unset)
            DcmDslProtocolTxBufferID = (unset)
            DcmDslConnection
      DcmDsp: DcmDspReadDIDReportsNODIByte=false
        DcmDspSecurity
        DcmDspSession
          DcmDspSessionRow: DcmDspSessionForBoot=DCM_NO_BOOT, DcmDspSessionLevel=0, DcmDspSessionP2ServerMax=0.05, DcmDspSessionP2StarServerMax=5
      DcmGeneral:
        DcmKeepAliveTime = 6
        DcmDevErrorDetect = true
        DcmRequestManufacturerNotificationEnabled = false
        DcmRequestSupplierNotificationEnabled = false
        DcmRespondAllRequest = true
        DcmTaskTime = 0.01
        DcmVersionInfoApi = false
        DcmDspDataDefaultEndianness = LITTLE_ENDIAN
        DcmSafeBswChecks = false
        DcmSupportedIDCalculationSuppressionEnabled = false
        DcmDtrDataProvisionViaDemEnabled = true
        DcmForeignDiagnosticRequestDetectionEnabled = false
        DcmSuppressResponseOnCanTpFuncMixedAddrRequests = false
        DcmSenderReceiverPRPortsEnabled = false
      DcmPageBufferCfg: DcmPagedBufferEnabled=true
