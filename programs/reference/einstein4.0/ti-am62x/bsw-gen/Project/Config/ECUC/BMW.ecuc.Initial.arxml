AUTOSAR XML (schema 4-2-1)
package /InitialEcuC
  ecuc value collection InitialEcuC: ecuc-values=[Can, CanIf, CanSM, Com, ComM, EcuC, EcuM, PduR]
  module config Can
    CanConfigSet
      CT_CAN00_783a5f42 (CanController):
        CanControllerActivation = true
        CanControllerDefaultBaudrate = CanControllerBaudrateConfig
        CanControllerSystemRef = CT_CAN00
        CanWakeupSourceRef = EcuMCommonConfiguration/CN_CAN00_bb949cc2
        CanControllerBaudrateConfig
      CN_CAN00_7d903542_Rx (CanHardwareObject): CanHandleType=BASIC, CanIdType=STANDARD, CanIdValue=0, CanObjectType=RECEIVE, CanControllerRef=CanConfigSet/CT_CAN00_783a5f42
      CN_CAN00_bb949cc2_Tx (CanHardwareObject): CanHandleType=BASIC, CanIdValue=0, CanObjectType=TRANSMIT, CanControllerRef=CanConfigSet/CT_CAN00_783a5f42
    CanGeneral: CanIndex=0
  module config CanIf
    CanIfCtrlDrvCfg_7d254554 (CanIfCtrlDrvCfg): CanIfCtrlDrvInitHohConfigRef=CanIfInitHohCfg, CanIfCtrlDrvNameRef=CanGeneral
      CT_CAN00_783a5f42 (CanIfCtrlCfg): CanIfCtrlCanCtrlRef=CanConfigSet/CT_CAN00_783a5f42
    CanIfInitCfg
      CHNL_0fb271d2 (CanIfBufferCfg): CanIfBufferSize=0, CanIfBufferHthRef=CanIfInitHohCfg/CN_CAN00_bb949cc2_Tx
      CanIfInitHohCfg: CanIfInitRefCfgSet=CanConfigSet
        CN_CAN00_7d903542_Rx (CanIfHrhCfg): CanIfHrhCanCtrlIdRef=CanIfCtrlDrvCfg_7d254554/CT_CAN00_783a5f42, CanIfHrhIdSymRef=CanConfigSet/CN_CAN00_7d903542_Rx
        CN_CAN00_bb949cc2_Tx (CanIfHthCfg): CanIfHthCanCtrlIdRef=CanIfCtrlDrvCfg_7d254554/CT_CAN00_783a5f42, CanIfHthIdSymRef=CanConfigSet/CN_CAN00_bb949cc2_Tx
      4 x CanIfRxPduCfg, all with CanIfRxPduCanIdType=STANDARD_CAN, CanIfRxPduHrhIdRef=CanIfInitHohCfg/CN_CAN00_7d903542_Rx:
        ABS_oCAN00_57574eb9_Rx: CanIfRxPduCanId=258, CanIfRxPduDlc=7, CanIfRxPduUserRxIndicationName=PduR_CanIfRxIndication, CanIfRxPduUserRxIndicationUL=PDUR, CanIfRxPduRef=EcucPduCollection/ABS_oCAN00_97526119_Rx
        Illum_control_oCAN00_7cebd788_Rx: CanIfRxPduCanId=257, CanIfRxPduDlc=3, CanIfRxPduUserRxIndicationName=PduR_CanIfRxIndication, CanIfRxPduUserRxIndicationUL=PDUR, CanIfRxPduRef=EcucPduCollection/Illum_control_oCAN00_8f78885e_Rx
        NM_CoOrd_NMPDU_oCAN00_3dfd6c1f_Rx: CanIfRxPduCanId=1280, CanIfRxPduDlc=8, CanIfRxPduUserRxIndicationName=CanNm_RxIndication, CanIfRxPduUserRxIndicationUL=CAN_NM, CanIfRxPduRef=NM_CoOrd_NMPDU_oCAN00_1fc35b6d_Rx
        VehicleControl_oCAN00_62cfea39_Rx: CanIfRxPduCanId=256, CanIfRxPduDlc=8, CanIfRxPduUserRxIndicationName=PduR_CanIfRxIndication, CanIfRxPduUserRxIndicationUL=PDUR, CanIfRxPduRef=EcucPduCollection/VehicleControl_oCAN00_8e397222_Rx
      13 x CanIfTxPduCfg, all with CanIfTxPduCanIdType=STANDARD_CAN, CanIfTxPduBufferRef=CanIfInitCfg/CHNL_0fb271d2:
        Cluster_Secure_Tx_oCAN00_022000d7_Tx: CanIfTxPduCanId=768, CanIfTxPduDlc=8, CanIfTxPduUserTxConfirmationName=PduR_CanIfTxConfirmation, CanIfTxPduUserTxConfirmationUL=PDUR, CanIfTxPduRef=EcucPduCollection/Cluster_Secure_Tx_oCAN00_fbf04cbe_Tx
        Cluster_Tx_Normal_COM_HS_oCAN00_b4afb8d0_Tx: CanIfTxPduCanId=512, CanIfTxPduDlc=3, CanIfTxPduUserTxConfirmationName=PduR_CanIfTxConfirmation, CanIfTxPduUserTxConfirmationUL=PDUR, CanIfTxPduRef=EcucPduCollection/Cluster_Tx_Normal_COM_HS_oCAN00_7765df5c_Tx
        Cluster_Tx_Normal_COM_LS_oCAN00_b2683444_Tx: CanIfTxPduCanId=514, CanIfTxPduDlc=4, CanIfTxPduUserTxConfirmationName=PduR_CanIfTxConfirmation, CanIfTxPduUserTxConfirmationUL=PDUR, CanIfTxPduRef=EcucPduCollection/Cluster_Tx_Normal_COM_LS_oCAN00_1e634103_Tx
        Cluster_Tx_Normal_COM_MS_oCAN00_b3d9d761_Tx: CanIfTxPduCanId=513, CanIfTxPduDlc=2, CanIfTxPduUserTxConfirmationName=PduR_CanIfTxConfirmation, CanIfTxPduUserTxConfirmationUL=PDUR, CanIfTxPduRef=EcucPduCollection/Cluster_Tx_Normal_COM_MS_oCAN00_9f462424_Tx
        Cluster_Tx_Reduced_Com_oCAN00_b8852611_Tx: CanIfTxPduCanId=528, CanIfTxPduDlc=1, CanIfTxPduUserTxConfirmationName=PduR_CanIfTxConfirmation, CanIfTxPduUserTxConfirmationUL=PDUR, CanIfTxPduRef=EcucPduCollection/Cluster_Tx_Reduced_Com_oCAN00_4e2ce421_Tx
        Debug_Frame1_oCAN00_a022c2ae_Tx: CanIfTxPduCanId=1360, CanIfTxPduDlc=8, CanIfTxPduUserTxConfirmationName=PduR_CanIfTxConfirmation, CanIfTxPduUserTxConfirmationUL=PDUR, CanIfTxPduRef=EcucPduCollection/Debug_Frame1_oCAN00_48431553_Tx
        Debug_Frame2_oCAN00_4753dbb2_Tx: CanIfTxPduCanId=1361, CanIfTxPduDlc=8, CanIfTxPduUserTxConfirmationName=PduR_CanIfTxConfirmation, CanIfTxPduUserTxConfirmationUL=PDUR, CanIfTxPduRef=EcucPduCollection/Debug_Frame2_oCAN00_3ea62c6e_Tx
        Debug_Frame3_oCAN00_1a7cd346_Tx: CanIfTxPduCanId=1362, CanIfTxPduDlc=8, CanIfTxPduUserTxConfirmationName=PduR_CanIfTxConfirmation, CanIfTxPduUserTxConfirmationUL=PDUR, CanIfTxPduRef=EcucPduCollection/Debug_Frame3_oCAN00_a5d5c6ba_Tx
        Debug_Frame4_oCAN00_52c0efcb_Tx: CanIfTxPduCanId=1363, CanIfTxPduDlc=8, CanIfTxPduUserTxConfirmationName=PduR_CanIfTxConfirmation, CanIfTxPduUserTxConfirmationUL=PDUR, CanIfTxPduRef=EcucPduCollection/Debug_Frame4_oCAN00_d36c5e14_Tx
        Debug_Frame5_oCAN00_0fefe73f_Tx: CanIfTxPduCanId=1364, CanIfTxPduDlc=8, CanIfTxPduUserTxConfirmationName=PduR_CanIfTxConfirmation, CanIfTxPduUserTxConfirmationUL=PDUR, CanIfTxPduRef=EcucPduCollection/Debug_Frame5_oCAN00_481fb4c0_Tx
        Diag_Resp_USDT_oCAN00_af8473d1_Tx: CanIfTxPduCanId=1800, CanIfTxPduDlc=8, CanIfTxPduUserTxConfirmationName=PduR_CanIfTxConfirmation, CanIfTxPduUserTxConfirmationUL=PDUR, CanIfTxPduRef=EcucPduCollection/Diag_Resp_USDT_oCAN00_14b29fad_Tx
        Diag_Resp_UUDT_oCAN00_26ad65ab_Tx: CanIfTxPduCanId=1544, CanIfTxPduDlc=8, CanIfTxPduUserTxConfirmationName=PduR_CanIfTxConfirmation, CanIfTxPduUserTxConfirmationUL=PDUR, CanIfTxPduRef=EcucPduCollection/Diag_Resp_UUDT_oCAN00_7f69f30b_Tx
        IC_NMPDU_oCAN00_e64e5991_Tx: CanIfTxPduCanId=1281, CanIfTxPduDlc=8, CanIfTxPduUserTxConfirmationName=CanNm_TxConfirmation, CanIfTxPduUserTxConfirmationUL=CAN_NM, CanIfTxPduRef=IC_NMPDU_oCAN00_57ad3fa9_Tx
    CanIfPrivateCfg: CanIfPrivateSoftwareFilterType=LINEAR
    CanIfPublicCfg: CanIfPublicPnSupport=false
  module config CanSM
    CanSMConfiguration
      CHNL_0fb271d2 (CanSMManagerNetwork): CanSMComMNetworkHandleRef=ComMConfigSet/CN_CAN00_bb949cc2
        CT_CAN00_72e96f1e (CanSMController): CanSMControllerId=CanIfCtrlDrvCfg_7d254554/CT_CAN00_783a5f42
  module config Com
    ComConfig
      16 x ComIPdu, all with ComIPduType=NORMAL:
        ABS_oCAN00_29f7b4f6_Rx: ComIPduDirection=RECEIVE, ComIPduGroupRef=IC_oCAN00_Rx_68aa05a4, ComIPduSignalGroupRef=SG_ABS_oABS_oCAN00_6681ad27_Rx, ComPduIdRef=EcucPduCollection/ABS_oCAN00_29f7b4f6_Rx
        Cluster_Secure_Tx_oCAN00_7e3ab6a5_Tx: ComIPduDirection=SEND, ComIPduGroupRef=IC_oCAN00_Tx_3ef0a222, ComIPduSignalRef=FV_Tx_oCluster_Secure_Tx_oCAN00_f077ac5c_Tx, ComIPduSignalRef=MAC_Tx_oCluster_Secure_Tx_oCAN00_b83a6da7_Tx, ComIPduSignalRef=SecureTxByte0_oCluster_Secure_Tx_oCAN00_659a0722_Tx, ComIPduSignalRef=SecureTxByte1_oCluster_Secure_Tx_oCAN00_0b161c63_Tx, ComIPduSignalRef=SecureTxByte2_oCluster_Secure_Tx_oCAN00_b88231a0_Tx, ComIPduSignalRef=SecureTxByte3_oCluster_Secure_Tx_oCAN00_d60e2ae1_Tx, ComPduIdRef=EcucPduCollection/Cluster_Secure_Tx_oCAN00_7e3ab6a5_Tx
          ComTxIPdu: ComMinimumDelayTime=0, ComTxIPduUnusedAreasDefault=0
            ComTxModeFalse
              ComTxMode: ComTxModeMode=PERIODIC, ComTxModeTimeOffset=0, ComTxModeTimePeriod=0
            ComTxModeTrue
              ComTxMode: ComTxModeMode=PERIODIC, ComTxModeTimeOffset=0, ComTxModeTimePeriod=0
        Cluster_Tx_Normal_COM_HS_oCAN00_017bc789_Tx: ComIPduDirection=SEND, ComIPduGroupRef=IC_oCAN00_Tx_3ef0a222, ComIPduSignalGroupRef=SG_COM_HS_oCluster_Tx_Normal_COM_HS_oCAN00_c9c3ed51_Tx, ComPduIdRef=EcucPduCollection/Cluster_Tx_Normal_COM_HS_oCAN00_017bc789_Tx
          ComTxIPdu: ComMinimumDelayTime=0, ComTxIPduUnusedAreasDefault=0
            ComTxModeFalse
              ComTxMode: ComTxModeMode=PERIODIC, ComTxModeTimeOffset=0, ComTxModeTimePeriod=0.01
            ComTxModeTrue
              ComTxMode: ComTxModeMode=PERIODIC, ComTxModeTimeOffset=0, ComTxModeTimePeriod=0.01
        Cluster_Tx_Normal_COM_LS_oCAN00_5c979685_Tx: ComIPduDirection=SEND, ComIPduGroupRef=IC_oCAN00_Tx_3ef0a222, ComIPduSignalRef=Odometer_oCluster_Tx_Normal_COM_LS_oCAN00_3e00d027_Tx, ComPduIdRef=EcucPduCollection/Cluster_Tx_Normal_COM_LS_oCAN00_5c979685_Tx
          ComTxIPdu: ComMinimumDelayTime=0, ComTxIPduUnusedAreasDefault=0
            ComTxModeFalse
              ComTxMode: ComTxModeMode=PERIODIC, ComTxModeTimeOffset=0, ComTxModeTimePeriod=1
            ComTxModeTrue
              ComTxMode: ComTxModeMode=PERIODIC, ComTxModeTimeOffset=0, ComTxModeTimePeriod=1
        Cluster_Tx_Normal_COM_MS_oCAN00_4bec82c6_Tx: ComIPduDirection=SEND, ComIPduGroupRef=IC_oCAN00_Tx_3ef0a222, ComIPduSignalRef=VehicleSpeedIC_oCluster_Tx_Normal_COM_MS_oCAN00_1b17fdcc_Tx, ComPduIdRef=EcucPduCollection/Cluster_Tx_Normal_COM_MS_oCAN00_4bec82c6_Tx
          ComTxIPdu: ComMinimumDelayTime=0, ComTxIPduUnusedAreasDefault=0
            ComTxModeFalse
              ComTxMode: ComTxModeMode=PERIODIC, ComTxModeTimeOffset=0, ComTxModeTimePeriod=0.1
            ComTxModeTrue
              ComTxMode: ComTxModeMode=PERIODIC, ComTxModeTimeOffset=0, ComTxModeTimePeriod=0.1
        Cluster_Tx_Reduced_Com_oCAN00_8ca7c169_Tx: ComIPduDirection=SEND, ComIPduGroupRef=IC_oCAN00_Tx_3ef0a222, ComIPduSignalRef=Illumination_PWM_oCluster_Tx_Reduced_Com_oCAN00_0a670875_Tx, ComPduIdRef=EcucPduCollection/Cluster_Tx_Reduced_Com_oCAN00_8ca7c169_Tx
          ComTxIPdu: ComMinimumDelayTime=0, ComTxIPduUnusedAreasDefault=0
            ComTxModeFalse
              ComTxMode: ComTxModeMode=PERIODIC, ComTxModeTimeOffset=0, ComTxModeTimePeriod=0.1
            ComTxModeTrue
              ComTxMode: ComTxModeMode=PERIODIC, ComTxModeTimeOffset=0, ComTxModeTimePeriod=0.1
        Debug_Frame1_oCAN00_d991a3bb_Tx: ComIPduDirection=SEND, ComIPduGroupRef=IC_oCAN00_Tx_3ef0a222, ComIPduSignalRef=Debug1_Byte0_oDebug_Frame1_oCAN00_7a3e08ee_Tx, ComIPduSignalRef=Debug1_Byte1_oDebug_Frame1_oCAN00_6d166c2e_Tx, ComIPduSignalRef=Debug1_Byte2_oDebug_Frame1_oCAN00_546ec16e_Tx, ComIPduSignalRef=Debug1_Byte3_oDebug_Frame1_oCAN00_4346a5ae_Tx, ComIPduSignalRef=Debug1_Byte4_oDebug_Frame1_oCAN00_269f9bee_Tx, ComIPduSignalRef=Debug1_Byte5_oDebug_Frame1_oCAN00_31b7ff2e_Tx, ComIPduSignalRef=Debug1_Byte6_oDebug_Frame1_oCAN00_08cf526e_Tx, ComIPduSignalRef=Debug1_Byte7_oDebug_Frame1_oCAN00_1fe736ae_Tx, ComPduIdRef=EcucPduCollection/Debug_Frame1_oCAN00_d991a3bb_Tx
          ComTxIPdu: ComMinimumDelayTime=0, ComTxIPduUnusedAreasDefault=0
            ComTxModeFalse
              ComTxMode: ComTxModeMode=PERIODIC, ComTxModeTimeOffset=0, ComTxModeTimePeriod=0.01
            ComTxModeTrue
              ComTxMode: ComTxModeMode=PERIODIC, ComTxModeTimeOffset=0, ComTxModeTimePeriod=0.01
        Debug_Frame2_oCAN00_571ea458_Tx: ComIPduDirection=SEND, ComIPduGroupRef=IC_oCAN00_Tx_3ef0a222, ComIPduSignalRef=Debug2_Byte0_oDebug_Frame2_oCAN00_f66f082a_Tx, ComIPduSignalRef=Debug2_Byte1_oDebug_Frame2_oCAN00_e1476cea_Tx, ComIPduSignalRef=Debug2_Byte2_oDebug_Frame2_oCAN00_d83fc1aa_Tx, ComIPduSignalRef=Debug2_Byte3_oDebug_Frame2_oCAN00_cf17a56a_Tx, ComIPduSignalRef=Debug2_Byte4_oDebug_Frame2_oCAN00_aace9b2a_Tx, ComIPduSignalRef=Debug2_Byte5_oDebug_Frame2_oCAN00_bde6ffea_Tx, ComIPduSignalRef=Debug2_Byte6_oDebug_Frame2_oCAN00_849e52aa_Tx, ComIPduSignalRef=Debug2_Byte7_oDebug_Frame2_oCAN00_93b6366a_Tx, ComPduIdRef=EcucPduCollection/Debug_Frame2_oCAN00_571ea458_Tx
          ComTxIPdu: ComMinimumDelayTime=0, ComTxIPduUnusedAreasDefault=0
            ComTxModeFalse
              ComTxMode: ComTxModeMode=PERIODIC, ComTxModeTimeOffset=0, ComTxModeTimePeriod=0.1
            ComTxModeTrue
              ComTxMode: ComTxModeMode=PERIODIC, ComTxModeTimeOffset=0, ComTxModeTimePeriod=0.1
        Debug_Frame3_oCAN00_9bb4a4c6_Tx: ComIPduDirection=SEND, ComIPduGroupRef=IC_oCAN00_Tx_3ef0a222, ComIPduSignalRef=Debug3_Byte0_oDebug_Frame3_oCAN00_3b70f5a9_Tx, ComIPduSignalRef=Debug3_Byte1_oDebug_Frame3_oCAN00_2c589169_Tx, ComIPduSignalRef=Debug3_Byte2_oDebug_Frame3_oCAN00_15203c29_Tx, ComIPduSignalRef=Debug3_Byte3_oDebug_Frame3_oCAN00_020858e9_Tx, ComIPduSignalRef=Debug3_Byte4_oDebug_Frame3_oCAN00_67d166a9_Tx, ComIPduSignalRef=Debug3_Byte5_oDebug_Frame3_oCAN00_70f90269_Tx, ComIPduSignalRef=Debug3_Byte6_oDebug_Frame3_oCAN00_4981af29_Tx, ComIPduSignalRef=Debug3_Byte7_oDebug_Frame3_oCAN00_5ea9cbe9_Tx, ComPduIdRef=EcucPduCollection/Debug_Frame3_oCAN00_9bb4a4c6_Tx
          ComTxIPdu: ComMinimumDelayTime=0, ComTxIPduUnusedAreasDefault=0
            ComTxModeFalse
              ComTxMode: ComTxModeMode=PERIODIC, ComTxModeTimeOffset=0, ComTxModeTimePeriod=0.1
            ComTxModeTrue
              ComTxMode: ComTxModeMode=PERIODIC, ComTxModeTimeOffset=0, ComTxModeTimePeriod=0.1
        Debug_Frame4_oCAN00_9171addf_Tx: ComIPduDirection=SEND, ComIPduGroupRef=IC_oCAN00_Tx_3ef0a222, ComIPduSignalRef=Debug4_Byte0_oDebug_Frame4_oCAN00_35bc0fe3_Tx, ComIPduSignalRef=Debug4_Byte1_oDebug_Frame4_oCAN00_22946b23_Tx, ComIPduSignalRef=Debug4_Byte2_oDebug_Frame4_oCAN00_1becc663_Tx, ComIPduSignalRef=Debug4_Byte3_oDebug_Frame4_oCAN00_0cc4a2a3_Tx, ComIPduSignalRef=Debug4_Byte4_oDebug_Frame4_oCAN00_691d9ce3_Tx, ComIPduSignalRef=Debug4_Byte5_oDebug_Frame4_oCAN00_7e35f823_Tx, ComIPduSignalRef=Debug4_Byte6_oDebug_Frame4_oCAN00_474d5563_Tx, ComIPduSignalRef=Debug4_Byte7_oDebug_Frame4_oCAN00_506531a3_Tx, ComPduIdRef=EcucPduCollection/Debug_Frame4_oCAN00_9171addf_Tx
          ComTxIPdu: ComMinimumDelayTime=0, ComTxIPduUnusedAreasDefault=0
            ComTxModeFalse
              ComTxMode: ComTxModeMode=PERIODIC, ComTxModeTimeOffset=0, ComTxModeTimePeriod=0.1
            ComTxModeTrue
              ComTxMode: ComTxModeMode=PERIODIC, ComTxModeTimeOffset=0, ComTxModeTimePeriod=0.1
        Debug_Frame5_oCAN00_5ddbad41_Tx: ComIPduDirection=SEND, ComIPduGroupRef=IC_oCAN00_Tx_3ef0a222, ComIPduSignalRef=Debug5_Byte0_oDebug_Frame5_oCAN00_f8a3f260_Tx, ComIPduSignalRef=Debug5_Byte1_oDebug_Frame5_oCAN00_ef8b96a0_Tx, ComIPduSignalRef=Debug5_Byte2_oDebug_Frame5_oCAN00_d6f33be0_Tx, ComIPduSignalRef=Debug5_Byte3_oDebug_Frame5_oCAN00_c1db5f20_Tx, ComIPduSignalRef=Debug5_Byte4_oDebug_Frame5_oCAN00_a4026160_Tx, ComIPduSignalRef=Debug5_Byte5_oDebug_Frame5_oCAN00_b32a05a0_Tx, ComIPduSignalRef=Debug5_Byte6_oDebug_Frame5_oCAN00_8a52a8e0_Tx, ComIPduSignalRef=Debug5_Byte7_oDebug_Frame5_oCAN00_9d7acc20_Tx, ComPduIdRef=EcucPduCollection/Debug_Frame5_oCAN00_5ddbad41_Tx
          ComTxIPdu: ComMinimumDelayTime=0, ComTxIPduUnusedAreasDefault=0
            ComTxModeFalse
              ComTxMode: ComTxModeMode=PERIODIC, ComTxModeTimeOffset=0, ComTxModeTimePeriod=0
            ComTxModeTrue
              ComTxMode: ComTxModeMode=PERIODIC, ComTxModeTimeOffset=0, ComTxModeTimePeriod=0
        Diag_Resp_USDT_oCAN00_0bcdd8e4_Tx: ComIPduDirection=SEND, ComIPduGroupRef=IC_oCAN00_Tx_3ef0a222, ComIPduSignalRef=Diag_Buffer_Tx_USDT_oDiag_Resp_USDT_oCAN00_3c21528d_Tx, ComPduIdRef=EcucPduCollection/Diag_Resp_USDT_oCAN00_0bcdd8e4_Tx
          ComTxIPdu: ComMinimumDelayTime=0, ComTxIPduUnusedAreasDefault=0
            ComTxModeFalse
              ComTxMode: ComTxModeMode=PERIODIC, ComTxModeTimeOffset=0, ComTxModeTimePeriod=0
            ComTxModeTrue
              ComTxMode: ComTxModeMode=PERIODIC, ComTxModeTimeOffset=0, ComTxModeTimePeriod=0
        Diag_Resp_UUDT_oCAN00_06d3a8a3_Tx: ComIPduDirection=SEND, ComIPduGroupRef=IC_oCAN00_Tx_3ef0a222, ComIPduSignalRef=Diag_Buffer_Tx_UUDT_oDiag_Resp_UUDT_oCAN00_0ee1ff7b_Tx, ComPduIdRef=EcucPduCollection/Diag_Resp_UUDT_oCAN00_06d3a8a3_Tx
          ComTxIPdu: ComMinimumDelayTime=0, ComTxIPduUnusedAreasDefault=0
            ComTxModeFalse
              ComTxMode: ComTxModeMode=PERIODIC, ComTxModeTimeOffset=0, ComTxModeTimePeriod=0
            ComTxModeTrue
              ComTxMode: ComTxModeMode=PERIODIC, ComTxModeTimeOffset=0, ComTxModeTimePeriod=0
        IC_NMPDU_oCAN00_7e631dbf_Tx: ComIPduDirection=SEND, ComIPduSignalRef=CurrentStateIC_oIC_NMPDU_oCAN00_ffb15989_Tx, ComIPduSignalRef=PreviousStateIC_oIC_NMPDU_oCAN00_54068aa2_Tx, ComIPduSignalRef=UserData1_IC_oIC_NMPDU_oCAN00_7de7a39d_Tx, ComIPduSignalRef=UserData2_IC_oIC_NMPDU_oCAN00_06f9217e_Tx, ComIPduSignalRef=UserData3_IC_oIC_NMPDU_oCAN00_9923a2e0_Tx, ComIPduSignalRef=UserData4_IC_oIC_NMPDU_oCAN00_f0c424b8_Tx, ComIPduSignalRef=UserData5_IC_oIC_NMPDU_oCAN00_6f1ea726_Tx, ComPduIdRef=EcucPduCollection/IC_NMPDU_oCAN00_7e631dbf_Tx
          ComTxIPdu: ComTxIPduUnusedAreasDefault=0  # IC_NMPDU_oCAN00
        Illum_control_oCAN00_e09f90e5_Rx: ComIPduDirection=RECEIVE, ComIPduGroupRef=IC_oCAN00_Rx_68aa05a4, ComIPduSignalRef=Ambient_Light_level_oIllum_control_oCAN00_888fcfad_Rx, ComIPduSignalRef=DayNightMode_oIllum_control_oCAN00_6d11bd91_Rx, ComIPduSignalRef=Illumination_level_oIllum_control_oCAN00_f3b042f8_Rx, ComPduIdRef=EcucPduCollection/Illum_control_oCAN00_e09f90e5_Rx
        VehicleControl_oCAN00_cbe9282b_Rx: ComIPduDirection=RECEIVE, ComIPduGroupRef=IC_oCAN00_Rx_68aa05a4, ComIPduSignalRef=EngineSpeed_oVehicleControl_oCAN00_7eb3f445_Rx, ComIPduSignalRef=GearMode_oVehicleControl_oCAN00_c0b273e8_Rx, ComIPduSignalRef=GearRecommendation_oVehicleControl_oCAN00_f980c505_Rx, ComIPduSignalRef=GearStatus_oVehicleControl_oCAN00_db10bc53_Rx, ComIPduSignalRef=Gear_oVehicleControl_oCAN00_45630abd_Rx, ComIPduSignalRef=PowerMode_oVehicleControl_oCAN00_4caafc19_Rx, ComIPduSignalRef=TransportMode_oVehicleControl_oCAN00_b498f884_Rx, ComIPduSignalRef=Turn_Indicator_Control_oVehicleControl_oCAN00_b06608e9_Rx, ComIPduSignalRef=Warning_oVehicleControl_oCAN00_ee369686_Rx, ComPduIdRef=EcucPduCollection/VehicleControl_oCAN00_cbe9282b_Rx
      IC_oCAN00_Rx_68aa05a4 (ComIPduGroup)
      IC_oCAN00_Tx_3ef0a222 (ComIPduGroup)
      70 x ComSignal:
        Ambient_Light_level_oIllum_control_oCAN00_888fcfad_Rx: ComBitPosition=23, ComBitSize=8, ComSignalEndianness=BIG_ENDIAN, ComSignalInitValue=0, ComSignalType=UINT8, ComSystemTemplateSystemSignalRef=Ambient_Light_level
        CurrentStateIC_oIC_NMPDU_oCAN00_ffb15989_Tx: ComBitPosition=19, ComBitSize=1, ComSignalEndianness=LITTLE_ENDIAN, ComSignalInitValue=0, ComSignalType=BOOLEAN, ComTransferProperty=PENDING, ComSystemTemplateSystemSignalRef=CurrentStateIC
        DayNightMode_oIllum_control_oCAN00_6d11bd91_Rx: ComBitPosition=7, ComBitSize=1, ComSignalEndianness=BIG_ENDIAN, ComSignalInitValue=0, ComSignalType=BOOLEAN, ComSystemTemplateSystemSignalRef=DayNightMode
        Debug1_Byte0_oDebug_Frame1_oCAN00_7a3e08ee_Tx: ComBitPosition=0, ComBitSize=8, ComSignalEndianness=LITTLE_ENDIAN, ComSignalInitValue=0, ComSignalType=UINT8, ComTransferProperty=PENDING, ComSystemTemplateSystemSignalRef=Debug1_Byte0
        Debug1_Byte1_oDebug_Frame1_oCAN00_6d166c2e_Tx: ComBitPosition=8, ComBitSize=8, ComSignalEndianness=LITTLE_ENDIAN, ComSignalInitValue=0, ComSignalType=UINT8, ComTransferProperty=PENDING, ComSystemTemplateSystemSignalRef=Debug1_Byte1
        Debug1_Byte2_oDebug_Frame1_oCAN00_546ec16e_Tx: ComBitPosition=16, ComBitSize=8, ComSignalEndianness=LITTLE_ENDIAN, ComSignalInitValue=0, ComSignalType=UINT8, ComTransferProperty=PENDING, ComSystemTemplateSystemSignalRef=Debug1_Byte2
        Debug1_Byte3_oDebug_Frame1_oCAN00_4346a5ae_Tx: ComBitPosition=24, ComBitSize=8, ComSignalEndianness=LITTLE_ENDIAN, ComSignalInitValue=0, ComSignalType=UINT8, ComTransferProperty=PENDING, ComSystemTemplateSystemSignalRef=Debug1_Byte3
        Debug1_Byte4_oDebug_Frame1_oCAN00_269f9bee_Tx: ComBitPosition=32, ComBitSize=8, ComSignalEndianness=LITTLE_ENDIAN, ComSignalInitValue=0, ComSignalType=UINT8, ComTransferProperty=PENDING, ComSystemTemplateSystemSignalRef=Debug1_Byte4
        Debug1_Byte5_oDebug_Frame1_oCAN00_31b7ff2e_Tx: ComBitPosition=40, ComBitSize=8, ComSignalEndianness=LITTLE_ENDIAN, ComSignalInitValue=0, ComSignalType=UINT8, ComTransferProperty=PENDING, ComSystemTemplateSystemSignalRef=Debug1_Byte5
        Debug1_Byte6_oDebug_Frame1_oCAN00_08cf526e_Tx: ComBitPosition=48, ComBitSize=8, ComSignalEndianness=LITTLE_ENDIAN, ComSignalInitValue=0, ComSignalType=UINT8, ComTransferProperty=PENDING, ComSystemTemplateSystemSignalRef=Debug1_Byte6
        Debug1_Byte7_oDebug_Frame1_oCAN00_1fe736ae_Tx: ComBitPosition=56, ComBitSize=8, ComSignalEndianness=LITTLE_ENDIAN, ComSignalInitValue=0, ComSignalType=UINT8, ComTransferProperty=PENDING, ComSystemTemplateSystemSignalRef=Debug1_Byte7
        Debug2_Byte0_oDebug_Frame2_oCAN00_f66f082a_Tx: ComBitPosition=0, ComBitSize=8, ComSignalEndianness=LITTLE_ENDIAN, ComSignalInitValue=0, ComSignalType=UINT8, ComTransferProperty=PENDING, ComSystemTemplateSystemSignalRef=Debug2_Byte0
        Debug2_Byte1_oDebug_Frame2_oCAN00_e1476cea_Tx: ComBitPosition=8, ComBitSize=8, ComSignalEndianness=LITTLE_ENDIAN, ComSignalInitValue=0, ComSignalType=UINT8, ComTransferProperty=PENDING, ComSystemTemplateSystemSignalRef=Debug2_Byte1
        Debug2_Byte2_oDebug_Frame2_oCAN00_d83fc1aa_Tx: ComBitPosition=16, ComBitSize=8, ComSignalEndianness=LITTLE_ENDIAN, ComSignalInitValue=0, ComSignalType=UINT8, ComTransferProperty=PENDING, ComSystemTemplateSystemSignalRef=Debug2_Byte2
        Debug2_Byte3_oDebug_Frame2_oCAN00_cf17a56a_Tx: ComBitPosition=24, ComBitSize=8, ComSignalEndianness=LITTLE_ENDIAN, ComSignalInitValue=0, ComSignalType=UINT8, ComTransferProperty=PENDING, ComSystemTemplateSystemSignalRef=Debug2_Byte3
        Debug2_Byte4_oDebug_Frame2_oCAN00_aace9b2a_Tx: ComBitPosition=32, ComBitSize=8, ComSignalEndianness=LITTLE_ENDIAN, ComSignalInitValue=0, ComSignalType=UINT8, ComTransferProperty=PENDING, ComSystemTemplateSystemSignalRef=Debug2_Byte4
        Debug2_Byte5_oDebug_Frame2_oCAN00_bde6ffea_Tx: ComBitPosition=40, ComBitSize=8, ComSignalEndianness=LITTLE_ENDIAN, ComSignalInitValue=0, ComSignalType=UINT8, ComTransferProperty=PENDING, ComSystemTemplateSystemSignalRef=Debug2_Byte5
        Debug2_Byte6_oDebug_Frame2_oCAN00_849e52aa_Tx: ComBitPosition=48, ComBitSize=8, ComSignalEndianness=LITTLE_ENDIAN, ComSignalInitValue=0, ComSignalType=UINT8, ComTransferProperty=PENDING, ComSystemTemplateSystemSignalRef=Debug2_Byte6
        Debug2_Byte7_oDebug_Frame2_oCAN00_93b6366a_Tx: ComBitPosition=56, ComBitSize=8, ComSignalEndianness=LITTLE_ENDIAN, ComSignalInitValue=0, ComSignalType=UINT8, ComTransferProperty=PENDING, ComSystemTemplateSystemSignalRef=Debug2_Byte7
        Debug3_Byte0_oDebug_Frame3_oCAN00_3b70f5a9_Tx: ComBitPosition=0, ComBitSize=8, ComSignalEndianness=LITTLE_ENDIAN, ComSignalInitValue=0, ComSignalType=UINT8, ComTransferProperty=PENDING, ComSystemTemplateSystemSignalRef=Debug3_Byte0
        Debug3_Byte1_oDebug_Frame3_oCAN00_2c589169_Tx: ComBitPosition=8, ComBitSize=8, ComSignalEndianness=LITTLE_ENDIAN, ComSignalInitValue=0, ComSignalType=UINT8, ComTransferProperty=PENDING, ComSystemTemplateSystemSignalRef=Debug3_Byte1
        Debug3_Byte2_oDebug_Frame3_oCAN00_15203c29_Tx: ComBitPosition=16, ComBitSize=8, ComSignalEndianness=LITTLE_ENDIAN, ComSignalInitValue=0, ComSignalType=UINT8, ComTransferProperty=PENDING, ComSystemTemplateSystemSignalRef=Debug3_Byte2
        Debug3_Byte3_oDebug_Frame3_oCAN00_020858e9_Tx: ComBitPosition=24, ComBitSize=8, ComSignalEndianness=LITTLE_ENDIAN, ComSignalInitValue=0, ComSignalType=UINT8, ComTransferProperty=PENDING, ComSystemTemplateSystemSignalRef=Debug3_Byte3
        Debug3_Byte4_oDebug_Frame3_oCAN00_67d166a9_Tx: ComBitPosition=32, ComBitSize=8, ComSignalEndianness=LITTLE_ENDIAN, ComSignalInitValue=0, ComSignalType=UINT8, ComTransferProperty=PENDING, ComSystemTemplateSystemSignalRef=Debug3_Byte4
        Debug3_Byte5_oDebug_Frame3_oCAN00_70f90269_Tx: ComBitPosition=40, ComBitSize=8, ComSignalEndianness=LITTLE_ENDIAN, ComSignalInitValue=0, ComSignalType=UINT8, ComTransferProperty=PENDING, ComSystemTemplateSystemSignalRef=Debug3_Byte5
        Debug3_Byte6_oDebug_Frame3_oCAN00_4981af29_Tx: ComBitPosition=48, ComBitSize=8, ComSignalEndianness=LITTLE_ENDIAN, ComSignalInitValue=0, ComSignalType=UINT8, ComTransferProperty=PENDING, ComSystemTemplateSystemSignalRef=Debug3_Byte6
        Debug3_Byte7_oDebug_Frame3_oCAN00_5ea9cbe9_Tx: ComBitPosition=56, ComBitSize=8, ComSignalEndianness=LITTLE_ENDIAN, ComSignalInitValue=0, ComSignalType=UINT8, ComTransferProperty=PENDING, ComSystemTemplateSystemSignalRef=Debug3_Byte7
        Debug4_Byte0_oDebug_Frame4_oCAN00_35bc0fe3_Tx: ComBitPosition=0, ComBitSize=8, ComSignalEndianness=LITTLE_ENDIAN, ComSignalInitValue=0, ComSignalType=UINT8, ComTransferProperty=PENDING, ComSystemTemplateSystemSignalRef=Debug4_Byte0
        Debug4_Byte1_oDebug_Frame4_oCAN00_22946b23_Tx: ComBitPosition=8, ComBitSize=8, ComSignalEndianness=LITTLE_ENDIAN, ComSignalInitValue=0, ComSignalType=UINT8, ComTransferProperty=PENDING, ComSystemTemplateSystemSignalRef=Debug4_Byte1
        Debug4_Byte2_oDebug_Frame4_oCAN00_1becc663_Tx: ComBitPosition=16, ComBitSize=8, ComSignalEndianness=LITTLE_ENDIAN, ComSignalInitValue=0, ComSignalType=UINT8, ComTransferProperty=PENDING, ComSystemTemplateSystemSignalRef=Debug4_Byte2
        Debug4_Byte3_oDebug_Frame4_oCAN00_0cc4a2a3_Tx: ComBitPosition=24, ComBitSize=8, ComSignalEndianness=LITTLE_ENDIAN, ComSignalInitValue=0, ComSignalType=UINT8, ComTransferProperty=PENDING, ComSystemTemplateSystemSignalRef=Debug4_Byte3
        Debug4_Byte4_oDebug_Frame4_oCAN00_691d9ce3_Tx: ComBitPosition=32, ComBitSize=8, ComSignalEndianness=LITTLE_ENDIAN, ComSignalInitValue=0, ComSignalType=UINT8, ComTransferProperty=PENDING, ComSystemTemplateSystemSignalRef=Debug4_Byte4
        Debug4_Byte5_oDebug_Frame4_oCAN00_7e35f823_Tx: ComBitPosition=40, ComBitSize=8, ComSignalEndianness=LITTLE_ENDIAN, ComSignalInitValue=0, ComSignalType=UINT8, ComTransferProperty=PENDING, ComSystemTemplateSystemSignalRef=Debug4_Byte5
        Debug4_Byte6_oDebug_Frame4_oCAN00_474d5563_Tx: ComBitPosition=48, ComBitSize=8, ComSignalEndianness=LITTLE_ENDIAN, ComSignalInitValue=0, ComSignalType=UINT8, ComTransferProperty=PENDING, ComSystemTemplateSystemSignalRef=Debug4_Byte6
        Debug4_Byte7_oDebug_Frame4_oCAN00_506531a3_Tx: ComBitPosition=56, ComBitSize=8, ComSignalEndianness=LITTLE_ENDIAN, ComSignalInitValue=0, ComSignalType=UINT8, ComTransferProperty=PENDING, ComSystemTemplateSystemSignalRef=Debug4_Byte7
        Debug5_Byte0_oDebug_Frame5_oCAN00_f8a3f260_Tx: ComBitPosition=0, ComBitSize=8, ComSignalEndianness=LITTLE_ENDIAN, ComSignalInitValue=0, ComSignalType=UINT8, ComTransferProperty=PENDING, ComSystemTemplateSystemSignalRef=Debug5_Byte0
        Debug5_Byte1_oDebug_Frame5_oCAN00_ef8b96a0_Tx: ComBitPosition=8, ComBitSize=8, ComSignalEndianness=LITTLE_ENDIAN, ComSignalInitValue=0, ComSignalType=UINT8, ComTransferProperty=PENDING, ComSystemTemplateSystemSignalRef=Debug5_Byte1
        Debug5_Byte2_oDebug_Frame5_oCAN00_d6f33be0_Tx: ComBitPosition=16, ComBitSize=8, ComSignalEndianness=LITTLE_ENDIAN, ComSignalInitValue=0, ComSignalType=UINT8, ComTransferProperty=PENDING, ComSystemTemplateSystemSignalRef=Debug5_Byte2
        Debug5_Byte3_oDebug_Frame5_oCAN00_c1db5f20_Tx: ComBitPosition=24, ComBitSize=8, ComSignalEndianness=LITTLE_ENDIAN, ComSignalInitValue=0, ComSignalType=UINT8, ComTransferProperty=PENDING, ComSystemTemplateSystemSignalRef=Debug5_Byte3
        Debug5_Byte4_oDebug_Frame5_oCAN00_a4026160_Tx: ComBitPosition=32, ComBitSize=8, ComSignalEndianness=LITTLE_ENDIAN, ComSignalInitValue=0, ComSignalType=UINT8, ComTransferProperty=PENDING, ComSystemTemplateSystemSignalRef=Debug5_Byte4
        Debug5_Byte5_oDebug_Frame5_oCAN00_b32a05a0_Tx: ComBitPosition=40, ComBitSize=8, ComSignalEndianness=LITTLE_ENDIAN, ComSignalInitValue=0, ComSignalType=UINT8, ComTransferProperty=PENDING, ComSystemTemplateSystemSignalRef=Debug5_Byte5
        Debug5_Byte6_oDebug_Frame5_oCAN00_8a52a8e0_Tx: ComBitPosition=48, ComBitSize=8, ComSignalEndianness=LITTLE_ENDIAN, ComSignalInitValue=0, ComSignalType=UINT8, ComTransferProperty=PENDING, ComSystemTemplateSystemSignalRef=Debug5_Byte6
        Debug5_Byte7_oDebug_Frame5_oCAN00_9d7acc20_Tx: ComBitPosition=56, ComBitSize=8, ComSignalEndianness=LITTLE_ENDIAN, ComSignalInitValue=0, ComSignalType=UINT8, ComTransferProperty=PENDING, ComSystemTemplateSystemSignalRef=Debug5_Byte7
        Diag_Buffer_Tx_USDT_oDiag_Resp_USDT_oCAN00_3c21528d_Tx: ComBitPosition=0, ComSignalEndianness=opaque, ComSignalInitValue=0 0 0 0 0 0 0 0, ComSignalLength=8, ComSignalType=UINT8_N, ComTransferProperty=PENDING, ComSystemTemplateSystemSignalRef=Diag_Buffer_Tx_USDT
        Diag_Buffer_Tx_UUDT_oDiag_Resp_UUDT_oCAN00_0ee1ff7b_Tx: ComBitPosition=0, ComSignalEndianness=opaque, ComSignalInitValue=0 0 0 0 0 0 0 0, ComSignalLength=8, ComSignalType=UINT8_N, ComTransferProperty=PENDING, ComSystemTemplateSystemSignalRef=Diag_Buffer_Tx_UUDT
        EngineSpeed_oVehicleControl_oCAN00_7eb3f445_Rx: ComBitPosition=39, ComBitSize=16, ComSignalEndianness=BIG_ENDIAN, ComSignalInitValue=0, ComSignalType=UINT16, ComSystemTemplateSystemSignalRef=EngineSpeed
        FV_Tx_oCluster_Secure_Tx_oCAN00_f077ac5c_Tx: ComBitPosition=60, ComBitSize=4, ComSignalEndianness=LITTLE_ENDIAN, ComSignalInitValue=0, ComSignalType=UINT8, ComTransferProperty=PENDING, ComSystemTemplateSystemSignalRef=FV_Tx
        GearMode_oVehicleControl_oCAN00_c0b273e8_Rx: ComBitPosition=51, ComBitSize=1, ComSignalEndianness=BIG_ENDIAN, ComSignalInitValue=0, ComSignalType=BOOLEAN, ComSystemTemplateSystemSignalRef=GearMode
        GearRecommendation_oVehicleControl_oCAN00_f980c505_Rx: ComBitPosition=50, ComBitSize=3, ComSignalEndianness=BIG_ENDIAN, ComSignalInitValue=0, ComSignalType=UINT8, ComSystemTemplateSystemSignalRef=GearRecommendation
        GearStatus_oVehicleControl_oCAN00_db10bc53_Rx: ComBitPosition=15, ComBitSize=8, ComSignalEndianness=BIG_ENDIAN, ComSignalInitValue=0, ComSignalType=UINT8, ComSystemTemplateSystemSignalRef=GearStatus
        Gear_oVehicleControl_oCAN00_45630abd_Rx: ComBitPosition=7, ComBitSize=4, ComSignalEndianness=BIG_ENDIAN, ComSignalInitValue=0, ComSignalType=UINT8, ComSystemTemplateSystemSignalRef=Gear
        Illumination_PWM_oCluster_Tx_Reduced_Com_oCAN00_0a670875_Tx: ComBitPosition=0, ComBitSize=8, ComSignalEndianness=LITTLE_ENDIAN, ComSignalInitValue=0, ComSignalType=UINT8, ComTransferProperty=PENDING, ComSystemTemplateSystemSignalRef=Illumination_PWM
        Illumination_level_oIllum_control_oCAN00_f3b042f8_Rx: ComBitPosition=1, ComBitSize=8, ComSignalEndianness=BIG_ENDIAN, ComSignalInitValue=0, ComSignalType=UINT8, ComSystemTemplateSystemSignalRef=Illumination_level
        MAC_Tx_oCluster_Secure_Tx_oCAN00_b83a6da7_Tx: ComBitPosition=32, ComBitSize=28, ComSignalEndianness=LITTLE_ENDIAN, ComSignalInitValue=0, ComSignalType=UINT32, ComTransferProperty=PENDING, ComSystemTemplateSystemSignalRef=MAC_Tx
        Odometer_oCluster_Tx_Normal_COM_LS_oCAN00_3e00d027_Tx: ComBitPosition=0, ComBitSize=32, ComSignalEndianness=LITTLE_ENDIAN, ComSignalInitValue=0, ComSignalType=UINT32, ComTransferProperty=PENDING, ComSystemTemplateSystemSignalRef=Odometer
        PowerMode_oVehicleControl_oCAN00_4caafc19_Rx: ComBitPosition=0, ComBitSize=4, ComSignalEndianness=LITTLE_ENDIAN, ComSignalInitValue=0, ComSignalType=UINT8, ComSystemTemplateSystemSignalRef=PowerMode
        PreviousStateIC_oIC_NMPDU_oCAN00_54068aa2_Tx: ComBitPosition=16, ComBitSize=3, ComSignalEndianness=LITTLE_ENDIAN, ComSignalInitValue=0, ComSignalType=SINT8, ComTransferProperty=PENDING, ComSystemTemplateSystemSignalRef=PreviousStateIC
        SecureTxByte0_oCluster_Secure_Tx_oCAN00_659a0722_Tx: ComBitPosition=0, ComBitSize=8, ComSignalEndianness=LITTLE_ENDIAN, ComSignalInitValue=0, ComSignalType=UINT8, ComTransferProperty=PENDING, ComSystemTemplateSystemSignalRef=SecureTxByte0
        SecureTxByte1_oCluster_Secure_Tx_oCAN00_0b161c63_Tx: ComBitPosition=8, ComBitSize=8, ComSignalEndianness=LITTLE_ENDIAN, ComSignalInitValue=0, ComSignalType=UINT8, ComTransferProperty=PENDING, ComSystemTemplateSystemSignalRef=SecureTxByte1
        SecureTxByte2_oCluster_Secure_Tx_oCAN00_b88231a0_Tx: ComBitPosition=16, ComBitSize=8, ComSignalEndianness=LITTLE_ENDIAN, ComSignalInitValue=0, ComSignalType=UINT8, ComTransferProperty=PENDING, ComSystemTemplateSystemSignalRef=SecureTxByte2
        SecureTxByte3_oCluster_Secure_Tx_oCAN00_d60e2ae1_Tx: ComBitPosition=24, ComBitSize=8, ComSignalEndianness=LITTLE_ENDIAN, ComSignalInitValue=0, ComSignalType=UINT8, ComTransferProperty=PENDING, ComSystemTemplateSystemSignalRef=SecureTxByte3
        TransportMode_oVehicleControl_oCAN00_b498f884_Rx: ComBitPosition=54, ComBitSize=1, ComSignalEndianness=LITTLE_ENDIAN, ComSignalInitValue=0, ComSignalType=BOOLEAN, ComSystemTemplateSystemSignalRef=TransportMode
        Turn_Indicator_Control_oVehicleControl_oCAN00_b06608e9_Rx: ComBitPosition=22, ComBitSize=2, ComSignalEndianness=LITTLE_ENDIAN, ComSignalInitValue=0, ComSignalType=UINT8, ComSystemTemplateSystemSignalRef=Turn_Indicator_Control
        UserData1_IC_oIC_NMPDU_oCAN00_7de7a39d_Tx: ComBitPosition=24, ComBitSize=8, ComSignalEndianness=LITTLE_ENDIAN, ComSignalInitValue=0, ComSignalType=UINT8, ComTransferProperty=PENDING, ComSystemTemplateSystemSignalRef=UserData1_IC
        UserData2_IC_oIC_NMPDU_oCAN00_06f9217e_Tx: ComBitPosition=32, ComBitSize=8, ComSignalEndianness=LITTLE_ENDIAN, ComSignalInitValue=0, ComSignalType=UINT8, ComTransferProperty=PENDING, ComSystemTemplateSystemSignalRef=UserData2_IC
        UserData3_IC_oIC_NMPDU_oCAN00_9923a2e0_Tx: ComBitPosition=40, ComBitSize=8, ComSignalEndianness=LITTLE_ENDIAN, ComSignalInitValue=0, ComSignalType=UINT8, ComTransferProperty=PENDING, ComSystemTemplateSystemSignalRef=UserData3_IC
        UserData4_IC_oIC_NMPDU_oCAN00_f0c424b8_Tx: ComBitPosition=48, ComBitSize=8, ComSignalEndianness=LITTLE_ENDIAN, ComSignalInitValue=0, ComSignalType=UINT8, ComTransferProperty=PENDING, ComSystemTemplateSystemSignalRef=UserData4_IC
        UserData5_IC_oIC_NMPDU_oCAN00_6f1ea726_Tx: ComBitPosition=56, ComBitSize=8, ComSignalEndianness=LITTLE_ENDIAN, ComSignalInitValue=0, ComSignalType=UINT8, ComTransferProperty=PENDING, ComSystemTemplateSystemSignalRef=UserData5_IC
        VehicleSpeedIC_oCluster_Tx_Normal_COM_MS_oCAN00_1b17fdcc_Tx: ComBitPosition=0, ComBitSize=16, ComSignalEndianness=LITTLE_ENDIAN, ComSignalInitValue=0, ComSignalType=UINT16, ComTransferProperty=PENDING, ComSystemTemplateSystemSignalRef=VehicleSpeedIC
        Warning_oVehicleControl_oCAN00_ee369686_Rx: ComBitPosition=63, ComBitSize=8, ComSignalEndianness=BIG_ENDIAN, ComSignalInitValue=0, ComSignalType=UINT8, ComSystemTemplateSystemSignalRef=Warning
      SG_ABS_oABS_oCAN00_6681ad27_Rx (ComSignalGroup): ComTransferProperty=PENDING, ComSystemTemplateSignalGroupRef=SG_ABS
        4 x ComGroupSignal, all with ComSignalEndianness=LITTLE_ENDIAN, ComSignalInitValue=0:
          Airbag_oABS_oCAN00_d379e7a9_Rx: ComBitPosition=14, ComBitSize=2, ComSignalType=UINT8, ComSystemTemplateSystemSignalRef=Airbag
          Alive_101_oABS_oCAN00_a0c1519e_Rx: ComBitPosition=44, ComBitSize=4, ComSignalType=UINT8, ComSystemTemplateSystemSignalRef=Alive_101
          CRC_101_oABS_oCAN00_bce9141a_Rx: ComBitPosition=48, ComBitSize=8, ComSignalType=UINT8, ComSystemTemplateSystemSignalRef=CRC_101
          VehicleSpeedABS_oABS_oCAN00_94c6f8d1_Rx: ComBitPosition=24, ComBitSize=16, ComSignalType=UINT16, ComSystemTemplateSystemSignalRef=VehicleSpeedABS
      SG_COM_HS_oCluster_Tx_Normal_COM_HS_oCAN00_c9c3ed51_Tx (ComSignalGroup): ComTransferProperty=PENDING, ComSystemTemplateSignalGroupRef=SG_COM_HS
        3 x ComGroupSignal, all with ComSignalEndianness=LITTLE_ENDIAN, ComSignalInitValue=0, ComSignalType=UINT8, ComTransferProperty=PENDING:
          Alive_200_oCluster_Tx_Normal_COM_HS_oCAN00_96cf5451_Tx: ComBitPosition=8, ComBitSize=4, ComSystemTemplateSystemSignalRef=Alive_200
          Battery_Voltage_oCluster_Tx_Normal_COM_HS_oCAN00_e5088019_Tx: ComBitPosition=0, ComBitSize=8, ComSystemTemplateSystemSignalRef=Battery_Voltage
          CRC_200_oCluster_Tx_Normal_COM_HS_oCAN00_b588f3c3_Tx: ComBitPosition=16, ComBitSize=8, ComSystemTemplateSystemSignalRef=CRC_200
    ComGeneral
  module config ComM
    ComMConfigSet: ComMPncEnabled=false
      CN_CAN00_bb949cc2 (ComMChannel): ComMBusType=COMM_BUS_TYPE_CAN, ComMChannelId=0
        ComMNetworkManagement: ComMNmVariant=NONE
        CN_CAN00_31ac7964 (ComMUserPerChannel): ComMUserChannel=CN_CAN00_0c767ef5
      CN_CAN00_0c767ef5 (ComMUser): ComMUserIdentifier=0
    ComMGeneral: ComMPncIdCounting=COMM_PNC_ID_COUNT_FROM_NM_MESSAGE, ComMPncSupport=false
  module config EcuC
    EcucPduCollection: PduIdTypeEnum=UINT8, PduLengthTypeEnum=UINT8
      33 x Pdu:
        ABS_oCAN00_29f7b4f6_Rx: PduLength=7
        ABS_oCAN00_97526119_Rx: PduLength=7, SysTPduToFrameMappingRef=ABS
        Cluster_Secure_Tx_oCAN00_7e3ab6a5_Tx: PduLength=8
        Cluster_Secure_Tx_oCAN00_fbf04cbe_Tx: PduLength=8, SysTPduToFrameMappingRef=Cluster_Secure_Tx
        Cluster_Tx_Normal_COM_HS_oCAN00_017bc789_Tx: PduLength=3
        Cluster_Tx_Normal_COM_HS_oCAN00_7765df5c_Tx: PduLength=3, SysTPduToFrameMappingRef=Cluster_Tx_Normal_COM_HS
        Cluster_Tx_Normal_COM_LS_oCAN00_1e634103_Tx: PduLength=4, SysTPduToFrameMappingRef=Cluster_Tx_Normal_COM_LS
        Cluster_Tx_Normal_COM_LS_oCAN00_5c979685_Tx: PduLength=4
        Cluster_Tx_Normal_COM_MS_oCAN00_4bec82c6_Tx: PduLength=2
        Cluster_Tx_Normal_COM_MS_oCAN00_9f462424_Tx: PduLength=2, SysTPduToFrameMappingRef=Cluster_Tx_Normal_COM_MS
        Cluster_Tx_Reduced_Com_oCAN00_4e2ce421_Tx: PduLength=1, SysTPduToFrameMappingRef=Cluster_Tx_Reduced_Com
        Cluster_Tx_Reduced_Com_oCAN00_8ca7c169_Tx: PduLength=1
        Debug_Frame1_oCAN00_48431553_Tx: PduLength=8, SysTPduToFrameMappingRef=Debug_Frame1
        Debug_Frame1_oCAN00_d991a3bb_Tx: PduLength=8
        Debug_Frame2_oCAN00_3ea62c6e_Tx: PduLength=8, SysTPduToFrameMappingRef=Debug_Frame2
        Debug_Frame2_oCAN00_571ea458_Tx: PduLength=8
        Debug_Frame3_oCAN00_9bb4a4c6_Tx: PduLength=8
        Debug_Frame3_oCAN00_a5d5c6ba_Tx: PduLength=8, SysTPduToFrameMappingRef=Debug_Frame3
        Debug_Frame4_oCAN00_9171addf_Tx: PduLength=8
        Debug_Frame4_oCAN00_d36c5e14_Tx: PduLength=8, SysTPduToFrameMappingRef=Debug_Frame4
        Debug_Frame5_oCAN00_481fb4c0_Tx: PduLength=8, SysTPduToFrameMappingRef=Debug_Frame5
        Debug_Frame5_oCAN00_5ddbad41_Tx: PduLength=8
        Diag_Resp_USDT_oCAN00_0bcdd8e4_Tx: PduLength=8
        Diag_Resp_USDT_oCAN00_14b29fad_Tx: PduLength=8, SysTPduToFrameMappingRef=Diag_Resp_USDT
        Diag_Resp_UUDT_oCAN00_06d3a8a3_Tx: PduLength=8
        Diag_Resp_UUDT_oCAN00_7f69f30b_Tx: PduLength=8, SysTPduToFrameMappingRef=Diag_Resp_UUDT
        IC_NMPDU_oCAN00_57ad3fa9_Tx: PduLength=8, SysTPduToFrameMappingRef=IC_NMPDU
        IC_NMPDU_oCAN00_7e631dbf_Tx
        Illum_control_oCAN00_8f78885e_Rx: PduLength=3, SysTPduToFrameMappingRef=Illum_control
        Illum_control_oCAN00_e09f90e5_Rx: PduLength=3
        NM_CoOrd_NMPDU_oCAN00_1fc35b6d_Rx: PduLength=8, SysTPduToFrameMappingRef=NM_CoOrd_NMPDU
        VehicleControl_oCAN00_8e397222_Rx: PduLength=8, SysTPduToFrameMappingRef=VehicleControl
        VehicleControl_oCAN00_cbe9282b_Rx: PduLength=8
  module config EcuM
    EcuMConfiguration
      EcuMCommonConfiguration
        EcuMDriverInitListOne
        EcuMDriverRestartList
        CN_CAN00_bb949cc2 (EcuMWakeupSource): EcuMWakeupSourceId=5, EcuMComMChannelRef=ComMConfigSet/CN_CAN00_bb949cc2
      EcuMFlexConfiguration: EcuMFlexModuleConfigurationRef=CanConfigSet
  module config PduR
    PduRGeneral
    PduRRoutingTables
      PduRRoutingTable
        15 x PduRRoutingPath:
          ABS_oCAN00_97526119_Rx
            ABS_oCAN00_97526119_Rx_6c2fc7d0_Rx (PduRDestPdu): PduRDestPduRef=EcucPduCollection/ABS_oCAN00_29f7b4f6_Rx
            PduRSrcPdu_6c2fc7d0 (PduRSrcPdu): PduRSrcPduRef=EcucPduCollection/ABS_oCAN00_97526119_Rx
          Cluster_Secure_Tx_oCAN00_7e3ab6a5_Tx
            Cluster_Secure_Tx_oCAN00_fbf04cbe_Tx (PduRDestPdu): PduRDestPduRef=EcucPduCollection/Cluster_Secure_Tx_oCAN00_fbf04cbe_Tx
            PduRSrcPdu_dbd9430d (PduRSrcPdu): PduRSrcPduRef=EcucPduCollection/Cluster_Secure_Tx_oCAN00_7e3ab6a5_Tx
          Cluster_Tx_Normal_COM_HS_oCAN00_017bc789_Tx
            Cluster_Tx_Normal_COM_HS_oCAN00_7765df5c_Tx (PduRDestPdu): PduRDestPduRef=EcucPduCollection/Cluster_Tx_Normal_COM_HS_oCAN00_7765df5c_Tx
            PduRSrcPdu_1ac28259 (PduRSrcPdu): PduRSrcPduRef=EcucPduCollection/Cluster_Tx_Normal_COM_HS_oCAN00_017bc789_Tx
          Cluster_Tx_Normal_COM_LS_oCAN00_5c979685_Tx
            Cluster_Tx_Normal_COM_LS_oCAN00_1e634103_Tx (PduRDestPdu): PduRDestPduRef=EcucPduCollection/Cluster_Tx_Normal_COM_LS_oCAN00_1e634103_Tx
            PduRSrcPdu_17a68001 (PduRSrcPdu): PduRSrcPduRef=EcucPduCollection/Cluster_Tx_Normal_COM_LS_oCAN00_5c979685_Tx
          Cluster_Tx_Normal_COM_MS_oCAN00_4bec82c6_Tx
            Cluster_Tx_Normal_COM_MS_oCAN00_9f462424_Tx (PduRDestPdu): PduRDestPduRef=EcucPduCollection/Cluster_Tx_Normal_COM_MS_oCAN00_9f462424_Tx
            PduRSrcPdu_83aae0a9 (PduRSrcPdu): PduRSrcPduRef=EcucPduCollection/Cluster_Tx_Normal_COM_MS_oCAN00_4bec82c6_Tx
          Cluster_Tx_Reduced_Com_oCAN00_8ca7c169_Tx
            Cluster_Tx_Reduced_Com_oCAN00_4e2ce421_Tx (PduRDestPdu): PduRDestPduRef=EcucPduCollection/Cluster_Tx_Reduced_Com_oCAN00_4e2ce421_Tx
            PduRSrcPdu_ebbff666 (PduRSrcPdu): PduRSrcPduRef=EcucPduCollection/Cluster_Tx_Reduced_Com_oCAN00_8ca7c169_Tx
          Debug_Frame1_oCAN00_d991a3bb_Tx
            Debug_Frame1_oCAN00_48431553_Tx (PduRDestPdu): PduRDestPduRef=EcucPduCollection/Debug_Frame1_oCAN00_48431553_Tx
            PduRSrcPdu_ee860893 (PduRSrcPdu): PduRSrcPduRef=EcucPduCollection/Debug_Frame1_oCAN00_d991a3bb_Tx
          Debug_Frame2_oCAN00_571ea458_Tx
            Debug_Frame2_oCAN00_3ea62c6e_Tx (PduRDestPdu): PduRDestPduRef=EcucPduCollection/Debug_Frame2_oCAN00_3ea62c6e_Tx
            PduRSrcPdu_bfe4e48f (PduRSrcPdu): PduRSrcPduRef=EcucPduCollection/Debug_Frame2_oCAN00_571ea458_Tx
          Debug_Frame3_oCAN00_9bb4a4c6_Tx
            Debug_Frame3_oCAN00_a5d5c6ba_Tx (PduRDestPdu): PduRDestPduRef=EcucPduCollection/Debug_Frame3_oCAN00_a5d5c6ba_Tx
            PduRSrcPdu_0a7bc3b1 (PduRSrcPdu): PduRSrcPduRef=EcucPduCollection/Debug_Frame3_oCAN00_9bb4a4c6_Tx
          Debug_Frame4_oCAN00_9171addf_Tx
            Debug_Frame4_oCAN00_d36c5e14_Tx (PduRDestPdu): PduRDestPduRef=EcucPduCollection/Debug_Frame4_oCAN00_d36c5e14_Tx
            PduRSrcPdu_bc9a8971 (PduRSrcPdu): PduRSrcPduRef=EcucPduCollection/Debug_Frame4_oCAN00_9171addf_Tx
          Debug_Frame5_oCAN00_5ddbad41_Tx
            Debug_Frame5_oCAN00_481fb4c0_Tx (PduRDestPdu): PduRDestPduRef=EcucPduCollection/Debug_Frame5_oCAN00_481fb4c0_Tx
            PduRSrcPdu_72651cba (PduRSrcPdu): PduRSrcPduRef=EcucPduCollection/Debug_Frame5_oCAN00_5ddbad41_Tx
          Diag_Resp_USDT_oCAN00_0bcdd8e4_Tx
            Diag_Resp_USDT_oCAN00_14b29fad_Tx (PduRDestPdu): PduRDestPduRef=EcucPduCollection/Diag_Resp_USDT_oCAN00_14b29fad_Tx
            PduRSrcPdu_87881d2d (PduRSrcPdu): PduRSrcPduRef=EcucPduCollection/Diag_Resp_USDT_oCAN00_0bcdd8e4_Tx
          Diag_Resp_UUDT_oCAN00_06d3a8a3_Tx
            Diag_Resp_UUDT_oCAN00_7f69f30b_Tx (PduRDestPdu): PduRDestPduRef=EcucPduCollection/Diag_Resp_UUDT_oCAN00_7f69f30b_Tx
            PduRSrcPdu_446b4757 (PduRSrcPdu): PduRSrcPduRef=EcucPduCollection/Diag_Resp_UUDT_oCAN00_06d3a8a3_Tx
          Illum_control_oCAN00_8f78885e_Rx
            Illum_control_oCAN00_8f78885e_Rx_44272a4f_Rx (PduRDestPdu): PduRDestPduRef=EcucPduCollection/Illum_control_oCAN00_e09f90e5_Rx
            PduRSrcPdu_44272a4f (PduRSrcPdu): PduRSrcPduRef=EcucPduCollection/Illum_control_oCAN00_8f78885e_Rx
          VehicleControl_oCAN00_8e397222_Rx
            VehicleControl_oCAN00_8e397222_Rx_7cc0fb52_Rx (PduRDestPdu): PduRDestPduRef=EcucPduCollection/VehicleControl_oCAN00_cbe9282b_Rx
            PduRSrcPdu_7cc0fb52 (PduRSrcPdu): PduRSrcPduRef=EcucPduCollection/VehicleControl_oCAN00_8e397222_Rx
