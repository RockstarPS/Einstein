AUTOSAR XML (schema 4-2-1)
package /ActiveEcuC
  module config Mcu: implementation-config-variant=VARIANT-PRE-COMPILE, module-description=Mcu_Impl
    McuPublishedInformation
    McuGeneralConfiguration:
      McuDevErrorDetect = true
      McuGetRamStateApi = true
      McuInitClock = true
      McuNoPll = true
      McuPerformResetApi = true
      McuVersionInfoApi = false
      McuEmulationFeature = true
    McuModuleConfiguration
