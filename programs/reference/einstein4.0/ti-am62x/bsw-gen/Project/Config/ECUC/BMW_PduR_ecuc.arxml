AUTOSAR XML (schema 4-2-1)
package /ActiveEcuC
  module config PduR: implementation-config-variant=VARIANT-PRE-COMPILE, module-description=PduR_Impl
    PduRGeneral:
      PduRDevErrorDetect = true
      PduRVersionInfoApi = false
      PduRMetaDataSupport = false
      PduRPduCallback = false
      PduRSwitching = false
      PduRSafeBswChecks = false
      PduREnableDeferredTransmission = false
      PduREnableDeferredReception = false
      PduRGeneration:
        PduROutOfBoundsWriteProtectionStrategy = NONE
        PduROutOfBoundsWriteSanitizer = false
        PduROutOfBoundsReadSanitizer = false
        PduRNumericalDataTypeMinimizationStrategy = WITH_CAST
        PduRReduceConstantData2Define = false
        PduRBoolDataInArrayOfStructStrategy = BITMASKING
        PduRDeduplicateIndirectedData = true
        PduRDataDeduplicationStrategy = WITH_CAST
        PduRReduceBoolDataByNegationThreshold = 2
        PduRReduceBoolDataByNumericalComparisonThreshold = 2
        PduRReduceBoolDataByNumericalRelationThreshold = 2
        PduRReduceBoolDataByNumericalOperandStrategy = WITH_ANY_VALUE
        PduRReduceNumericalDataByOffsetThreshold = 2
        PduRReduceNumericalDataByArraySubtractionThreshold = 2
        PduRReduceDataByStreaming = false
        PduRShortSymbols = false
        PduRInterfacesForDeactivatedData = false
        PduRReferringKeysInComments = false
    PduRRoutingTables: PduRConfigurationId=0
      PduRRoutingTable
        15 x PduRRoutingPath, all with PduRRoutingPathCommunicationType=COMMUNICATION_INTERFACE:
          Diag_Resp_UUDT_oCAN00_06d3a8a3_Tx
            PduRSrcPdu_446b4757 (PduRSrcPdu): PduRSourcePduHandleId=11, PduRSrcPduDirection=TRANSMIT, PduRSrcPduRef=Diag_Resp_UUDT_oCAN00_06d3a8a3_Tx, PduRSrcPduPduRBswModulesRef=Com
            Diag_Resp_UUDT_oCAN00_7f69f30b_Tx (PduRDestPdu):
              PduRDestPduHandleId = 11
              PduRDestPduDirection = TRANSMIT
              PduRDestPduRoutingType = API_FORWARDING
              PduRDestPduDataProcessing = IMMEDIATE
              PduRPduLengthHandlingStrategy = UNUSED
              PduRDestPduDataProvision = PDUR_DIRECT
              PduRTransmissionConfirmation = false
              PduRDestPduRef = Diag_Resp_UUDT_oCAN00_7f69f30b_Tx
              PduRDestPduPduRBswModulesRef = CanIf
          Debug_Frame3_oCAN00_9bb4a4c6_Tx
            PduRSrcPdu_0a7bc3b1 (PduRSrcPdu): PduRSourcePduHandleId=7, PduRSrcPduDirection=TRANSMIT, PduRSrcPduRef=Debug_Frame3_oCAN00_9bb4a4c6_Tx, PduRSrcPduPduRBswModulesRef=Com
            Debug_Frame3_oCAN00_a5d5c6ba_Tx (PduRDestPdu):
              PduRDestPduHandleId = 7
              PduRDestPduDirection = TRANSMIT
              PduRDestPduRoutingType = API_FORWARDING
              PduRDestPduDataProcessing = IMMEDIATE
              PduRPduLengthHandlingStrategy = UNUSED
              PduRDestPduDataProvision = PDUR_DIRECT
              PduRTransmissionConfirmation = false
              PduRDestPduRef = Debug_Frame3_oCAN00_a5d5c6ba_Tx
              PduRDestPduPduRBswModulesRef = CanIf
          Cluster_Tx_Reduced_Com_oCAN00_8ca7c169_Tx
            PduRSrcPdu_ebbff666 (PduRSrcPdu): PduRSourcePduHandleId=4, PduRSrcPduDirection=TRANSMIT, PduRSrcPduRef=Cluster_Tx_Reduced_Com_oCAN00_8ca7c169_Tx, PduRSrcPduPduRBswModulesRef=Com
            Cluster_Tx_Reduced_Com_oCAN00_4e2ce421_Tx (PduRDestPdu):
              PduRDestPduHandleId = 4
              PduRDestPduDirection = TRANSMIT
              PduRDestPduRoutingType = API_FORWARDING
              PduRDestPduDataProcessing = IMMEDIATE
              PduRPduLengthHandlingStrategy = UNUSED
              PduRDestPduDataProvision = PDUR_DIRECT
              PduRTransmissionConfirmation = false
              PduRDestPduRef = Cluster_Tx_Reduced_Com_oCAN00_4e2ce421_Tx
              PduRDestPduPduRBswModulesRef = CanIf
          Diag_Resp_USDT_oCAN00_0bcdd8e4_Tx
            PduRSrcPdu_87881d2d (PduRSrcPdu): PduRSourcePduHandleId=10, PduRSrcPduDirection=TRANSMIT, PduRSrcPduRef=Diag_Resp_USDT_oCAN00_0bcdd8e4_Tx, PduRSrcPduPduRBswModulesRef=Com
            Diag_Resp_USDT_oCAN00_14b29fad_Tx (PduRDestPdu):
              PduRDestPduHandleId = 10
              PduRDestPduDirection = TRANSMIT
              PduRDestPduRoutingType = API_FORWARDING
              PduRDestPduDataProcessing = IMMEDIATE
              PduRPduLengthHandlingStrategy = UNUSED
              PduRDestPduDataProvision = PDUR_DIRECT
              PduRTransmissionConfirmation = false
              PduRDestPduRef = Diag_Resp_USDT_oCAN00_14b29fad_Tx
              PduRDestPduPduRBswModulesRef = CanIf
          Debug_Frame1_oCAN00_d991a3bb_Tx
            Debug_Frame1_oCAN00_48431553_Tx (PduRDestPdu):
              PduRDestPduHandleId = 5
              PduRDestPduDirection = TRANSMIT
              PduRDestPduRoutingType = API_FORWARDING
              PduRDestPduDataProcessing = IMMEDIATE
              PduRPduLengthHandlingStrategy = UNUSED
              PduRDestPduDataProvision = PDUR_DIRECT
              PduRTransmissionConfirmation = false
              PduRDestPduRef = Debug_Frame1_oCAN00_48431553_Tx
              PduRDestPduPduRBswModulesRef = CanIf
            PduRSrcPdu_ee860893 (PduRSrcPdu): PduRSourcePduHandleId=5, PduRSrcPduDirection=TRANSMIT, PduRSrcPduRef=Debug_Frame1_oCAN00_d991a3bb_Tx, PduRSrcPduPduRBswModulesRef=Com
          Cluster_Tx_Normal_COM_HS_oCAN00_017bc789_Tx
            PduRSrcPdu_1ac28259 (PduRSrcPdu): PduRSourcePduHandleId=1, PduRSrcPduDirection=TRANSMIT, PduRSrcPduRef=Cluster_Tx_Normal_COM_HS_oCAN00_017bc789_Tx, PduRSrcPduPduRBswModulesRef=Com
            Cluster_Tx_Normal_COM_HS_oCAN00_7765df5c_Tx (PduRDestPdu):
              PduRDestPduHandleId = 1
              PduRDestPduDirection = TRANSMIT
              PduRDestPduRoutingType = API_FORWARDING
              PduRDestPduDataProcessing = IMMEDIATE
              PduRPduLengthHandlingStrategy = UNUSED
              PduRDestPduDataProvision = PDUR_DIRECT
              PduRTransmissionConfirmation = false
              PduRDestPduRef = Cluster_Tx_Normal_COM_HS_oCAN00_7765df5c_Tx
              PduRDestPduPduRBswModulesRef = CanIf
          Cluster_Tx_Normal_COM_MS_oCAN00_4bec82c6_Tx
            PduRSrcPdu_83aae0a9 (PduRSrcPdu): PduRSourcePduHandleId=3, PduRSrcPduDirection=TRANSMIT, PduRSrcPduRef=Cluster_Tx_Normal_COM_MS_oCAN00_4bec82c6_Tx, PduRSrcPduPduRBswModulesRef=Com
            Cluster_Tx_Normal_COM_MS_oCAN00_9f462424_Tx (PduRDestPdu):
              PduRDestPduHandleId = 3
              PduRDestPduDirection = TRANSMIT
              PduRDestPduRoutingType = API_FORWARDING
              PduRDestPduDataProcessing = IMMEDIATE
              PduRPduLengthHandlingStrategy = UNUSED
              PduRDestPduDataProvision = PDUR_DIRECT
              PduRTransmissionConfirmation = false
              PduRDestPduRef = Cluster_Tx_Normal_COM_MS_oCAN00_9f462424_Tx
              PduRDestPduPduRBswModulesRef = CanIf
          Illum_control_oCAN00_8f78885e_Rx
            Illum_control_oCAN00_8f78885e_Rx_44272a4f_Rx (PduRDestPdu):
              PduRDestPduHandleId = 1
              PduRDestPduDirection = RECEIVE
              PduRDestPduRoutingType = API_FORWARDING
              PduRDestPduDataProcessing = IMMEDIATE
              PduRPduLengthHandlingStrategy = UNUSED
              PduRTransmissionConfirmation = false
              PduRDestPduRef = Illum_control_oCAN00_e09f90e5_Rx
              PduRDestPduPduRBswModulesRef = Com
            PduRSrcPdu_44272a4f (PduRSrcPdu): PduRSourcePduHandleId=1, PduRSrcPduDirection=RECEIVE, PduRSrcPduRef=Illum_control_oCAN00_8f78885e_Rx, PduRSrcPduPduRBswModulesRef=CanIf
          Cluster_Tx_Normal_COM_LS_oCAN00_5c979685_Tx
            PduRSrcPdu_17a68001 (PduRSrcPdu): PduRSourcePduHandleId=2, PduRSrcPduDirection=TRANSMIT, PduRSrcPduRef=Cluster_Tx_Normal_COM_LS_oCAN00_5c979685_Tx, PduRSrcPduPduRBswModulesRef=Com
            Cluster_Tx_Normal_COM_LS_oCAN00_1e634103_Tx (PduRDestPdu):
              PduRDestPduHandleId = 2
              PduRDestPduDirection = TRANSMIT
              PduRDestPduRoutingType = API_FORWARDING
              PduRDestPduDataProcessing = IMMEDIATE
              PduRPduLengthHandlingStrategy = UNUSED
              PduRDestPduDataProvision = PDUR_DIRECT
              PduRTransmissionConfirmation = false
              PduRDestPduRef = Cluster_Tx_Normal_COM_LS_oCAN00_1e634103_Tx
              PduRDestPduPduRBswModulesRef = CanIf
          Cluster_Secure_Tx_oCAN00_7e3ab6a5_Tx
            PduRSrcPdu_dbd9430d (PduRSrcPdu): PduRSourcePduHandleId=0, PduRSrcPduDirection=TRANSMIT, PduRSrcPduRef=Cluster_Secure_Tx_oCAN00_7e3ab6a5_Tx, PduRSrcPduPduRBswModulesRef=Com
            Cluster_Secure_Tx_oCAN00_fbf04cbe_Tx (PduRDestPdu):
              PduRDestPduHandleId = 0
              PduRDestPduDirection = TRANSMIT
              PduRDestPduRoutingType = API_FORWARDING
              PduRDestPduDataProcessing = IMMEDIATE
              PduRPduLengthHandlingStrategy = UNUSED
              PduRDestPduDataProvision = PDUR_DIRECT
              PduRTransmissionConfirmation = false
              PduRDestPduRef = Cluster_Secure_Tx_oCAN00_fbf04cbe_Tx
              PduRDestPduPduRBswModulesRef = CanIf
          Debug_Frame2_oCAN00_571ea458_Tx
            PduRSrcPdu_bfe4e48f (PduRSrcPdu): PduRSourcePduHandleId=6, PduRSrcPduDirection=TRANSMIT, PduRSrcPduRef=Debug_Frame2_oCAN00_571ea458_Tx, PduRSrcPduPduRBswModulesRef=Com
            Debug_Frame2_oCAN00_3ea62c6e_Tx (PduRDestPdu):
              PduRDestPduHandleId = 6
              PduRDestPduDirection = TRANSMIT
              PduRDestPduRoutingType = API_FORWARDING
              PduRDestPduDataProcessing = IMMEDIATE
              PduRPduLengthHandlingStrategy = UNUSED
              PduRDestPduDataProvision = PDUR_DIRECT
              PduRTransmissionConfirmation = false
              PduRDestPduRef = Debug_Frame2_oCAN00_3ea62c6e_Tx
              PduRDestPduPduRBswModulesRef = CanIf
          Debug_Frame5_oCAN00_5ddbad41_Tx
            PduRSrcPdu_72651cba (PduRSrcPdu): PduRSourcePduHandleId=9, PduRSrcPduDirection=TRANSMIT, PduRSrcPduRef=Debug_Frame5_oCAN00_5ddbad41_Tx, PduRSrcPduPduRBswModulesRef=Com
            Debug_Frame5_oCAN00_481fb4c0_Tx (PduRDestPdu):
              PduRDestPduHandleId = 9
              PduRDestPduDirection = TRANSMIT
              PduRDestPduRoutingType = API_FORWARDING
              PduRDestPduDataProcessing = IMMEDIATE
              PduRPduLengthHandlingStrategy = UNUSED
              PduRDestPduDataProvision = PDUR_DIRECT
              PduRTransmissionConfirmation = false
              PduRDestPduRef = Debug_Frame5_oCAN00_481fb4c0_Tx
              PduRDestPduPduRBswModulesRef = CanIf
          VehicleControl_oCAN00_8e397222_Rx
            VehicleControl_oCAN00_8e397222_Rx_7cc0fb52_Rx (PduRDestPdu):
              PduRDestPduHandleId = 2
              PduRDestPduDirection = RECEIVE
              PduRDestPduRoutingType = API_FORWARDING
              PduRDestPduDataProcessing = IMMEDIATE
              PduRPduLengthHandlingStrategy = UNUSED
              PduRTransmissionConfirmation = false
              PduRDestPduRef = VehicleControl_oCAN00_cbe9282b_Rx
              PduRDestPduPduRBswModulesRef = Com
            PduRSrcPdu_7cc0fb52 (PduRSrcPdu): PduRSourcePduHandleId=2, PduRSrcPduDirection=RECEIVE, PduRSrcPduRef=VehicleControl_oCAN00_8e397222_Rx, PduRSrcPduPduRBswModulesRef=CanIf
          Debug_Frame4_oCAN00_9171addf_Tx
            Debug_Frame4_oCAN00_d36c5e14_Tx (PduRDestPdu):
              PduRDestPduHandleId = 8
              PduRDestPduDirection = TRANSMIT
              PduRDestPduRoutingType = API_FORWARDING
              PduRDestPduDataProcessing = IMMEDIATE
              PduRPduLengthHandlingStrategy = UNUSED
              PduRDestPduDataProvision = PDUR_DIRECT
              PduRTransmissionConfirmation = false
              PduRDestPduRef = Debug_Frame4_oCAN00_d36c5e14_Tx
              PduRDestPduPduRBswModulesRef = CanIf
            PduRSrcPdu_bc9a8971 (PduRSrcPdu): PduRSourcePduHandleId=8, PduRSrcPduDirection=TRANSMIT, PduRSrcPduRef=Debug_Frame4_oCAN00_9171addf_Tx, PduRSrcPduPduRBswModulesRef=Com
          ABS_oCAN00_97526119_Rx
            PduRSrcPdu_6c2fc7d0 (PduRSrcPdu): PduRSourcePduHandleId=0, PduRSrcPduDirection=RECEIVE, PduRSrcPduRef=ABS_oCAN00_97526119_Rx, PduRSrcPduPduRBswModulesRef=CanIf
            ABS_oCAN00_97526119_Rx_6c2fc7d0_Rx (PduRDestPdu):
              PduRDestPduHandleId = 0
              PduRDestPduDirection = RECEIVE
              PduRDestPduRoutingType = API_FORWARDING
              PduRDestPduDataProcessing = IMMEDIATE
              PduRPduLengthHandlingStrategy = UNUSED
              PduRDestPduRef = ABS_oCAN00_29f7b4f6_Rx
              PduRDestPduPduRBswModulesRef = Com
    CanIf (PduRBswModules):
      PduRCancelReceive = false
      PduRCancelTransmit = false
      PduRChangeParameterRequestApi = false
      PduRCommunicationInterface = true
      PduRLowerModule = true
      PduRTransportProtocol = false
      PduRTriggertransmit = false
      PduRTxConfirmation = false
      PduRUpperModule = false
      PduRUseTag = false
      PduRBswModuleRef = CanIf
    Com (PduRBswModules):
      PduRCancelReceive = false
      PduRCancelTransmit = false
      PduRChangeParameterRequestApi = false
      PduRCommunicationInterface = true
      PduRLowerModule = false
      PduRTransportProtocol = false
      PduRTriggertransmit = false
      PduRTxConfirmation = false
      PduRUpperModule = true
      PduRUseTag = false
      PduRBswModuleRef = Com
