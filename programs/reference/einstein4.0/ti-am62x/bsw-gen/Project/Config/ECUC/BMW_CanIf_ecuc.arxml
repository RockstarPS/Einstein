AUTOSAR XML (schema 4-2-1)
package /ActiveEcuC
  module config CanIf: implementation-config-variant=VARIANT-PRE-COMPILE, module-description=CanIf_Impl
    CanIfCtrlDrvCfg_7d254554 (CanIfCtrlDrvCfg): CanIfCtrlDrvTxCancellation=false, CanIfCtrlDrvInitHohConfigRef=CanIfInitHohCfg, CanIfCtrlDrvNameRef=CanGeneral
      CT_CAN00_783a5f42 (CanIfCtrlCfg): CanIfCtrlId=0, CanIfCtrlWakeupSupport=false, CanIfCtrlJ1939DynAddrSupport=DISABLED, CanIfCtrlCanCtrlRef=CT_CAN00_783a5f42
    CanIfDispatchCfg:
      CanIfDispatchUserCtrlBusOffName = CanSM_ControllerBusOff
      CanIfDispatchUserCtrlBusOffUL = CAN_SM
      CanIfDispatchUserCtrlModeIndicationName = CanSM_ControllerModeIndication
      CanIfDispatchUserCtrlModeIndicationUL = CAN_SM
    CanIfInitCfg
      VehicleControl_oCAN00_62cfea39_Rx (CanIfRxPduCfg):
        CanIfRxPduCanId = 256
        CanIfRxPduCanIdType = STANDARD_CAN
        CanIfRxPduDlc = 8
        CanIfRxPduUserRxIndicationName = PduR_CanIfRxIndication
        CanIfRxPduUserRxIndicationUL = PDUR
        CanIfRxPduId = 0
        CanIfRxPduReadData = false
        CanIfRxPduReadNotifyStatus = false
        CanIfRxPduDlcCheck = true
        CanIfRxPduHrhIdRef = CN_CAN00_7d903542_Rx
        CanIfRxPduRef = VehicleControl_oCAN00_8e397222_Rx
      NM_CoOrd_NMPDU_oCAN00_3dfd6c1f_Rx (CanIfRxPduCfg):
        CanIfRxPduCanId = 1280
        CanIfRxPduCanIdType = STANDARD_CAN
        CanIfRxPduDlc = 8
        CanIfRxPduUserRxIndicationName = CanNm_RxIndication
        CanIfRxPduUserRxIndicationUL = CAN_NM
        CanIfRxPduId = 0
        CanIfRxPduReadData = false
        CanIfRxPduReadNotifyStatus = false
        CanIfRxPduDlcCheck = true
        CanIfRxPduHrhIdRef = CN_CAN00_7d903542_Rx
        CanIfRxPduRef = NM_CoOrd_NMPDU_oCAN00_1fc35b6d_Rx
      Debug_Frame3_oCAN00_1a7cd346_Tx (CanIfTxPduCfg):
        CanIfTxPduCanId = 1362
        CanIfTxPduCanIdType = STANDARD_CAN
        CanIfTxPduDlc = 8
        CanIfTxPduUserTxConfirmationName = NULL_PTR
        CanIfTxPduUserTxConfirmationUL = NONE
        CanIfTxPduId = 0
        CanIfTxPduReadNotifyStatus = false
        CanIfTxPduType = STATIC
        CanIfTxPduBufferRef = CHNL_0fb271d2
        CanIfTxPduRef = Debug_Frame3_oCAN00_a5d5c6ba_Tx
      Diag_Resp_USDT_oCAN00_af8473d1_Tx (CanIfTxPduCfg):
        CanIfTxPduCanId = 1800
        CanIfTxPduCanIdType = STANDARD_CAN
        CanIfTxPduDlc = 8
        CanIfTxPduUserTxConfirmationName = NULL_PTR
        CanIfTxPduUserTxConfirmationUL = NONE
        CanIfTxPduId = 0
        CanIfTxPduReadNotifyStatus = false
        CanIfTxPduType = STATIC
        CanIfTxPduBufferRef = CHNL_0fb271d2
        CanIfTxPduRef = Diag_Resp_USDT_oCAN00_14b29fad_Tx
      Illum_control_oCAN00_7cebd788_Rx (CanIfRxPduCfg):
        CanIfRxPduCanId = 257
        CanIfRxPduCanIdType = STANDARD_CAN
        CanIfRxPduDlc = 3
        CanIfRxPduUserRxIndicationName = PduR_CanIfRxIndication
        CanIfRxPduUserRxIndicationUL = PDUR
        CanIfRxPduId = 0
        CanIfRxPduReadData = false
        CanIfRxPduReadNotifyStatus = false
        CanIfRxPduDlcCheck = true
        CanIfRxPduHrhIdRef = CN_CAN00_7d903542_Rx
        CanIfRxPduRef = Illum_control_oCAN00_8f78885e_Rx
      9 x CanIfTxPduCfg, all with CanIfTxPduCanIdType=STANDARD_CAN, CanIfTxPduId=0, CanIfTxPduReadNotifyStatus=false, CanIfTxPduType=STATIC, CanIfTxPduBufferRef=CHNL_0fb271d2:
        IC_NMPDU_oCAN00_e64e5991_Tx: CanIfTxPduCanId=1281, CanIfTxPduDlc=8, CanIfTxPduUserTxConfirmationName=CanNm_TxConfirmation, CanIfTxPduUserTxConfirmationUL=CAN_NM, CanIfTxPduRef=IC_NMPDU_oCAN00_57ad3fa9_Tx
        Debug_Frame2_oCAN00_4753dbb2_Tx: CanIfTxPduCanId=1361, CanIfTxPduDlc=8, CanIfTxPduUserTxConfirmationName=NULL_PTR, CanIfTxPduUserTxConfirmationUL=NONE, CanIfTxPduRef=Debug_Frame2_oCAN00_3ea62c6e_Tx
        Debug_Frame4_oCAN00_52c0efcb_Tx: CanIfTxPduCanId=1363, CanIfTxPduDlc=8, CanIfTxPduUserTxConfirmationName=NULL_PTR, CanIfTxPduUserTxConfirmationUL=NONE, CanIfTxPduRef=Debug_Frame4_oCAN00_d36c5e14_Tx
        Cluster_Secure_Tx_oCAN00_022000d7_Tx: CanIfTxPduCanId=768, CanIfTxPduDlc=8, CanIfTxPduUserTxConfirmationName=NULL_PTR, CanIfTxPduUserTxConfirmationUL=NONE, CanIfTxPduRef=Cluster_Secure_Tx_oCAN00_fbf04cbe_Tx
        Cluster_Tx_Normal_COM_LS_oCAN00_b2683444_Tx: CanIfTxPduCanId=514, CanIfTxPduDlc=4, CanIfTxPduUserTxConfirmationName=NULL_PTR, CanIfTxPduUserTxConfirmationUL=NONE, CanIfTxPduRef=Cluster_Tx_Normal_COM_LS_oCAN00_1e634103_Tx
        Debug_Frame5_oCAN00_0fefe73f_Tx: CanIfTxPduCanId=1364, CanIfTxPduDlc=8, CanIfTxPduUserTxConfirmationName=NULL_PTR, CanIfTxPduUserTxConfirmationUL=NONE, CanIfTxPduRef=Debug_Frame5_oCAN00_481fb4c0_Tx
        Diag_Resp_UUDT_oCAN00_26ad65ab_Tx: CanIfTxPduCanId=1544, CanIfTxPduDlc=8, CanIfTxPduUserTxConfirmationName=NULL_PTR, CanIfTxPduUserTxConfirmationUL=NONE, CanIfTxPduRef=Diag_Resp_UUDT_oCAN00_7f69f30b_Tx
        Cluster_Tx_Reduced_Com_oCAN00_b8852611_Tx: CanIfTxPduCanId=528, CanIfTxPduDlc=1, CanIfTxPduUserTxConfirmationName=NULL_PTR, CanIfTxPduUserTxConfirmationUL=NONE, CanIfTxPduRef=Cluster_Tx_Reduced_Com_oCAN00_4e2ce421_Tx
        Debug_Frame1_oCAN00_a022c2ae_Tx: CanIfTxPduCanId=1360, CanIfTxPduDlc=8, CanIfTxPduUserTxConfirmationName=NULL_PTR, CanIfTxPduUserTxConfirmationUL=NONE, CanIfTxPduRef=Debug_Frame1_oCAN00_48431553_Tx
      CHNL_0fb271d2 (CanIfBufferCfg):
        CanIfBufferSize = 13
        CanIfTxBufferHandlingType = PRIO_BY_CANID
        CanIfTxBufferMappedTxPdus = 13
        CanIfTxBufferMaxPduLength = 8
        CanIfBufferHthRef = CN_CAN00_bb949cc2_Tx
      Cluster_Tx_Normal_COM_MS_oCAN00_b3d9d761_Tx (CanIfTxPduCfg):
        CanIfTxPduCanId = 513
        CanIfTxPduCanIdType = STANDARD_CAN
        CanIfTxPduDlc = 2
        CanIfTxPduUserTxConfirmationName = NULL_PTR
        CanIfTxPduUserTxConfirmationUL = NONE
        CanIfTxPduId = 0
        CanIfTxPduReadNotifyStatus = false
        CanIfTxPduType = STATIC
        CanIfTxPduBufferRef = CHNL_0fb271d2
        CanIfTxPduRef = Cluster_Tx_Normal_COM_MS_oCAN00_9f462424_Tx
      CanIfInitHohCfg: CanIfInitRefCfgSet=CanConfigSet
        CN_CAN00_7d903542_Rx (CanIfHrhCfg): CanIfHrhSoftwareFilter=true, CanIfHrhCanCtrlIdRef=CT_CAN00_783a5f42, CanIfHrhIdSymRef=CN_CAN00_7d903542_Rx
        CN_CAN00_bb949cc2_Tx (CanIfHthCfg): CanIfHthCanCtrlIdRef=CT_CAN00_783a5f42, CanIfHthIdSymRef=CN_CAN00_bb949cc2_Tx
      Cluster_Tx_Normal_COM_HS_oCAN00_b4afb8d0_Tx (CanIfTxPduCfg):
        CanIfTxPduCanId = 512
        CanIfTxPduCanIdType = STANDARD_CAN
        CanIfTxPduDlc = 3
        CanIfTxPduUserTxConfirmationName = NULL_PTR
        CanIfTxPduUserTxConfirmationUL = NONE
        CanIfTxPduId = 0
        CanIfTxPduReadNotifyStatus = false
        CanIfTxPduType = STATIC
        CanIfTxPduBufferRef = CHNL_0fb271d2
        CanIfTxPduRef = Cluster_Tx_Normal_COM_HS_oCAN00_7765df5c_Tx
      ABS_oCAN00_57574eb9_Rx (CanIfRxPduCfg):
        CanIfRxPduCanId = 258
        CanIfRxPduCanIdType = STANDARD_CAN
        CanIfRxPduDlc = 7
        CanIfRxPduUserRxIndicationName = PduR_CanIfRxIndication
        CanIfRxPduUserRxIndicationUL = PDUR
        CanIfRxPduId = 0
        CanIfRxPduReadData = false
        CanIfRxPduReadNotifyStatus = false
        CanIfRxPduDlcCheck = true
        CanIfRxPduHrhIdRef = CN_CAN00_7d903542_Rx
        CanIfRxPduRef = ABS_oCAN00_97526119_Rx
    CanIfPrivateCfg:
      CanIfPrivateSoftwareFilterType = LINEAR
      CanIfPrivateDlcCheck = true
      CanIfSupportTTCAN = false
      CanIfTransceiverMapping = false
      CanIfTransceiverHandling = false
      CanIfSupportExtendedIds = false
      CanIfSupportNmOsek = false
      CanIfTxBufferType = BYTE_QUEUE
      CanIfOptimizeOneController = true
      CanIfWakeupSupport = false
      CanIfStaticFdTxBufferSupport = false
      CanIfRxSearchConsiderMsgType = false
      CanIfMultipleBasicCANTxObjects = false
      CanIfTxBufferFifoSupport = false
      CanIfSetPduReceptionModeSupport = false
      CanIfDataChecksumRxSupport = false
      CanIfDataChecksumTxSupport = false
    CanIfPublicCfg:
      CanIfPublicPnSupport = false
      CanIfPublicCancelTransmitSupport = false
      CanIfPublicDevErrorDetect = true
      CanIfPublicHandleTypeEnum = UINT8
      CanIfPublicMultipleDrvSupport = false
      CanIfPublicNumberOfCanHwUnits = 1
      CanIfPublicReadRxPduDataApi = false
      CanIfPublicReadRxPduNotifyStatusApi = false
      CanIfPublicReadTxPduNotifyStatusApi = false
      CanIfPublicSetDynamicTxIdApi = false
      CanIfPublicTxBuffering = true
      CanIfPublicTxConfirmPollingSupport = false
      CanIfPublicVersionInfoApi = false
      CanIfPublicWakeupCheckValidSupport = false
      CanIfPnWakeupTxPduFilterSupport = false
      CanIfPnTrcvHandlingSupport = false
      CanIfJ1939DynAddrSupport = DISABLED
      CanIfSafeBswChecks = false
      CanIfSetBaudrateApi = false
