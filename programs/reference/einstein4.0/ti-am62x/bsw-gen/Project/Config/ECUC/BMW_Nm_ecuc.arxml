AUTOSAR XML (schema 4-2-1)
package /ActiveEcuC
  module config Nm: implementation-config-variant=VARIANT-PRE-COMPILE, module-description=Nm_Impl
    NmGlobalConfig
      NmGlobalFeatures:
        NmCarWakeUpRxEnabled = false
        NmUserDataEnabled = true
        NmComUserDataSupport = false
        NmBusSynchronizationEnabled = false
        NmComControlEnabled = false
        NmCoordinatorSupportEnabled = false
        NmNodeDetectionEnabled = false
        NmNodeIdEnabled = false
        NmPduRxIndicationEnabled = false
        NmRemoteSleepIndEnabled = true
        NmRepeatMsgIndEnabled = false
        NmStateChangeIndEnabled = true
        NmMacroLayerEnabled = false
        NmCoordinatorSyncSupport = false
        NmRuntimeMeasurementSupport = false
        NmCoordinatorRequestChannelsInBusSleep = false
        NmCoordinatorPassiveStartUpForwarding = false
      NmGeneration:
        NmOutOfBoundsWriteSanitizer = false
        NmOutOfBoundsReadSanitizer = false
        NmShortSymbols = false
        NmInterfacesForDeactivatedData = false
        NmReferringKeysInComments = false
      NmGlobalProperties: NmDevErrorDetect=true, NmVersionInfoApi=false, NmSafeBswChecks=false
      NmGlobalConstants
    NmChannelConfig:
      NmPassiveModeEnabled = false
      NmShutdownDelayTimer = 0
      NmStateReportEnabled = false
      NmChannelSleepMaster = false
      NmChannelId = 0
      NmSynchronizingNetwork = false
      NmComMChannelRef = (unset)
      NmBusType
