AUTOSAR XML (schema 4-2-1)
package /ActiveEcuC
  module config CanSM: implementation-config-variant=VARIANT-PRE-COMPILE, module-description=CanSM_Impl
    CanSMConfiguration: CanSMModeRequestRepetitionMax=10, CanSMModeRequestRepetitionTime=0.1
      CHNL_0fb271d2 (CanSMManagerNetwork):
        CanSMBorCounterL1ToL2 = 11
        CanSMBorTimeL1 = 0.04
        CanSMBorTimeL2 = 1
        CanSMBorTimeTxEnsured = 1
        CanSMBorTxConfirmationPolling = false
        CanSMComMNetworkHandleRef = CN_CAN00_bb949cc2
        CT_CAN00_72e96f1e (CanSMController): CanSMControllerId=CT_CAN00_783a5f42
    CanSMGeneral: CanSMDevErrorDetect=true, CanSMMainFunctionTimePeriod=0.01, CanSMVersionInfoApi=false, CanSMBorCheckLevel=false, CanSMSetBaudrateApi=false
      CanSMGeneration: CanSMOutOfBoundsWriteSanitizer=false, CanSMOutOfBoundsReadSanitizer=false
