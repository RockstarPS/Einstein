AUTOSAR XML (schema 4-2-1)
package /ActiveEcuC
  module config Com: implementation-config-variant=VARIANT-PRE-COMPILE, module-description=Com_Impl
    ComGeneration:
      ComOutOfBoundsWriteProtectionStrategy = NONE
      ComOutOfBoundsWriteSanitizer = false
      ComOutOfBoundsReadSanitizer = false
      ComReduceConstantData2Define = false
      ComBoolDataInArrayOfStructStrategy = BOOLEAN
      ComDeduplicateIndirectedData = true
      ComDataDeduplicationStrategy = WITH_CAST
      ComReduceBoolDataByNegationThreshold = 2
      ComReduceBoolDataByNumericalComparisonThreshold = 2
      ComReduceBoolDataByNumericalRelationThreshold = 2
      ComReduceBoolDataByNumericalOperandStrategy = WITH_ANY_VALUE
      ComReduceNumericalDataByOffsetThreshold = 2
      ComReduceNumericalDataByArraySubtractionThreshold = 2
      ComReduceDataByStreaming = false
      ComShortSymbols = false
      ComInterfacesForDeactivatedData = false
      ComReferringKeysInComments = false
    ComOptimization:
      ComTxCyclicProcessingISRLockThreshold = 1
      ComTxDeadlineMonitoringISRLockThreshold = 1
      ComTxProcessingISRLockThreshold = 1
      ComRxDeadlineMonitoringISRLockThreshold = 1
      ComRxDeferredProcessingISRLockThreshold = 1
      ComGatewayProcessingISRLockThreshold = 1
      ComGatewayDescriptionProcessingISRLockThreshold = 1
      ComIPduGroupISRLockThreshold = 1
    ComConfig: ComConfigurationId=0, ComRxDeferredNotificationCacheSize=0, ComRxImmediateNotificationCacheSize=0
      4 x ComSignal, all with ComBitSize=8, ComSignalEndianness=LITTLE_ENDIAN, ComSignalInitValue=0, ComSignalType=UINT8, ComTransferProperty=PENDING, ComSignalAccess=ACCESS_UNCLEAR:
        Debug1_Byte1_oDebug_Frame1_oCAN00_6d166c2e_Tx: ComBitPosition=8, ComHandleId=5, ComSystemTemplateSystemSignalRef=Debug1_Byte1
        Debug2_Byte1_oDebug_Frame2_oCAN00_e1476cea_Tx: ComBitPosition=8, ComHandleId=13, ComSystemTemplateSystemSignalRef=Debug2_Byte1
        UserData1_IC_oIC_NMPDU_oCAN00_7de7a39d_Tx: ComBitPosition=24, ComHandleId=55, ComSystemTemplateSystemSignalRef=UserData1_IC
        UserData4_IC_oIC_NMPDU_oCAN00_f0c424b8_Tx: ComBitPosition=48, ComHandleId=58, ComSystemTemplateSystemSignalRef=UserData4_IC
      IC_oCAN00_Rx_68aa05a4 (ComIPduGroup): ComIPduGroupHandleId=0
      Debug3_Byte1_oDebug_Frame3_oCAN00_2c589169_Tx (ComSignal):
        ComBitPosition = 8
        ComBitSize = 8
        ComSignalEndianness = LITTLE_ENDIAN
        ComSignalInitValue = 0
        ComSignalType = UINT8
        ComTransferProperty = PENDING
        ComSignalAccess = ACCESS_UNCLEAR
        ComHandleId = 21
        ComSystemTemplateSystemSignalRef = Debug3_Byte1
      Debug_Frame2_oCAN00_571ea458_Tx (ComIPdu):
        ComIPduDirection = SEND
        ComIPduType = NORMAL
        ComIPduHandleId = 6
        ComIPduSignalProcessing = DEFERRED
        ComIPduCancellationSupport = false
        ComIPduGroupRef = IC_oCAN00_Tx_3ef0a222
        ComIPduSignalRef = Debug2_Byte0_oDebug_Frame2_oCAN00_f66f082a_Tx
        ComIPduSignalRef = Debug2_Byte1_oDebug_Frame2_oCAN00_e1476cea_Tx
        ComIPduSignalRef = Debug2_Byte2_oDebug_Frame2_oCAN00_d83fc1aa_Tx
        ComIPduSignalRef = Debug2_Byte3_oDebug_Frame2_oCAN00_cf17a56a_Tx
        ComIPduSignalRef = Debug2_Byte4_oDebug_Frame2_oCAN00_aace9b2a_Tx
        ComIPduSignalRef = Debug2_Byte5_oDebug_Frame2_oCAN00_bde6ffea_Tx
        ComIPduSignalRef = Debug2_Byte6_oDebug_Frame2_oCAN00_849e52aa_Tx
        ComIPduSignalRef = Debug2_Byte7_oDebug_Frame2_oCAN00_93b6366a_Tx
        ComPduIdRef = Debug_Frame2_oCAN00_571ea458_Tx
        ComTxIPdu: ComMinimumDelayTime=0, ComTxIPduUnusedAreasDefault=0
          ComTxModeTrue
            ComTxMode: ComTxModeMode=PERIODIC, ComTxModeTimeOffset=0, ComTxModeTimePeriod=0.1
          ComTxModeFalse
            ComTxMode: ComTxModeMode=PERIODIC, ComTxModeTimeOffset=0, ComTxModeTimePeriod=0.1
      4 x ComSignal, all with ComBitSize=8, ComSignalInitValue=0, ComSignalType=UINT8, ComSignalAccess=ACCESS_UNCLEAR:
        Debug1_Byte7_oDebug_Frame1_oCAN00_1fe736ae_Tx: ComBitPosition=56, ComSignalEndianness=LITTLE_ENDIAN, ComTransferProperty=PENDING, ComHandleId=11, ComSystemTemplateSystemSignalRef=Debug1_Byte7
        Illumination_level_oIllum_control_oCAN00_f3b042f8_Rx: ComBitPosition=1, ComSignalEndianness=BIG_ENDIAN, ComHandleId=10, ComSystemTemplateSystemSignalRef=Illumination_level
        Warning_oVehicleControl_oCAN00_ee369686_Rx: ComBitPosition=63, ComSignalEndianness=BIG_ENDIAN, ComHandleId=15, ComSystemTemplateSystemSignalRef=Warning
        Debug5_Byte7_oDebug_Frame5_oCAN00_9d7acc20_Tx: ComBitPosition=56, ComSignalEndianness=LITTLE_ENDIAN, ComTransferProperty=PENDING, ComHandleId=43, ComSystemTemplateSystemSignalRef=Debug5_Byte7
      Debug_Frame3_oCAN00_9bb4a4c6_Tx (ComIPdu):
        ComIPduDirection = SEND
        ComIPduType = NORMAL
        ComIPduHandleId = 7
        ComIPduSignalProcessing = DEFERRED
        ComIPduCancellationSupport = false
        ComIPduGroupRef = IC_oCAN00_Tx_3ef0a222
        ComIPduSignalRef = Debug3_Byte0_oDebug_Frame3_oCAN00_3b70f5a9_Tx
        ComIPduSignalRef = Debug3_Byte1_oDebug_Frame3_oCAN00_2c589169_Tx
        ComIPduSignalRef = Debug3_Byte2_oDebug_Frame3_oCAN00_15203c29_Tx
        ComIPduSignalRef = Debug3_Byte3_oDebug_Frame3_oCAN00_020858e9_Tx
        ComIPduSignalRef = Debug3_Byte4_oDebug_Frame3_oCAN00_67d166a9_Tx
        ComIPduSignalRef = Debug3_Byte5_oDebug_Frame3_oCAN00_70f90269_Tx
        ComIPduSignalRef = Debug3_Byte6_oDebug_Frame3_oCAN00_4981af29_Tx
        ComIPduSignalRef = Debug3_Byte7_oDebug_Frame3_oCAN00_5ea9cbe9_Tx
        ComPduIdRef = Debug_Frame3_oCAN00_9bb4a4c6_Tx
        ComTxIPdu: ComMinimumDelayTime=0, ComTxIPduUnusedAreasDefault=0
          ComTxModeTrue
            ComTxMode: ComTxModeMode=PERIODIC, ComTxModeTimeOffset=0, ComTxModeTimePeriod=0.1
          ComTxModeFalse
            ComTxMode: ComTxModeMode=PERIODIC, ComTxModeTimeOffset=0, ComTxModeTimePeriod=0.1
      GearRecommendation_oVehicleControl_oCAN00_f980c505_Rx (ComSignal):
        ComBitPosition = 50
        ComBitSize = 3
        ComSignalEndianness = BIG_ENDIAN
        ComSignalInitValue = 0
        ComSignalType = UINT8
        ComSignalAccess = ACCESS_UNCLEAR
        ComHandleId = 7
        ComSystemTemplateSystemSignalRef = GearRecommendation
      VehicleControl_oCAN00_cbe9282b_Rx (ComIPdu):
        ComIPduDirection = RECEIVE
        ComIPduType = NORMAL
        ComIPduHandleId = 2
        ComIPduSignalProcessing = DEFERRED
        ComIPduCancellationSupport = false
        ComIPduGroupRef = IC_oCAN00_Rx_68aa05a4
        ComIPduSignalRef = EngineSpeed_oVehicleControl_oCAN00_7eb3f445_Rx
        ComIPduSignalRef = GearMode_oVehicleControl_oCAN00_c0b273e8_Rx
        ComIPduSignalRef = GearRecommendation_oVehicleControl_oCAN00_f980c505_Rx
        ComIPduSignalRef = GearStatus_oVehicleControl_oCAN00_db10bc53_Rx
        ComIPduSignalRef = Gear_oVehicleControl_oCAN00_45630abd_Rx
        ComIPduSignalRef = PowerMode_oVehicleControl_oCAN00_4caafc19_Rx
        ComIPduSignalRef = TransportMode_oVehicleControl_oCAN00_b498f884_Rx
        ComIPduSignalRef = Turn_Indicator_Control_oVehicleControl_oCAN00_b06608e9_Rx
        ComIPduSignalRef = Warning_oVehicleControl_oCAN00_ee369686_Rx
        ComPduIdRef = VehicleControl_oCAN00_cbe9282b_Rx
      Debug_Frame1_oCAN00_d991a3bb_Tx (ComIPdu):
        ComIPduDirection = SEND
        ComIPduType = NORMAL
        ComIPduHandleId = 5
        ComIPduSignalProcessing = DEFERRED
        ComIPduCancellationSupport = false
        ComIPduGroupRef = IC_oCAN00_Tx_3ef0a222
        ComIPduSignalRef = Debug1_Byte0_oDebug_Frame1_oCAN00_7a3e08ee_Tx
        ComIPduSignalRef = Debug1_Byte1_oDebug_Frame1_oCAN00_6d166c2e_Tx
        ComIPduSignalRef = Debug1_Byte2_oDebug_Frame1_oCAN00_546ec16e_Tx
        ComIPduSignalRef = Debug1_Byte3_oDebug_Frame1_oCAN00_4346a5ae_Tx
        ComIPduSignalRef = Debug1_Byte4_oDebug_Frame1_oCAN00_269f9bee_Tx
        ComIPduSignalRef = Debug1_Byte5_oDebug_Frame1_oCAN00_31b7ff2e_Tx
        ComIPduSignalRef = Debug1_Byte6_oDebug_Frame1_oCAN00_08cf526e_Tx
        ComIPduSignalRef = Debug1_Byte7_oDebug_Frame1_oCAN00_1fe736ae_Tx
        ComPduIdRef = Debug_Frame1_oCAN00_d991a3bb_Tx
        ComTxIPdu: ComMinimumDelayTime=0, ComTxIPduUnusedAreasDefault=0
          ComTxModeTrue
            ComTxMode: ComTxModeMode=PERIODIC, ComTxModeTimeOffset=0, ComTxModeTimePeriod=0.01
          ComTxModeFalse
            ComTxMode: ComTxModeMode=PERIODIC, ComTxModeTimeOffset=0, ComTxModeTimePeriod=0.01
      5 x ComSignal, all with ComBitSize=8, ComSignalEndianness=LITTLE_ENDIAN, ComSignalInitValue=0, ComSignalType=UINT8, ComTransferProperty=PENDING, ComSignalAccess=ACCESS_UNCLEAR:
        Debug3_Byte5_oDebug_Frame3_oCAN00_70f90269_Tx: ComBitPosition=40, ComHandleId=25, ComSystemTemplateSystemSignalRef=Debug3_Byte5
        Debug4_Byte0_oDebug_Frame4_oCAN00_35bc0fe3_Tx: ComBitPosition=0, ComHandleId=28, ComSystemTemplateSystemSignalRef=Debug4_Byte0
        Debug3_Byte7_oDebug_Frame3_oCAN00_5ea9cbe9_Tx: ComBitPosition=56, ComHandleId=27, ComSystemTemplateSystemSignalRef=Debug3_Byte7
        SecureTxByte0_oCluster_Secure_Tx_oCAN00_659a0722_Tx: ComBitPosition=0, ComHandleId=51, ComSystemTemplateSystemSignalRef=SecureTxByte0
        UserData2_IC_oIC_NMPDU_oCAN00_06f9217e_Tx: ComBitPosition=32, ComHandleId=56, ComSystemTemplateSystemSignalRef=UserData2_IC
      Cluster_Tx_Reduced_Com_oCAN00_8ca7c169_Tx (ComIPdu):
        ComIPduDirection = SEND
        ComIPduType = NORMAL
        ComIPduHandleId = 4
        ComIPduSignalProcessing = DEFERRED
        ComIPduCancellationSupport = false
        ComIPduGroupRef = IC_oCAN00_Tx_3ef0a222
        ComIPduSignalRef = Illumination_PWM_oCluster_Tx_Reduced_Com_oCAN00_0a670875_Tx
        ComPduIdRef = Cluster_Tx_Reduced_Com_oCAN00_8ca7c169_Tx
        ComTxIPdu: ComMinimumDelayTime=0, ComTxIPduUnusedAreasDefault=0
          ComTxModeTrue
            ComTxMode: ComTxModeMode=PERIODIC, ComTxModeTimeOffset=0, ComTxModeTimePeriod=0.1
          ComTxModeFalse
            ComTxMode: ComTxModeMode=PERIODIC, ComTxModeTimeOffset=0, ComTxModeTimePeriod=0.1
      17 x ComSignal, all with ComSignalAccess=ACCESS_UNCLEAR:
        DayNightMode_oIllum_control_oCAN00_6d11bd91_Rx: ComBitPosition=7, ComBitSize=1, ComSignalEndianness=BIG_ENDIAN, ComSignalInitValue=0, ComSignalType=BOOLEAN, ComHandleId=4, ComSystemTemplateSystemSignalRef=DayNightMode
        CurrentStateIC_oIC_NMPDU_oCAN00_ffb15989_Tx: ComBitPosition=19, ComBitSize=1, ComSignalEndianness=LITTLE_ENDIAN, ComSignalInitValue=0, ComSignalType=BOOLEAN, ComTransferProperty=PENDING, ComHandleId=3, ComSystemTemplateSystemSignalRef=CurrentStateIC
        VehicleSpeedIC_oCluster_Tx_Normal_COM_MS_oCAN00_1b17fdcc_Tx: ComBitPosition=0, ComBitSize=16, ComSignalEndianness=LITTLE_ENDIAN, ComSignalInitValue=0, ComSignalType=UINT16, ComTransferProperty=PENDING, ComHandleId=60, ComSystemTemplateSystemSignalRef=VehicleSpeedIC
        Debug1_Byte3_oDebug_Frame1_oCAN00_4346a5ae_Tx: ComBitPosition=24, ComBitSize=8, ComSignalEndianness=LITTLE_ENDIAN, ComSignalInitValue=0, ComSignalType=UINT8, ComTransferProperty=PENDING, ComHandleId=7, ComSystemTemplateSystemSignalRef=Debug1_Byte3
        SecureTxByte2_oCluster_Secure_Tx_oCAN00_b88231a0_Tx: ComBitPosition=16, ComBitSize=8, ComSignalEndianness=LITTLE_ENDIAN, ComSignalInitValue=0, ComSignalType=UINT8, ComTransferProperty=PENDING, ComHandleId=53, ComSystemTemplateSystemSignalRef=SecureTxByte2
        Diag_Buffer_Tx_UUDT_oDiag_Resp_UUDT_oCAN00_0ee1ff7b_Tx: ComBitPosition=0, ComSignalEndianness=opaque, ComSignalInitValue=0 0 0 0 0 0 0 0, ComSignalLength=8, ComSignalType=UINT8_N, ComTransferProperty=PENDING, ComHandleId=45, ComSystemTemplateSystemSignalRef=Diag_Buffer_Tx_UUDT
        PowerMode_oVehicleControl_oCAN00_4caafc19_Rx: ComBitPosition=0, ComBitSize=4, ComSignalEndianness=LITTLE_ENDIAN, ComSignalInitValue=0, ComSignalType=UINT8, ComHandleId=11, ComSystemTemplateSystemSignalRef=PowerMode
        Debug4_Byte1_oDebug_Frame4_oCAN00_22946b23_Tx: ComBitPosition=8, ComBitSize=8, ComSignalEndianness=LITTLE_ENDIAN, ComSignalInitValue=0, ComSignalType=UINT8, ComTransferProperty=PENDING, ComHandleId=29, ComSystemTemplateSystemSignalRef=Debug4_Byte1
        Debug5_Byte3_oDebug_Frame5_oCAN00_c1db5f20_Tx: ComBitPosition=24, ComBitSize=8, ComSignalEndianness=LITTLE_ENDIAN, ComSignalInitValue=0, ComSignalType=UINT8, ComTransferProperty=PENDING, ComHandleId=39, ComSystemTemplateSystemSignalRef=Debug5_Byte3
        Ambient_Light_level_oIllum_control_oCAN00_888fcfad_Rx: ComBitPosition=23, ComBitSize=8, ComSignalEndianness=BIG_ENDIAN, ComSignalInitValue=0, ComSignalType=UINT8, ComHandleId=2, ComSystemTemplateSystemSignalRef=Ambient_Light_level
        SecureTxByte3_oCluster_Secure_Tx_oCAN00_d60e2ae1_Tx: ComBitPosition=24, ComBitSize=8, ComSignalEndianness=LITTLE_ENDIAN, ComSignalInitValue=0, ComSignalType=UINT8, ComTransferProperty=PENDING, ComHandleId=54, ComSystemTemplateSystemSignalRef=SecureTxByte3
        Debug2_Byte4_oDebug_Frame2_oCAN00_aace9b2a_Tx: ComBitPosition=32, ComBitSize=8, ComSignalEndianness=LITTLE_ENDIAN, ComSignalInitValue=0, ComSignalType=UINT8, ComTransferProperty=PENDING, ComHandleId=16, ComSystemTemplateSystemSignalRef=Debug2_Byte4
        Debug3_Byte2_oDebug_Frame3_oCAN00_15203c29_Tx: ComBitPosition=16, ComBitSize=8, ComSignalEndianness=LITTLE_ENDIAN, ComSignalInitValue=0, ComSignalType=UINT8, ComTransferProperty=PENDING, ComHandleId=22, ComSystemTemplateSystemSignalRef=Debug3_Byte2
        Debug4_Byte2_oDebug_Frame4_oCAN00_1becc663_Tx: ComBitPosition=16, ComBitSize=8, ComSignalEndianness=LITTLE_ENDIAN, ComSignalInitValue=0, ComSignalType=UINT8, ComTransferProperty=PENDING, ComHandleId=30, ComSystemTemplateSystemSignalRef=Debug4_Byte2
        Debug5_Byte2_oDebug_Frame5_oCAN00_d6f33be0_Tx: ComBitPosition=16, ComBitSize=8, ComSignalEndianness=LITTLE_ENDIAN, ComSignalInitValue=0, ComSignalType=UINT8, ComTransferProperty=PENDING, ComHandleId=38, ComSystemTemplateSystemSignalRef=Debug5_Byte2
        Debug1_Byte4_oDebug_Frame1_oCAN00_269f9bee_Tx: ComBitPosition=32, ComBitSize=8, ComSignalEndianness=LITTLE_ENDIAN, ComSignalInitValue=0, ComSignalType=UINT8, ComTransferProperty=PENDING, ComHandleId=8, ComSystemTemplateSystemSignalRef=Debug1_Byte4
        Debug3_Byte3_oDebug_Frame3_oCAN00_020858e9_Tx: ComBitPosition=24, ComBitSize=8, ComSignalEndianness=LITTLE_ENDIAN, ComSignalInitValue=0, ComSignalType=UINT8, ComTransferProperty=PENDING, ComHandleId=23, ComSystemTemplateSystemSignalRef=Debug3_Byte3
      IC_oCAN00_Tx_3ef0a222 (ComIPduGroup): ComIPduGroupHandleId=1
      Debug5_Byte4_oDebug_Frame5_oCAN00_a4026160_Tx (ComSignal):
        ComBitPosition = 32
        ComBitSize = 8
        ComSignalEndianness = LITTLE_ENDIAN
        ComSignalInitValue = 0
        ComSignalType = UINT8
        ComTransferProperty = PENDING
        ComSignalAccess = ACCESS_UNCLEAR
        ComHandleId = 40
        ComSystemTemplateSystemSignalRef = Debug5_Byte4
      Illum_control_oCAN00_e09f90e5_Rx (ComIPdu):
        ComIPduDirection = RECEIVE
        ComIPduType = NORMAL
        ComIPduHandleId = 1
        ComIPduSignalProcessing = DEFERRED
        ComIPduCancellationSupport = false
        ComIPduGroupRef = IC_oCAN00_Rx_68aa05a4
        ComIPduSignalRef = Ambient_Light_level_oIllum_control_oCAN00_888fcfad_Rx
        ComIPduSignalRef = DayNightMode_oIllum_control_oCAN00_6d11bd91_Rx
        ComIPduSignalRef = Illumination_level_oIllum_control_oCAN00_f3b042f8_Rx
        ComPduIdRef = Illum_control_oCAN00_e09f90e5_Rx
      6 x ComSignal, all with ComSignalEndianness=LITTLE_ENDIAN, ComSignalInitValue=0, ComTransferProperty=PENDING, ComSignalAccess=ACCESS_UNCLEAR:
        Debug2_Byte7_oDebug_Frame2_oCAN00_93b6366a_Tx: ComBitPosition=56, ComBitSize=8, ComSignalType=UINT8, ComHandleId=19, ComSystemTemplateSystemSignalRef=Debug2_Byte7
        Debug4_Byte6_oDebug_Frame4_oCAN00_474d5563_Tx: ComBitPosition=48, ComBitSize=8, ComSignalType=UINT8, ComHandleId=34, ComSystemTemplateSystemSignalRef=Debug4_Byte6
        Debug3_Byte0_oDebug_Frame3_oCAN00_3b70f5a9_Tx: ComBitPosition=0, ComBitSize=8, ComSignalType=UINT8, ComHandleId=20, ComSystemTemplateSystemSignalRef=Debug3_Byte0
        Odometer_oCluster_Tx_Normal_COM_LS_oCAN00_3e00d027_Tx: ComBitPosition=0, ComBitSize=32, ComSignalType=UINT32, ComHandleId=49, ComSystemTemplateSystemSignalRef=Odometer
        FV_Tx_oCluster_Secure_Tx_oCAN00_f077ac5c_Tx: ComBitPosition=60, ComBitSize=4, ComSignalType=UINT8, ComHandleId=46, ComSystemTemplateSystemSignalRef=FV_Tx
        Illumination_PWM_oCluster_Tx_Reduced_Com_oCAN00_0a670875_Tx: ComBitPosition=0, ComBitSize=8, ComSignalType=UINT8, ComHandleId=47, ComSystemTemplateSystemSignalRef=Illumination_PWM
      4 x ComIPdu, all with ComIPduDirection=SEND, ComIPduType=NORMAL, ComIPduSignalProcessing=DEFERRED, ComIPduCancellationSupport=false, ComIPduGroupRef=IC_oCAN00_Tx_3ef0a222:
        Cluster_Secure_Tx_oCAN00_7e3ab6a5_Tx: ComIPduHandleId=0, ComIPduSignalRef=FV_Tx_oCluster_Secure_Tx_oCAN00_f077ac5c_Tx, ComIPduSignalRef=MAC_Tx_oCluster_Secure_Tx_oCAN00_b83a6da7_Tx, ComIPduSignalRef=SecureTxByte0_oCluster_Secure_Tx_oCAN00_659a0722_Tx, ComIPduSignalRef=SecureTxByte1_oCluster_Secure_Tx_oCAN00_0b161c63_Tx, ComIPduSignalRef=SecureTxByte2_oCluster_Secure_Tx_oCAN00_b88231a0_Tx, ComIPduSignalRef=SecureTxByte3_oCluster_Secure_Tx_oCAN00_d60e2ae1_Tx, ComPduIdRef=Cluster_Secure_Tx_oCAN00_7e3ab6a5_Tx
          ComTxIPdu: ComMinimumDelayTime=0, ComTxIPduUnusedAreasDefault=0
            ComTxModeTrue
              ComTxMode: ComTxModeMode=PERIODIC, ComTxModeTimeOffset=0, ComTxModeTimePeriod=0
            ComTxModeFalse
              ComTxMode: ComTxModeMode=PERIODIC, ComTxModeTimeOffset=0, ComTxModeTimePeriod=0
        Cluster_Tx_Normal_COM_MS_oCAN00_4bec82c6_Tx: ComIPduHandleId=3, ComIPduSignalRef=VehicleSpeedIC_oCluster_Tx_Normal_COM_MS_oCAN00_1b17fdcc_Tx, ComPduIdRef=Cluster_Tx_Normal_COM_MS_oCAN00_4bec82c6_Tx
          ComTxIPdu: ComMinimumDelayTime=0, ComTxIPduUnusedAreasDefault=0
            ComTxModeTrue
              ComTxMode: ComTxModeMode=PERIODIC, ComTxModeTimeOffset=0, ComTxModeTimePeriod=0.1
            ComTxModeFalse
              ComTxMode: ComTxModeMode=PERIODIC, ComTxModeTimeOffset=0, ComTxModeTimePeriod=0.1
        Debug_Frame4_oCAN00_9171addf_Tx: ComIPduHandleId=8, ComIPduSignalRef=Debug4_Byte0_oDebug_Frame4_oCAN00_35bc0fe3_Tx, ComIPduSignalRef=Debug4_Byte1_oDebug_Frame4_oCAN00_22946b23_Tx, ComIPduSignalRef=Debug4_Byte2_oDebug_Frame4_oCAN00_1becc663_Tx, ComIPduSignalRef=Debug4_Byte3_oDebug_Frame4_oCAN00_0cc4a2a3_Tx, ComIPduSignalRef=Debug4_Byte4_oDebug_Frame4_oCAN00_691d9ce3_Tx, ComIPduSignalRef=Debug4_Byte5_oDebug_Frame4_oCAN00_7e35f823_Tx, ComIPduSignalRef=Debug4_Byte6_oDebug_Frame4_oCAN00_474d5563_Tx, ComIPduSignalRef=Debug4_Byte7_oDebug_Frame4_oCAN00_506531a3_Tx, ComPduIdRef=Debug_Frame4_oCAN00_9171addf_Tx
          ComTxIPdu: ComMinimumDelayTime=0, ComTxIPduUnusedAreasDefault=0
            ComTxModeTrue
              ComTxMode: ComTxModeMode=PERIODIC, ComTxModeTimeOffset=0, ComTxModeTimePeriod=0.1
            ComTxModeFalse
              ComTxMode: ComTxModeMode=PERIODIC, ComTxModeTimeOffset=0, ComTxModeTimePeriod=0.1
        Debug_Frame5_oCAN00_5ddbad41_Tx: ComIPduHandleId=9, ComIPduSignalRef=Debug5_Byte0_oDebug_Frame5_oCAN00_f8a3f260_Tx, ComIPduSignalRef=Debug5_Byte1_oDebug_Frame5_oCAN00_ef8b96a0_Tx, ComIPduSignalRef=Debug5_Byte2_oDebug_Frame5_oCAN00_d6f33be0_Tx, ComIPduSignalRef=Debug5_Byte3_oDebug_Frame5_oCAN00_c1db5f20_Tx, ComIPduSignalRef=Debug5_Byte4_oDebug_Frame5_oCAN00_a4026160_Tx, ComIPduSignalRef=Debug5_Byte5_oDebug_Frame5_oCAN00_b32a05a0_Tx, ComIPduSignalRef=Debug5_Byte6_oDebug_Frame5_oCAN00_8a52a8e0_Tx, ComIPduSignalRef=Debug5_Byte7_oDebug_Frame5_oCAN00_9d7acc20_Tx, ComPduIdRef=Debug_Frame5_oCAN00_5ddbad41_Tx
          ComTxIPdu: ComMinimumDelayTime=0, ComTxIPduUnusedAreasDefault=0
            ComTxModeTrue
              ComTxMode: ComTxModeMode=PERIODIC, ComTxModeTimeOffset=0, ComTxModeTimePeriod=0
            ComTxModeFalse
              ComTxMode: ComTxModeMode=PERIODIC, ComTxModeTimeOffset=0, ComTxModeTimePeriod=0
      10 x ComSignal, all with ComSignalAccess=ACCESS_UNCLEAR:
        Debug4_Byte7_oDebug_Frame4_oCAN00_506531a3_Tx: ComBitPosition=56, ComBitSize=8, ComSignalEndianness=LITTLE_ENDIAN, ComSignalInitValue=0, ComSignalType=UINT8, ComTransferProperty=PENDING, ComHandleId=35, ComSystemTemplateSystemSignalRef=Debug4_Byte7
        Debug2_Byte2_oDebug_Frame2_oCAN00_d83fc1aa_Tx: ComBitPosition=16, ComBitSize=8, ComSignalEndianness=LITTLE_ENDIAN, ComSignalInitValue=0, ComSignalType=UINT8, ComTransferProperty=PENDING, ComHandleId=14, ComSystemTemplateSystemSignalRef=Debug2_Byte2
        Diag_Buffer_Tx_USDT_oDiag_Resp_USDT_oCAN00_3c21528d_Tx: ComBitPosition=0, ComSignalEndianness=opaque, ComSignalInitValue=0 0 0 0 0 0 0 0, ComSignalLength=8, ComSignalType=UINT8_N, ComTransferProperty=PENDING, ComHandleId=44, ComSystemTemplateSystemSignalRef=Diag_Buffer_Tx_USDT
        GearStatus_oVehicleControl_oCAN00_db10bc53_Rx: ComBitPosition=15, ComBitSize=8, ComSignalEndianness=BIG_ENDIAN, ComSignalInitValue=0, ComSignalType=UINT8, ComHandleId=8, ComSystemTemplateSystemSignalRef=GearStatus
        SecureTxByte1_oCluster_Secure_Tx_oCAN00_0b161c63_Tx: ComBitPosition=8, ComBitSize=8, ComSignalEndianness=LITTLE_ENDIAN, ComSignalInitValue=0, ComSignalType=UINT8, ComTransferProperty=PENDING, ComHandleId=52, ComSystemTemplateSystemSignalRef=SecureTxByte1
        Debug2_Byte0_oDebug_Frame2_oCAN00_f66f082a_Tx: ComBitPosition=0, ComBitSize=8, ComSignalEndianness=LITTLE_ENDIAN, ComSignalInitValue=0, ComSignalType=UINT8, ComTransferProperty=PENDING, ComHandleId=12, ComSystemTemplateSystemSignalRef=Debug2_Byte0
        Debug3_Byte4_oDebug_Frame3_oCAN00_67d166a9_Tx: ComBitPosition=32, ComBitSize=8, ComSignalEndianness=LITTLE_ENDIAN, ComSignalInitValue=0, ComSignalType=UINT8, ComTransferProperty=PENDING, ComHandleId=24, ComSystemTemplateSystemSignalRef=Debug3_Byte4
        Debug3_Byte6_oDebug_Frame3_oCAN00_4981af29_Tx: ComBitPosition=48, ComBitSize=8, ComSignalEndianness=LITTLE_ENDIAN, ComSignalInitValue=0, ComSignalType=UINT8, ComTransferProperty=PENDING, ComHandleId=26, ComSystemTemplateSystemSignalRef=Debug3_Byte6
        Debug1_Byte5_oDebug_Frame1_oCAN00_31b7ff2e_Tx: ComBitPosition=40, ComBitSize=8, ComSignalEndianness=LITTLE_ENDIAN, ComSignalInitValue=0, ComSignalType=UINT8, ComTransferProperty=PENDING, ComHandleId=9, ComSystemTemplateSystemSignalRef=Debug1_Byte5
        Debug2_Byte5_oDebug_Frame2_oCAN00_bde6ffea_Tx: ComBitPosition=40, ComBitSize=8, ComSignalEndianness=LITTLE_ENDIAN, ComSignalInitValue=0, ComSignalType=UINT8, ComTransferProperty=PENDING, ComHandleId=17, ComSystemTemplateSystemSignalRef=Debug2_Byte5
      Diag_Resp_USDT_oCAN00_0bcdd8e4_Tx (ComIPdu):
        ComIPduDirection = SEND
        ComIPduType = NORMAL
        ComIPduHandleId = 10
        ComIPduSignalProcessing = DEFERRED
        ComIPduCancellationSupport = false
        ComIPduGroupRef = IC_oCAN00_Tx_3ef0a222
        ComIPduSignalRef = Diag_Buffer_Tx_USDT_oDiag_Resp_USDT_oCAN00_3c21528d_Tx
        ComPduIdRef = Diag_Resp_USDT_oCAN00_0bcdd8e4_Tx
        ComTxIPdu: ComMinimumDelayTime=0, ComTxIPduUnusedAreasDefault=0
          ComTxModeTrue
            ComTxMode: ComTxModeMode=PERIODIC, ComTxModeTimeOffset=0, ComTxModeTimePeriod=0
          ComTxModeFalse
            ComTxMode: ComTxModeMode=PERIODIC, ComTxModeTimeOffset=0, ComTxModeTimePeriod=0
      IC_NMPDU_oCAN00_7e631dbf_Tx (ComIPdu):
        ComIPduDirection = SEND
        ComIPduType = NORMAL
        ComIPduHandleId = 12
        ComIPduSignalProcessing = DEFERRED
        ComIPduCancellationSupport = false
        ComIPduSignalRef = CurrentStateIC_oIC_NMPDU_oCAN00_ffb15989_Tx
        ComIPduSignalRef = PreviousStateIC_oIC_NMPDU_oCAN00_54068aa2_Tx
        ComIPduSignalRef = UserData1_IC_oIC_NMPDU_oCAN00_7de7a39d_Tx
        ComIPduSignalRef = UserData2_IC_oIC_NMPDU_oCAN00_06f9217e_Tx
        ComIPduSignalRef = UserData3_IC_oIC_NMPDU_oCAN00_9923a2e0_Tx
        ComIPduSignalRef = UserData4_IC_oIC_NMPDU_oCAN00_f0c424b8_Tx
        ComIPduSignalRef = UserData5_IC_oIC_NMPDU_oCAN00_6f1ea726_Tx
        ComPduIdRef = IC_NMPDU_oCAN00_7e631dbf_Tx
        ComTxIPdu: ComTxIPduUnusedAreasDefault=0, ComMinimumDelayTime=0  # IC_NMPDU_oCAN00
          ComTxModeTrue
            ComTxMode: ComTxModeMode=NONE
          ComTxModeFalse
            ComTxMode: ComTxModeMode=NONE
      UserData3_IC_oIC_NMPDU_oCAN00_9923a2e0_Tx (ComSignal):
        ComBitPosition = 40
        ComBitSize = 8
        ComSignalEndianness = LITTLE_ENDIAN
        ComSignalInitValue = 0
        ComSignalType = UINT8
        ComTransferProperty = PENDING
        ComSignalAccess = ACCESS_UNCLEAR
        ComHandleId = 57
        ComSystemTemplateSystemSignalRef = UserData3_IC
      Cluster_Tx_Normal_COM_LS_oCAN00_5c979685_Tx (ComIPdu):
        ComIPduDirection = SEND
        ComIPduType = NORMAL
        ComIPduHandleId = 2
        ComIPduSignalProcessing = DEFERRED
        ComIPduCancellationSupport = false
        ComIPduGroupRef = IC_oCAN00_Tx_3ef0a222
        ComIPduSignalRef = Odometer_oCluster_Tx_Normal_COM_LS_oCAN00_3e00d027_Tx
        ComPduIdRef = Cluster_Tx_Normal_COM_LS_oCAN00_5c979685_Tx
        ComTxIPdu: ComMinimumDelayTime=0, ComTxIPduUnusedAreasDefault=0
          ComTxModeTrue
            ComTxMode: ComTxModeMode=PERIODIC, ComTxModeTimeOffset=0, ComTxModeTimePeriod=1
          ComTxModeFalse
            ComTxMode: ComTxModeMode=PERIODIC, ComTxModeTimeOffset=0, ComTxModeTimePeriod=1
      Debug5_Byte1_oDebug_Frame5_oCAN00_ef8b96a0_Tx (ComSignal):
        ComBitPosition = 8
        ComBitSize = 8
        ComSignalEndianness = LITTLE_ENDIAN
        ComSignalInitValue = 0
        ComSignalType = UINT8
        ComTransferProperty = PENDING
        ComSignalAccess = ACCESS_UNCLEAR
        ComHandleId = 37
        ComSystemTemplateSystemSignalRef = Debug5_Byte1
      PreviousStateIC_oIC_NMPDU_oCAN00_54068aa2_Tx (ComSignal):
        ComBitPosition = 16
        ComBitSize = 3
        ComSignalEndianness = LITTLE_ENDIAN
        ComSignalInitValue = 0
        ComSignalType = SINT8
        ComTransferProperty = PENDING
        ComSignalAccess = ACCESS_UNCLEAR
        ComHandleId = 50
        ComSystemTemplateSystemSignalRef = PreviousStateIC
      Diag_Resp_UUDT_oCAN00_06d3a8a3_Tx (ComIPdu):
        ComIPduDirection = SEND
        ComIPduType = NORMAL
        ComIPduHandleId = 11
        ComIPduSignalProcessing = DEFERRED
        ComIPduCancellationSupport = false
        ComIPduGroupRef = IC_oCAN00_Tx_3ef0a222
        ComIPduSignalRef = Diag_Buffer_Tx_UUDT_oDiag_Resp_UUDT_oCAN00_0ee1ff7b_Tx
        ComPduIdRef = Diag_Resp_UUDT_oCAN00_06d3a8a3_Tx
        ComTxIPdu: ComMinimumDelayTime=0, ComTxIPduUnusedAreasDefault=0
          ComTxModeTrue
            ComTxMode: ComTxModeMode=PERIODIC, ComTxModeTimeOffset=0, ComTxModeTimePeriod=0
          ComTxModeFalse
            ComTxMode: ComTxModeMode=PERIODIC, ComTxModeTimeOffset=0, ComTxModeTimePeriod=0
      3 x ComSignal, all with ComBitSize=8, ComSignalEndianness=LITTLE_ENDIAN, ComSignalInitValue=0, ComSignalType=UINT8, ComTransferProperty=PENDING, ComSignalAccess=ACCESS_UNCLEAR:
        UserData5_IC_oIC_NMPDU_oCAN00_6f1ea726_Tx: ComBitPosition=56, ComHandleId=59, ComSystemTemplateSystemSignalRef=UserData5_IC
        Debug4_Byte3_oDebug_Frame4_oCAN00_0cc4a2a3_Tx: ComBitPosition=24, ComHandleId=31, ComSystemTemplateSystemSignalRef=Debug4_Byte3
        Debug5_Byte0_oDebug_Frame5_oCAN00_f8a3f260_Tx: ComBitPosition=0, ComHandleId=36, ComSystemTemplateSystemSignalRef=Debug5_Byte0
      ComTimeBase: ComRxTimeBase=0.01, ComTxTimeBase=0.01, ComGwTimeBase=0.01
      Debug4_Byte5_oDebug_Frame4_oCAN00_7e35f823_Tx (ComSignal):
        ComBitPosition = 40
        ComBitSize = 8
        ComSignalEndianness = LITTLE_ENDIAN
        ComSignalInitValue = 0
        ComSignalType = UINT8
        ComTransferProperty = PENDING
        ComSignalAccess = ACCESS_UNCLEAR
        ComHandleId = 33
        ComSystemTemplateSystemSignalRef = Debug4_Byte5
      Debug1_Byte2_oDebug_Frame1_oCAN00_546ec16e_Tx (ComSignal):
        ComBitPosition = 16
        ComBitSize = 8
        ComSignalEndianness = LITTLE_ENDIAN
        ComSignalInitValue = 0
        ComSignalType = UINT8
        ComTransferProperty = PENDING
        ComSignalAccess = ACCESS_UNCLEAR
        ComHandleId = 6
        ComSystemTemplateSystemSignalRef = Debug1_Byte2
      Cluster_Tx_Normal_COM_HS_oCAN00_017bc789_Tx (ComIPdu):
        ComIPduDirection = SEND
        ComIPduType = NORMAL
        ComIPduHandleId = 1
        ComIPduSignalProcessing = DEFERRED
        ComIPduCancellationSupport = false
        ComIPduGroupRef = IC_oCAN00_Tx_3ef0a222
        ComIPduSignalGroupRef = SG_COM_HS_oCluster_Tx_Normal_COM_HS_oCAN00_c9c3ed51_Tx
        ComPduIdRef = Cluster_Tx_Normal_COM_HS_oCAN00_017bc789_Tx
        ComTxIPdu: ComMinimumDelayTime=0, ComTxIPduUnusedAreasDefault=0
          ComTxModeTrue
            ComTxMode: ComTxModeMode=PERIODIC, ComTxModeTimeOffset=0, ComTxModeTimePeriod=0.01
          ComTxModeFalse
            ComTxMode: ComTxModeMode=PERIODIC, ComTxModeTimeOffset=0, ComTxModeTimePeriod=0.01
      11 x ComSignal, all with ComSignalInitValue=0, ComSignalAccess=ACCESS_UNCLEAR:
        Debug5_Byte6_oDebug_Frame5_oCAN00_8a52a8e0_Tx: ComBitPosition=48, ComBitSize=8, ComSignalEndianness=LITTLE_ENDIAN, ComSignalType=UINT8, ComTransferProperty=PENDING, ComHandleId=42, ComSystemTemplateSystemSignalRef=Debug5_Byte6
        Debug2_Byte6_oDebug_Frame2_oCAN00_849e52aa_Tx: ComBitPosition=48, ComBitSize=8, ComSignalEndianness=LITTLE_ENDIAN, ComSignalType=UINT8, ComTransferProperty=PENDING, ComHandleId=18, ComSystemTemplateSystemSignalRef=Debug2_Byte6
        Debug2_Byte3_oDebug_Frame2_oCAN00_cf17a56a_Tx: ComBitPosition=24, ComBitSize=8, ComSignalEndianness=LITTLE_ENDIAN, ComSignalType=UINT8, ComTransferProperty=PENDING, ComHandleId=15, ComSystemTemplateSystemSignalRef=Debug2_Byte3
        Debug4_Byte4_oDebug_Frame4_oCAN00_691d9ce3_Tx: ComBitPosition=32, ComBitSize=8, ComSignalEndianness=LITTLE_ENDIAN, ComSignalType=UINT8, ComTransferProperty=PENDING, ComHandleId=32, ComSystemTemplateSystemSignalRef=Debug4_Byte4
        TransportMode_oVehicleControl_oCAN00_b498f884_Rx: ComBitPosition=54, ComBitSize=1, ComSignalEndianness=LITTLE_ENDIAN, ComSignalType=BOOLEAN, ComHandleId=12, ComSystemTemplateSystemSignalRef=TransportMode
        Debug1_Byte6_oDebug_Frame1_oCAN00_08cf526e_Tx: ComBitPosition=48, ComBitSize=8, ComSignalEndianness=LITTLE_ENDIAN, ComSignalType=UINT8, ComTransferProperty=PENDING, ComHandleId=10, ComSystemTemplateSystemSignalRef=Debug1_Byte6
        Debug1_Byte0_oDebug_Frame1_oCAN00_7a3e08ee_Tx: ComBitPosition=0, ComBitSize=8, ComSignalEndianness=LITTLE_ENDIAN, ComSignalType=UINT8, ComTransferProperty=PENDING, ComHandleId=4, ComSystemTemplateSystemSignalRef=Debug1_Byte0
        Debug5_Byte5_oDebug_Frame5_oCAN00_b32a05a0_Tx: ComBitPosition=40, ComBitSize=8, ComSignalEndianness=LITTLE_ENDIAN, ComSignalType=UINT8, ComTransferProperty=PENDING, ComHandleId=41, ComSystemTemplateSystemSignalRef=Debug5_Byte5
        GearMode_oVehicleControl_oCAN00_c0b273e8_Rx: ComBitPosition=51, ComBitSize=1, ComSignalEndianness=BIG_ENDIAN, ComSignalType=BOOLEAN, ComHandleId=6, ComSystemTemplateSystemSignalRef=GearMode
        Gear_oVehicleControl_oCAN00_45630abd_Rx: ComBitPosition=7, ComBitSize=4, ComSignalEndianness=BIG_ENDIAN, ComSignalType=UINT8, ComHandleId=9, ComSystemTemplateSystemSignalRef=Gear
        MAC_Tx_oCluster_Secure_Tx_oCAN00_b83a6da7_Tx: ComBitPosition=32, ComBitSize=28, ComSignalEndianness=LITTLE_ENDIAN, ComSignalType=UINT32, ComTransferProperty=PENDING, ComHandleId=48, ComSystemTemplateSystemSignalRef=MAC_Tx
      ABS_oCAN00_29f7b4f6_Rx (ComIPdu):
        ComIPduDirection = RECEIVE
        ComIPduType = NORMAL
        ComIPduHandleId = 0
        ComIPduSignalProcessing = DEFERRED
        ComIPduCancellationSupport = false
        ComIPduGroupRef = IC_oCAN00_Rx_68aa05a4
        ComIPduSignalGroupRef = SG_ABS_oABS_oCAN00_6681ad27_Rx
        ComPduIdRef = ABS_oCAN00_29f7b4f6_Rx
      SG_ABS_oABS_oCAN00_6681ad27_Rx (ComSignalGroup):
        ComTransferProperty = PENDING
        ComSignalGroupAccess = ACCESS_NEEDED_BY_SWC_OR_COM
        ComHandleId = 0
        ComSignalGroupArrayAccess = true
        ComNotification = Rte_COMCbk_SG_ABS_oABS_oCAN00_6681ad27_Rx
        ComSystemTemplateSignalGroupRef = SG_ABS
        4 x ComGroupSignal, all with ComSignalEndianness=LITTLE_ENDIAN, ComSignalInitValue=0, ComSignalAccess=ACCESS_UNCLEAR:
          Airbag_oABS_oCAN00_d379e7a9_Rx: ComBitPosition=14, ComBitSize=2, ComSignalType=UINT8, ComHandleId=0, ComSystemTemplateSystemSignalRef=Airbag
          CRC_101_oABS_oCAN00_bce9141a_Rx: ComBitPosition=48, ComBitSize=8, ComSignalType=UINT8, ComHandleId=3, ComSystemTemplateSystemSignalRef=CRC_101
          Alive_101_oABS_oCAN00_a0c1519e_Rx: ComBitPosition=44, ComBitSize=4, ComSignalType=UINT8, ComHandleId=1, ComSystemTemplateSystemSignalRef=Alive_101
          VehicleSpeedABS_oABS_oCAN00_94c6f8d1_Rx: ComBitPosition=24, ComBitSize=16, ComSignalType=UINT16, ComHandleId=14, ComSystemTemplateSystemSignalRef=VehicleSpeedABS
      SG_COM_HS_oCluster_Tx_Normal_COM_HS_oCAN00_c9c3ed51_Tx (ComSignalGroup):
        ComTransferProperty = PENDING
        ComSignalGroupAccess = ACCESS_NEEDED_BY_SWC_OR_COM
        ComHandleId = 0
        ComSignalGroupArrayAccess = true
        ComErrorNotification = Rte_COMCbkTErr_SG_COM_HS_oCluster_Tx_Normal_COM_HS_oCAN00_c9c3ed51_Tx
        ComNotification = Rte_COMCbkTAck_SG_COM_HS_oCluster_Tx_Normal_COM_HS_oCAN00_c9c3ed51_Tx
        ComTimeoutNotification = Rte_COMCbkTxTOut_SG_COM_HS_oCluster_Tx_Normal_COM_HS_oCAN00_c9c3ed51_Tx
        ComSystemTemplateSignalGroupRef = SG_COM_HS
        3 x ComGroupSignal, all with ComSignalEndianness=LITTLE_ENDIAN, ComSignalInitValue=0, ComSignalType=UINT8, ComTransferProperty=PENDING, ComSignalAccess=ACCESS_UNCLEAR:
          Battery_Voltage_oCluster_Tx_Normal_COM_HS_oCAN00_e5088019_Tx: ComBitPosition=0, ComBitSize=8, ComHandleId=1, ComSystemTemplateSystemSignalRef=Battery_Voltage
          CRC_200_oCluster_Tx_Normal_COM_HS_oCAN00_b588f3c3_Tx: ComBitPosition=16, ComBitSize=8, ComHandleId=2, ComSystemTemplateSystemSignalRef=CRC_200
          Alive_200_oCluster_Tx_Normal_COM_HS_oCAN00_96cf5451_Tx: ComBitPosition=8, ComBitSize=4, ComHandleId=0, ComSystemTemplateSystemSignalRef=Alive_200
      EngineSpeed_oVehicleControl_oCAN00_7eb3f445_Rx (ComSignal):
        ComBitPosition = 39
        ComBitSize = 16
        ComSignalEndianness = BIG_ENDIAN
        ComSignalInitValue = 0
        ComSignalType = UINT16
        ComSignalAccess = ACCESS_NEEDED_BY_SWC_OR_COM
        ComHandleId = 5
        ComSystemTemplateSystemSignalRef = EngineSpeed
      Turn_Indicator_Control_oVehicleControl_oCAN00_b06608e9_Rx (ComSignal):
        ComBitPosition = 22
        ComBitSize = 2
        ComSignalEndianness = LITTLE_ENDIAN
        ComSignalInitValue = 0
        ComSignalType = UINT8
        ComSignalAccess = ACCESS_NEEDED_BY_SWC_OR_COM
        ComHandleId = 13
        ComSystemTemplateSystemSignalRef = Turn_Indicator_Control
    ComGeneral:
      ComConfigurationUseDet = true
      ComEnableSignalGroupArrayApi = true
      ComRetryFailedTransmitRequests = true
      ComSupportedIPduGroups = 2
      ComVersionInfoApi = false
      ComAdvancedIPduCallouts = true
      ComOptimizedIPduGroupHandling = false
      ComMetaDataSupport = false
      ComReceiveSignalMacroAPI = false
      ComDeferredEventCacheSupport = false
      ComMainfunctionTimingDomainSupport = false
      ComDescriptionRoutingCodeGeneration = false
      ComSafeBswChecks = false
