AUTOSAR XML (schema 4-2-1)
package /ActiveEcuC
  module config ComM: implementation-config-variant=VARIANT-PRE-COMPILE, module-description=ComM_Impl
    ComMGeneral:
      ComMPncIdCounting = COMM_PNC_ID_COUNT_FROM_NM_MESSAGE
      ComMPncSupport = false
      ComMWakeupInhibitionEnabled = false
      ComMPncGatewayEnabled = false
      ComMEcuGroupClassification = 0
      ComMDevErrorDetect = true
      ComMModeLimitationEnabled = false
      ComMSynchronousWakeUp = false
      ComMTMinFullComModeDuration = 5
      ComMVersionInfoApi = false
      ComMSafeBswChecks = false
      ComMGeneration: ComMOutOfBoundsWriteSanitizer=false, ComMOutOfBoundsReadSanitizer=false
    ComMConfigSet: ComMPncEnabled=false
      CN_CAN00_bb949cc2 (ComMChannel):
        ComMBusType = COMM_BUS_TYPE_CAN
        ComMChannelId = 0
        ComMPncGatewayType = COMM_GATEWAY_TYPE_NONE
        ComMNoWakeup = false
        ComMNoCom = false
        ComMFullCommRequestNotificationEnabled = false
        ComMMainFunctionPeriod = 0.01
        ComMNetworkManagement: ComMNmVariant=NONE, ComMPncNmRequest=false
        CN_CAN00_31ac7964 (ComMUserPerChannel): ComMUserChannel=CN_CAN00_0c767ef5
      CN_CAN00_0c767ef5 (ComMUser): ComMUserIdentifier=0, ComMUserModeNotification=false
