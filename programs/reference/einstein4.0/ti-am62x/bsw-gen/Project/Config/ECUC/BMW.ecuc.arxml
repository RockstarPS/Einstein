AUTOSAR XML (schema 4-2-1)
package /ActiveEcuC
  ecuc value collection ActiveEcuC: ecu-extract=SYSTEM, ecuc-values=[Rte, Os, EcuC, Dcm, Dem, Ea, Com, ComM, CanIf, Can, PduR, EcuM, CanSM, BswM, Mcu, Nm, Fee, NvM]
  module config Fee: implementation-config-variant=VARIANT-PRE-COMPILE, module-description=Fee_Impl
    FeeBlock_Template (FeeBlockConfiguration):
      FeeBlockIdFixed = false
      FeeBlockIsCritical = false
      FeeImmediateData = true
      FeeNumberOfChunkInstances = 1
      FeeBlockNumber = 1
      FeeBlockSize = 1
      FeeNumberOfWriteCycles = 10000
      FeeNumberOfDatasets = 1
      FeeBlockId = 1
      FeePartition = FeePartitionConfiguration
      FeeDeviceIndex = FlsGeneral
    FeeConfigBlock (FeeBlockConfiguration):
      FeeBlockIdFixed = false
      FeeBlockIsCritical = false
      FeeImmediateData = false
      FeeNumberOfChunkInstances = 1
      FeeBlockNumber = 42
      FeeBlockSize = 4
      FeeNumberOfWriteCycles = 10000
      FeeNumberOfDatasets = 2
      FeeBlockId = 2
      FeePartition = FeePartitionConfiguration_DIAG
      FeeDeviceIndex = FlsGeneral
    FeeGeneral:
      FeeDevErrorDetect = true
      FeeVersionInfoApi = false
      FeePollingMode = false
      FeeSetModeSupported = true
      FeeIndex = 0
      FeeNvmJobEndNotification = NvM_JobEndNotification
      FeeNvmJobErrorNotification = NvM_JobErrorNotification
      FeeInternalBufferSize = 64
      FeeMainFunctionPeriod = 0.01
      FeeNvmCbkIncludeFile = NvM_Cbk.h
      FeeMainFunctionTriggering = FixedCycleTime
      FeeDevErrorChecks: FeeDebugReporting=true, FeeDetErrorhook=Det_ReportError, FeeDetIncludeFile=Det.h
      FeeFlsApi:
        FeeFlsIncludeFile = NvMExt_Stubs.h
        FeeFlsSetMode = Fls_SetMode
        FeeFlsRead = NvmExt_Stubs_FlsRead
        FeeFlsWrite = NvmExt_Stubs_FlsWrite
        FeeFlsCancel = Fls_Cancel
        FeeFlsGetStatus = Fls_GetStatus
        FeeFlsGetJobResult = Fls_GetJobResult
        FeeFlsErase = Fls_Erase
        FeeFlsCompare = Fls_Compare
        FeeFlsDeviceIndex = FlsGeneral
    4 x FeePartitionConfiguration, all with FeeBssThresholdReserved=3072, FeeFssThresholdReserved=1024, FeeAddressAlignment=8, FeeWriteAlignment=8, FeeUpperSectorSize=8192, FeeLowerSectorSize=8192, FeePartitionDevice=FlsConfigSet_0:
      FeePartitionConfiguration_DIAG: FeeLowerSectorAddress=8192, FeeUpperSectorAddress=65536
      FeePartitionConfiguration_ODO: FeeLowerSectorAddress=24576, FeeUpperSectorAddress=81920
      FeePartitionConfiguration_SIGMA_FEE_BLK_1: FeeLowerSectorAddress=32768, FeeUpperSectorAddress=90112
      FeePartitionConfiguration_SIGMA_FEE_BLK_2: FeeLowerSectorAddress=49152, FeeUpperSectorAddress=106496
    FeePublishedInformation: FeeBlockOverhead=2, FeeMaximumBlockingTime=1, FeePageOverhead=0, FeeChunkHeader=16, FeeChunkLink=8, FeeSectorHeader=8
    FeeSpecificFeatures:
      FeeApplErrorCallbackFunction = Appl_FeeCriticalErrorCallback
      FeeApplErrorCallbackIncludeFile = ApplMain.h
      FeeGetEraseCycleApi = false
      FeeGetWriteCycleApi = false
      FeeUseApplErrorCallback = false
      FeeUseJobCache = false
      FeeForceSectorSwitchApi = false
      FeeDataConversionApi = false
      FeeFblConfig = false
      FeeMaxLinkTableSize = 4095
      FeeFssControlApi = false
    54 x FeeBlockConfiguration, all with FeeBlockIdFixed=false, FeeBlockIsCritical=false, FeeImmediateData=true, FeeNumberOfChunkInstances=1, FeeBlockSize=, FeeNumberOfDatasets=1, FeePartition=FeePartitionConfiguration_CALIB, FeeDeviceIndex=FlsGeneral:
      Fee_BsConst_Audio: FeeBlockNumber=19, FeeNumberOfWriteCycles=10000, FeeBlockId=19
      Fee_BsConst_Communication: FeeBlockNumber=22, FeeNumberOfWriteCycles=10000, FeeBlockId=22
      Fee_BsConst_EngOffTimer: FeeBlockNumber=25, FeeNumberOfWriteCycles=10000, FeeBlockId=25
      Fee_BsConst_FuelGauge: FeeBlockNumber=11, FeeNumberOfWriteCycles=10000, FeeBlockId=11
      Fee_BsConst_Illumination: FeeBlockNumber=16, FeeNumberOfWriteCycles=10000, FeeBlockId=16
      Fee_BsConst_Illumination_Copy1: FeeBlockNumber=17, FeeNumberOfWriteCycles=10000, FeeBlockId=17
      Fee_BsConst_Illumination_Copy2: FeeBlockNumber=18, FeeNumberOfWriteCycles=10000, FeeBlockId=18
      Fee_BsConst_OilGauge: FeeBlockNumber=14, FeeNumberOfWriteCycles=10000, FeeBlockId=14
      Fee_BsConst_Power: FeeBlockNumber=23, FeeNumberOfWriteCycles=10000, FeeBlockId=23
      Fee_BsConst_PowerGauge: FeeBlockNumber=13, FeeNumberOfWriteCycles=10000, FeeBlockId=13
      Fee_BsConst_RealTimeClock: FeeBlockNumber=21, FeeNumberOfWriteCycles=10000, FeeBlockId=21
      Fee_BsConst_ServiceReminder: FeeBlockNumber=24, FeeNumberOfWriteCycles=10000, FeeBlockId=24
      Fee_BsConst_SpeedoGauge: FeeBlockNumber=9, FeeNumberOfWriteCycles=10000, FeeBlockId=9
      Fee_BsConst_TachoGauge: FeeBlockNumber=10, FeeNumberOfWriteCycles=10000, FeeBlockId=10
      Fee_BsConst_TempGauge: FeeBlockNumber=12, FeeNumberOfWriteCycles=10000, FeeBlockId=12
      Fee_BsConst_TripComputer: FeeBlockNumber=15, FeeNumberOfWriteCycles=10000, FeeBlockId=15
      Fee_BsConst_Warning: FeeBlockNumber=20, FeeNumberOfWriteCycles=10000, FeeBlockId=20
      Fee_BsCys_Certicificate: FeeBlockNumber=26, FeeNumberOfWriteCycles=10000, FeeBlockId=26
      Fee_BsDiag_Dtc: FeeBlockNumber=54, FeeNumberOfWriteCycles=10000, FeeBlockId=54
      Fee_BsDiag_ErrorRecord: FeeBlockNumber=53, FeeNumberOfWriteCycles=10000, FeeBlockId=53
      Fee_BsReten_Audio: FeeBlockNumber=46, FeeNumberOfWriteCycles=10000, FeeBlockId=46
      Fee_BsReten_Communication: FeeBlockNumber=49, FeeNumberOfWriteCycles=10000, FeeBlockId=49
      Fee_BsReten_Display: FeeBlockNumber=52, FeeNumberOfWriteCycles=10000, FeeBlockId=52
      Fee_BsReten_Gauges: FeeBlockNumber=43, FeeNumberOfWriteCycles=10000, FeeBlockId=43
      Fee_BsReten_Illumination: FeeBlockNumber=45, FeeNumberOfWriteCycles=10000, FeeBlockId=45
      Fee_BsReten_Odometer: FeeBlockNumber=42, FeeNumberOfWriteCycles=10000, FeeBlockId=42
      Fee_BsReten_Personalization: FeeBlockNumber=50, FeeNumberOfWriteCycles=10000, FeeBlockId=50
      Fee_BsReten_Power: FeeBlockNumber=51, FeeNumberOfWriteCycles=10000, FeeBlockId=51
      Fee_BsReten_RealTimeClock: FeeBlockNumber=48, FeeNumberOfWriteCycles=10000, FeeBlockId=48
      Fee_BsReten_Tripcomputer: FeeBlockNumber=44, FeeNumberOfWriteCycles=10000, FeeBlockId=44
      Fee_BsReten_Warning: FeeBlockNumber=47, FeeNumberOfWriteCycles=10000, FeeBlockId=47
      Fee_BsRt_CusDlt: FeeBlockNumber=41, FeeNumberOfWriteCycles=10000, FeeBlockId=41
      Fee_BsRt_FuelGauge: FeeBlockNumber=32, FeeNumberOfWriteCycles=10000, FeeBlockId=32
      Fee_BsRt_Illumination: FeeBlockNumber=40, FeeNumberOfWriteCycles=10000, FeeBlockId=40
      Fee_BsRt_Odometer: FeeBlockNumber=29, FeeNumberOfWriteCycles=1000000, FeeBlockId=29
      Fee_BsRt_OilGauge: FeeBlockNumber=35, FeeNumberOfWriteCycles=10000, FeeBlockId=35
      Fee_BsRt_Personalization: FeeBlockNumber=39, FeeNumberOfWriteCycles=10000, FeeBlockId=39
      Fee_BsRt_PowerGauge: FeeBlockNumber=34, FeeNumberOfWriteCycles=10000, FeeBlockId=34
      Fee_BsRt_RealTimeClock: FeeBlockNumber=38, FeeNumberOfWriteCycles=10000, FeeBlockId=38
      Fee_BsRt_SpeedoGauge: FeeBlockNumber=30, FeeNumberOfWriteCycles=10000, FeeBlockId=30
      Fee_BsRt_TachoGauge: FeeBlockNumber=31, FeeNumberOfWriteCycles=10000, FeeBlockId=31
      Fee_BsRt_TempGauge: FeeBlockNumber=33, FeeNumberOfWriteCycles=10000, FeeBlockId=33
      Fee_BsRt_TripComputer: FeeBlockNumber=36, FeeNumberOfWriteCycles=10000, FeeBlockId=36
      Fee_BsRt_Warning: FeeBlockNumber=37, FeeNumberOfWriteCycles=10000, FeeBlockId=37
      Fee_BsShare_EcuPartNumber: FeeBlockNumber=6, FeeNumberOfWriteCycles=20000, FeeBlockId=6
      Fee_BsShare_SwUpdFotaFinPrint: FeeBlockNumber=3, FeeNumberOfWriteCycles=20000, FeeBlockId=3
      Fee_BsShare_SwUpdFotaMode: FeeBlockNumber=2, FeeNumberOfWriteCycles=10000, FeeBlockId=2
      Fee_BsShare_SwUpdFotaStatus: FeeBlockNumber=4, FeeNumberOfWriteCycles=20000, FeeBlockId=4
      Fee_BsShare_SwUpdFotadecrypt: FeeBlockNumber=5, FeeNumberOfWriteCycles=20000, FeeBlockId=5
      Fee_BsShare_SwUpdReflash: FeeBlockNumber=1, FeeNumberOfWriteCycles=10000, FeeBlockId=1
      Fee_BsShare_VehicleConfig: FeeBlockNumber=8, FeeNumberOfWriteCycles=10000, FeeBlockId=8
      Fee_BsShare_VisMeet: FeeBlockNumber=7, FeeNumberOfWriteCycles=10000, FeeBlockId=7
      Fee_RefCys_Certicificate: FeeBlockNumber=27, FeeNumberOfWriteCycles=10000, FeeBlockId=27
      Fee_RefCys_Certicificate1: FeeBlockNumber=28, FeeNumberOfWriteCycles=10000, FeeBlockId=28
