AUTOSAR XML (schema 00044)
package /E40_Platform_System_SystemPackage/Components
  application sw component type SafeBsw
    behavior IB_SafeBsw
      timing event TMT_Spi_MainFunction_Handling: start-on-event=Spi_MainFunction_Handling, period=0.01
      runnable Spi_MainFunction_Handling
  swc implementation IMPL_SafeBsw: behavior=IB_SafeBsw
