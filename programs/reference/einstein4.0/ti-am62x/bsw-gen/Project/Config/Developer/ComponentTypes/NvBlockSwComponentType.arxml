AUTOSAR XML (schema 00044)
package /ComponentTypes
  nv block sw component type NvBlockSwComponentType
    94 x provide/require port:
      BsConst_Audio_Element: nv-provide-com-spec{ram-block-init-value=128 x 0, rom-block-init-value=128 x 0, variable=Value}, nv-require-com-spec{init-value=128 x 0, variable=Value}, provided-required-interface=BsConst_Audio_Element
      BsConst_Communication_Element: nv-provide-com-spec{ram-block-init-value=64 x 0, rom-block-init-value=64 x 0, variable=Value}, nv-require-com-spec{init-value=64 x 0, variable=Value}, provided-required-interface=BsConst_Communication_Element
      BsConst_EngOffTimer_Element: nv-provide-com-spec{ram-block-init-value=32 x 0, rom-block-init-value=32 x 0, variable=Value}, nv-require-com-spec{init-value=32 x 0, variable=Value}, provided-required-interface=BsConst_EngOffTimer_Element
      BsConst_FuelGauge_Element: nv-provide-com-spec{ram-block-init-value=128 x 0, rom-block-init-value=128 x 0, variable=Value}, nv-require-com-spec{init-value=128 x 0, variable=Value}, provided-required-interface=BsConst_FuelGauge_Element
      BsConst_OilGauge_Element: nv-provide-com-spec{ram-block-init-value=64 x 0, rom-block-init-value=64 x 0, variable=Value}, nv-require-com-spec{init-value=64 x 0, variable=Value}, provided-required-interface=BsConst_OilGauge_Element
      BsConst_PowerGauge_Element: nv-provide-com-spec{ram-block-init-value=64 x 0, rom-block-init-value=64 x 0, variable=Value}, nv-require-com-spec{init-value=64 x 0, variable=Value}, provided-required-interface=BsConst_PowerGauge_Element
      BsConst_Power_Element: nv-provide-com-spec{ram-block-init-value=32 x 0, rom-block-init-value=32 x 0, variable=Value}, nv-require-com-spec{init-value=32 x 0, variable=Value}, provided-required-interface=BsConst_Power_Element
      BsConst_RealTimeClock_Element: nv-provide-com-spec{ram-block-init-value=48 x 0, rom-block-init-value=48 x 0, variable=Value}, nv-require-com-spec{init-value=48 x 0, variable=Value}, provided-required-interface=BsConst_RealTimeClock_Element
      BsConst_ServiceReminder_Element: nv-provide-com-spec{ram-block-init-value=48 x 0, rom-block-init-value=48 x 0, variable=Value}, nv-require-com-spec{init-value=48 x 0, variable=Value}, provided-required-interface=BsConst_ServiceReminder_Element
      BsConst_SpeedoGauge_Element: nv-provide-com-spec{ram-block-init-value=64 x 0, rom-block-init-value=64 x 0, variable=Value}, nv-require-com-spec{init-value=64 x 0, variable=Value}, provided-required-interface=BsConst_SpeedoGauge_Element
      BsConst_TachoGauge_Element: nv-provide-com-spec{ram-block-init-value=64 x 0, rom-block-init-value=64 x 0, variable=Value}, nv-require-com-spec{init-value=64 x 0, variable=Value}, provided-required-interface=BsConst_TachoGauge_Element
      BsConst_TempGauge_Element: nv-provide-com-spec{ram-block-init-value=64 x 0, rom-block-init-value=64 x 0, variable=Value}, nv-require-com-spec{init-value=64 x 0, variable=Value}, provided-required-interface=BsConst_TempGauge_Element
      BsConst_TripComputer_Element: nv-provide-com-spec{ram-block-init-value=64 x 0, rom-block-init-value=64 x 0, variable=Value}, nv-require-com-spec{init-value=64 x 0, variable=Value}, provided-required-interface=BsConst_TripComputer_Element
      BsConst_Warning_Element: nv-provide-com-spec{ram-block-init-value=64 x 0, rom-block-init-value=64 x 0, variable=Value}, nv-require-com-spec{init-value=64 x 0, variable=Value}, provided-required-interface=BsConst_Warning_Element
      BsCys_Certicificate_Element: nv-provide-com-spec{ram-block-init-value=64 x 0, rom-block-init-value=64 x 0, variable=Value}, nv-require-com-spec{init-value=64 x 0, variable=Value}, provided-required-interface=BsCys_Certicificate_Element
      BsDiag_Dtc_Element: nv-provide-com-spec{ram-block-init-value=2048 x 0, rom-block-init-value=2048 x 0, variable=Value}, nv-require-com-spec{init-value=2048 x 0, variable=Value}, provided-required-interface=BsDiag_Dtc_Element
      BsDiag_ErrorRecord_Element: nv-provide-com-spec{ram-block-init-value=1024 x 0, rom-block-init-value=1024 x 0, variable=Value}, nv-require-com-spec{init-value=1024 x 0, variable=Value}, provided-required-interface=BsDiag_ErrorRecord_Element
      BsReten_Audio_Element: nv-provide-com-spec{ram-block-init-value=100 x 0, rom-block-init-value=100 x 0, variable=Value}, nv-require-com-spec{init-value=100 x 0, variable=Value}, provided-required-interface=BsReten_Audio_Element
      BsReten_Communication_Element: nv-provide-com-spec{ram-block-init-value=100 x 0, rom-block-init-value=100 x 0, variable=Value}, nv-require-com-spec{init-value=100 x 0, variable=Value}, provided-required-interface=BsReten_Communication_Element
      BsReten_Display_Element: nv-provide-com-spec{ram-block-init-value=100 x 0, rom-block-init-value=100 x 0, variable=Value}, nv-require-com-spec{init-value=100 x 0, variable=Value}, provided-required-interface=BsReten_Display_Element
      BsReten_Gauges_Element: nv-provide-com-spec{ram-block-init-value=100 x 0, rom-block-init-value=100 x 0, variable=Value}, nv-require-com-spec{init-value=100 x 0, variable=Value}, provided-required-interface=BsReten_Gauges_Element
      BsReten_Illumination_Element: nv-provide-com-spec{ram-block-init-value=100 x 0, rom-block-init-value=100 x 0, variable=Value}, nv-require-com-spec{init-value=100 x 0, variable=Value}, provided-required-interface=BsReten_Illumination_Element
      BsReten_Odometer_Element: nv-provide-com-spec{ram-block-init-value=100 x 0, rom-block-init-value=100 x 0, variable=Value}, nv-require-com-spec{init-value=100 x 0, variable=Value}, provided-required-interface=BsReten_Odometer_Element
      BsReten_Personalization_Element: nv-provide-com-spec{ram-block-init-value=100 x 0, rom-block-init-value=100 x 0, variable=Value}, nv-require-com-spec{init-value=100 x 0, variable=Value}, provided-required-interface=BsReten_Personalization_Element
      BsReten_Power_Element: nv-provide-com-spec{ram-block-init-value=100 x 0, rom-block-init-value=100 x 0, variable=Value}, nv-require-com-spec{init-value=100 x 0, variable=Value}, provided-required-interface=BsReten_Power_Element
      BsReten_RealTimeClock_Element: nv-provide-com-spec{ram-block-init-value=100 x 0, rom-block-init-value=100 x 0, variable=Value}, nv-require-com-spec{init-value=100 x 0, variable=Value}, provided-required-interface=BsReten_RealTimeClock_Element
      BsReten_Tripcomputer_Element: nv-provide-com-spec{ram-block-init-value=100 x 0, rom-block-init-value=100 x 0, variable=Value}, nv-require-com-spec{init-value=100 x 0, variable=Value}, provided-required-interface=BsReten_Tripcomputer_Element
      BsReten_Warning_Element: nv-provide-com-spec{ram-block-init-value=100 x 0, rom-block-init-value=100 x 0, variable=Value}, nv-require-com-spec{init-value=100 x 0, variable=Value}, provided-required-interface=BsReten_Warning_Element
      BsRt_CusDlt_Element: nv-provide-com-spec{ram-block-init-value=128 x 0, rom-block-init-value=128 x 0, variable=Value}, nv-require-com-spec{init-value=128 x 0, variable=Value}, provided-required-interface=BsRt_CusDlt_Element
      BsRt_FuelGauge_Element: nv-provide-com-spec{ram-block-init-value=32 x 0, rom-block-init-value=32 x 0, variable=Value}, nv-require-com-spec{init-value=32 x 0, variable=Value}, provided-required-interface=BsRt_FuelGauge_Element
      BsRt_Illumination_Element: nv-provide-com-spec{ram-block-init-value=100 x 0, rom-block-init-value=100 x 0, variable=Value}, nv-require-com-spec{init-value=100 x 0, variable=Value}, provided-required-interface=BsRt_Illumination_Element
      BsRt_Odometer_Element: nv-provide-com-spec{ram-block-init-value=128 x 0, rom-block-init-value=128 x 0, variable=Value}, nv-require-com-spec{init-value=128 x 0, variable=Value}, provided-required-interface=BsRt_Odometer_Element
      BsRt_OilGauge_Element: nv-provide-com-spec{ram-block-init-value=8 x 0, rom-block-init-value=8 x 0, variable=Value}, nv-require-com-spec{init-value=8 x 0, variable=Value}, provided-required-interface=BsRt_OilGauge_Element
      BsRt_Personalization_Element: nv-provide-com-spec{ram-block-init-value=128 x 0, rom-block-init-value=128 x 0, variable=Value}, nv-require-com-spec{init-value=128 x 0, variable=Value}, provided-required-interface=BsRt_Personalization_Element
      BsRt_PowerGauge_Element: nv-provide-com-spec{ram-block-init-value=32 x 0, rom-block-init-value=32 x 0, variable=Value}, nv-require-com-spec{init-value=32 x 0, variable=Value}, provided-required-interface=BsRt_PowerGauge_Element
      BsRt_RealTimeClock_Element: nv-provide-com-spec{ram-block-init-value=48 x 0, rom-block-init-value=48 x 0, variable=Value}, nv-require-com-spec{init-value=48 x 0, variable=Value}, provided-required-interface=BsRt_RealTimeClock_Element
      BsRt_SpeedoGauge_Element: nv-provide-com-spec{ram-block-init-value=8 x 0, rom-block-init-value=8 x 0, variable=Value}, nv-require-com-spec{init-value=8 x 0, variable=Value}, provided-required-interface=BsRt_SpeedoGauge_Element
      BsRt_TachoGauge_Element: nv-provide-com-spec{ram-block-init-value=16 x 0, rom-block-init-value=16 x 0, variable=Value}, nv-require-com-spec{init-value=16 x 0, variable=Value}, provided-required-interface=BsRt_TachoGauge_Element
      BsRt_TempGauge_Element: nv-provide-com-spec{ram-block-init-value=32 x 0, rom-block-init-value=32 x 0, variable=Value}, nv-require-com-spec{init-value=32 x 0, variable=Value}, provided-required-interface=BsRt_TempGauge_Element
      BsRt_TripComputer_Element: nv-provide-com-spec{ram-block-init-value=64 x 0, rom-block-init-value=64 x 0, variable=Value}, nv-require-com-spec{init-value=64 x 0, variable=Value}, provided-required-interface=BsRt_TripComputer_Element
      BsRt_Warning_Element: nv-provide-com-spec{ram-block-init-value=32 x 0, rom-block-init-value=32 x 0, variable=Value}, nv-require-com-spec{init-value=32 x 0, variable=Value}, provided-required-interface=BsRt_Warning_Element
      BsShare_EcuPartNumber_Element: nv-provide-com-spec{ram-block-init-value=61 x 0, rom-block-init-value=61 x 0, variable=Value}, nv-require-com-spec{init-value=61 x 0, variable=Value}, provided-required-interface=BsShare_EcuPartNumber_Element
      BsShare_SwUpdFotaFinPrint_Element: nv-provide-com-spec{ram-block-init-value=32 x 0, rom-block-init-value=32 x 0, variable=Value}, nv-require-com-spec{init-value=32 x 0, variable=Value}, provided-required-interface=BsShare_SwUpdFotaFinPrint_Element
      BsShare_SwUpdFotaMode_Element: nv-provide-com-spec{ram-block-init-value=16 x 0, rom-block-init-value=16 x 0, variable=Value}, nv-require-com-spec{init-value=16 x 0, variable=Value}, provided-required-interface=BsShare_SwUpdFotaMode_Element
      BsShare_SwUpdFotaStatus_Element: nv-provide-com-spec{ram-block-init-value=48 x 0, rom-block-init-value=48 x 0, variable=Value}, nv-require-com-spec{init-value=48 x 0, variable=Value}, provided-required-interface=BsShare_SwUpdFotaStatus_Element
      BsShare_SwUpdFotadecrypt_Element: nv-provide-com-spec{ram-block-init-value=64 x 0, rom-block-init-value=64 x 0, variable=Value}, nv-require-com-spec{init-value=64 x 0, variable=Value}, provided-required-interface=BsShare_SwUpdFotadecrypt_Element
      BsShare_SwUpdReflash_Element: nv-provide-com-spec{ram-block-init-value=8 x 0, rom-block-init-value=8 x 0, variable=Value}, nv-require-com-spec{init-value=8 x 0, variable=Value}, provided-required-interface=BsShare_SwUpdReflash_Element
      BsShare_VehicleConfig_Element: nv-provide-com-spec{ram-block-init-value=256 x 0, rom-block-init-value=256 x 0, variable=Value}, nv-require-com-spec{init-value=256 x 0, variable=Value}, provided-required-interface=BsShare_VehicleConfig_Element
      BsShare_VisMeet_Element: nv-provide-com-spec{ram-block-init-value=46 x 0, rom-block-init-value=46 x 0, variable=Value}, nv-require-com-spec{init-value=46 x 0, variable=Value}, provided-required-interface=BsShare_VisMeet_Element
      RefCys_Certicificate1_Element: nv-provide-com-spec{ram-block-init-value=64 x 0, rom-block-init-value=64 x 0, variable=Value}, nv-require-com-spec{init-value=64 x 0, variable=Value}, provided-required-interface=RefCys_Certicificate1_Element
      RefCys_Certicificate_Element: nv-provide-com-spec{ram-block-init-value=64 x 0, rom-block-init-value=64 x 0, variable=Value}, nv-require-com-spec{init-value=64 x 0, variable=Value}, provided-required-interface=RefCys_Certicificate_Element
      BsShare_AssemblyManufacturingDate: nv-provide-com-spec{ram-block-init-value=[1, 1, 0], rom-block-init-value=[1, 1, 0], variable=Value}, nv-require-com-spec{init-value=[1, 1, 0], variable=Value}, provided-required-interface=BsShare_AssemblyManufacturingDate
      BsShare_AssemblyPlantNumber: nv-provide-com-spec{ram-block-init-value=[255, 255, 255], rom-block-init-value=[255, 255, 255], variable=Value}, nv-require-com-spec{init-value=[255, 255, 255], variable=Value}, provided-required-interface=BsShare_AssemblyPlantNumber
      BsShare_HWModification: nv-provide-com-spec{ram-block-init-value=0, rom-block-init-value=0, variable=Value}, nv-require-com-spec{init-value=0, variable=Value}, provided-required-interface=BsShare_HWModification
      BsShare_PCBSerialNumber: nv-provide-com-spec{ram-block-init-value=9 x 255, rom-block-init-value=9 x 255, variable=Value}, nv-require-com-spec{init-value=9 x 255, variable=Value}, provided-required-interface=BsShare_PCBSerialNumber
      BsShare_ProductSerialNumber: nv-provide-com-spec{ram-block-init-value=10 x 255, rom-block-init-value=10 x 255, variable=Value}, nv-require-com-spec{init-value=10 x 255, variable=Value}, provided-required-interface=BsShare_ProductSerialNumber
      BsShare_SMTManufacturingDate: nv-provide-com-spec{ram-block-init-value=[1, 1, 0], rom-block-init-value=[1, 1, 0], variable=Value}, nv-require-com-spec{init-value=[1, 1, 0], variable=Value}, provided-required-interface=BsShare_SMTManufacturingDate
      BsShare_SMTPlantNumber: nv-provide-com-spec{ram-block-init-value=[255, 255, 255], rom-block-init-value=[255, 255, 255], variable=Value}, nv-require-com-spec{init-value=[255, 255, 255], variable=Value}, provided-required-interface=BsShare_SMTPlantNumber
      BsShare_VisMeet_EOLEntry_Element: nv-provide-com-spec{ram-block-init-value=65535, rom-block-init-value=65535, variable=Value}, nv-require-com-spec{init-value=65535, variable=Value}, provided-required-interface=BsShare_VisMeet_EOLEntry_Element
      BsShare_VisteonPCBPartNumber: nv-provide-com-spec{ram-block-init-value=17 x 255, rom-block-init-value=17 x 255, variable=Value}, nv-require-com-spec{init-value=17 x 255, variable=Value}, provided-required-interface=BsShare_VisteonPCBPartNumber
      BsShare_VisteonPartNumber: nv-provide-com-spec{ram-block-init-value=17 x 255, rom-block-init-value=17 x 255, variable=Value}, nv-require-com-spec{init-value=17 x 255, variable=Value}, provided-required-interface=BsShare_VisteonPartNumber
      BsConst_BsConst_Illumination_ReservedByte: nv-provide-com-spec{ram-block-init-value=28 x 0, rom-block-init-value=28 x 0, variable=Value}, nv-require-com-spec{init-value=28 x 0, variable=Value}, provided-required-interface=BsConst_BsConst_Illumination_ReservedByte
      BsConst_BsConst_Illumination_ReservedByte_SafeCopy1: nv-provide-com-spec{ram-block-init-value=28 x 0, rom-block-init-value=28 x 0, variable=Value}, nv-require-com-spec{init-value=28 x 0, variable=Value}, provided-required-interface=BsConst_BsConst_Illumination_ReservedByte_SafeCopy1
      BsConst_BsConst_Illumination_ReservedByte_SafeCopy2: nv-provide-com-spec{ram-block-init-value=28 x 0, rom-block-init-value=28 x 0, variable=Value}, nv-require-com-spec{init-value=28 x 0, variable=Value}, provided-required-interface=BsConst_BsConst_Illumination_ReservedByte_SafeCopy2
      BsConst_Compensation_Line_Shift_b: nv-provide-com-spec{ram-block-init-value=11, rom-block-init-value=11, variable=Value}, nv-require-com-spec{init-value=11, variable=Value}, provided-required-interface=BsConst_Compensation_Line_Shift_b
      BsConst_Compensation_Line_Shift_b_SafeCopy1: nv-provide-com-spec{ram-block-init-value=11, rom-block-init-value=11, variable=Value}, nv-require-com-spec{init-value=11, variable=Value}, provided-required-interface=BsConst_Compensation_Line_Shift_b_SafeCopy1
      BsConst_Compensation_Line_Shift_b_SafeCopy2: nv-provide-com-spec{ram-block-init-value=11, rom-block-init-value=11, variable=Value}, nv-require-com-spec{init-value=11, variable=Value}, provided-required-interface=BsConst_Compensation_Line_Shift_b_SafeCopy2
      BsConst_Compensation_Line_Slope_m: nv-provide-com-spec{ram-block-init-value=44433, rom-block-init-value=44433, variable=Value}, nv-require-com-spec{init-value=44433, variable=Value}, provided-required-interface=BsConst_Compensation_Line_Slope_m
      BsConst_Compensation_Line_Slope_m_SafeCopy1: nv-provide-com-spec{ram-block-init-value=44433, rom-block-init-value=44433, variable=Value}, nv-require-com-spec{init-value=44433, variable=Value}, provided-required-interface=BsConst_Compensation_Line_Slope_m_SafeCopy1
      BsConst_Compensation_Line_Slope_m_SafeCopy2: nv-provide-com-spec{ram-block-init-value=44433, rom-block-init-value=44433, variable=Value}, nv-require-com-spec{init-value=44433, variable=Value}, provided-required-interface=BsConst_Compensation_Line_Slope_m_SafeCopy2
      BsConst_Derating_Backlight_Disable: nv-provide-com-spec{ram-block-init-value=0, rom-block-init-value=0, variable=Value}, nv-require-com-spec{init-value=0, variable=Value}, provided-required-interface=BsConst_Derating_Backlight_Disable
      BsConst_Derating_Backlight_Disable_SafeCopy1: nv-provide-com-spec{ram-block-init-value=0, rom-block-init-value=0, variable=Value}, nv-require-com-spec{init-value=0, variable=Value}, provided-required-interface=BsConst_Derating_Backlight_Disable_SafeCopy1
      BsConst_Derating_Backlight_Disable_SafeCopy2: nv-provide-com-spec{ram-block-init-value=0, rom-block-init-value=0, variable=Value}, nv-require-com-spec{init-value=0, variable=Value}, provided-required-interface=BsConst_Derating_Backlight_Disable_SafeCopy2
      BsConst_Display_Illum_Max_Level: nv-provide-com-spec{ram-block-init-value=670, rom-block-init-value=670, variable=Value}, nv-require-com-spec{init-value=670, variable=Value}, provided-required-interface=BsConst_Display_Illum_Max_Level
      BsConst_Display_Illum_Max_Level_SafeCopy1: nv-provide-com-spec{ram-block-init-value=670, rom-block-init-value=670, variable=Value}, nv-require-com-spec{init-value=670, variable=Value}, provided-required-interface=BsConst_Display_Illum_Max_Level_SafeCopy1
      BsConst_Display_Illum_Max_Level_SafeCopy2: nv-provide-com-spec{ram-block-init-value=670, rom-block-init-value=670, variable=Value}, nv-require-com-spec{init-value=670, variable=Value}, provided-required-interface=BsConst_Display_Illum_Max_Level_SafeCopy2
      BsConst_Lookup_Curve_HotSpot_Coef_X: nv-provide-com-spec{ram-block-init-value=[700, 710, 720, 730, 740, 750, 760], rom-block-init-value=[700, 710, 720, 730, 740, 750, 760], variable=Value}, nv-require-com-spec{init-value=[700, 710, 720, 730, 740, 750, 760], variable=Value}, provided-required-interface=BsConst_Lookup_Curve_HotSpot_Coef_X
      BsConst_Lookup_Curve_HotSpot_Coef_X_SafeCopy1: nv-provide-com-spec{ram-block-init-value=[700, 710, 720, 730, 740, 750, 760], rom-block-init-value=[700, 710, 720, 730, 740, 750, 760], variable=Value}, nv-require-com-spec{init-value=[700, 710, 720, 730, 740, 750, 760], variable=Value}, provided-required-interface=BsConst_Lookup_Curve_HotSpot_Coef_X_SafeCopy1
      BsConst_Lookup_Curve_HotSpot_Coef_X_SafeCopy2: nv-provide-com-spec{ram-block-init-value=[700, 710, 720, 730, 740, 750, 760], rom-block-init-value=[700, 710, 720, 730, 740, 750, 760], variable=Value}, nv-require-com-spec{init-value=[700, 710, 720, 730, 740, 750, 760], variable=Value}, provided-required-interface=BsConst_Lookup_Curve_HotSpot_Coef_X_SafeCopy2
      BsConst_Lookup_Curve_HotSpot_Coef_Y: nv-provide-com-spec{ram-block-init-value=[8600, 7700, 6700, 5800, 4800, 3900, 3000], rom-block-init-value=[8600, 7700, 6700, 5800, 4800, 3900, 3000], variable=Value}, nv-require-com-spec{init-value=[8600, 7700, 6700, 5800, 4800, 3900, 3000], variable=Value}, provided-required-interface=BsConst_Lookup_Curve_HotSpot_Coef_Y
      BsConst_Lookup_Curve_HotSpot_Coef_Y_SafeCopy1: nv-provide-com-spec{ram-block-init-value=[8600, 7700, 6700, 5800, 4800, 3900, 3000], rom-block-init-value=[8600, 7700, 6700, 5800, 4800, 3900, 3000], variable=Value}, nv-require-com-spec{init-value=[8600, 7700, 6700, 5800, 4800, 3900, 3000], variable=Value}, provided-required-interface=BsConst_Lookup_Curve_HotSpot_Coef_Y_SafeCopy1
      BsConst_Lookup_Curve_HotSpot_Coef_Y_SafeCopy2: nv-provide-com-spec{ram-block-init-value=[8600, 7700, 6700, 5800, 4800, 3900, 3000], rom-block-init-value=[8600, 7700, 6700, 5800, 4800, 3900, 3000], variable=Value}, nv-require-com-spec{init-value=[8600, 7700, 6700, 5800, 4800, 3900, 3000], variable=Value}, provided-required-interface=BsConst_Lookup_Curve_HotSpot_Coef_Y_SafeCopy2
      BsConst_PCB_Temperature_Sensor_Conv: nv-provide-com-spec{ram-block-init-value=[4095, 4095], rom-block-init-value=[4095, 4095], variable=Value}, nv-require-com-spec{init-value=[4095, 4095], variable=Value}, provided-required-interface=BsConst_PCB_Temperature_Sensor_Conv
      BsConst_PCB_Temperature_Sensor_Conv_SafeCopy1: nv-provide-com-spec{ram-block-init-value=[4095, 4095], rom-block-init-value=[4095, 4095], variable=Value}, nv-require-com-spec{init-value=[4095, 4095], variable=Value}, provided-required-interface=BsConst_PCB_Temperature_Sensor_Conv_SafeCopy1
      BsConst_PCB_Temperature_Sensor_Conv_SafeCopy2: nv-provide-com-spec{ram-block-init-value=[4095, 4095], rom-block-init-value=[4095, 4095], variable=Value}, nv-require-com-spec{init-value=[4095, 4095], variable=Value}, provided-required-interface=BsConst_PCB_Temperature_Sensor_Conv_SafeCopy2
      BsConst_PWM_boost_bypass_duty: nv-provide-com-spec{ram-block-init-value=100, rom-block-init-value=100, variable=Value}, nv-require-com-spec{init-value=100, variable=Value}, provided-required-interface=BsConst_PWM_boost_bypass_duty
      BsConst_PWM_boost_bypass_duty_SafeCopy1: nv-provide-com-spec{ram-block-init-value=100, rom-block-init-value=100, variable=Value}, nv-require-com-spec{init-value=100, variable=Value}, provided-required-interface=BsConst_PWM_boost_bypass_duty_SafeCopy1
      BsConst_PWM_boost_bypass_duty_SafeCopy2: nv-provide-com-spec{ram-block-init-value=100, rom-block-init-value=100, variable=Value}, nv-require-com-spec{init-value=100, variable=Value}, provided-required-interface=BsConst_PWM_boost_bypass_duty_SafeCopy2
      BsConst_Temp_Threshold_Hysteresis_Derating: nv-provide-com-spec{ram-block-init-value=68, rom-block-init-value=68, variable=Value}, nv-require-com-spec{init-value=68, variable=Value}, provided-required-interface=BsConst_Temp_Threshold_Hysteresis_Derating
      BsConst_Temp_Threshold_Hysteresis_Derating_SafeCopy1: nv-provide-com-spec{ram-block-init-value=68, rom-block-init-value=68, variable=Value}, nv-require-com-spec{init-value=68, variable=Value}, provided-required-interface=BsConst_Temp_Threshold_Hysteresis_Derating_SafeCopy1
      BsConst_Temp_Threshold_Hysteresis_Derating_SafeCopy2: nv-provide-com-spec{ram-block-init-value=68, rom-block-init-value=68, variable=Value}, nv-require-com-spec{init-value=68, variable=Value}, provided-required-interface=BsConst_Temp_Threshold_Hysteresis_Derating_SafeCopy2
      BsConst_Temperature_Sensor_Conv: nv-provide-com-spec{ram-block-init-value=[4095, 4095], rom-block-init-value=[4095, 4095], variable=Value}, nv-require-com-spec{init-value=[4095, 4095], variable=Value}, provided-required-interface=BsConst_Temperature_Sensor_Conv
      BsConst_Temperature_Sensor_Conv_SafeCopy1: nv-provide-com-spec{ram-block-init-value=[4095, 4095], rom-block-init-value=[4095, 4095], variable=Value}, nv-require-com-spec{init-value=[4095, 4095], variable=Value}, provided-required-interface=BsConst_Temperature_Sensor_Conv_SafeCopy1
      BsConst_Temperature_Sensor_Conv_SafeCopy2: nv-provide-com-spec{ram-block-init-value=[4095, 4095], rom-block-init-value=[4095, 4095], variable=Value}, nv-require-com-spec{init-value=[4095, 4095], variable=Value}, provided-required-interface=BsConst_Temperature_Sensor_Conv_SafeCopy2
    behavior NvBlockSwComponentType_InternalBehavior
      94 x data received event, all with start-on-event=NvBlockSwComponentTypeRunnable:
        DRT_NvBlockSwComponentTypeRunnable_BsConst_Audio_Element_Value: data=BsConst_Audio_Element.Value
        DRT_NvBlockSwComponentTypeRunnable_BsConst_Communication_Element_Value: data=BsConst_Communication_Element.Value
        DRT_NvBlockSwComponentTypeRunnable_BsConst_EngOffTimer_Element_Value: data=BsConst_EngOffTimer_Element.Value
        DRT_NvBlockSwComponentTypeRunnable_BsConst_FuelGauge_Element_Value: data=BsConst_FuelGauge_Element.Value
        DRT_NvBlockSwComponentTypeRunnable_BsConst_OilGauge_Element_Value: data=BsConst_OilGauge_Element.Value
        DRT_NvBlockSwComponentTypeRunnable_BsConst_PowerGauge_Element_Value: data=BsConst_PowerGauge_Element.Value
        DRT_NvBlockSwComponentTypeRunnable_BsConst_Power_Element_Value: data=BsConst_Power_Element.Value
        DRT_NvBlockSwComponentTypeRunnable_BsConst_RealTimeClock_Element_Value: data=BsConst_RealTimeClock_Element.Value
        DRT_NvBlockSwComponentTypeRunnable_BsConst_ServiceReminder_Element_Value: data=BsConst_ServiceReminder_Element.Value
        DRT_NvBlockSwComponentTypeRunnable_BsConst_SpeedoGauge_Element_Value: data=BsConst_SpeedoGauge_Element.Value
        DRT_NvBlockSwComponentTypeRunnable_BsConst_TachoGauge_Element_Value: data=BsConst_TachoGauge_Element.Value
        DRT_NvBlockSwComponentTypeRunnable_BsConst_TempGauge_Element_Value: data=BsConst_TempGauge_Element.Value
        DRT_NvBlockSwComponentTypeRunnable_BsConst_TripComputer_Element_Value: data=BsConst_TripComputer_Element.Value
        DRT_NvBlockSwComponentTypeRunnable_BsConst_Warning_Element_Value: data=BsConst_Warning_Element.Value
        DRT_NvBlockSwComponentTypeRunnable_BsCys_Certicificate_Element_Value: data=BsCys_Certicificate_Element.Value
        DRT_NvBlockSwComponentTypeRunnable_BsDiag_Dtc_Element_Value: data=BsDiag_Dtc_Element.Value
        DRT_NvBlockSwComponentTypeRunnable_BsDiag_ErrorRecord_Element_Value: data=BsDiag_ErrorRecord_Element.Value
        DRT_NvBlockSwComponentTypeRunnable_BsReten_Audio_Element_Value: data=BsReten_Audio_Element.Value
        DRT_NvBlockSwComponentTypeRunnable_BsReten_Communication_Element_Value: data=BsReten_Communication_Element.Value
        DRT_NvBlockSwComponentTypeRunnable_BsReten_Display_Element_Value: data=BsReten_Display_Element.Value
        DRT_NvBlockSwComponentTypeRunnable_BsReten_Gauges_Element_Value: data=BsReten_Gauges_Element.Value
        DRT_NvBlockSwComponentTypeRunnable_BsReten_Illumination_Element_Value: data=BsReten_Illumination_Element.Value
        DRT_NvBlockSwComponentTypeRunnable_BsReten_Odometer_Element_Value: data=BsReten_Odometer_Element.Value
        DRT_NvBlockSwComponentTypeRunnable_BsReten_Personalization_Element_Value: data=BsReten_Personalization_Element.Value
        DRT_NvBlockSwComponentTypeRunnable_BsReten_Power_Element_Value: data=BsReten_Power_Element.Value
        DRT_NvBlockSwComponentTypeRunnable_BsReten_RealTimeClock_Element_Value: data=BsReten_RealTimeClock_Element.Value
        DRT_NvBlockSwComponentTypeRunnable_BsReten_Tripcomputer_Element_Value: data=BsReten_Tripcomputer_Element.Value
        DRT_NvBlockSwComponentTypeRunnable_BsReten_Warning_Element_Value: data=BsReten_Warning_Element.Value
        DRT_NvBlockSwComponentTypeRunnable_BsRt_CusDlt_Element_Value: data=BsRt_CusDlt_Element.Value
        DRT_NvBlockSwComponentTypeRunnable_BsRt_FuelGauge_Element_Value: data=BsRt_FuelGauge_Element.Value
        DRT_NvBlockSwComponentTypeRunnable_BsRt_Illumination_Element_Value: data=BsRt_Illumination_Element.Value
        DRT_NvBlockSwComponentTypeRunnable_BsRt_Odometer_Element_Value: data=BsRt_Odometer_Element.Value
        DRT_NvBlockSwComponentTypeRunnable_BsRt_OilGauge_Element_Value: data=BsRt_OilGauge_Element.Value
        DRT_NvBlockSwComponentTypeRunnable_BsRt_Personalization_Element_Value: data=BsRt_Personalization_Element.Value
        DRT_NvBlockSwComponentTypeRunnable_BsRt_PowerGauge_Element_Value: data=BsRt_PowerGauge_Element.Value
        DRT_NvBlockSwComponentTypeRunnable_BsRt_RealTimeClock_Element_Value: data=BsRt_RealTimeClock_Element.Value
        DRT_NvBlockSwComponentTypeRunnable_BsRt_SpeedoGauge_Element_Value: data=BsRt_SpeedoGauge_Element.Value
        DRT_NvBlockSwComponentTypeRunnable_BsRt_TachoGauge_Element_Value: data=BsRt_TachoGauge_Element.Value
        DRT_NvBlockSwComponentTypeRunnable_BsRt_TempGauge_Element_Value: data=BsRt_TempGauge_Element.Value
        DRT_NvBlockSwComponentTypeRunnable_BsRt_TripComputer_Element_Value: data=BsRt_TripComputer_Element.Value
        DRT_NvBlockSwComponentTypeRunnable_BsRt_Warning_Element_Value: data=BsRt_Warning_Element.Value
        DRT_NvBlockSwComponentTypeRunnable_BsShare_EcuPartNumber_Element_Value: data=BsShare_EcuPartNumber_Element.Value
        DRT_NvBlockSwComponentTypeRunnable_BsShare_SwUpdFotaFinPrint_Element_Value: data=BsShare_SwUpdFotaFinPrint_Element.Value
        DRT_NvBlockSwComponentTypeRunnable_BsShare_SwUpdFotaMode_Element_Value: data=BsShare_SwUpdFotaMode_Element.Value
        DRT_NvBlockSwComponentTypeRunnable_BsShare_SwUpdFotaStatus_Element_Value: data=BsShare_SwUpdFotaStatus_Element.Value
        DRT_NvBlockSwComponentTypeRunnable_BsShare_SwUpdFotadecrypt_Element_Value: data=BsShare_SwUpdFotadecrypt_Element.Value
        DRT_NvBlockSwComponentTypeRunnable_BsShare_SwUpdReflash_Element_Value: data=BsShare_SwUpdReflash_Element.Value
        DRT_NvBlockSwComponentTypeRunnable_BsShare_VehicleConfig_Element_Value: data=BsShare_VehicleConfig_Element.Value
        DRT_NvBlockSwComponentTypeRunnable_BsShare_VisMeet_Element_Value: data=BsShare_VisMeet_Element.Value
        DRT_NvBlockSwComponentTypeRunnable_RefCys_Certicificate1_Element_Value: data=RefCys_Certicificate1_Element.Value
        DRT_NvBlockSwComponentTypeRunnable_RefCys_Certicificate_Element_Value: data=RefCys_Certicificate_Element.Value
        DRT_NvBlockSwComponentTypeRunnable_BsShare_AssemblyManufacturingDate_Value: data=BsShare_AssemblyManufacturingDate.Value
        DRT_NvBlockSwComponentTypeRunnable_BsShare_AssemblyPlantNumber_Value: data=BsShare_AssemblyPlantNumber.Value
        DRT_NvBlockSwComponentTypeRunnable_BsShare_HWModification_Value: data=BsShare_HWModification.Value
        DRT_NvBlockSwComponentTypeRunnable_BsShare_PCBSerialNumber_Value: data=BsShare_PCBSerialNumber.Value
        DRT_NvBlockSwComponentTypeRunnable_BsShare_ProductSerialNumber_Value: data=BsShare_ProductSerialNumber.Value
        DRT_NvBlockSwComponentTypeRunnable_BsShare_SMTManufacturingDate_Value: data=BsShare_SMTManufacturingDate.Value
        DRT_NvBlockSwComponentTypeRunnable_BsShare_SMTPlantNumber_Value: data=BsShare_SMTPlantNumber.Value
        DRT_NvBlockSwComponentTypeRunnable_BsShare_VisMeet_EOLEntry_Element_Value: data=BsShare_VisMeet_EOLEntry_Element.Value
        DRT_NvBlockSwComponentTypeRunnable_BsShare_VisteonPCBPartNumber_Value: data=BsShare_VisteonPCBPartNumber.Value
        DRT_NvBlockSwComponentTypeRunnable_BsShare_VisteonPartNumber_Value: data=BsShare_VisteonPartNumber.Value
        DRT_NvBlockSwComponentTypeRunnable_BsConst_BsConst_Illumination_ReservedByte_SafeCopy1_Value: data=BsConst_BsConst_Illumination_ReservedByte_SafeCopy1.Value
        DRT_NvBlockSwComponentTypeRunnable_BsConst_BsConst_Illumination_ReservedByte_SafeCopy2_Value: data=BsConst_BsConst_Illumination_ReservedByte_SafeCopy2.Value
        DRT_NvBlockSwComponentTypeRunnable_BsConst_BsConst_Illumination_ReservedByte_Value: data=BsConst_BsConst_Illumination_ReservedByte.Value
        DRT_NvBlockSwComponentTypeRunnable_BsConst_Compensation_Line_Shift_b_SafeCopy1_Value: data=BsConst_Compensation_Line_Shift_b_SafeCopy1.Value
        DRT_NvBlockSwComponentTypeRunnable_BsConst_Compensation_Line_Shift_b_SafeCopy2_Value: data=BsConst_Compensation_Line_Shift_b_SafeCopy2.Value
        DRT_NvBlockSwComponentTypeRunnable_BsConst_Compensation_Line_Shift_b_Value: data=BsConst_Compensation_Line_Shift_b.Value
        DRT_NvBlockSwComponentTypeRunnable_BsConst_Compensation_Line_Slope_m_SafeCopy1_Value: data=BsConst_Compensation_Line_Slope_m_SafeCopy1.Value
        DRT_NvBlockSwComponentTypeRunnable_BsConst_Compensation_Line_Slope_m_SafeCopy2_Value: data=BsConst_Compensation_Line_Slope_m_SafeCopy2.Value
        DRT_NvBlockSwComponentTypeRunnable_BsConst_Compensation_Line_Slope_m_Value: data=BsConst_Compensation_Line_Slope_m.Value
        DRT_NvBlockSwComponentTypeRunnable_BsConst_Derating_Backlight_Disable_SafeCopy1_Value: data=BsConst_Derating_Backlight_Disable_SafeCopy1.Value
        DRT_NvBlockSwComponentTypeRunnable_BsConst_Derating_Backlight_Disable_SafeCopy2_Value: data=BsConst_Derating_Backlight_Disable_SafeCopy2.Value
        DRT_NvBlockSwComponentTypeRunnable_BsConst_Derating_Backlight_Disable_Value: data=BsConst_Derating_Backlight_Disable.Value
        DRT_NvBlockSwComponentTypeRunnable_BsConst_Display_Illum_Max_Level_SafeCopy1_Value: data=BsConst_Display_Illum_Max_Level_SafeCopy1.Value
        DRT_NvBlockSwComponentTypeRunnable_BsConst_Display_Illum_Max_Level_SafeCopy2_Value: data=BsConst_Display_Illum_Max_Level_SafeCopy2.Value
        DRT_NvBlockSwComponentTypeRunnable_BsConst_Display_Illum_Max_Level_Value: data=BsConst_Display_Illum_Max_Level.Value
        DRT_NvBlockSwComponentTypeRunnable_BsConst_Lookup_Curve_HotSpot_Coef_X_SafeCopy1_Value: data=BsConst_Lookup_Curve_HotSpot_Coef_X_SafeCopy1.Value
        DRT_NvBlockSwComponentTypeRunnable_BsConst_Lookup_Curve_HotSpot_Coef_X_SafeCopy2_Value: data=BsConst_Lookup_Curve_HotSpot_Coef_X_SafeCopy2.Value
        DRT_NvBlockSwComponentTypeRunnable_BsConst_Lookup_Curve_HotSpot_Coef_X_Value: data=BsConst_Lookup_Curve_HotSpot_Coef_X.Value
        DRT_NvBlockSwComponentTypeRunnable_BsConst_Lookup_Curve_HotSpot_Coef_Y_SafeCopy1_Value: data=BsConst_Lookup_Curve_HotSpot_Coef_Y_SafeCopy1.Value
        DRT_NvBlockSwComponentTypeRunnable_BsConst_Lookup_Curve_HotSpot_Coef_Y_SafeCopy2_Value: data=BsConst_Lookup_Curve_HotSpot_Coef_Y_SafeCopy2.Value
        DRT_NvBlockSwComponentTypeRunnable_BsConst_Lookup_Curve_HotSpot_Coef_Y_Value: data=BsConst_Lookup_Curve_HotSpot_Coef_Y.Value
        DRT_NvBlockSwComponentTypeRunnable_BsConst_PCB_Temperature_Sensor_Conv_SafeCopy1_Value: data=BsConst_PCB_Temperature_Sensor_Conv_SafeCopy1.Value
        DRT_NvBlockSwComponentTypeRunnable_BsConst_PCB_Temperature_Sensor_Conv_SafeCopy2_Value: data=BsConst_PCB_Temperature_Sensor_Conv_SafeCopy2.Value
        DRT_NvBlockSwComponentTypeRunnable_BsConst_PCB_Temperature_Sensor_Conv_Value: data=BsConst_PCB_Temperature_Sensor_Conv.Value
        DRT_NvBlockSwComponentTypeRunnable_BsConst_PWM_boost_bypass_duty_SafeCopy1_Value: data=BsConst_PWM_boost_bypass_duty_SafeCopy1.Value
        DRT_NvBlockSwComponentTypeRunnable_BsConst_PWM_boost_bypass_duty_SafeCopy2_Value: data=BsConst_PWM_boost_bypass_duty_SafeCopy2.Value
        DRT_NvBlockSwComponentTypeRunnable_BsConst_PWM_boost_bypass_duty_Value: data=BsConst_PWM_boost_bypass_duty.Value
        DRT_NvBlockSwComponentTypeRunnable_BsConst_Temp_Threshold_Hysteresis_Derating_SafeCopy1_Value: data=BsConst_Temp_Threshold_Hysteresis_Derating_SafeCopy1.Value
        DRT_NvBlockSwComponentTypeRunnable_BsConst_Temp_Threshold_Hysteresis_Derating_SafeCopy2_Value: data=BsConst_Temp_Threshold_Hysteresis_Derating_SafeCopy2.Value
        DRT_NvBlockSwComponentTypeRunnable_BsConst_Temp_Threshold_Hysteresis_Derating_Value: data=BsConst_Temp_Threshold_Hysteresis_Derating.Value
        DRT_NvBlockSwComponentTypeRunnable_BsConst_Temperature_Sensor_Conv_SafeCopy1_Value: data=BsConst_Temperature_Sensor_Conv_SafeCopy1.Value
        DRT_NvBlockSwComponentTypeRunnable_BsConst_Temperature_Sensor_Conv_SafeCopy2_Value: data=BsConst_Temperature_Sensor_Conv_SafeCopy2.Value
        DRT_NvBlockSwComponentTypeRunnable_BsConst_Temperature_Sensor_Conv_Value: data=BsConst_Temperature_Sensor_Conv.Value
      runnable NvBlockSwComponentTypeRunnable
    54 x nv block descriptor, all with support-dirty-flag=true:
      NVBlockDescriptor_BsConst_Audio: nv-block-data-mapping{nv-ram-block-element=autosar-variable-in-impl-datatype={root-variable-data-prototype=RAM_NVBlockDescriptor_BsConst_Audio, target-data-prototype=BsConst_Audio_Element}, written-read-nv-data=BsConst_Audio_Element.Value}
        nv block needs NVNeed_NVBlockDescriptor: n-data-sets=2, ram-block-status-control=API, reliability=NO-PROTECTION, restore-at-start=true, store-at-shutdown=false, store-immediate=true, write-verification=false
        ram block RAM_NVBlockDescriptor_BsConst_Audio: type=NV_Data_BsConst_Audio, init-value=fields=BsConst_Audio_Element:128 x 0
        rom block ROM_NVBlockDescriptor_BsConst_Audio: sw-calibration-access=READ-WRITE, type=NV_Data_BsConst_Audio, init-value=fields=BsConst_Audio_Element:128 x 0
      NVBlockDescriptor_BsConst_Communication: nv-block-data-mapping{nv-ram-block-element=autosar-variable-in-impl-datatype={root-variable-data-prototype=RAM_NVBlockDescriptor_BsConst_Communication, target-data-prototype=BsConst_Communication_Element}, written-read-nv-data=BsConst_Communication_Element.Value}
        nv block needs NVNeed_NVBlockDescriptor: n-data-sets=2, ram-block-status-control=API, reliability=NO-PROTECTION, restore-at-start=true, store-at-shutdown=false, store-immediate=true, write-verification=false
        ram block RAM_NVBlockDescriptor_BsConst_Communication: type=NV_Data_BsConst_Communication, init-value=fields=BsConst_Communication_Element:64 x 0
        rom block ROM_NVBlockDescriptor_BsConst_Communication: sw-calibration-access=READ-WRITE, type=NV_Data_BsConst_Communication, init-value=fields=BsConst_Communication_Element:64 x 0
      NVBlockDescriptor_BsConst_EngOffTimer: nv-block-data-mapping{nv-ram-block-element=autosar-variable-in-impl-datatype={root-variable-data-prototype=RAM_NVBlockDescriptor_BsConst_EngOffTimer, target-data-prototype=BsConst_EngOffTimer_Element}, written-read-nv-data=BsConst_EngOffTimer_Element.Value}
        nv block needs NVNeed_NVBlockDescriptor: n-data-sets=2, ram-block-status-control=API, reliability=NO-PROTECTION, restore-at-start=true, store-at-shutdown=false, store-immediate=true, write-verification=false
        ram block RAM_NVBlockDescriptor_BsConst_EngOffTimer: type=NV_Data_BsConst_EngOffTimer, init-value=fields=BsConst_EngOffTimer_Element:32 x 0
        rom block ROM_NVBlockDescriptor_BsConst_EngOffTimer: sw-calibration-access=READ-WRITE, type=NV_Data_BsConst_EngOffTimer, init-value=fields=BsConst_EngOffTimer_Element:32 x 0
      NVBlockDescriptor_BsConst_FuelGauge: nv-block-data-mapping{nv-ram-block-element=autosar-variable-in-impl-datatype={root-variable-data-prototype=RAM_NVBlockDescriptor_BsConst_FuelGauge, target-data-prototype=BsConst_FuelGauge_Element}, written-read-nv-data=BsConst_FuelGauge_Element.Value}
        nv block needs NVNeed_NVBlockDescriptor: n-data-sets=2, ram-block-status-control=API, reliability=NO-PROTECTION, restore-at-start=true, store-at-shutdown=false, store-immediate=true, write-verification=false
        ram block RAM_NVBlockDescriptor_BsConst_FuelGauge: type=NV_Data_BsConst_FuelGauge, init-value=fields=BsConst_FuelGauge_Element:128 x 0
        rom block ROM_NVBlockDescriptor_BsConst_FuelGauge: sw-calibration-access=READ-WRITE, type=NV_Data_BsConst_FuelGauge, init-value=fields=BsConst_FuelGauge_Element:128 x 0
      NVBlockDescriptor_BsConst_OilGauge: nv-block-data-mapping{nv-ram-block-element=autosar-variable-in-impl-datatype={root-variable-data-prototype=RAM_NVBlockDescriptor_BsConst_OilGauge, target-data-prototype=BsConst_OilGauge_Element}, written-read-nv-data=BsConst_OilGauge_Element.Value}
        nv block needs NVNeed_NVBlockDescriptor: n-data-sets=2, ram-block-status-control=API, reliability=NO-PROTECTION, restore-at-start=true, store-at-shutdown=false, store-immediate=true, write-verification=false
        ram block RAM_NVBlockDescriptor_BsConst_OilGauge: type=NV_Data_BsConst_OilGauge, init-value=fields=BsConst_OilGauge_Element:64 x 0
        rom block ROM_NVBlockDescriptor_BsConst_OilGauge: sw-calibration-access=READ-WRITE, type=NV_Data_BsConst_OilGauge, init-value=fields=BsConst_OilGauge_Element:64 x 0
      NVBlockDescriptor_BsConst_Power: nv-block-data-mapping{nv-ram-block-element=autosar-variable-in-impl-datatype={root-variable-data-prototype=RAM_NVBlockDescriptor_BsConst_Power, target-data-prototype=BsConst_Power_Element}, written-read-nv-data=BsConst_Power_Element.Value}
        nv block needs NVNeed_NVBlockDescriptor: n-data-sets=2, ram-block-status-control=API, reliability=NO-PROTECTION, restore-at-start=true, store-at-shutdown=false, store-immediate=true, write-verification=false
        ram block RAM_NVBlockDescriptor_BsConst_Power: type=NV_Data_BsConst_Power, init-value=fields=BsConst_Power_Element:32 x 0
        rom block ROM_NVBlockDescriptor_BsConst_Power: sw-calibration-access=READ-WRITE, type=NV_Data_BsConst_Power, init-value=fields=BsConst_Power_Element:32 x 0
      NVBlockDescriptor_BsConst_PowerGauge: nv-block-data-mapping{nv-ram-block-element=autosar-variable-in-impl-datatype={root-variable-data-prototype=RAM_NVBlockDescriptor_BsConst_PowerGauge, target-data-prototype=BsConst_PowerGauge_Element}, written-read-nv-data=BsConst_PowerGauge_Element.Value}
        nv block needs NVNeed_NVBlockDescriptor: n-data-sets=2, ram-block-status-control=API, reliability=NO-PROTECTION, restore-at-start=true, store-at-shutdown=false, store-immediate=true, write-verification=false
        ram block RAM_NVBlockDescriptor_BsConst_PowerGauge: type=NV_Data_BsConst_PowerGauge, init-value=fields=BsConst_PowerGauge_Element:64 x 0
        rom block ROM_NVBlockDescriptor_BsConst_PowerGauge: sw-calibration-access=READ-WRITE, type=NV_Data_BsConst_PowerGauge, init-value=fields=BsConst_PowerGauge_Element:64 x 0
      NVBlockDescriptor_BsConst_RealTimeClock: nv-block-data-mapping{nv-ram-block-element=autosar-variable-in-impl-datatype={root-variable-data-prototype=RAM_NVBlockDescriptor_BsConst_RealTimeClock, target-data-prototype=BsConst_RealTimeClock_Element}, written-read-nv-data=BsConst_RealTimeClock_Element.Value}
        nv block needs NVNeed_NVBlockDescriptor: n-data-sets=2, ram-block-status-control=API, reliability=NO-PROTECTION, restore-at-start=true, store-at-shutdown=false, store-immediate=true, write-verification=false
        ram block RAM_NVBlockDescriptor_BsConst_RealTimeClock: type=NV_Data_BsConst_RealTimeClock, init-value=fields=BsConst_RealTimeClock_Element:48 x 0
        rom block ROM_NVBlockDescriptor_BsConst_RealTimeClock: sw-calibration-access=READ-WRITE, type=NV_Data_BsConst_RealTimeClock, init-value=fields=BsConst_RealTimeClock_Element:48 x 0
      NVBlockDescriptor_BsConst_ServiceReminder: nv-block-data-mapping{nv-ram-block-element=autosar-variable-in-impl-datatype={root-variable-data-prototype=RAM_NVBlockDescriptor_BsConst_ServiceReminder, target-data-prototype=BsConst_ServiceReminder_Element}, written-read-nv-data=BsConst_ServiceReminder_Element.Value}
        nv block needs NVNeed_NVBlockDescriptor: n-data-sets=2, ram-block-status-control=API, reliability=NO-PROTECTION, restore-at-start=true, store-at-shutdown=false, store-immediate=true, write-verification=false
        ram block RAM_NVBlockDescriptor_BsConst_ServiceReminder: type=NV_Data_BsConst_ServiceReminder, init-value=fields=BsConst_ServiceReminder_Element:48 x 0
        rom block ROM_NVBlockDescriptor_BsConst_ServiceReminder: sw-calibration-access=READ-WRITE, type=NV_Data_BsConst_ServiceReminder, init-value=fields=BsConst_ServiceReminder_Element:48 x 0
      NVBlockDescriptor_BsConst_SpeedoGauge: nv-block-data-mapping{nv-ram-block-element=autosar-variable-in-impl-datatype={root-variable-data-prototype=RAM_NVBlockDescriptor_BsConst_SpeedoGauge, target-data-prototype=BsConst_SpeedoGauge_Element}, written-read-nv-data=BsConst_SpeedoGauge_Element.Value}
        nv block needs NVNeed_NVBlockDescriptor: n-data-sets=2, ram-block-status-control=API, reliability=NO-PROTECTION, restore-at-start=true, store-at-shutdown=false, store-immediate=true, write-verification=false
        ram block RAM_NVBlockDescriptor_BsConst_SpeedoGauge: type=NV_Data_BsConst_SpeedoGauge, init-value=fields=BsConst_SpeedoGauge_Element:64 x 0
        rom block ROM_NVBlockDescriptor_BsConst_SpeedoGauge: sw-calibration-access=READ-WRITE, type=NV_Data_BsConst_SpeedoGauge, init-value=fields=BsConst_SpeedoGauge_Element:64 x 0
      NVBlockDescriptor_BsConst_TachoGauge: nv-block-data-mapping{nv-ram-block-element=autosar-variable-in-impl-datatype={root-variable-data-prototype=RAM_NVBlockDescriptor_BsConst_TachoGauge, target-data-prototype=BsConst_TachoGauge_Element}, written-read-nv-data=BsConst_TachoGauge_Element.Value}
        nv block needs NVNeed_NVBlockDescriptor: n-data-sets=2, ram-block-status-control=API, reliability=NO-PROTECTION, restore-at-start=true, store-at-shutdown=false, store-immediate=true, write-verification=false
        ram block RAM_NVBlockDescriptor_BsConst_TachoGauge: type=NV_Data_BsConst_TachoGauge, init-value=fields=BsConst_TachoGauge_Element:64 x 0
        rom block ROM_NVBlockDescriptor_BsConst_TachoGauge: sw-calibration-access=READ-WRITE, type=NV_Data_BsConst_TachoGauge, init-value=fields=BsConst_TachoGauge_Element:64 x 0
      NVBlockDescriptor_BsConst_TempGauge: nv-block-data-mapping{nv-ram-block-element=autosar-variable-in-impl-datatype={root-variable-data-prototype=RAM_NVBlockDescriptor_BsConst_TempGauge, target-data-prototype=BsConst_TempGauge_Element}, written-read-nv-data=BsConst_TempGauge_Element.Value}
        nv block needs NVNeed_NVBlockDescriptor: n-data-sets=2, ram-block-status-control=API, reliability=NO-PROTECTION, restore-at-start=true, store-at-shutdown=false, store-immediate=true, write-verification=false
        ram block RAM_NVBlockDescriptor_BsConst_TempGauge: type=NV_Data_BsConst_TempGauge, init-value=fields=BsConst_TempGauge_Element:64 x 0
        rom block ROM_NVBlockDescriptor_BsConst_TempGauge: sw-calibration-access=READ-WRITE, type=NV_Data_BsConst_TempGauge, init-value=fields=BsConst_TempGauge_Element:64 x 0
      NVBlockDescriptor_BsConst_TripComputer: nv-block-data-mapping{nv-ram-block-element=autosar-variable-in-impl-datatype={root-variable-data-prototype=RAM_NVBlockDescriptor_BsConst_TripComputer, target-data-prototype=BsConst_TripComputer_Element}, written-read-nv-data=BsConst_TripComputer_Element.Value}
        nv block needs NVNeed_NVBlockDescriptor: n-data-sets=2, ram-block-status-control=API, reliability=NO-PROTECTION, restore-at-start=true, store-at-shutdown=false, store-immediate=true, write-verification=false
        ram block RAM_NVBlockDescriptor_BsConst_TripComputer: type=NV_Data_BsConst_TripComputer, init-value=fields=BsConst_TripComputer_Element:64 x 0
        rom block ROM_NVBlockDescriptor_BsConst_TripComputer: sw-calibration-access=READ-WRITE, type=NV_Data_BsConst_TripComputer, init-value=fields=BsConst_TripComputer_Element:64 x 0
      NVBlockDescriptor_BsConst_Warning: nv-block-data-mapping{nv-ram-block-element=autosar-variable-in-impl-datatype={root-variable-data-prototype=RAM_NVBlockDescriptor_BsConst_Warning, target-data-prototype=BsConst_Warning_Element}, written-read-nv-data=BsConst_Warning_Element.Value}
        nv block needs NVNeed_NVBlockDescriptor: n-data-sets=2, ram-block-status-control=API, reliability=NO-PROTECTION, restore-at-start=true, store-at-shutdown=false, store-immediate=true, write-verification=false
        ram block RAM_NVBlockDescriptor_BsConst_Warning: type=NV_Data_BsConst_Warning, init-value=fields=BsConst_Warning_Element:64 x 0
        rom block ROM_NVBlockDescriptor_BsConst_Warning: sw-calibration-access=READ-WRITE, type=NV_Data_BsConst_Warning, init-value=fields=BsConst_Warning_Element:64 x 0
      NVBlockDescriptor_BsCys_Certicificate: nv-block-data-mapping{nv-ram-block-element=autosar-variable-in-impl-datatype={root-variable-data-prototype=RAM_NVBlockDescriptor_BsCys_Certicificate, target-data-prototype=BsCys_Certicificate_Element}, written-read-nv-data=BsCys_Certicificate_Element.Value}
        nv block needs NVNeed_NVBlockDescriptor: n-data-sets=2, ram-block-status-control=API, reliability=NO-PROTECTION, restore-at-start=true, store-at-shutdown=false, store-immediate=true, write-verification=false
        ram block RAM_NVBlockDescriptor_BsCys_Certicificate: type=NV_Data_BsCys_Certicificate, init-value=fields=BsCys_Certicificate_Element:64 x 0
        rom block ROM_NVBlockDescriptor_BsCys_Certicificate: sw-calibration-access=READ-WRITE, type=NV_Data_BsCys_Certicificate, init-value=fields=BsCys_Certicificate_Element:64 x 0
      NVBlockDescriptor_BsDiag_Dtc: nv-block-data-mapping{nv-ram-block-element=autosar-variable-in-impl-datatype={root-variable-data-prototype=RAM_NVBlockDescriptor_BsDiag_Dtc, target-data-prototype=BsDiag_Dtc_Element}, written-read-nv-data=BsDiag_Dtc_Element.Value}
        nv block needs NVNeed_NVBlockDescriptor: n-data-sets=2, ram-block-status-control=API, reliability=NO-PROTECTION, restore-at-start=true, store-at-shutdown=false, store-immediate=true, write-verification=false
        ram block RAM_NVBlockDescriptor_BsDiag_Dtc: type=NV_Data_BsDiag_Dtc, init-value=fields=BsDiag_Dtc_Element:2048 x 0
        rom block ROM_NVBlockDescriptor_BsDiag_Dtc: sw-calibration-access=READ-WRITE, type=NV_Data_BsDiag_Dtc, init-value=fields=BsDiag_Dtc_Element:2048 x 0
      NVBlockDescriptor_BsDiag_ErrorRecord: nv-block-data-mapping{nv-ram-block-element=autosar-variable-in-impl-datatype={root-variable-data-prototype=RAM_NVBlockDescriptor_BsDiag_ErrorRecord, target-data-prototype=BsDiag_ErrorRecord_Element}, written-read-nv-data=BsDiag_ErrorRecord_Element.Value}
        nv block needs NVNeed_NVBlockDescriptor: n-data-sets=2, ram-block-status-control=API, reliability=NO-PROTECTION, restore-at-start=true, store-at-shutdown=false, store-immediate=true, write-verification=false
        ram block RAM_NVBlockDescriptor_BsDiag_ErrorRecord: type=NV_Data_BsDiag_ErrorRecord, init-value=fields=BsDiag_ErrorRecord_Element:1024 x 0
        rom block ROM_NVBlockDescriptor_BsDiag_ErrorRecord: sw-calibration-access=READ-WRITE, type=NV_Data_BsDiag_ErrorRecord, init-value=fields=BsDiag_ErrorRecord_Element:1024 x 0
      NVBlockDescriptor_BsReten_Audio: nv-block-data-mapping{nv-ram-block-element=autosar-variable-in-impl-datatype={root-variable-data-prototype=RAM_NVBlockDescriptor_BsReten_Audio, target-data-prototype=BsReten_Audio_Element}, written-read-nv-data=BsReten_Audio_Element.Value}
        nv block needs NVNeed_NVBlockDescriptor: n-data-sets=2, ram-block-status-control=API, reliability=NO-PROTECTION, restore-at-start=true, store-at-shutdown=false, store-immediate=true, write-verification=false
        ram block RAM_NVBlockDescriptor_BsReten_Audio: type=NV_Data_BsReten_Audio, init-value=fields=BsReten_Audio_Element:100 x 0
        rom block ROM_NVBlockDescriptor_BsReten_Audio: sw-calibration-access=READ-WRITE, type=NV_Data_BsReten_Audio, init-value=fields=BsReten_Audio_Element:100 x 0
      NVBlockDescriptor_BsReten_Communication: nv-block-data-mapping{nv-ram-block-element=autosar-variable-in-impl-datatype={root-variable-data-prototype=RAM_NVBlockDescriptor_BsReten_Communication, target-data-prototype=BsReten_Communication_Element}, written-read-nv-data=BsReten_Communication_Element.Value}
        nv block needs NVNeed_NVBlockDescriptor: n-data-sets=2, ram-block-status-control=API, reliability=NO-PROTECTION, restore-at-start=true, store-at-shutdown=false, store-immediate=true, write-verification=false
        ram block RAM_NVBlockDescriptor_BsReten_Communication: type=NV_Data_BsReten_Communication, init-value=fields=BsReten_Communication_Element:100 x 0
        rom block ROM_NVBlockDescriptor_BsReten_Communication: sw-calibration-access=READ-WRITE, type=NV_Data_BsReten_Communication, init-value=fields=BsReten_Communication_Element:100 x 0
      NVBlockDescriptor_BsReten_Display: nv-block-data-mapping{nv-ram-block-element=autosar-variable-in-impl-datatype={root-variable-data-prototype=RAM_NVBlockDescriptor_BsReten_Display, target-data-prototype=BsReten_Display_Element}, written-read-nv-data=BsReten_Display_Element.Value}
        nv block needs NVNeed_NVBlockDescriptor: n-data-sets=2, ram-block-status-control=API, reliability=NO-PROTECTION, restore-at-start=true, store-at-shutdown=false, store-immediate=true, write-verification=false
        ram block RAM_NVBlockDescriptor_BsReten_Display: type=NV_Data_BsReten_Display, init-value=fields=BsReten_Display_Element:100 x 0
        rom block ROM_NVBlockDescriptor_BsReten_Display: sw-calibration-access=READ-WRITE, type=NV_Data_BsReten_Display, init-value=fields=BsReten_Display_Element:100 x 0
      NVBlockDescriptor_BsReten_Gauges: nv-block-data-mapping{nv-ram-block-element=autosar-variable-in-impl-datatype={root-variable-data-prototype=RAM_NVBlockDescriptor_BsReten_Gauges, target-data-prototype=BsReten_Gauges_Element}, written-read-nv-data=BsReten_Gauges_Element.Value}
        nv block needs NVNeed_NVBlockDescriptor: n-data-sets=2, ram-block-status-control=API, reliability=NO-PROTECTION, restore-at-start=true, store-at-shutdown=false, store-immediate=true, write-verification=false
        ram block RAM_NVBlockDescriptor_BsReten_Gauges: type=NV_Data_BsReten_Gauges, init-value=fields=BsReten_Gauges_Element:100 x 0
        rom block ROM_NVBlockDescriptor_BsReten_Gauges: sw-calibration-access=READ-WRITE, type=NV_Data_BsReten_Gauges, init-value=fields=BsReten_Gauges_Element:100 x 0
      NVBlockDescriptor_BsReten_Illumination: nv-block-data-mapping{nv-ram-block-element=autosar-variable-in-impl-datatype={root-variable-data-prototype=RAM_NVBlockDescriptor_BsReten_Illumination, target-data-prototype=BsReten_Illumination_Element}, written-read-nv-data=BsReten_Illumination_Element.Value}
        nv block needs NVNeed_NVBlockDescriptor: n-data-sets=2, ram-block-status-control=API, reliability=NO-PROTECTION, restore-at-start=true, store-at-shutdown=false, store-immediate=true, write-verification=false
        ram block RAM_NVBlockDescriptor_BsReten_Illumination: type=NV_Data_BsReten_Illumination, init-value=fields=BsReten_Illumination_Element:100 x 0
        rom block ROM_NVBlockDescriptor_BsReten_Illumination: sw-calibration-access=READ-WRITE, type=NV_Data_BsReten_Illumination, init-value=fields=BsReten_Illumination_Element:100 x 0
      NVBlockDescriptor_BsReten_Odometer: nv-block-data-mapping{nv-ram-block-element=autosar-variable-in-impl-datatype={root-variable-data-prototype=RAM_NVBlockDescriptor_BsReten_Odometer, target-data-prototype=BsReten_Odometer_Element}, written-read-nv-data=BsReten_Odometer_Element.Value}
        nv block needs NVNeed_NVBlockDescriptor: n-data-sets=2, ram-block-status-control=API, reliability=NO-PROTECTION, restore-at-start=true, store-at-shutdown=false, store-immediate=true, write-verification=false
        ram block RAM_NVBlockDescriptor_BsReten_Odometer: type=NV_Data_BsReten_Odometer, init-value=fields=BsReten_Odometer_Element:100 x 0
        rom block ROM_NVBlockDescriptor_BsReten_Odometer: sw-calibration-access=READ-WRITE, type=NV_Data_BsReten_Odometer, init-value=fields=BsReten_Odometer_Element:100 x 0
      NVBlockDescriptor_BsReten_Personalization: nv-block-data-mapping{nv-ram-block-element=autosar-variable-in-impl-datatype={root-variable-data-prototype=RAM_NVBlockDescriptor_BsReten_Personalization, target-data-prototype=BsReten_Personalization_Element}, written-read-nv-data=BsReten_Personalization_Element.Value}
        nv block needs NVNeed_NVBlockDescriptor: n-data-sets=2, ram-block-status-control=API, reliability=NO-PROTECTION, restore-at-start=true, store-at-shutdown=false, store-immediate=true, write-verification=false
        ram block RAM_NVBlockDescriptor_BsReten_Personalization: type=NV_Data_BsReten_Personalization, init-value=fields=BsReten_Personalization_Element:100 x 0
        rom block ROM_NVBlockDescriptor_BsReten_Personalization: sw-calibration-access=READ-WRITE, type=NV_Data_BsReten_Personalization, init-value=fields=BsReten_Personalization_Element:100 x 0
      NVBlockDescriptor_BsReten_Power: nv-block-data-mapping{nv-ram-block-element=autosar-variable-in-impl-datatype={root-variable-data-prototype=RAM_NVBlockDescriptor_BsReten_Power, target-data-prototype=BsReten_Power_Element}, written-read-nv-data=BsReten_Power_Element.Value}
        nv block needs NVNeed_NVBlockDescriptor: n-data-sets=2, ram-block-status-control=API, reliability=NO-PROTECTION, restore-at-start=true, store-at-shutdown=false, store-immediate=true, write-verification=false
        ram block RAM_NVBlockDescriptor_BsReten_Power: type=NV_Data_BsReten_Power, init-value=fields=BsReten_Power_Element:100 x 0
        rom block ROM_NVBlockDescriptor_BsReten_Power: sw-calibration-access=READ-WRITE, type=NV_Data_BsReten_Power, init-value=fields=BsReten_Power_Element:100 x 0
      NVBlockDescriptor_BsReten_RealTimeClock: nv-block-data-mapping{nv-ram-block-element=autosar-variable-in-impl-datatype={root-variable-data-prototype=RAM_NVBlockDescriptor_BsReten_RealTimeClock, target-data-prototype=BsReten_RealTimeClock_Element}, written-read-nv-data=BsReten_RealTimeClock_Element.Value}
        nv block needs NVNeed_NVBlockDescriptor: n-data-sets=2, ram-block-status-control=API, reliability=NO-PROTECTION, restore-at-start=true, store-at-shutdown=false, store-immediate=true, write-verification=false
        ram block RAM_NVBlockDescriptor_BsReten_RealTimeClock: type=NV_Data_BsReten_RealTimeClock, init-value=fields=BsReten_RealTimeClock_Element:100 x 0
        rom block ROM_NVBlockDescriptor_BsReten_RealTimeClock: sw-calibration-access=READ-WRITE, type=NV_Data_BsReten_RealTimeClock, init-value=fields=BsReten_RealTimeClock_Element:100 x 0
      NVBlockDescriptor_BsReten_Tripcomputer: nv-block-data-mapping{nv-ram-block-element=autosar-variable-in-impl-datatype={root-variable-data-prototype=RAM_NVBlockDescriptor_BsReten_Tripcomputer, target-data-prototype=BsReten_Tripcomputer_Element}, written-read-nv-data=BsReten_Tripcomputer_Element.Value}
        nv block needs NVNeed_NVBlockDescriptor: n-data-sets=2, ram-block-status-control=API, reliability=NO-PROTECTION, restore-at-start=true, store-at-shutdown=false, store-immediate=true, write-verification=false
        ram block RAM_NVBlockDescriptor_BsReten_Tripcomputer: type=NV_Data_BsReten_Tripcomputer, init-value=fields=BsReten_Tripcomputer_Element:100 x 0
        rom block ROM_NVBlockDescriptor_BsReten_Tripcomputer: sw-calibration-access=READ-WRITE, type=NV_Data_BsReten_Tripcomputer, init-value=fields=BsReten_Tripcomputer_Element:100 x 0
      NVBlockDescriptor_BsReten_Warning: nv-block-data-mapping{nv-ram-block-element=autosar-variable-in-impl-datatype={root-variable-data-prototype=RAM_NVBlockDescriptor_BsReten_Warning, target-data-prototype=BsReten_Warning_Element}, written-read-nv-data=BsReten_Warning_Element.Value}
        nv block needs NVNeed_NVBlockDescriptor: n-data-sets=2, ram-block-status-control=API, reliability=NO-PROTECTION, restore-at-start=true, store-at-shutdown=false, store-immediate=true, write-verification=false
        ram block RAM_NVBlockDescriptor_BsReten_Warning: type=NV_Data_BsReten_Warning, init-value=fields=BsReten_Warning_Element:100 x 0
        rom block ROM_NVBlockDescriptor_BsReten_Warning: sw-calibration-access=READ-WRITE, type=NV_Data_BsReten_Warning, init-value=fields=BsReten_Warning_Element:100 x 0
      NVBlockDescriptor_BsRt_CusDlt: nv-block-data-mapping{nv-ram-block-element=autosar-variable-in-impl-datatype={root-variable-data-prototype=RAM_NVBlockDescriptor_BsRt_CusDlt, target-data-prototype=BsRt_CusDlt_Element}, written-read-nv-data=BsRt_CusDlt_Element.Value}
        nv block needs NVNeed_NVBlockDescriptor: n-data-sets=2, ram-block-status-control=API, reliability=NO-PROTECTION, restore-at-start=true, store-at-shutdown=false, store-immediate=true, write-verification=false
        ram block RAM_NVBlockDescriptor_BsRt_CusDlt: type=NV_Data_BsRt_CusDlt, init-value=fields=BsRt_CusDlt_Element:128 x 0
        rom block ROM_NVBlockDescriptor_BsRt_CusDlt: sw-calibration-access=READ-WRITE, type=NV_Data_BsRt_CusDlt, init-value=fields=BsRt_CusDlt_Element:128 x 0
      NVBlockDescriptor_BsRt_FuelGauge: nv-block-data-mapping{nv-ram-block-element=autosar-variable-in-impl-datatype={root-variable-data-prototype=RAM_NVBlockDescriptor_BsRt_FuelGauge, target-data-prototype=BsRt_FuelGauge_Element}, written-read-nv-data=BsRt_FuelGauge_Element.Value}
        nv block needs NVNeed_NVBlockDescriptor: n-data-sets=2, ram-block-status-control=API, reliability=NO-PROTECTION, restore-at-start=true, store-at-shutdown=false, store-immediate=true, write-verification=false
        ram block RAM_NVBlockDescriptor_BsRt_FuelGauge: type=NV_Data_BsRt_FuelGauge, init-value=fields=BsRt_FuelGauge_Element:32 x 0
        rom block ROM_NVBlockDescriptor_BsRt_FuelGauge: sw-calibration-access=READ-WRITE, type=NV_Data_BsRt_FuelGauge, init-value=fields=BsRt_FuelGauge_Element:32 x 0
      NVBlockDescriptor_BsRt_Illumination: nv-block-data-mapping{nv-ram-block-element=autosar-variable-in-impl-datatype={root-variable-data-prototype=RAM_NVBlockDescriptor_BsRt_Illumination, target-data-prototype=BsRt_Illumination_Element}, written-read-nv-data=BsRt_Illumination_Element.Value}
        nv block needs NVNeed_NVBlockDescriptor: n-data-sets=2, ram-block-status-control=API, reliability=NO-PROTECTION, restore-at-start=true, store-at-shutdown=false, store-immediate=true, write-verification=false
        ram block RAM_NVBlockDescriptor_BsRt_Illumination: type=NV_Data_BsRt_Illumination, init-value=fields=BsRt_Illumination_Element:100 x 0
        rom block ROM_NVBlockDescriptor_BsRt_Illumination: sw-calibration-access=READ-WRITE, type=NV_Data_BsRt_Illumination, init-value=fields=BsRt_Illumination_Element:100 x 0
      NVBlockDescriptor_BsRt_Odometer: nv-block-data-mapping{nv-ram-block-element=autosar-variable-in-impl-datatype={root-variable-data-prototype=RAM_NVBlockDescriptor_BsRt_Odometer, target-data-prototype=BsRt_Odometer_Element}, written-read-nv-data=BsRt_Odometer_Element.Value}
        nv block needs NVNeed_NVBlockDescriptor: n-data-sets=2, ram-block-status-control=API, reliability=NO-PROTECTION, restore-at-start=true, store-at-shutdown=false, store-immediate=true, write-verification=false
        ram block RAM_NVBlockDescriptor_BsRt_Odometer: type=NV_Data_BsRt_Odometer, init-value=fields=BsRt_Odometer_Element:128 x 0
        rom block ROM_NVBlockDescriptor_BsRt_Odometer: sw-calibration-access=READ-WRITE, type=NV_Data_BsRt_Odometer, init-value=fields=BsRt_Odometer_Element:128 x 0
      NVBlockDescriptor_BsRt_OilGauge: nv-block-data-mapping{nv-ram-block-element=autosar-variable-in-impl-datatype={root-variable-data-prototype=RAM_NVBlockDescriptor_BsRt_OilGauge, target-data-prototype=BsRt_OilGauge_Element}, written-read-nv-data=BsRt_OilGauge_Element.Value}
        nv block needs NVNeed_NVBlockDescriptor: n-data-sets=2, ram-block-status-control=API, reliability=NO-PROTECTION, restore-at-start=true, store-at-shutdown=false, store-immediate=true, write-verification=false
        ram block RAM_NVBlockDescriptor_BsRt_OilGauge: type=NV_Data_BsRt_OilGauge, init-value=fields=BsRt_OilGauge_Element:8 x 0
        rom block ROM_NVBlockDescriptor_BsRt_OilGauge: sw-calibration-access=READ-WRITE, type=NV_Data_BsRt_OilGauge, init-value=fields=BsRt_OilGauge_Element:8 x 0
      NVBlockDescriptor_BsRt_Personalization: nv-block-data-mapping{nv-ram-block-element=autosar-variable-in-impl-datatype={root-variable-data-prototype=RAM_NVBlockDescriptor_BsRt_Personalization, target-data-prototype=BsRt_Personalization_Element}, written-read-nv-data=BsRt_Personalization_Element.Value}
        nv block needs NVNeed_NVBlockDescriptor: n-data-sets=2, ram-block-status-control=API, reliability=NO-PROTECTION, restore-at-start=true, store-at-shutdown=false, store-immediate=true, write-verification=false
        ram block RAM_NVBlockDescriptor_BsRt_Personalization: type=NV_Data_BsRt_Personalization, init-value=fields=BsRt_Personalization_Element:128 x 0
        rom block ROM_NVBlockDescriptor_BsRt_Personalization: sw-calibration-access=READ-WRITE, type=NV_Data_BsRt_Personalization, init-value=fields=BsRt_Personalization_Element:128 x 0
      NVBlockDescriptor_BsRt_PowerGauge: nv-block-data-mapping{nv-ram-block-element=autosar-variable-in-impl-datatype={root-variable-data-prototype=RAM_NVBlockDescriptor_BsRt_PowerGauge, target-data-prototype=BsRt_PowerGauge_Element}, written-read-nv-data=BsRt_PowerGauge_Element.Value}
        nv block needs NVNeed_NVBlockDescriptor: n-data-sets=2, ram-block-status-control=API, reliability=NO-PROTECTION, restore-at-start=true, store-at-shutdown=false, store-immediate=true, write-verification=false
        ram block RAM_NVBlockDescriptor_BsRt_PowerGauge: type=NV_Data_BsRt_PowerGauge, init-value=fields=BsRt_PowerGauge_Element:32 x 0
        rom block ROM_NVBlockDescriptor_BsRt_PowerGauge: sw-calibration-access=READ-WRITE, type=NV_Data_BsRt_PowerGauge, init-value=fields=BsRt_PowerGauge_Element:32 x 0
      NVBlockDescriptor_BsRt_RealTimeClock: nv-block-data-mapping{nv-ram-block-element=autosar-variable-in-impl-datatype={root-variable-data-prototype=RAM_NVBlockDescriptor_BsRt_RealTimeClock, target-data-prototype=BsRt_RealTimeClock_Element}, written-read-nv-data=BsRt_RealTimeClock_Element.Value}
        nv block needs NVNeed_NVBlockDescriptor: n-data-sets=2, ram-block-status-control=API, reliability=NO-PROTECTION, restore-at-start=true, store-at-shutdown=false, store-immediate=true, write-verification=false
        ram block RAM_NVBlockDescriptor_BsRt_RealTimeClock: type=NV_Data_BsRt_RealTimeClock, init-value=fields=BsRt_RealTimeClock_Element:48 x 0
        rom block ROM_NVBlockDescriptor_BsRt_RealTimeClock: sw-calibration-access=READ-WRITE, type=NV_Data_BsRt_RealTimeClock, init-value=fields=BsRt_RealTimeClock_Element:48 x 0
      NVBlockDescriptor_BsRt_SpeedoGauge: nv-block-data-mapping{nv-ram-block-element=autosar-variable-in-impl-datatype={root-variable-data-prototype=RAM_NVBlockDescriptor_BsRt_SpeedoGauge, target-data-prototype=BsRt_SpeedoGauge_Element}, written-read-nv-data=BsRt_SpeedoGauge_Element.Value}
        nv block needs NVNeed_NVBlockDescriptor: n-data-sets=2, ram-block-status-control=API, reliability=NO-PROTECTION, restore-at-start=true, store-at-shutdown=false, store-immediate=true, write-verification=false
        ram block RAM_NVBlockDescriptor_BsRt_SpeedoGauge: type=NV_Data_BsRt_SpeedoGauge, init-value=fields=BsRt_SpeedoGauge_Element:8 x 0
        rom block ROM_NVBlockDescriptor_BsRt_SpeedoGauge: sw-calibration-access=READ-WRITE, type=NV_Data_BsRt_SpeedoGauge, init-value=fields=BsRt_SpeedoGauge_Element:8 x 0
      NVBlockDescriptor_BsRt_TachoGauge: nv-block-data-mapping{nv-ram-block-element=autosar-variable-in-impl-datatype={root-variable-data-prototype=RAM_NVBlockDescriptor_BsRt_TachoGauge, target-data-prototype=BsRt_TachoGauge_Element}, written-read-nv-data=BsRt_TachoGauge_Element.Value}
        nv block needs NVNeed_NVBlockDescriptor: n-data-sets=2, ram-block-status-control=API, reliability=NO-PROTECTION, restore-at-start=true, store-at-shutdown=false, store-immediate=true, write-verification=false
        ram block RAM_NVBlockDescriptor_BsRt_TachoGauge: type=NV_Data_BsRt_TachoGauge, init-value=fields=BsRt_TachoGauge_Element:16 x 0
        rom block ROM_NVBlockDescriptor_BsRt_TachoGauge: sw-calibration-access=READ-WRITE, type=NV_Data_BsRt_TachoGauge, init-value=fields=BsRt_TachoGauge_Element:16 x 0
      NVBlockDescriptor_BsRt_TempGauge: nv-block-data-mapping{nv-ram-block-element=autosar-variable-in-impl-datatype={root-variable-data-prototype=RAM_NVBlockDescriptor_BsRt_TempGauge, target-data-prototype=BsRt_TempGauge_Element}, written-read-nv-data=BsRt_TempGauge_Element.Value}
        nv block needs NVNeed_NVBlockDescriptor: n-data-sets=2, ram-block-status-control=API, reliability=NO-PROTECTION, restore-at-start=true, store-at-shutdown=false, store-immediate=true, write-verification=false
        ram block RAM_NVBlockDescriptor_BsRt_TempGauge: type=NV_Data_BsRt_TempGauge, init-value=fields=BsRt_TempGauge_Element:32 x 0
        rom block ROM_NVBlockDescriptor_BsRt_TempGauge: sw-calibration-access=READ-WRITE, type=NV_Data_BsRt_TempGauge, init-value=fields=BsRt_TempGauge_Element:32 x 0
      NVBlockDescriptor_BsRt_TripComputer: nv-block-data-mapping{nv-ram-block-element=autosar-variable-in-impl-datatype={root-variable-data-prototype=RAM_NVBlockDescriptor_BsRt_TripComputer, target-data-prototype=BsRt_TripComputer_Element}, written-read-nv-data=BsRt_TripComputer_Element.Value}
        nv block needs NVNeed_NVBlockDescriptor: n-data-sets=2, ram-block-status-control=API, reliability=NO-PROTECTION, restore-at-start=true, store-at-shutdown=false, store-immediate=true, write-verification=false
        ram block RAM_NVBlockDescriptor_BsRt_TripComputer: type=NV_Data_BsRt_TripComputer, init-value=fields=BsRt_TripComputer_Element:64 x 0
        rom block ROM_NVBlockDescriptor_BsRt_TripComputer: sw-calibration-access=READ-WRITE, type=NV_Data_BsRt_TripComputer, init-value=fields=BsRt_TripComputer_Element:64 x 0
      NVBlockDescriptor_BsRt_Warning: nv-block-data-mapping{nv-ram-block-element=autosar-variable-in-impl-datatype={root-variable-data-prototype=RAM_NVBlockDescriptor_BsRt_Warning, target-data-prototype=BsRt_Warning_Element}, written-read-nv-data=BsRt_Warning_Element.Value}
        nv block needs NVNeed_NVBlockDescriptor: n-data-sets=2, ram-block-status-control=API, reliability=NO-PROTECTION, restore-at-start=true, store-at-shutdown=false, store-immediate=true, write-verification=false
        ram block RAM_NVBlockDescriptor_BsRt_Warning: type=NV_Data_BsRt_Warning, init-value=fields=BsRt_Warning_Element:32 x 0
        rom block ROM_NVBlockDescriptor_BsRt_Warning: sw-calibration-access=READ-WRITE, type=NV_Data_BsRt_Warning, init-value=fields=BsRt_Warning_Element:32 x 0
      NVBlockDescriptor_BsShare_EcuPartNumber
        nv-block-data-mappings:
          {nv-ram-block-element=autosar-variable-in-impl-datatype={root-variable-data-prototype=RAM_NVBlockDescriptor_BsShare_EcuPartNumber, target-data-prototype=BsShare_EcuPartNumber_Element}, written-read-nv-data=BsShare_EcuPartNumber_Element.Value}
          {nv-ram-block-element=autosar-variable-in-impl-datatype={root-variable-data-prototype=RAM_NVBlockDescriptor_BsShare_EcuPartNumber, target-data-prototype=BsShare_VisteonPartNumber}, written-read-nv-data=BsShare_VisteonPartNumber.Value}
          {nv-ram-block-element=autosar-variable-in-impl-datatype={root-variable-data-prototype=RAM_NVBlockDescriptor_BsShare_EcuPartNumber, target-data-prototype=BsShare_VisteonPCBPartNumber}, written-read-nv-data=BsShare_VisteonPCBPartNumber.Value}
          {nv-ram-block-element=autosar-variable-in-impl-datatype={root-variable-data-prototype=RAM_NVBlockDescriptor_BsShare_EcuPartNumber, target-data-prototype=BsShare_ProductSerialNumber}, written-read-nv-data=BsShare_ProductSerialNumber.Value}
          {nv-ram-block-element=autosar-variable-in-impl-datatype={root-variable-data-prototype=RAM_NVBlockDescriptor_BsShare_EcuPartNumber, target-data-prototype=BsShare_PCBSerialNumber}, written-read-nv-data=BsShare_PCBSerialNumber.Value}
          {nv-ram-block-element=autosar-variable-in-impl-datatype={root-variable-data-prototype=RAM_NVBlockDescriptor_BsShare_EcuPartNumber, target-data-prototype=BsShare_SMTManufacturingDate}, written-read-nv-data=BsShare_SMTManufacturingDate.Value}
          {nv-ram-block-element=autosar-variable-in-impl-datatype={root-variable-data-prototype=RAM_NVBlockDescriptor_BsShare_EcuPartNumber, target-data-prototype=BsShare_AssemblyManufacturingDate}, written-read-nv-data=BsShare_AssemblyManufacturingDate.Value}
          {nv-ram-block-element=autosar-variable-in-impl-datatype={root-variable-data-prototype=RAM_NVBlockDescriptor_BsShare_EcuPartNumber, target-data-prototype=BsShare_SMTPlantNumber}, written-read-nv-data=BsShare_SMTPlantNumber.Value}
          {nv-ram-block-element=autosar-variable-in-impl-datatype={root-variable-data-prototype=RAM_NVBlockDescriptor_BsShare_EcuPartNumber, target-data-prototype=BsShare_AssemblyPlantNumber}, written-read-nv-data=BsShare_AssemblyPlantNumber.Value}
          {nv-ram-block-element=autosar-variable-in-impl-datatype={root-variable-data-prototype=RAM_NVBlockDescriptor_BsShare_EcuPartNumber, target-data-prototype=BsShare_HWModification}, written-read-nv-data=BsShare_HWModification.Value}
        nv block needs NVNeed_NVBlockDescriptor: n-data-sets=2, ram-block-status-control=API, reliability=NO-PROTECTION, restore-at-start=true, store-at-shutdown=false, store-immediate=true, write-verification=false
        ram block RAM_NVBlockDescriptor_BsShare_EcuPartNumber: type=NV_Data_BsShare_EcuPartNumber, init-value=fields=[BsShare_EcuPartNumber_Element:61 x 0, BsShare_VisteonPartNumber:17 x 255, BsShare_VisteonPCBPartNumber:17 x 255, BsShare_ProductSerialNumber:10 x 255, BsShare_PCBSerialNumber:9 x 255, BsShare_SMTManufacturingDate:[1, 1, 0], BsShare_AssemblyManufacturingDate:[1, 1, 0], BsShare_SMTPlantNumber:[255, 255, 255], BsShare_AssemblyPlantNumber:[255, 255, 255], BsShare_HWModification:0]
        rom block ROM_NVBlockDescriptor_BsShare_EcuPartNumber:
          sw-calibration-access=READ-WRITE
          type=NV_Data_BsShare_EcuPartNumber
          init-value=fields=[BsShare_EcuPartNumber_Element:61 x 0, BsShare_VisteonPartNumber:17 x 255, BsShare_VisteonPCBPartNumber:17 x 255, BsShare_ProductSerialNumber:10 x 255, BsShare_PCBSerialNumber:9 x 255, BsShare_SMTManufacturingDate:[1, 1, 0], BsShare_AssemblyManufacturingDate:[1, 1, 0], BsShare_SMTPlantNumber:[255, 255, 255], BsShare_AssemblyPlantNumber:[255, 255, 255], BsShare_HWModification:0]
      NVBlockDescriptor_BsShare_SwUpdFotaFinPrint: nv-block-data-mapping{nv-ram-block-element=autosar-variable-in-impl-datatype={root-variable-data-prototype=RAM_NVBlockDescriptor_BsShare_SwUpdFotaFinPrint, target-data-prototype=BsShare_SwUpdFotaFinPrint_Element}, written-read-nv-data=BsShare_SwUpdFotaFinPrint_Element.Value}
        nv block needs NVNeed_NVBlockDescriptor: n-data-sets=2, ram-block-status-control=API, reliability=NO-PROTECTION, restore-at-start=true, store-at-shutdown=false, store-immediate=true, write-verification=false
        ram block RAM_NVBlockDescriptor_BsShare_SwUpdFotaFinPrint: type=NV_Data_BsShare_SwUpdFotaFinPrint, init-value=fields=BsShare_SwUpdFotaFinPrint_Element:32 x 0
        rom block ROM_NVBlockDescriptor_BsShare_SwUpdFotaFinPrint: sw-calibration-access=READ-WRITE, type=NV_Data_BsShare_SwUpdFotaFinPrint, init-value=fields=BsShare_SwUpdFotaFinPrint_Element:32 x 0
      NVBlockDescriptor_BsShare_SwUpdFotaMode: nv-block-data-mapping{nv-ram-block-element=autosar-variable-in-impl-datatype={root-variable-data-prototype=RAM_NVBlockDescriptor_BsShare_SwUpdFotaMode, target-data-prototype=BsShare_SwUpdFotaMode_Element}, written-read-nv-data=BsShare_SwUpdFotaMode_Element.Value}
        nv block needs NVNeed_NVBlockDescriptor: n-data-sets=2, ram-block-status-control=API, reliability=NO-PROTECTION, restore-at-start=true, store-at-shutdown=false, store-immediate=true, write-verification=false
        ram block RAM_NVBlockDescriptor_BsShare_SwUpdFotaMode: type=NV_Data_BsShare_SwUpdFotaMode, init-value=fields=BsShare_SwUpdFotaMode_Element:16 x 0
        rom block ROM_NVBlockDescriptor_BsShare_SwUpdFotaMode: sw-calibration-access=READ-WRITE, type=NV_Data_BsShare_SwUpdFotaMode, init-value=fields=BsShare_SwUpdFotaMode_Element:16 x 0
      NVBlockDescriptor_BsShare_SwUpdFotaStatus: nv-block-data-mapping{nv-ram-block-element=autosar-variable-in-impl-datatype={root-variable-data-prototype=RAM_NVBlockDescriptor_BsShare_SwUpdFotaStatus, target-data-prototype=BsShare_SwUpdFotaStatus_Element}, written-read-nv-data=BsShare_SwUpdFotaStatus_Element.Value}
        nv block needs NVNeed_NVBlockDescriptor: n-data-sets=2, ram-block-status-control=API, reliability=NO-PROTECTION, restore-at-start=true, store-at-shutdown=false, store-immediate=true, write-verification=false
        ram block RAM_NVBlockDescriptor_BsShare_SwUpdFotaStatus: type=NV_Data_BsShare_SwUpdFotaStatus, init-value=fields=BsShare_SwUpdFotaStatus_Element:48 x 0
        rom block ROM_NVBlockDescriptor_BsShare_SwUpdFotaStatus: sw-calibration-access=READ-WRITE, type=NV_Data_BsShare_SwUpdFotaStatus, init-value=fields=BsShare_SwUpdFotaStatus_Element:48 x 0
      NVBlockDescriptor_BsShare_SwUpdFotadecrypt: nv-block-data-mapping{nv-ram-block-element=autosar-variable-in-impl-datatype={root-variable-data-prototype=RAM_NVBlockDescriptor_BsShare_SwUpdFotadecrypt, target-data-prototype=BsShare_SwUpdFotadecrypt_Element}, written-read-nv-data=BsShare_SwUpdFotadecrypt_Element.Value}
        nv block needs NVNeed_NVBlockDescriptor: n-data-sets=2, ram-block-status-control=API, reliability=NO-PROTECTION, restore-at-start=true, store-at-shutdown=false, store-immediate=true, write-verification=false
        ram block RAM_NVBlockDescriptor_BsShare_SwUpdFotadecrypt: type=NV_Data_BsShare_SwUpdFotadecrypt, init-value=fields=BsShare_SwUpdFotadecrypt_Element:64 x 0
        rom block ROM_NVBlockDescriptor_BsShare_SwUpdFotadecrypt: sw-calibration-access=READ-WRITE, type=NV_Data_BsShare_SwUpdFotadecrypt, init-value=fields=BsShare_SwUpdFotadecrypt_Element:64 x 0
      NVBlockDescriptor_BsShare_SwUpdReflash: nv-block-data-mapping{nv-ram-block-element=autosar-variable-in-impl-datatype={root-variable-data-prototype=RAM_NVBlockDescriptor_BsShare_SwUpdReflash, target-data-prototype=BsShare_SwUpdReflash_Element}, written-read-nv-data=BsShare_SwUpdReflash_Element.Value}
        nv block needs NVNeed_NVBlockDescriptor: n-data-sets=2, ram-block-status-control=API, reliability=NO-PROTECTION, restore-at-start=true, store-at-shutdown=false, store-immediate=true, write-verification=false
        ram block RAM_NVBlockDescriptor_BsShare_SwUpdReflash: type=NV_Data_BsShare_SwUpdReflash, init-value=fields=BsShare_SwUpdReflash_Element:8 x 0
        rom block ROM_NVBlockDescriptor_BsShare_SwUpdReflash: sw-calibration-access=READ-WRITE, type=NV_Data_BsShare_SwUpdReflash, init-value=fields=BsShare_SwUpdReflash_Element:8 x 0
      NVBlockDescriptor_BsShare_VehicleConfig: nv-block-data-mapping{nv-ram-block-element=autosar-variable-in-impl-datatype={root-variable-data-prototype=RAM_NVBlockDescriptor_BsShare_VehicleConfig, target-data-prototype=BsShare_VehicleConfig_Element}, written-read-nv-data=BsShare_VehicleConfig_Element.Value}
        nv block needs NVNeed_NVBlockDescriptor: n-data-sets=2, ram-block-status-control=API, reliability=NO-PROTECTION, restore-at-start=true, store-at-shutdown=false, store-immediate=true, write-verification=false
        ram block RAM_NVBlockDescriptor_BsShare_VehicleConfig: type=NV_Data_BsShare_VehicleConfig, init-value=fields=BsShare_VehicleConfig_Element:256 x 0
        rom block ROM_NVBlockDescriptor_BsShare_VehicleConfig: sw-calibration-access=READ-WRITE, type=NV_Data_BsShare_VehicleConfig, init-value=fields=BsShare_VehicleConfig_Element:256 x 0
      NVBlockDescriptor_BsShare_VisMeet
        nv-block-data-mappings:
          {nv-ram-block-element=autosar-variable-in-impl-datatype={root-variable-data-prototype=RAM_NVBlockDescriptor_BsShare_VisMeet, target-data-prototype=BsShare_VisMeet_Element}, written-read-nv-data=BsShare_VisMeet_Element.Value}
          {nv-ram-block-element=autosar-variable-in-impl-datatype={root-variable-data-prototype=RAM_NVBlockDescriptor_BsShare_VisMeet, target-data-prototype=BsShare_VisMeet_EOLEntry_Element}, written-read-nv-data=BsShare_VisMeet_EOLEntry_Element.Value}
        nv block needs NVNeed_NVBlockDescriptor: n-data-sets=2, ram-block-status-control=API, reliability=NO-PROTECTION, restore-at-start=true, store-at-shutdown=false, store-immediate=true, write-verification=false
        ram block RAM_NVBlockDescriptor_BsShare_VisMeet: type=NV_Data_BsShare_VisMeet, init-value=fields=[BsShare_VisMeet_Element:46 x 0, BsShare_VisMeet_EOLEntry_Element:65535]
        rom block ROM_NVBlockDescriptor_BsShare_VisMeet: sw-calibration-access=READ-WRITE, type=NV_Data_BsShare_VisMeet, init-value=fields=[BsShare_VisMeet_Element:46 x 0, BsShare_VisMeet_EOLEntry_Element:65535]
      NVBlockDescriptor_RefCys_Certicificate: nv-block-data-mapping{nv-ram-block-element=autosar-variable-in-impl-datatype={root-variable-data-prototype=RAM_NVBlockDescriptor_RefCys_Certicificate, target-data-prototype=RefCys_Certicificate_Element}, written-read-nv-data=RefCys_Certicificate_Element.Value}
        nv block needs NVNeed_NVBlockDescriptor: n-data-sets=2, ram-block-status-control=API, reliability=NO-PROTECTION, restore-at-start=true, store-at-shutdown=false, store-immediate=true, write-verification=false
        ram block RAM_NVBlockDescriptor_RefCys_Certicificate: type=NV_Data_RefCys_Certicificate, init-value=fields=RefCys_Certicificate_Element:64 x 0
        rom block ROM_NVBlockDescriptor_RefCys_Certicificate: sw-calibration-access=READ-WRITE, type=NV_Data_RefCys_Certicificate, init-value=fields=RefCys_Certicificate_Element:64 x 0
      NVBlockDescriptor_RefCys_Certicificate1: nv-block-data-mapping{nv-ram-block-element=autosar-variable-in-impl-datatype={root-variable-data-prototype=RAM_NVBlockDescriptor_RefCys_Certicificate1, target-data-prototype=RefCys_Certicificate1_Element}, written-read-nv-data=RefCys_Certicificate1_Element.Value}
        nv block needs NVNeed_NVBlockDescriptor: n-data-sets=2, ram-block-status-control=API, reliability=NO-PROTECTION, restore-at-start=true, store-at-shutdown=false, store-immediate=true, write-verification=false
        ram block RAM_NVBlockDescriptor_RefCys_Certicificate1: type=NV_Data_RefCys_Certicificate1, init-value=fields=RefCys_Certicificate1_Element:64 x 0
        rom block ROM_NVBlockDescriptor_RefCys_Certicificate1: sw-calibration-access=READ-WRITE, type=NV_Data_RefCys_Certicificate1, init-value=fields=RefCys_Certicificate1_Element:64 x 0
      NVBlockDescriptor_BsConst_Illumination
        nv-block-data-mappings:
          {nv-ram-block-element=autosar-variable-in-impl-datatype={root-variable-data-prototype=RAM_NVBlockDescriptor_BsConst_Illumination, target-data-prototype=BsConst_Compensation_Line_Slope_m}, written-read-nv-data=BsConst_Compensation_Line_Slope_m.Value}
          {nv-ram-block-element=autosar-variable-in-impl-datatype={root-variable-data-prototype=RAM_NVBlockDescriptor_BsConst_Illumination, target-data-prototype=BsConst_Compensation_Line_Shift_b}, written-read-nv-data=BsConst_Compensation_Line_Shift_b.Value}
          {nv-ram-block-element=autosar-variable-in-impl-datatype={root-variable-data-prototype=RAM_NVBlockDescriptor_BsConst_Illumination, target-data-prototype=BsConst_Lookup_Curve_HotSpot_Coef_X}, written-read-nv-data=BsConst_Lookup_Curve_HotSpot_Coef_X.Value}
          {nv-ram-block-element=autosar-variable-in-impl-datatype={root-variable-data-prototype=RAM_NVBlockDescriptor_BsConst_Illumination, target-data-prototype=BsConst_Lookup_Curve_HotSpot_Coef_Y}, written-read-nv-data=BsConst_Lookup_Curve_HotSpot_Coef_Y.Value}
          {nv-ram-block-element=autosar-variable-in-impl-datatype={root-variable-data-prototype=RAM_NVBlockDescriptor_BsConst_Illumination, target-data-prototype=BsConst_Temp_Threshold_Hysteresis_Derating}, written-read-nv-data=BsConst_Temp_Threshold_Hysteresis_Derating.Value}
          {nv-ram-block-element=autosar-variable-in-impl-datatype={root-variable-data-prototype=RAM_NVBlockDescriptor_BsConst_Illumination, target-data-prototype=BsConst_Derating_Backlight_Disable}, written-read-nv-data=BsConst_Derating_Backlight_Disable.Value}
          {nv-ram-block-element=autosar-variable-in-impl-datatype={root-variable-data-prototype=RAM_NVBlockDescriptor_BsConst_Illumination, target-data-prototype=BsConst_Temperature_Sensor_Conv}, written-read-nv-data=BsConst_Temperature_Sensor_Conv.Value}
          {nv-ram-block-element=autosar-variable-in-impl-datatype={root-variable-data-prototype=RAM_NVBlockDescriptor_BsConst_Illumination, target-data-prototype=BsConst_PCB_Temperature_Sensor_Conv}, written-read-nv-data=BsConst_PCB_Temperature_Sensor_Conv.Value}
          {nv-ram-block-element=autosar-variable-in-impl-datatype={root-variable-data-prototype=RAM_NVBlockDescriptor_BsConst_Illumination, target-data-prototype=BsConst_Display_Illum_Max_Level}, written-read-nv-data=BsConst_Display_Illum_Max_Level.Value}
          {nv-ram-block-element=autosar-variable-in-impl-datatype={root-variable-data-prototype=RAM_NVBlockDescriptor_BsConst_Illumination, target-data-prototype=BsConst_PWM_boost_bypass_duty}, written-read-nv-data=BsConst_PWM_boost_bypass_duty.Value}
          {nv-ram-block-element=autosar-variable-in-impl-datatype={root-variable-data-prototype=RAM_NVBlockDescriptor_BsConst_Illumination, target-data-prototype=BsConst_BsConst_Illumination_ReservedByte}, written-read-nv-data=BsConst_BsConst_Illumination_ReservedByte.Value}
        nv block needs NVNeed_NVBlockDescriptor: n-data-sets=2, ram-block-status-control=API, reliability=NO-PROTECTION, restore-at-start=true, store-at-shutdown=false, store-immediate=true, write-verification=false
        ram block RAM_NVBlockDescriptor_BsConst_Illumination: type=NV_Data_BsConst_Illumination, init-value=fields=[BsConst_Compensation_Line_Slope_m:44433, BsConst_Compensation_Line_Shift_b:11, BsConst_Lookup_Curve_HotSpot_Coef_X:[700, 710, 720, 730, 740, 750, 760], BsConst_Lookup_Curve_HotSpot_Coef_Y:[8600, 7700, 6700, 5800, 4800, 3900, 3000], BsConst_Temp_Threshold_Hysteresis_Derating:68, BsConst_Derating_Backlight_Disable:0, BsConst_Temperature_Sensor_Conv:[4095, 4095], BsConst_PCB_Temperature_Sensor_Conv:[4095, 4095], BsConst_Display_Illum_Max_Level:670, BsConst_PWM_boost_bypass_duty:100, BsConst_BsConst_Illumination_ReservedByte:28 x 0]
        rom block ROM_NVBlockDescriptor_BsConst_Illumination:
          sw-calibration-access=READ-WRITE
          type=NV_Data_BsConst_Illumination
          init-value=fields=[BsConst_Compensation_Line_Slope_m:44433, BsConst_Compensation_Line_Shift_b:11, BsConst_Lookup_Curve_HotSpot_Coef_X:[700, 710, 720, 730, 740, 750, 760], BsConst_Lookup_Curve_HotSpot_Coef_Y:[8600, 7700, 6700, 5800, 4800, 3900, 3000], BsConst_Temp_Threshold_Hysteresis_Derating:68, BsConst_Derating_Backlight_Disable:0, BsConst_Temperature_Sensor_Conv:[4095, 4095], BsConst_PCB_Temperature_Sensor_Conv:[4095, 4095], BsConst_Display_Illum_Max_Level:670, BsConst_PWM_boost_bypass_duty:100, BsConst_BsConst_Illumination_ReservedByte:28 x 0]
      NVBlockDescriptor_BsConst_Illumination_Copy1
        nv-block-data-mappings:
          {nv-ram-block-element=autosar-variable-in-impl-datatype={root-variable-data-prototype=RAM_NVBlockDescriptor_BsConst_Illumination_Copy1, target-data-prototype=BsConst_Compensation_Line_Slope_m_SafeCopy1}, written-read-nv-data=BsConst_Compensation_Line_Slope_m_SafeCopy1.Value}
          {nv-ram-block-element=autosar-variable-in-impl-datatype={root-variable-data-prototype=RAM_NVBlockDescriptor_BsConst_Illumination_Copy1, target-data-prototype=BsConst_Compensation_Line_Shift_b_SafeCopy1}, written-read-nv-data=BsConst_Compensation_Line_Shift_b_SafeCopy1.Value}
          {nv-ram-block-element=autosar-variable-in-impl-datatype={root-variable-data-prototype=RAM_NVBlockDescriptor_BsConst_Illumination_Copy1, target-data-prototype=BsConst_Lookup_Curve_HotSpot_Coef_X_SafeCopy1}, written-read-nv-data=BsConst_Lookup_Curve_HotSpot_Coef_X_SafeCopy1.Value}
          {nv-ram-block-element=autosar-variable-in-impl-datatype={root-variable-data-prototype=RAM_NVBlockDescriptor_BsConst_Illumination_Copy1, target-data-prototype=BsConst_Lookup_Curve_HotSpot_Coef_Y_SafeCopy1}, written-read-nv-data=BsConst_Lookup_Curve_HotSpot_Coef_Y_SafeCopy1.Value}
          {nv-ram-block-element=autosar-variable-in-impl-datatype={root-variable-data-prototype=RAM_NVBlockDescriptor_BsConst_Illumination_Copy1, target-data-prototype=BsConst_Temp_Threshold_Hysteresis_Derating_SafeCopy1}, written-read-nv-data=BsConst_Temp_Threshold_Hysteresis_Derating_SafeCopy1.Value}
          {nv-ram-block-element=autosar-variable-in-impl-datatype={root-variable-data-prototype=RAM_NVBlockDescriptor_BsConst_Illumination_Copy1, target-data-prototype=BsConst_Derating_Backlight_Disable_SafeCopy1}, written-read-nv-data=BsConst_Derating_Backlight_Disable_SafeCopy1.Value}
          {nv-ram-block-element=autosar-variable-in-impl-datatype={root-variable-data-prototype=RAM_NVBlockDescriptor_BsConst_Illumination_Copy1, target-data-prototype=BsConst_Temperature_Sensor_Conv_SafeCopy1}, written-read-nv-data=BsConst_Temperature_Sensor_Conv_SafeCopy1.Value}
          {nv-ram-block-element=autosar-variable-in-impl-datatype={root-variable-data-prototype=RAM_NVBlockDescriptor_BsConst_Illumination_Copy1, target-data-prototype=BsConst_PCB_Temperature_Sensor_Conv_SafeCopy1}, written-read-nv-data=BsConst_PCB_Temperature_Sensor_Conv_SafeCopy1.Value}
          {nv-ram-block-element=autosar-variable-in-impl-datatype={root-variable-data-prototype=RAM_NVBlockDescriptor_BsConst_Illumination_Copy1, target-data-prototype=BsConst_Display_Illum_Max_Level_SafeCopy1}, written-read-nv-data=BsConst_Display_Illum_Max_Level_SafeCopy1.Value}
          {nv-ram-block-element=autosar-variable-in-impl-datatype={root-variable-data-prototype=RAM_NVBlockDescriptor_BsConst_Illumination_Copy1, target-data-prototype=BsConst_PWM_boost_bypass_duty_SafeCopy1}, written-read-nv-data=BsConst_PWM_boost_bypass_duty_SafeCopy1.Value}
          {nv-ram-block-element=autosar-variable-in-impl-datatype={root-variable-data-prototype=RAM_NVBlockDescriptor_BsConst_Illumination_Copy1, target-data-prototype=BsConst_BsConst_Illumination_ReservedByte_SafeCopy1}, written-read-nv-data=BsConst_BsConst_Illumination_ReservedByte_SafeCopy1.Value}
        nv block needs NVNeed_NVBlockDescriptor: n-data-sets=2, ram-block-status-control=API, reliability=NO-PROTECTION, restore-at-start=true, store-at-shutdown=false, store-immediate=true, write-verification=false
        ram block RAM_NVBlockDescriptor_BsConst_Illumination_Copy1: type=NV_Data_BsConst_Illumination_Copy1, init-value=fields=[BsConst_Compensation_Line_Slope_m_SafeCopy1:44433, BsConst_Compensation_Line_Shift_b_SafeCopy1:11, BsConst_Lookup_Curve_HotSpot_Coef_X_SafeCopy1:[700, 710, 720, 730, 740, 750, 760], BsConst_Lookup_Curve_HotSpot_Coef_Y_SafeCopy1:[8600, 7700, 6700, 5800, 4800, 3900, 3000], BsConst_Temp_Threshold_Hysteresis_Derating_SafeCopy1:68, BsConst_Derating_Backlight_Disable_SafeCopy1:0, BsConst_Temperature_Sensor_Conv_SafeCopy1:[4095, 4095], BsConst_PCB_Temperature_Sensor_Conv_SafeCopy1:[4095, 4095], BsConst_Display_Illum_Max_Level_SafeCopy1:670, BsConst_PWM_boost_bypass_duty_SafeCopy1:100, BsConst_BsConst_Illumination_ReservedByte_SafeCopy1:28 x 0]
        rom block ROM_NVBlockDescriptor_BsConst_Illumination_Copy1:
          sw-calibration-access=READ-WRITE
          type=NV_Data_BsConst_Illumination_Copy1
          init-value=fields=[BsConst_Compensation_Line_Slope_m_SafeCopy1:44433, BsConst_Compensation_Line_Shift_b_SafeCopy1:11, BsConst_Lookup_Curve_HotSpot_Coef_X_SafeCopy1:[700, 710, 720, 730, 740, 750, 760], BsConst_Lookup_Curve_HotSpot_Coef_Y_SafeCopy1:[8600, 7700, 6700, 5800, 4800, 3900, 3000], BsConst_Temp_Threshold_Hysteresis_Derating_SafeCopy1:68, BsConst_Derating_Backlight_Disable_SafeCopy1:0, BsConst_Temperature_Sensor_Conv_SafeCopy1:[4095, 4095], BsConst_PCB_Temperature_Sensor_Conv_SafeCopy1:[4095, 4095], BsConst_Display_Illum_Max_Level_SafeCopy1:670, BsConst_PWM_boost_bypass_duty_SafeCopy1:100, BsConst_BsConst_Illumination_ReservedByte_SafeCopy1:28 x 0]
      NVBlockDescriptor_BsConst_Illumination_Copy2
        nv-block-data-mappings:
          {nv-ram-block-element=autosar-variable-in-impl-datatype={root-variable-data-prototype=RAM_NVBlockDescriptor_BsConst_Illumination_Copy2, target-data-prototype=BsConst_Compensation_Line_Slope_m_SafeCopy2}, written-read-nv-data=BsConst_Compensation_Line_Slope_m_SafeCopy2.Value}
          {nv-ram-block-element=autosar-variable-in-impl-datatype={root-variable-data-prototype=RAM_NVBlockDescriptor_BsConst_Illumination_Copy2, target-data-prototype=BsConst_Compensation_Line_Shift_b_SafeCopy2}, written-read-nv-data=BsConst_Compensation_Line_Shift_b_SafeCopy2.Value}
          {nv-ram-block-element=autosar-variable-in-impl-datatype={root-variable-data-prototype=RAM_NVBlockDescriptor_BsConst_Illumination_Copy2, target-data-prototype=BsConst_Lookup_Curve_HotSpot_Coef_X_SafeCopy2}, written-read-nv-data=BsConst_Lookup_Curve_HotSpot_Coef_X_SafeCopy2.Value}
          {nv-ram-block-element=autosar-variable-in-impl-datatype={root-variable-data-prototype=RAM_NVBlockDescriptor_BsConst_Illumination_Copy2, target-data-prototype=BsConst_Lookup_Curve_HotSpot_Coef_Y_SafeCopy2}, written-read-nv-data=BsConst_Lookup_Curve_HotSpot_Coef_Y_SafeCopy2.Value}
          {nv-ram-block-element=autosar-variable-in-impl-datatype={root-variable-data-prototype=RAM_NVBlockDescriptor_BsConst_Illumination_Copy2, target-data-prototype=BsConst_Temp_Threshold_Hysteresis_Derating_SafeCopy2}, written-read-nv-data=BsConst_Temp_Threshold_Hysteresis_Derating_SafeCopy2.Value}
          {nv-ram-block-element=autosar-variable-in-impl-datatype={root-variable-data-prototype=RAM_NVBlockDescriptor_BsConst_Illumination_Copy2, target-data-prototype=BsConst_Derating_Backlight_Disable_SafeCopy2}, written-read-nv-data=BsConst_Derating_Backlight_Disable_SafeCopy2.Value}
          {nv-ram-block-element=autosar-variable-in-impl-datatype={root-variable-data-prototype=RAM_NVBlockDescriptor_BsConst_Illumination_Copy2, target-data-prototype=BsConst_Temperature_Sensor_Conv_SafeCopy2}, written-read-nv-data=BsConst_Temperature_Sensor_Conv_SafeCopy2.Value}
          {nv-ram-block-element=autosar-variable-in-impl-datatype={root-variable-data-prototype=RAM_NVBlockDescriptor_BsConst_Illumination_Copy2, target-data-prototype=BsConst_PCB_Temperature_Sensor_Conv_SafeCopy2}, written-read-nv-data=BsConst_PCB_Temperature_Sensor_Conv_SafeCopy2.Value}
          {nv-ram-block-element=autosar-variable-in-impl-datatype={root-variable-data-prototype=RAM_NVBlockDescriptor_BsConst_Illumination_Copy2, target-data-prototype=BsConst_Display_Illum_Max_Level_SafeCopy2}, written-read-nv-data=BsConst_Display_Illum_Max_Level_SafeCopy2.Value}
          {nv-ram-block-element=autosar-variable-in-impl-datatype={root-variable-data-prototype=RAM_NVBlockDescriptor_BsConst_Illumination_Copy2, target-data-prototype=BsConst_PWM_boost_bypass_duty_SafeCopy2}, written-read-nv-data=BsConst_PWM_boost_bypass_duty_SafeCopy2.Value}
          {nv-ram-block-element=autosar-variable-in-impl-datatype={root-variable-data-prototype=RAM_NVBlockDescriptor_BsConst_Illumination_Copy2, target-data-prototype=BsConst_BsConst_Illumination_ReservedByte_SafeCopy2}, written-read-nv-data=BsConst_BsConst_Illumination_ReservedByte_SafeCopy2.Value}
        nv block needs NVNeed_NVBlockDescriptor: n-data-sets=2, ram-block-status-control=API, reliability=NO-PROTECTION, restore-at-start=true, store-at-shutdown=false, store-immediate=true, write-verification=false
        ram block RAM_NVBlockDescriptor_BsConst_Illumination_Copy2: type=NV_Data_BsConst_Illumination_Copy2, init-value=fields=[BsConst_Compensation_Line_Slope_m_SafeCopy2:44433, BsConst_Compensation_Line_Shift_b_SafeCopy2:11, BsConst_Lookup_Curve_HotSpot_Coef_X_SafeCopy2:[700, 710, 720, 730, 740, 750, 760], BsConst_Lookup_Curve_HotSpot_Coef_Y_SafeCopy2:[8600, 7700, 6700, 5800, 4800, 3900, 3000], BsConst_Temp_Threshold_Hysteresis_Derating_SafeCopy2:68, BsConst_Derating_Backlight_Disable_SafeCopy2:0, BsConst_Temperature_Sensor_Conv_SafeCopy2:[4095, 4095], BsConst_PCB_Temperature_Sensor_Conv_SafeCopy2:[4095, 4095], BsConst_Display_Illum_Max_Level_SafeCopy2:670, BsConst_PWM_boost_bypass_duty_SafeCopy2:100, BsConst_BsConst_Illumination_ReservedByte_SafeCopy2:28 x 0]
        rom block ROM_NVBlockDescriptor_BsConst_Illumination_Copy2:
          sw-calibration-access=READ-WRITE
          type=NV_Data_BsConst_Illumination_Copy2
          init-value=fields=[BsConst_Compensation_Line_Slope_m_SafeCopy2:44433, BsConst_Compensation_Line_Shift_b_SafeCopy2:11, BsConst_Lookup_Curve_HotSpot_Coef_X_SafeCopy2:[700, 710, 720, 730, 740, 750, 760], BsConst_Lookup_Curve_HotSpot_Coef_Y_SafeCopy2:[8600, 7700, 6700, 5800, 4800, 3900, 3000], BsConst_Temp_Threshold_Hysteresis_Derating_SafeCopy2:68, BsConst_Derating_Backlight_Disable_SafeCopy2:0, BsConst_Temperature_Sensor_Conv_SafeCopy2:[4095, 4095], BsConst_PCB_Temperature_Sensor_Conv_SafeCopy2:[4095, 4095], BsConst_Display_Illum_Max_Level_SafeCopy2:670, BsConst_PWM_boost_bypass_duty_SafeCopy2:100, BsConst_BsConst_Illumination_ReservedByte_SafeCopy2:28 x 0]
  swc implementation NvBlockSwComponentType_Implementation: behavior=NvBlockSwComponentType_InternalBehavior
    code-descriptors:
      code Default: artifact-descriptors=autosar-engineering-object=category=SWSRC
