AUTOSAR XML (schema 00044)
package /E40_Platform_System_SystemPackage/Components
  application sw component type WdgM
    behavior IB_WdgM
      timing event TMT_WdgM_MainFunction: start-on-event=WdgM_MainFunction, period=0.01
      timing event TMT_TxRxIpcMessage: start-on-event=TxRxIpcMessage, period=0.03
      timing event TMT_GraphicsTaskStubRunnable: start-on-event=GraphicsTaskStubRunnable, period=0.03
      runnable WdgM_MainFunction
      runnable TxRxIpcMessage: can-be-invoked-concurrently=true
      runnable GraphicsTaskStubRunnable
  swc implementation IMPL_WdgM: behavior=IB_WdgM
