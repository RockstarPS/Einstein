AUTOSAR XML (schema 00044)
package /E40_Platform_System_SystemPackage/Components
  849 x constant specification:
    CSleepManagerSleepManager_SleepStatusValue0: value-spec=CSleepManagerSleepManager_SleepStatusValue0:0
    EcuAppMSleepManager_SleepStatusValue0: value-spec=EcuAppMSleepManager_SleepStatusValue0:0
    MemAbstractMdlJobStatus_NVM_DG_13_Airbag_Fdbk_IC_sts_BOOLValue0: value-spec=MemAbstractMdlJobStatus_NVM_DG_13_Airbag_Fdbk_IC_sts_BOOLValue0:0
    MemAbstractMdlJobStatus_NVM_DG_16_vehicle_type_U8Value0: value-spec=MemAbstractMdlJobStatus_NVM_DG_16_vehicle_type_U8Value0:0
    MemAbstractMdlJobStatus_NVM_Diag_config_var_16_padding_U8AValue0: value-spec=MemAbstractMdlJobStatus_NVM_Diag_config_var_16_padding_U8AValue0:0
    MemAbstractMdlJobStatus_NVM_Diag_config_var_5_padding_U8AValue0: value-spec=MemAbstractMdlJobStatus_NVM_Diag_config_var_5_padding_U8AValue0:0
    NvMExtWakeupFlagValue0: value-spec=NvMExtWakeupFlagValue0:false
    MemAbstractMdlJobStatus_SampleElement1Value0: value-spec=MemAbstractMdlJobStatus_SampleElement1Value0:0
    MemAbstractMdlJobStatus_SampleElement2Value0: value-spec=MemAbstractMdlJobStatus_SampleElement2Value0:0
    MemAbstractMdlJobStatus_BsConst_Audio_ElementValue0: value-spec=MemAbstractMdlJobStatus_BsConst_Audio_ElementValue0:0
    MemAbstractMdlJobStatus_BsConst_Communication_ElementValue0: value-spec=MemAbstractMdlJobStatus_BsConst_Communication_ElementValue0:0
    MemAbstractMdlJobStatus_BsConst_EngOffTimer_ElementValue0: value-spec=MemAbstractMdlJobStatus_BsConst_EngOffTimer_ElementValue0:0
    MemAbstractMdlJobStatus_BsConst_FuelGauge_ElementValue0: value-spec=MemAbstractMdlJobStatus_BsConst_FuelGauge_ElementValue0:0
    MemAbstractMdlJobStatus_BsConst_Illumination_ElementValue0: value-spec=MemAbstractMdlJobStatus_BsConst_Illumination_ElementValue0:0
    MemAbstractMdlJobStatus_BsConst_OilGauge_ElementValue0: value-spec=MemAbstractMdlJobStatus_BsConst_OilGauge_ElementValue0:0
    MemAbstractMdlJobStatus_BsConst_PowerGauge_ElementValue0: value-spec=MemAbstractMdlJobStatus_BsConst_PowerGauge_ElementValue0:0
    MemAbstractMdlJobStatus_BsConst_Power_ElementValue0: value-spec=MemAbstractMdlJobStatus_BsConst_Power_ElementValue0:0
    MemAbstractMdlJobStatus_BsConst_RealTimeClock_ElementValue0: value-spec=MemAbstractMdlJobStatus_BsConst_RealTimeClock_ElementValue0:0
    MemAbstractMdlJobStatus_BsConst_ServiceReminder_ElementValue0: value-spec=MemAbstractMdlJobStatus_BsConst_ServiceReminder_ElementValue0:0
    MemAbstractMdlJobStatus_BsConst_SpeedoGauge_ElementValue0: value-spec=MemAbstractMdlJobStatus_BsConst_SpeedoGauge_ElementValue0:0
    MemAbstractMdlJobStatus_BsConst_TachoGauge_ElementValue0: value-spec=MemAbstractMdlJobStatus_BsConst_TachoGauge_ElementValue0:0
    MemAbstractMdlJobStatus_BsConst_TempGauge_ElementValue0: value-spec=MemAbstractMdlJobStatus_BsConst_TempGauge_ElementValue0:0
    MemAbstractMdlJobStatus_BsConst_TripComputer_ElementValue0: value-spec=MemAbstractMdlJobStatus_BsConst_TripComputer_ElementValue0:0
    MemAbstractMdlJobStatus_BsConst_Warning_ElementValue0: value-spec=MemAbstractMdlJobStatus_BsConst_Warning_ElementValue0:0
    MemAbstractMdlJobStatus_BsCys_Certicificate_ElementValue0: value-spec=MemAbstractMdlJobStatus_BsCys_Certicificate_ElementValue0:0
    MemAbstractMdlJobStatus_BsDiag_Dtc_ElementValue0: value-spec=MemAbstractMdlJobStatus_BsDiag_Dtc_ElementValue0:0
    MemAbstractMdlJobStatus_BsDiag_ErrorRecord_ElementValue0: value-spec=MemAbstractMdlJobStatus_BsDiag_ErrorRecord_ElementValue0:0
    MemAbstractMdlJobStatus_BsFuSa_Audio_ElementValue0: value-spec=MemAbstractMdlJobStatus_BsFuSa_Audio_ElementValue0:0
    MemAbstractMdlJobStatus_BsFuSa_Communication_ElementValue0: value-spec=MemAbstractMdlJobStatus_BsFuSa_Communication_ElementValue0:0
    MemAbstractMdlJobStatus_BsFuSa_Config_ElementValue0: value-spec=MemAbstractMdlJobStatus_BsFuSa_Config_ElementValue0:0
    MemAbstractMdlJobStatus_BsFuSa_Display_ElementValue0: value-spec=MemAbstractMdlJobStatus_BsFuSa_Display_ElementValue0:0
    MemAbstractMdlJobStatus_BsFuSa_Power_ElementValue0: value-spec=MemAbstractMdlJobStatus_BsFuSa_Power_ElementValue0:0
    MemAbstractMdlJobStatus_BsFuSa_Warning_ElementValue0: value-spec=MemAbstractMdlJobStatus_BsFuSa_Warning_ElementValue0:0
    MemAbstractMdlJobStatus_BsFusa_Fota_ElementValue0: value-spec=MemAbstractMdlJobStatus_BsFusa_Fota_ElementValue0:0
    MemAbstractMdlJobStatus_BsReten_Audio_ElementValue0: value-spec=MemAbstractMdlJobStatus_BsReten_Audio_ElementValue0:0
    MemAbstractMdlJobStatus_BsReten_Communication_ElementValue0: value-spec=MemAbstractMdlJobStatus_BsReten_Communication_ElementValue0:0
    MemAbstractMdlJobStatus_BsReten_Display_ElementValue0: value-spec=MemAbstractMdlJobStatus_BsReten_Display_ElementValue0:0
    MemAbstractMdlJobStatus_BsReten_Gauges_ElementValue0: value-spec=MemAbstractMdlJobStatus_BsReten_Gauges_ElementValue0:0
    MemAbstractMdlJobStatus_BsReten_Illumination_ElementValue0: value-spec=MemAbstractMdlJobStatus_BsReten_Illumination_ElementValue0:0
    MemAbstractMdlJobStatus_BsReten_Odometer_ElementValue0: value-spec=MemAbstractMdlJobStatus_BsReten_Odometer_ElementValue0:0
    MemAbstractMdlJobStatus_BsReten_Personalization_ElementValue0: value-spec=MemAbstractMdlJobStatus_BsReten_Personalization_ElementValue0:0
    MemAbstractMdlJobStatus_BsReten_Power_ElementValue0: value-spec=MemAbstractMdlJobStatus_BsReten_Power_ElementValue0:0
    MemAbstractMdlJobStatus_BsReten_RealTimeClock_ElementValue0: value-spec=MemAbstractMdlJobStatus_BsReten_RealTimeClock_ElementValue0:0
    MemAbstractMdlJobStatus_BsReten_Tripcomputer_ElementValue0: value-spec=MemAbstractMdlJobStatus_BsReten_Tripcomputer_ElementValue0:0
    MemAbstractMdlJobStatus_BsReten_VisDlt_ElementValue0: value-spec=MemAbstractMdlJobStatus_BsReten_VisDlt_ElementValue0:0
    MemAbstractMdlJobStatus_BsReten_Warning_ElementValue0: value-spec=MemAbstractMdlJobStatus_BsReten_Warning_ElementValue0:0
    MemAbstractMdlJobStatus_BsRt_CusDlt_ElementValue0: value-spec=MemAbstractMdlJobStatus_BsRt_CusDlt_ElementValue0:0
    MemAbstractMdlJobStatus_BsRt_FuelGauge_ElementValue0: value-spec=MemAbstractMdlJobStatus_BsRt_FuelGauge_ElementValue0:0
    MemAbstractMdlJobStatus_BsRt_Illumination_ElementValue0: value-spec=MemAbstractMdlJobStatus_BsRt_Illumination_ElementValue0:0
    MemAbstractMdlJobStatus_BsRt_Odometer_ElementValue0: value-spec=MemAbstractMdlJobStatus_BsRt_Odometer_ElementValue0:0
    MemAbstractMdlJobStatus_BsRt_OilGauge_ElementValue0: value-spec=MemAbstractMdlJobStatus_BsRt_OilGauge_ElementValue0:0
    MemAbstractMdlJobStatus_BsRt_Personalization_ElementValue0: value-spec=MemAbstractMdlJobStatus_BsRt_Personalization_ElementValue0:0
    MemAbstractMdlJobStatus_BsRt_PowerGauge_ElementValue0: value-spec=MemAbstractMdlJobStatus_BsRt_PowerGauge_ElementValue0:0
    MemAbstractMdlJobStatus_BsRt_RealTimeClock_ElementValue0: value-spec=MemAbstractMdlJobStatus_BsRt_RealTimeClock_ElementValue0:0
    MemAbstractMdlJobStatus_BsRt_SpeedoGauge_ElementValue0: value-spec=MemAbstractMdlJobStatus_BsRt_SpeedoGauge_ElementValue0:0
    MemAbstractMdlJobStatus_BsRt_TachoGauge_ElementValue0: value-spec=MemAbstractMdlJobStatus_BsRt_TachoGauge_ElementValue0:0
    MemAbstractMdlJobStatus_BsRt_TempGauge_ElementValue0: value-spec=MemAbstractMdlJobStatus_BsRt_TempGauge_ElementValue0:0
    MemAbstractMdlJobStatus_BsRt_TripComputer_ElementValue0: value-spec=MemAbstractMdlJobStatus_BsRt_TripComputer_ElementValue0:0
    MemAbstractMdlJobStatus_BsRt_Warning_ElementValue0: value-spec=MemAbstractMdlJobStatus_BsRt_Warning_ElementValue0:0
    MemAbstractMdlJobStatus_BsShare_EcuPartNumber_ElementValue0: value-spec=MemAbstractMdlJobStatus_BsShare_EcuPartNumber_ElementValue0:0
    MemAbstractMdlJobStatus_BsShare_SwUpdFotaFinPrint_ElementValue0: value-spec=MemAbstractMdlJobStatus_BsShare_SwUpdFotaFinPrint_ElementValue0:0
    MemAbstractMdlJobStatus_BsShare_SwUpdFotaMode_ElementValue0: value-spec=MemAbstractMdlJobStatus_BsShare_SwUpdFotaMode_ElementValue0:0
    MemAbstractMdlJobStatus_BsShare_SwUpdFotaStatus_ElementValue0: value-spec=MemAbstractMdlJobStatus_BsShare_SwUpdFotaStatus_ElementValue0:0
    MemAbstractMdlJobStatus_BsShare_SwUpdFotadecrypt_ElementValue0: value-spec=MemAbstractMdlJobStatus_BsShare_SwUpdFotadecrypt_ElementValue0:0
    MemAbstractMdlJobStatus_BsShare_SwUpdReflash_ElementValue0: value-spec=MemAbstractMdlJobStatus_BsShare_SwUpdReflash_ElementValue0:0
    MemAbstractMdlJobStatus_BsShare_VehicleConfig_ElementValue0: value-spec=MemAbstractMdlJobStatus_BsShare_VehicleConfig_ElementValue0:0
    MemAbstractMdlJobStatus_BsShare_VisMeet_ElementValue0: value-spec=MemAbstractMdlJobStatus_BsShare_VisMeet_ElementValue0:0
    MemAbstractMdlJobStatus_RefCys_Certicificate1_ElementValue0: value-spec=MemAbstractMdlJobStatus_RefCys_Certicificate1_ElementValue0:0
    MemAbstractMdlJobStatus_RefCys_Certicificate_ElementValue0: value-spec=MemAbstractMdlJobStatus_RefCys_Certicificate_ElementValue0:0
    DmnMgrPowerSystemStateReqChangeDataValue0: value-spec={short-label=DmnMgrPowerSystemStateReqChangeDataValue0, fields=[DmnMgrPowerSystemStateReqChangeDataValue_0:0, DmnMgrPowerSystemStateReqChangeDataValue_1:0]}
    DmnMgrSDmnStatusValue0: value-spec={short-label=DmnMgrSDmnStatusValue0, fields=[DmnMgrSDmnStatusValue_0:0, DmnMgrSDmnStatusValue_1:0, DmnMgrSDmnStatusValue_2:0, DmnMgrSDmnStatusValue_3:0, DmnMgrSDmnStatusValue_4:0, DmnMgrSDmnStatusValue_5:0]}
    DmnMgrPowerSystemStateDataValue0: value-spec={short-label=DmnMgrPowerSystemStateDataValue0, fields=[DmnMgrPowerSystemStateDataValue_0:0, DmnMgrPowerSystemStateDataValue_1:0]}
    DmnMgrSleepManager_SleepStatusValue0: value-spec=DmnMgrSleepManager_SleepStatusValue0:0
    UclProxyCddPowerSystemStateDataValue0: value-spec={short-label=UclProxyCddPowerSystemStateDataValue0, fields=[UclProxyCddPowerSystemStateDataValue_0:0, UclProxyCddPowerSystemStateDataValue_1:0]}
    UclProxyCddPowerSystemStateReqChangeDataValue0: value-spec={short-label=UclProxyCddPowerSystemStateReqChangeDataValue0, fields=[UclProxyCddPowerSystemStateReqChangeDataValue_0:0, UclProxyCddPowerSystemStateReqChangeDataValue_1:0]}
    CBattMdlHVP0FlagValue0: value-spec=CBattMdlHVP0FlagValue0:false
    CBattMdlHVSD{0..4}FlagValue0: value-spec=CBattMdlHVSD{0..4}FlagValue0:false
    CBattMdlLVP0FlagValue0: value-spec=CBattMdlLVP0FlagValue0:false
    CBattMdlLVP1FlagValue0: value-spec=CBattMdlLVP1FlagValue0:false
    CBattMdlLVSD{0..4}FlagValue0: value-spec=CBattMdlLVSD{0..4}FlagValue0:false
    CBattMdlSVPFlagValue0: value-spec=CBattMdlSVPFlagValue0:false
    CBattMdlOverVoltageInterruptFlagValue0: value-spec=CBattMdlOverVoltageInterruptFlagValue0:false
    CMeetCddSleepReqDataValue0: value-spec=CMeetCddSleepReqDataValue0:false
    CMeetCddJobStatus_BsConst_Audio_ElementValue0: value-spec=CMeetCddJobStatus_BsConst_Audio_ElementValue0:0
    CMeetCddJobStatus_BsConst_Communication_ElementValue0: value-spec=CMeetCddJobStatus_BsConst_Communication_ElementValue0:0
    CMeetCddJobStatus_BsConst_EngOffTimer_ElementValue0: value-spec=CMeetCddJobStatus_BsConst_EngOffTimer_ElementValue0:0
    CMeetCddJobStatus_BsConst_FuelGauge_ElementValue0: value-spec=CMeetCddJobStatus_BsConst_FuelGauge_ElementValue0:0
    CMeetCddJobStatus_BsConst_Illumination_ElementValue0: value-spec=CMeetCddJobStatus_BsConst_Illumination_ElementValue0:0
    CMeetCddJobStatus_BsConst_OilGauge_ElementValue0: value-spec=CMeetCddJobStatus_BsConst_OilGauge_ElementValue0:0
    CMeetCddJobStatus_BsConst_PowerGauge_ElementValue0: value-spec=CMeetCddJobStatus_BsConst_PowerGauge_ElementValue0:0
    CMeetCddJobStatus_BsConst_Power_ElementValue0: value-spec=CMeetCddJobStatus_BsConst_Power_ElementValue0:0
    CMeetCddJobStatus_BsConst_RealTimeClock_ElementValue0: value-spec=CMeetCddJobStatus_BsConst_RealTimeClock_ElementValue0:0
    CMeetCddJobStatus_BsConst_ServiceReminder_ElementValue0: value-spec=CMeetCddJobStatus_BsConst_ServiceReminder_ElementValue0:0
    CMeetCddJobStatus_BsConst_SpeedoGauge_ElementValue0: value-spec=CMeetCddJobStatus_BsConst_SpeedoGauge_ElementValue0:0
    CMeetCddJobStatus_BsConst_TachoGauge_ElementValue0: value-spec=CMeetCddJobStatus_BsConst_TachoGauge_ElementValue0:0
    CMeetCddJobStatus_BsConst_TempGauge_ElementValue0: value-spec=CMeetCddJobStatus_BsConst_TempGauge_ElementValue0:0
    CMeetCddJobStatus_BsConst_TripComputer_ElementValue0: value-spec=CMeetCddJobStatus_BsConst_TripComputer_ElementValue0:0
    CMeetCddJobStatus_BsConst_Warning_ElementValue0: value-spec=CMeetCddJobStatus_BsConst_Warning_ElementValue0:0
    CMeetCddJobStatus_BsCys_Certicificate_ElementValue0: value-spec=CMeetCddJobStatus_BsCys_Certicificate_ElementValue0:0
    CMeetCddJobStatus_BsDiag_Dtc_ElementValue0: value-spec=CMeetCddJobStatus_BsDiag_Dtc_ElementValue0:0
    CMeetCddJobStatus_BsDiag_ErrorRecord_ElementValue0: value-spec=CMeetCddJobStatus_BsDiag_ErrorRecord_ElementValue0:0
    CMeetCddJobStatus_BsFuSa_Audio_ElementValue0: value-spec=CMeetCddJobStatus_BsFuSa_Audio_ElementValue0:0
    CMeetCddJobStatus_BsFuSa_Communication_ElementValue0: value-spec=CMeetCddJobStatus_BsFuSa_Communication_ElementValue0:0
    CMeetCddJobStatus_BsFuSa_Config_ElementValue0: value-spec=CMeetCddJobStatus_BsFuSa_Config_ElementValue0:0
    CMeetCddJobStatus_BsFuSa_Display_ElementValue0: value-spec=CMeetCddJobStatus_BsFuSa_Display_ElementValue0:0
    CMeetCddJobStatus_BsFuSa_Power_ElementValue0: value-spec=CMeetCddJobStatus_BsFuSa_Power_ElementValue0:0
    CMeetCddJobStatus_BsFuSa_Warning_ElementValue0: value-spec=CMeetCddJobStatus_BsFuSa_Warning_ElementValue0:0
    CMeetCddJobStatus_BsFusa_Fota_ElementValue0: value-spec=CMeetCddJobStatus_BsFusa_Fota_ElementValue0:0
    CMeetCddJobStatus_BsReten_Audio_ElementValue0: value-spec=CMeetCddJobStatus_BsReten_Audio_ElementValue0:0
    CMeetCddJobStatus_BsReten_Communication_ElementValue0: value-spec=CMeetCddJobStatus_BsReten_Communication_ElementValue0:0
    CMeetCddJobStatus_BsReten_Display_ElementValue0: value-spec=CMeetCddJobStatus_BsReten_Display_ElementValue0:0
    CMeetCddJobStatus_BsReten_Gauges_ElementValue0: value-spec=CMeetCddJobStatus_BsReten_Gauges_ElementValue0:0
    CMeetCddJobStatus_BsReten_Illumination_ElementValue0: value-spec=CMeetCddJobStatus_BsReten_Illumination_ElementValue0:0
    CMeetCddJobStatus_BsReten_Odometer_ElementValue0: value-spec=CMeetCddJobStatus_BsReten_Odometer_ElementValue0:0
    CMeetCddJobStatus_BsReten_Personalization_ElementValue0: value-spec=CMeetCddJobStatus_BsReten_Personalization_ElementValue0:0
    CMeetCddJobStatus_BsReten_Power_ElementValue0: value-spec=CMeetCddJobStatus_BsReten_Power_ElementValue0:0
    CMeetCddJobStatus_BsReten_RealTimeClock_ElementValue0: value-spec=CMeetCddJobStatus_BsReten_RealTimeClock_ElementValue0:0
    CMeetCddJobStatus_BsReten_Tripcomputer_ElementValue0: value-spec=CMeetCddJobStatus_BsReten_Tripcomputer_ElementValue0:0
    CMeetCddJobStatus_BsReten_VisDlt_ElementValue0: value-spec=CMeetCddJobStatus_BsReten_VisDlt_ElementValue0:0
    CMeetCddJobStatus_BsReten_Warning_ElementValue0: value-spec=CMeetCddJobStatus_BsReten_Warning_ElementValue0:0
    CMeetCddJobStatus_BsRt_CusDlt_ElementValue0: value-spec=CMeetCddJobStatus_BsRt_CusDlt_ElementValue0:0
    CMeetCddJobStatus_BsRt_FuelGauge_ElementValue0: value-spec=CMeetCddJobStatus_BsRt_FuelGauge_ElementValue0:0
    CMeetCddJobStatus_BsRt_Illumination_ElementValue0: value-spec=CMeetCddJobStatus_BsRt_Illumination_ElementValue0:0
    CMeetCddJobStatus_BsRt_Odometer_ElementValue0: value-spec=CMeetCddJobStatus_BsRt_Odometer_ElementValue0:0
    CMeetCddJobStatus_BsRt_OilGauge_ElementValue0: value-spec=CMeetCddJobStatus_BsRt_OilGauge_ElementValue0:0
    CMeetCddJobStatus_BsRt_Personalization_ElementValue0: value-spec=CMeetCddJobStatus_BsRt_Personalization_ElementValue0:0
    CMeetCddJobStatus_BsRt_PowerGauge_ElementValue0: value-spec=CMeetCddJobStatus_BsRt_PowerGauge_ElementValue0:0
    CMeetCddJobStatus_BsRt_RealTimeClock_ElementValue0: value-spec=CMeetCddJobStatus_BsRt_RealTimeClock_ElementValue0:0
    CMeetCddJobStatus_BsRt_SpeedoGauge_ElementValue0: value-spec=CMeetCddJobStatus_BsRt_SpeedoGauge_ElementValue0:0
    CMeetCddJobStatus_BsRt_TachoGauge_ElementValue0: value-spec=CMeetCddJobStatus_BsRt_TachoGauge_ElementValue0:0
    CMeetCddJobStatus_BsRt_TempGauge_ElementValue0: value-spec=CMeetCddJobStatus_BsRt_TempGauge_ElementValue0:0
    CMeetCddJobStatus_BsRt_TripComputer_ElementValue0: value-spec=CMeetCddJobStatus_BsRt_TripComputer_ElementValue0:0
    CMeetCddJobStatus_BsRt_Warning_ElementValue0: value-spec=CMeetCddJobStatus_BsRt_Warning_ElementValue0:0
    CMeetCddJobStatus_BsShare_EcuPartNumber_ElementValue0: value-spec=CMeetCddJobStatus_BsShare_EcuPartNumber_ElementValue0:0
    CMeetCddJobStatus_BsShare_SwUpdFotaFinPrint_ElementValue0: value-spec=CMeetCddJobStatus_BsShare_SwUpdFotaFinPrint_ElementValue0:0
    CMeetCddJobStatus_BsShare_SwUpdFotaMode_ElementValue0: value-spec=CMeetCddJobStatus_BsShare_SwUpdFotaMode_ElementValue0:0
    CMeetCddJobStatus_BsShare_SwUpdFotaStatus_ElementValue0: value-spec=CMeetCddJobStatus_BsShare_SwUpdFotaStatus_ElementValue0:0
    CMeetCddJobStatus_BsShare_SwUpdFotadecrypt_ElementValue0: value-spec=CMeetCddJobStatus_BsShare_SwUpdFotadecrypt_ElementValue0:0
    CMeetCddJobStatus_BsShare_SwUpdReflash_ElementValue0: value-spec=CMeetCddJobStatus_BsShare_SwUpdReflash_ElementValue0:0
    CMeetCddJobStatus_BsShare_VehicleConfig_ElementValue0: value-spec=CMeetCddJobStatus_BsShare_VehicleConfig_ElementValue0:0
    CMeetCddJobStatus_BsShare_VisMeet_ElementValue0: value-spec=CMeetCddJobStatus_BsShare_VisMeet_ElementValue0:0
    CMeetCddJobStatus_RefCys_Certicificate1_ElementValue0: value-spec=CMeetCddJobStatus_RefCys_Certicificate1_ElementValue0:0
    CMeetCddJobStatus_RefCys_Certicificate_ElementValue0: value-spec=CMeetCddJobStatus_RefCys_Certicificate_ElementValue0:0
    UclProxyCddEmmcErrorNotifierDataValue0: value-spec={short-label=UclProxyCddEmmcErrorNotifierDataValue0, fields=UclProxyCddEmmcErrorNotifierDataValue_0:0}
    CMeetCddJobStatus_BsShare_VisMeet_EOLEntry_ElementValue0: value-spec=CMeetCddJobStatus_BsShare_VisMeet_EOLEntry_ElementValue0:0
    MemAbstractMdlJobStatus_BsShare_VisMeet_EOLEntry_ElementValue0: value-spec=MemAbstractMdlJobStatus_BsShare_VisMeet_EOLEntry_ElementValue0:0
    DcmExtJobStatus_BsConst_Audio_ElementValue0: value-spec=DcmExtJobStatus_BsConst_Audio_ElementValue0:0
    DcmExtJobStatus_BsConst_Communication_ElementValue0: value-spec=DcmExtJobStatus_BsConst_Communication_ElementValue0:0
    DcmExtJobStatus_BsConst_EngOffTimer_ElementValue0: value-spec=DcmExtJobStatus_BsConst_EngOffTimer_ElementValue0:0
    DcmExtJobStatus_BsConst_FuelGauge_ElementValue0: value-spec=DcmExtJobStatus_BsConst_FuelGauge_ElementValue0:0
    DcmExtJobStatus_BsConst_Illumination_ElementValue0: value-spec=DcmExtJobStatus_BsConst_Illumination_ElementValue0:0
    DcmExtJobStatus_BsConst_OilGauge_ElementValue0: value-spec=DcmExtJobStatus_BsConst_OilGauge_ElementValue0:0
    DcmExtJobStatus_BsConst_PowerGauge_ElementValue0: value-spec=DcmExtJobStatus_BsConst_PowerGauge_ElementValue0:0
    DcmExtJobStatus_BsConst_Power_ElementValue0: value-spec=DcmExtJobStatus_BsConst_Power_ElementValue0:0
    DcmExtJobStatus_BsConst_RealTimeClock_ElementValue0: value-spec=DcmExtJobStatus_BsConst_RealTimeClock_ElementValue0:0
    DcmExtJobStatus_BsConst_ServiceReminder_ElementValue0: value-spec=DcmExtJobStatus_BsConst_ServiceReminder_ElementValue0:0
    DcmExtJobStatus_BsConst_SpeedoGauge_ElementValue0: value-spec=DcmExtJobStatus_BsConst_SpeedoGauge_ElementValue0:0
    DcmExtJobStatus_BsConst_TachoGauge_ElementValue0: value-spec=DcmExtJobStatus_BsConst_TachoGauge_ElementValue0:0
    DcmExtJobStatus_BsConst_TempGauge_ElementValue0: value-spec=DcmExtJobStatus_BsConst_TempGauge_ElementValue0:0
    DcmExtJobStatus_BsConst_TripComputer_ElementValue0: value-spec=DcmExtJobStatus_BsConst_TripComputer_ElementValue0:0
    DcmExtJobStatus_BsConst_Warning_ElementValue0: value-spec=DcmExtJobStatus_BsConst_Warning_ElementValue0:0
    DcmExtJobStatus_BsCys_Certicificate_ElementValue0: value-spec=DcmExtJobStatus_BsCys_Certicificate_ElementValue0:0
    DcmExtJobStatus_BsDiag_Dtc_ElementValue0: value-spec=DcmExtJobStatus_BsDiag_Dtc_ElementValue0:0
    DcmExtJobStatus_BsDiag_ErrorRecord_ElementValue0: value-spec=DcmExtJobStatus_BsDiag_ErrorRecord_ElementValue0:0
    DcmExtJobStatus_BsFuSa_Audio_ElementValue0: value-spec=DcmExtJobStatus_BsFuSa_Audio_ElementValue0:0
    DcmExtJobStatus_BsFuSa_Communication_ElementValue0: value-spec=DcmExtJobStatus_BsFuSa_Communication_ElementValue0:0
    DcmExtJobStatus_BsFuSa_Config_ElementValue0: value-spec=DcmExtJobStatus_BsFuSa_Config_ElementValue0:0
    DcmExtJobStatus_BsFuSa_Display_ElementValue0: value-spec=DcmExtJobStatus_BsFuSa_Display_ElementValue0:0
    DcmExtJobStatus_BsFuSa_Power_ElementValue0: value-spec=DcmExtJobStatus_BsFuSa_Power_ElementValue0:0
    DcmExtJobStatus_BsFuSa_Warning_ElementValue0: value-spec=DcmExtJobStatus_BsFuSa_Warning_ElementValue0:0
    DcmExtJobStatus_BsFusa_Fota_ElementValue0: value-spec=DcmExtJobStatus_BsFusa_Fota_ElementValue0:0
    DcmExtJobStatus_BsReten_Audio_ElementValue0: value-spec=DcmExtJobStatus_BsReten_Audio_ElementValue0:0
    DcmExtJobStatus_BsReten_Communication_ElementValue0: value-spec=DcmExtJobStatus_BsReten_Communication_ElementValue0:0
    DcmExtJobStatus_BsReten_Display_ElementValue0: value-spec=DcmExtJobStatus_BsReten_Display_ElementValue0:0
    DcmExtJobStatus_BsReten_Gauges_ElementValue0: value-spec=DcmExtJobStatus_BsReten_Gauges_ElementValue0:0
    DcmExtJobStatus_BsReten_Illumination_ElementValue0: value-spec=DcmExtJobStatus_BsReten_Illumination_ElementValue0:0
    DcmExtJobStatus_BsReten_Odometer_ElementValue0: value-spec=DcmExtJobStatus_BsReten_Odometer_ElementValue0:0
    DcmExtJobStatus_BsReten_Personalization_ElementValue0: value-spec=DcmExtJobStatus_BsReten_Personalization_ElementValue0:0
    DcmExtJobStatus_BsReten_Power_ElementValue0: value-spec=DcmExtJobStatus_BsReten_Power_ElementValue0:0
    DcmExtJobStatus_BsReten_RealTimeClock_ElementValue0: value-spec=DcmExtJobStatus_BsReten_RealTimeClock_ElementValue0:0
    DcmExtJobStatus_BsReten_Tripcomputer_ElementValue0: value-spec=DcmExtJobStatus_BsReten_Tripcomputer_ElementValue0:0
    DcmExtJobStatus_BsReten_VisDlt_ElementValue0: value-spec=DcmExtJobStatus_BsReten_VisDlt_ElementValue0:0
    DcmExtJobStatus_BsReten_Warning_ElementValue0: value-spec=DcmExtJobStatus_BsReten_Warning_ElementValue0:0
    DcmExtJobStatus_BsRt_CusDlt_ElementValue0: value-spec=DcmExtJobStatus_BsRt_CusDlt_ElementValue0:0
    DcmExtJobStatus_BsRt_FuelGauge_ElementValue0: value-spec=DcmExtJobStatus_BsRt_FuelGauge_ElementValue0:0
    DcmExtJobStatus_BsRt_Illumination_ElementValue0: value-spec=DcmExtJobStatus_BsRt_Illumination_ElementValue0:0
    DcmExtJobStatus_BsRt_Odometer_ElementValue0: value-spec=DcmExtJobStatus_BsRt_Odometer_ElementValue0:0
    DcmExtJobStatus_BsRt_OilGauge_ElementValue0: value-spec=DcmExtJobStatus_BsRt_OilGauge_ElementValue0:0
    DcmExtJobStatus_BsRt_Personalization_ElementValue0: value-spec=DcmExtJobStatus_BsRt_Personalization_ElementValue0:0
    DcmExtJobStatus_BsRt_PowerGauge_ElementValue0: value-spec=DcmExtJobStatus_BsRt_PowerGauge_ElementValue0:0
    DcmExtJobStatus_BsRt_RealTimeClock_ElementValue0: value-spec=DcmExtJobStatus_BsRt_RealTimeClock_ElementValue0:0
    DcmExtJobStatus_BsRt_SpeedoGauge_ElementValue0: value-spec=DcmExtJobStatus_BsRt_SpeedoGauge_ElementValue0:0
    DcmExtJobStatus_BsRt_TachoGauge_ElementValue0: value-spec=DcmExtJobStatus_BsRt_TachoGauge_ElementValue0:0
    DcmExtJobStatus_BsRt_TempGauge_ElementValue0: value-spec=DcmExtJobStatus_BsRt_TempGauge_ElementValue0:0
    DcmExtJobStatus_BsRt_TripComputer_ElementValue0: value-spec=DcmExtJobStatus_BsRt_TripComputer_ElementValue0:0
    DcmExtJobStatus_BsRt_Warning_ElementValue0: value-spec=DcmExtJobStatus_BsRt_Warning_ElementValue0:0
    DcmExtJobStatus_BsShare_EcuPartNumber_ElementValue0: value-spec=DcmExtJobStatus_BsShare_EcuPartNumber_ElementValue0:0
    DcmExtJobStatus_BsShare_SwUpdFotaFinPrint_ElementValue0: value-spec=DcmExtJobStatus_BsShare_SwUpdFotaFinPrint_ElementValue0:0
    DcmExtJobStatus_BsShare_SwUpdFotaMode_ElementValue0: value-spec=DcmExtJobStatus_BsShare_SwUpdFotaMode_ElementValue0:0
    DcmExtJobStatus_BsShare_SwUpdFotaStatus_ElementValue0: value-spec=DcmExtJobStatus_BsShare_SwUpdFotaStatus_ElementValue0:0
    DcmExtJobStatus_BsShare_SwUpdFotadecrypt_ElementValue0: value-spec=DcmExtJobStatus_BsShare_SwUpdFotadecrypt_ElementValue0:0
    DcmExtJobStatus_BsShare_SwUpdReflash_ElementValue0: value-spec=DcmExtJobStatus_BsShare_SwUpdReflash_ElementValue0:0
    DcmExtJobStatus_BsShare_VehicleConfig_ElementValue0: value-spec=DcmExtJobStatus_BsShare_VehicleConfig_ElementValue0:0
    DcmExtJobStatus_BsShare_VisMeet_EOLEntry_ElementValue0: value-spec=DcmExtJobStatus_BsShare_VisMeet_EOLEntry_ElementValue0:0
    DcmExtJobStatus_BsShare_VisMeet_ElementValue0: value-spec=DcmExtJobStatus_BsShare_VisMeet_ElementValue0:0
    DcmExtJobStatus_RefCys_Certicificate1_ElementValue0: value-spec=DcmExtJobStatus_RefCys_Certicificate1_ElementValue0:0
    DcmExtJobStatus_RefCys_Certicificate_ElementValue0: value-spec=DcmExtJobStatus_RefCys_Certicificate_ElementValue0:0
    UclProxyCddDisplayCurrentStateDataValue0: value-spec={short-label=UclProxyCddDisplayCurrentStateDataValue0, fields=[UclProxyCddDisplayCurrentStateDataValue_0:0, UclProxyCddDisplayCurrentStateDataValue_1:0]}
    UclProxyCddDisplaySetPowerDataValue0: value-spec={short-label=UclProxyCddDisplaySetPowerDataValue0, fields=[UclProxyCddDisplaySetPowerDataValue_0:0, UclProxyCddDisplaySetPowerDataValue_1:0]}
    CMeetCddJobStatus_BsShare_AssemblyManufacturingDateValue0: value-spec=CMeetCddJobStatus_BsShare_AssemblyManufacturingDateValue0:0
    CMeetCddJobStatus_BsShare_AssemblyPlantNumberValue0: value-spec=CMeetCddJobStatus_BsShare_AssemblyPlantNumberValue0:0
    CMeetCddJobStatus_BsShare_HWModificationValue0: value-spec=CMeetCddJobStatus_BsShare_HWModificationValue0:0
    CMeetCddJobStatus_BsShare_PCBSerialNumberValue0: value-spec=CMeetCddJobStatus_BsShare_PCBSerialNumberValue0:0
    CMeetCddJobStatus_BsShare_ProductSerialNumberValue0: value-spec=CMeetCddJobStatus_BsShare_ProductSerialNumberValue0:0
    CMeetCddJobStatus_BsShare_SMTManufacturingDateValue0: value-spec=CMeetCddJobStatus_BsShare_SMTManufacturingDateValue0:0
    CMeetCddJobStatus_BsShare_SMTPlantNumberValue0: value-spec=CMeetCddJobStatus_BsShare_SMTPlantNumberValue0:0
    CMeetCddJobStatus_BsShare_VisteonPCBPartNumberValue0: value-spec=CMeetCddJobStatus_BsShare_VisteonPCBPartNumberValue0:0
    CMeetCddJobStatus_BsShare_VisteonPartNumberValue0: value-spec=CMeetCddJobStatus_BsShare_VisteonPartNumberValue0:0
    MemAbstractMdlJobStatus_BsShare_AssemblyManufacturingDateValue0: value-spec=MemAbstractMdlJobStatus_BsShare_AssemblyManufacturingDateValue0:0
    MemAbstractMdlJobStatus_BsShare_AssemblyPlantNumberValue0: value-spec=MemAbstractMdlJobStatus_BsShare_AssemblyPlantNumberValue0:0
    MemAbstractMdlJobStatus_BsShare_HWModificationValue0: value-spec=MemAbstractMdlJobStatus_BsShare_HWModificationValue0:0
    MemAbstractMdlJobStatus_BsShare_PCBSerialNumberValue0: value-spec=MemAbstractMdlJobStatus_BsShare_PCBSerialNumberValue0:0
    MemAbstractMdlJobStatus_BsShare_ProductSerialNumberValue0: value-spec=MemAbstractMdlJobStatus_BsShare_ProductSerialNumberValue0:0
    MemAbstractMdlJobStatus_BsShare_SMTManufacturingDateValue0: value-spec=MemAbstractMdlJobStatus_BsShare_SMTManufacturingDateValue0:0
    MemAbstractMdlJobStatus_BsShare_SMTPlantNumberValue0: value-spec=MemAbstractMdlJobStatus_BsShare_SMTPlantNumberValue0:0
    MemAbstractMdlJobStatus_BsShare_VisteonPCBPartNumberValue0: value-spec=MemAbstractMdlJobStatus_BsShare_VisteonPCBPartNumberValue0:0
    MemAbstractMdlJobStatus_BsShare_VisteonPartNumberValue0: value-spec=MemAbstractMdlJobStatus_BsShare_VisteonPartNumberValue0:0
    DcmExtJobStatus_BsShare_AssemblyManufacturingDateValue0: value-spec=DcmExtJobStatus_BsShare_AssemblyManufacturingDateValue0:0
    DcmExtJobStatus_BsShare_AssemblyPlantNumberValue0: value-spec=DcmExtJobStatus_BsShare_AssemblyPlantNumberValue0:0
    DcmExtJobStatus_BsShare_HWModificationValue0: value-spec=DcmExtJobStatus_BsShare_HWModificationValue0:0
    DcmExtJobStatus_BsShare_PCBSerialNumberValue0: value-spec=DcmExtJobStatus_BsShare_PCBSerialNumberValue0:0
    DcmExtJobStatus_BsShare_ProductSerialNumberValue0: value-spec=DcmExtJobStatus_BsShare_ProductSerialNumberValue0:0
    DcmExtJobStatus_BsShare_SMTManufacturingDateValue0: value-spec=DcmExtJobStatus_BsShare_SMTManufacturingDateValue0:0
    DcmExtJobStatus_BsShare_SMTPlantNumberValue0: value-spec=DcmExtJobStatus_BsShare_SMTPlantNumberValue0:0
    DcmExtJobStatus_BsShare_VisteonPCBPartNumberValue0: value-spec=DcmExtJobStatus_BsShare_VisteonPCBPartNumberValue0:0
    DcmExtJobStatus_BsShare_VisteonPartNumberValue0: value-spec=DcmExtJobStatus_BsShare_VisteonPartNumberValue0:0
    EcuAppMDisplaySetPowerDataValue0: value-spec={short-label=EcuAppMDisplaySetPowerDataValue0, fields=[EcuAppMDisplaySetPowerDataValue_0:0, EcuAppMDisplaySetPowerDataValue_1:0]}
    EcuAppMDisplayCurrentStateDataValue0: value-spec={short-label=EcuAppMDisplayCurrentStateDataValue0, fields=[EcuAppMDisplayCurrentStateDataValue_0:0, EcuAppMDisplayCurrentStateDataValue_1:0]}
    CComAbsMdlBattery_VoltageValue0: value-spec=CComAbsMdlBattery_VoltageValue0:0
    CComAbsMdlDebug1_Byte{0..7}Value0: value-spec=CComAbsMdlDebug1_Byte{0..7}Value0:0
    CComAbsMdlDebug2_Byte{0..7}Value0: value-spec=CComAbsMdlDebug2_Byte{0..7}Value0:0
    CComAbsMdlDebug3_Byte{0..7}Value0: value-spec=CComAbsMdlDebug3_Byte{0..7}Value0:0
    CComAbsMdlDebug4_Byte{0..7}Value0: value-spec=CComAbsMdlDebug4_Byte{0..7}Value0:0
    CComAbsMdlDebug5_Byte{0..7}Value0: value-spec=CComAbsMdlDebug5_Byte{0..7}Value0:0
    CComAbsMdlFV_TxValue0: value-spec=CComAbsMdlFV_TxValue0:0
    CComAbsMdlIllumination_PWMValue0: value-spec=CComAbsMdlIllumination_PWMValue0:0
    CComAbsMdlMAC_TxValue0: value-spec=CComAbsMdlMAC_TxValue0:0
    CComAbsMdlOdometerValue0: value-spec=CComAbsMdlOdometerValue0:0
    CComAbsMdlSecureTxByte{0..3}Value0: value-spec=CComAbsMdlSecureTxByte{0..3}Value0:0
    CComAbsMdlVehicleSpeedICValue0: value-spec=CComAbsMdlVehicleSpeedICValue0:0
    CComAbsMdlAirbagValue0: value-spec=CComAbsMdlAirbagValue0:0
    CComAbsMdlAmbient_Light_levelValue0: value-spec=CComAbsMdlAmbient_Light_levelValue0:0
    CComAbsMdlDayNightModeValue0: value-spec=CComAbsMdlDayNightModeValue0:0
    CComAbsMdlEngineSpeedValue0: value-spec=CComAbsMdlEngineSpeedValue0:0
    CComAbsMdlGearValue0: value-spec=CComAbsMdlGearValue0:0
    CComAbsMdlGearModeValue0: value-spec=CComAbsMdlGearModeValue0:0
    CComAbsMdlGearRecommendationValue0: value-spec=CComAbsMdlGearRecommendationValue0:0
    CComAbsMdlGearStatusValue0: value-spec=CComAbsMdlGearStatusValue0:0
    CComAbsMdlIllumination_levelValue0: value-spec=CComAbsMdlIllumination_levelValue0:0
    CComAbsMdlPowerModeValue0: value-spec=CComAbsMdlPowerModeValue0:0
    CComAbsMdlTransportModeValue0: value-spec=CComAbsMdlTransportModeValue0:0
    CComAbsMdlVehicleSpeedABSValue0: value-spec=CComAbsMdlVehicleSpeedABSValue0:0
    CComAbsMdlWarningValue0: value-spec=CComAbsMdlWarningValue0:0
    CCtrl_TelltaleTTBlinkStatusArrayValue0: value-spec=CCtrl_TelltaleTTBlinkStatusArrayValue0:[CCtrl_TelltaleTTBlinkStatusArray0Value:0, CCtrl_TelltaleTTBlinkStatusArray1Value:0, CCtrl_TelltaleTTBlinkStatusArray2Value:0, CCtrl_TelltaleTTBlinkStatusArray3Value:0, CCtrl_TelltaleTTBlinkStatusArray4Value:0, CCtrl_TelltaleTTBlinkStatusArray5Value:0, CCtrl_TelltaleTTBlinkStatusArray6Value:0, CCtrl_TelltaleTTBlinkStatusArray7Value:0, CCtrl_TelltaleTTBlinkStatusArray8Value:0, CCtrl_TelltaleTTBlinkStatusArray9Value:0, CCtrl_TelltaleTTBlinkStatusArray10Value:0, CCtrl_TelltaleTTBlinkStatusArray11Value:0, CCtrl_TelltaleTTBlinkStatusArray12Value:0, CCtrl_TelltaleTTBlinkStatusArray13Value:0, CCtrl_TelltaleTTBlinkStatusArray14Value:0, CCtrl_TelltaleTTBlinkStatusArray15Value:0]
    CCtrl_TelltaleTTdummyDataForTypesValue0: value-spec=CCtrl_TelltaleTTdummyDataForTypesValue0:0
    CCtrl_TelltaleTelltaleFunctionalOpStatusValue0: value-spec=CCtrl_TelltaleTelltaleFunctionalOpStatusValue0:[CCtrl_TelltaleTelltaleFunctionalOpStatus0Value:0, CCtrl_TelltaleTelltaleFunctionalOpStatus1Value:0, CCtrl_TelltaleTelltaleFunctionalOpStatus2Value:0, CCtrl_TelltaleTelltaleFunctionalOpStatus3Value:0, CCtrl_TelltaleTelltaleFunctionalOpStatus4Value:0, CCtrl_TelltaleTelltaleFunctionalOpStatus5Value:0, CCtrl_TelltaleTelltaleFunctionalOpStatus6Value:0, CCtrl_TelltaleTelltaleFunctionalOpStatus7Value:0, CCtrl_TelltaleTelltaleFunctionalOpStatus8Value:0, CCtrl_TelltaleTelltaleFunctionalOpStatus9Value:0, CCtrl_TelltaleTelltaleFunctionalOpStatus10Value:0, CCtrl_TelltaleTelltaleFunctionalOpStatus11Value:0, CCtrl_TelltaleTelltaleFunctionalOpStatus12Value:0, CCtrl_TelltaleTelltaleFunctionalOpStatus13Value:0, CCtrl_TelltaleTelltaleFunctionalOpStatus14Value:0, CCtrl_TelltaleTelltaleFunctionalOpStatus15Value:0, CCtrl_TelltaleTelltaleFunctionalOpStatus16Value:0, CCtrl_TelltaleTelltaleFunctionalOpStatus17Value:0, CCtrl_TelltaleTelltaleFunctionalOpStatus18Value:0, CCtrl_TelltaleTelltaleFunctionalOpStatus19Value:0, CCtrl_TelltaleTelltaleFunctionalOpStatus20Value:0, CCtrl_TelltaleTelltaleFunctionalOpStatus21Value:0, CCtrl_TelltaleTelltaleFunctionalOpStatus22Value:0, CCtrl_TelltaleTelltaleFunctionalOpStatus23Value:0, CCtrl_TelltaleTelltaleFunctionalOpStatus24Value:0, CCtrl_TelltaleTelltaleFunctionalOpStatus25Value:0, CCtrl_TelltaleTelltaleFunctionalOpStatus26Value:0, CCtrl_TelltaleTelltaleFunctionalOpStatus27Value:0, CCtrl_TelltaleTelltaleFunctionalOpStatus28Value:0, CCtrl_TelltaleTelltaleFunctionalOpStatus29Value:0, CCtrl_TelltaleTelltaleFunctionalOpStatus30Value:0, CCtrl_TelltaleTelltaleFunctionalOpStatus31Value:0, CCtrl_TelltaleTelltaleFunctionalOpStatus32Value:0, CCtrl_TelltaleTelltaleFunctionalOpStatus33Value:0, CCtrl_TelltaleTelltaleFunctionalOpStatus34Value:0, CCtrl_TelltaleTelltaleFunctionalOpStatus35Value:0, CCtrl_TelltaleTelltaleFunctionalOpStatus36Value:0, CCtrl_TelltaleTelltaleFunctionalOpStatus37Value:0, CCtrl_TelltaleTelltaleFunctionalOpStatus38Value:0, CCtrl_TelltaleTelltaleFunctionalOpStatus39Value:0, CCtrl_TelltaleTelltaleFunctionalOpStatus40Value:0, CCtrl_TelltaleTelltaleFunctionalOpStatus41Value:0, CCtrl_TelltaleTelltaleFunctionalOpStatus42Value:0, CCtrl_TelltaleTelltaleFunctionalOpStatus43Value:0, CCtrl_TelltaleTelltaleFunctionalOpStatus44Value:0, CCtrl_TelltaleTelltaleFunctionalOpStatus45Value:0, CCtrl_TelltaleTelltaleFunctionalOpStatus46Value:0, CCtrl_TelltaleTelltaleFunctionalOpStatus47Value:0, CCtrl_TelltaleTelltaleFunctionalOpStatus48Value:0, CCtrl_TelltaleTelltaleFunctionalOpStatus49Value:0, CCtrl_TelltaleTelltaleFunctionalOpStatus50Value:0, CCtrl_TelltaleTelltaleFunctionalOpStatus51Value:0, CCtrl_TelltaleTelltaleFunctionalOpStatus52Value:0, CCtrl_TelltaleTelltaleFunctionalOpStatus53Value:0, CCtrl_TelltaleTelltaleFunctionalOpStatus54Value:0, CCtrl_TelltaleTelltaleFunctionalOpStatus55Value:0, CCtrl_TelltaleTelltaleFunctionalOpStatus56Value:0, CCtrl_TelltaleTelltaleFunctionalOpStatus57Value:0, CCtrl_TelltaleTelltaleFunctionalOpStatus58Value:0, CCtrl_TelltaleTelltaleFunctionalOpStatus59Value:0, CCtrl_TelltaleTelltaleFunctionalOpStatus60Value:0, CCtrl_TelltaleTelltaleFunctionalOpStatus61Value:0, CCtrl_TelltaleTelltaleFunctionalOpStatus62Value:0, CCtrl_TelltaleTelltaleFunctionalOpStatus63Value:0, CCtrl_TelltaleTelltaleFunctionalOpStatus64Value:0, CCtrl_TelltaleTelltaleFunctionalOpStatus65Value:0, CCtrl_TelltaleTelltaleFunctionalOpStatus66Value:0, CCtrl_TelltaleTelltaleFunctionalOpStatus67Value:0, CCtrl_TelltaleTelltaleFunctionalOpStatus68Value:0, CCtrl_TelltaleTelltaleFunctionalOpStatus69Value:0, CCtrl_TelltaleTelltaleFunctionalOpStatus70Value:0, CCtrl_TelltaleTelltaleFunctionalOpStatus71Value:0, CCtrl_TelltaleTelltaleFunctionalOpStatus72Value:0, CCtrl_TelltaleTelltaleFunctionalOpStatus73Value:0, CCtrl_TelltaleTelltaleFunctionalOpStatus74Value:0, CCtrl_TelltaleTelltaleFunctionalOpStatus75Value:0, CCtrl_TelltaleTelltaleFunctionalOpStatus76Value:0, CCtrl_TelltaleTelltaleFunctionalOpStatus77Value:0, CCtrl_TelltaleTelltaleFunctionalOpStatus78Value:0, CCtrl_TelltaleTelltaleFunctionalOpStatus79Value:0, CCtrl_TelltaleTelltaleFunctionalOpStatus80Value:0, CCtrl_TelltaleTelltaleFunctionalOpStatus81Value:0, CCtrl_TelltaleTelltaleFunctionalOpStatus82Value:0, CCtrl_TelltaleTelltaleFunctionalOpStatus83Value:0, CCtrl_TelltaleTelltaleFunctionalOpStatus84Value:0, CCtrl_TelltaleTelltaleFunctionalOpStatus85Value:0, CCtrl_TelltaleTelltaleFunctionalOpStatus86Value:0, CCtrl_TelltaleTelltaleFunctionalOpStatus87Value:0, CCtrl_TelltaleTelltaleFunctionalOpStatus88Value:0, CCtrl_TelltaleTelltaleFunctionalOpStatus89Value:0, CCtrl_TelltaleTelltaleFunctionalOpStatus90Value:0, CCtrl_TelltaleTelltaleFunctionalOpStatus91Value:0]
    CCtrl_TelltaleTelltaleOpArrayValue0: value-spec=CCtrl_TelltaleTelltaleOpArrayValue0:[CCtrl_TelltaleTelltaleOpArray0Value:0, CCtrl_TelltaleTelltaleOpArray1Value:0, CCtrl_TelltaleTelltaleOpArray2Value:0, CCtrl_TelltaleTelltaleOpArray3Value:0, CCtrl_TelltaleTelltaleOpArray4Value:0, CCtrl_TelltaleTelltaleOpArray5Value:0, CCtrl_TelltaleTelltaleOpArray6Value:0, CCtrl_TelltaleTelltaleOpArray7Value:0, CCtrl_TelltaleTelltaleOpArray8Value:0, CCtrl_TelltaleTelltaleOpArray9Value:0, CCtrl_TelltaleTelltaleOpArray10Value:0, CCtrl_TelltaleTelltaleOpArray11Value:0, CCtrl_TelltaleTelltaleOpArray12Value:0, CCtrl_TelltaleTelltaleOpArray13Value:0, CCtrl_TelltaleTelltaleOpArray14Value:0, CCtrl_TelltaleTelltaleOpArray15Value:0, CCtrl_TelltaleTelltaleOpArray16Value:0, CCtrl_TelltaleTelltaleOpArray17Value:0, CCtrl_TelltaleTelltaleOpArray18Value:0, CCtrl_TelltaleTelltaleOpArray19Value:0, CCtrl_TelltaleTelltaleOpArray20Value:0, CCtrl_TelltaleTelltaleOpArray21Value:0, CCtrl_TelltaleTelltaleOpArray22Value:0, CCtrl_TelltaleTelltaleOpArray23Value:0, CCtrl_TelltaleTelltaleOpArray24Value:0, CCtrl_TelltaleTelltaleOpArray25Value:0, CCtrl_TelltaleTelltaleOpArray26Value:0, CCtrl_TelltaleTelltaleOpArray27Value:0, CCtrl_TelltaleTelltaleOpArray28Value:0, CCtrl_TelltaleTelltaleOpArray29Value:0, CCtrl_TelltaleTelltaleOpArray30Value:0, CCtrl_TelltaleTelltaleOpArray31Value:0, CCtrl_TelltaleTelltaleOpArray32Value:0, CCtrl_TelltaleTelltaleOpArray33Value:0, CCtrl_TelltaleTelltaleOpArray34Value:0, CCtrl_TelltaleTelltaleOpArray35Value:0, CCtrl_TelltaleTelltaleOpArray36Value:0, CCtrl_TelltaleTelltaleOpArray37Value:0, CCtrl_TelltaleTelltaleOpArray38Value:0, CCtrl_TelltaleTelltaleOpArray39Value:0, CCtrl_TelltaleTelltaleOpArray40Value:0, CCtrl_TelltaleTelltaleOpArray41Value:0, CCtrl_TelltaleTelltaleOpArray42Value:0, CCtrl_TelltaleTelltaleOpArray43Value:0, CCtrl_TelltaleTelltaleOpArray44Value:0, CCtrl_TelltaleTelltaleOpArray45Value:0, CCtrl_TelltaleTelltaleOpArray46Value:0, CCtrl_TelltaleTelltaleOpArray47Value:0, CCtrl_TelltaleTelltaleOpArray48Value:0, CCtrl_TelltaleTelltaleOpArray49Value:0, CCtrl_TelltaleTelltaleOpArray50Value:0, CCtrl_TelltaleTelltaleOpArray51Value:0, CCtrl_TelltaleTelltaleOpArray52Value:0, CCtrl_TelltaleTelltaleOpArray53Value:0, CCtrl_TelltaleTelltaleOpArray54Value:0, CCtrl_TelltaleTelltaleOpArray55Value:0, CCtrl_TelltaleTelltaleOpArray56Value:0, CCtrl_TelltaleTelltaleOpArray57Value:0, CCtrl_TelltaleTelltaleOpArray58Value:0, CCtrl_TelltaleTelltaleOpArray59Value:0, CCtrl_TelltaleTelltaleOpArray60Value:0, CCtrl_TelltaleTelltaleOpArray61Value:0, CCtrl_TelltaleTelltaleOpArray62Value:0, CCtrl_TelltaleTelltaleOpArray63Value:0, CCtrl_TelltaleTelltaleOpArray64Value:0, CCtrl_TelltaleTelltaleOpArray65Value:0, CCtrl_TelltaleTelltaleOpArray66Value:0, CCtrl_TelltaleTelltaleOpArray67Value:0, CCtrl_TelltaleTelltaleOpArray68Value:0, CCtrl_TelltaleTelltaleOpArray69Value:0, CCtrl_TelltaleTelltaleOpArray70Value:0, CCtrl_TelltaleTelltaleOpArray71Value:0, CCtrl_TelltaleTelltaleOpArray72Value:0, CCtrl_TelltaleTelltaleOpArray73Value:0, CCtrl_TelltaleTelltaleOpArray74Value:0, CCtrl_TelltaleTelltaleOpArray75Value:0, CCtrl_TelltaleTelltaleOpArray76Value:0, CCtrl_TelltaleTelltaleOpArray77Value:0, CCtrl_TelltaleTelltaleOpArray78Value:0, CCtrl_TelltaleTelltaleOpArray79Value:0, CCtrl_TelltaleTelltaleOpArray80Value:0, CCtrl_TelltaleTelltaleOpArray81Value:0, CCtrl_TelltaleTelltaleOpArray82Value:0, CCtrl_TelltaleTelltaleOpArray83Value:0, CCtrl_TelltaleTelltaleOpArray84Value:0, CCtrl_TelltaleTelltaleOpArray85Value:0, CCtrl_TelltaleTelltaleOpArray86Value:0, CCtrl_TelltaleTelltaleOpArray87Value:0, CCtrl_TelltaleTelltaleOpArray88Value:0, CCtrl_TelltaleTelltaleOpArray89Value:0, CCtrl_TelltaleTelltaleOpArray90Value:0, CCtrl_TelltaleTelltaleOpArray91Value:0]
    CCtrl_TelltaleCurrentBulbTestStatusValue0: value-spec=CCtrl_TelltaleCurrentBulbTestStatusValue0:0
    CCtrl_TelltaleHMI_ReadyStatusValue0: value-spec=CCtrl_TelltaleHMI_ReadyStatusValue0:0
    CCtrl_TelltaleIgnBlankOutCheckValue0: value-spec=CCtrl_TelltaleIgnBlankOutCheckValue0:0
    CCtrl_TelltaleIgnitionSubstateValue0: value-spec=CCtrl_TelltaleIgnitionSubstateValue0:0
    CCtrl_TelltaleHVP0FlagValue0: value-spec=CCtrl_TelltaleHVP0FlagValue0:false
    CCtrl_TelltaleHVSD{0..4}FlagValue0: value-spec=CCtrl_TelltaleHVSD{0..4}FlagValue0:false
    CCtrl_TelltaleLVP0FlagValue0: value-spec=CCtrl_TelltaleLVP0FlagValue0:false
    CCtrl_TelltaleLVP1FlagValue0: value-spec=CCtrl_TelltaleLVP1FlagValue0:false
    CCtrl_TelltaleLVSD{0..4}FlagValue0: value-spec=CCtrl_TelltaleLVSD{0..4}FlagValue0:false
    CCtrl_TelltaleSVPFlagValue0: value-spec=CCtrl_TelltaleSVPFlagValue0:false
    CCtrl_TelltaleTTIndexValue0: value-spec=CCtrl_TelltaleTTIndexValue0:0
    CCtrl_TelltaleTTStatusValue0: value-spec=CCtrl_TelltaleTTStatusValue0:0
    CCtrl_TelltaleCurrentTelltaleStatusValue0: value-spec=CCtrl_TelltaleCurrentTelltaleStatusValue0:0
    CCtrl_TelltaleWSSCurrentClusterModeValue0: value-spec=CCtrl_TelltaleWSSCurrentClusterModeValue0:0
    Ctrl_WSSWSSAccStateValue0: value-spec=Ctrl_WSSWSSAccStateValue0:0
    Ctrl_WSSWSSBaStateValue0: value-spec=Ctrl_WSSWSSBaStateValue0:0
    Ctrl_WSSWSSBaOfStateValue0: value-spec=Ctrl_WSSWSSBaOfStateValue0:0
    Ctrl_WSSIgnitioBuznstateValue0: value-spec=Ctrl_WSSIgnitioBuznstateValue0:0
    Ctrl_WSSIgnitionSubstateValue0: value-spec=Ctrl_WSSIgnitionSubstateValue0:0
    Ctrl_WSSWSSIGPCANStateValue0: value-spec=Ctrl_WSSWSSIGPCANStateValue0:0
    Ctrl_WSSWSSIGPStateValue0: value-spec=Ctrl_WSSWSSIGPStateValue0:0
    Ctrl_WSSWSSCurrentClusterModeValue0: value-spec=Ctrl_WSSWSSCurrentClusterModeValue0:0
    Ctrl_WSSHMI_ReadyStatusValue0: value-spec=Ctrl_WSSHMI_ReadyStatusValue0:0
    Ctrl_WSSWSSCurrentClusterInitModeValue0: value-spec=0
    Ctrl_WSSSleep_StatusValue0: value-spec=Ctrl_WSSSleep_StatusValue0:0
    Ctrl_WSSTFTDisplayOnValue0: value-spec=Ctrl_WSSTFTDisplayOnValue0:0
    Ctrl_WSSTFTDisplayOnExTurnValue0: value-spec=Ctrl_WSSTFTDisplayOnExTurnValue0:0
    Ctrl_WSSWSSCurrentVehicleStateValue0: value-spec=Ctrl_WSSWSSCurrentVehicleStateValue0:0
    Ctrl_WSSPhasedRead_Status_phase1readcompletedValue0: value-spec=Ctrl_WSSPhasedRead_Status_phase1readcompletedValue0:false
    Ctrl_WSSPhasedRead_Status_phase2readcompletedValue0: value-spec=Ctrl_WSSPhasedRead_Status_phase2readcompletedValue0:false
    Ctrl_WSSTTIndexValue0: value-spec=Ctrl_WSSTTIndexValue0:0
    Ctrl_WSSTTStatusValue0: value-spec=Ctrl_WSSTTStatusValue0:0
    Ctrl_WSSTelltaleOpArrayValue0: value-spec=Ctrl_WSSTelltaleOpArrayValue0:[Ctrl_WSSTelltaleOpArray0Value:0, Ctrl_WSSTelltaleOpArray1Value:0, Ctrl_WSSTelltaleOpArray2Value:0, Ctrl_WSSTelltaleOpArray3Value:0, Ctrl_WSSTelltaleOpArray4Value:0, Ctrl_WSSTelltaleOpArray5Value:0, Ctrl_WSSTelltaleOpArray6Value:0, Ctrl_WSSTelltaleOpArray7Value:0, Ctrl_WSSTelltaleOpArray8Value:0, Ctrl_WSSTelltaleOpArray9Value:0, Ctrl_WSSTelltaleOpArray10Value:0, Ctrl_WSSTelltaleOpArray11Value:0, Ctrl_WSSTelltaleOpArray12Value:0, Ctrl_WSSTelltaleOpArray13Value:0, Ctrl_WSSTelltaleOpArray14Value:0, Ctrl_WSSTelltaleOpArray15Value:0, Ctrl_WSSTelltaleOpArray16Value:0, Ctrl_WSSTelltaleOpArray17Value:0, Ctrl_WSSTelltaleOpArray18Value:0, Ctrl_WSSTelltaleOpArray19Value:0, Ctrl_WSSTelltaleOpArray20Value:0, Ctrl_WSSTelltaleOpArray21Value:0, Ctrl_WSSTelltaleOpArray22Value:0, Ctrl_WSSTelltaleOpArray23Value:0, Ctrl_WSSTelltaleOpArray24Value:0, Ctrl_WSSTelltaleOpArray25Value:0, Ctrl_WSSTelltaleOpArray26Value:0, Ctrl_WSSTelltaleOpArray27Value:0, Ctrl_WSSTelltaleOpArray28Value:0, Ctrl_WSSTelltaleOpArray29Value:0, Ctrl_WSSTelltaleOpArray30Value:0, Ctrl_WSSTelltaleOpArray31Value:0, Ctrl_WSSTelltaleOpArray32Value:0, Ctrl_WSSTelltaleOpArray33Value:0, Ctrl_WSSTelltaleOpArray34Value:0, Ctrl_WSSTelltaleOpArray35Value:0, Ctrl_WSSTelltaleOpArray36Value:0, Ctrl_WSSTelltaleOpArray37Value:0, Ctrl_WSSTelltaleOpArray38Value:0, Ctrl_WSSTelltaleOpArray39Value:0, Ctrl_WSSTelltaleOpArray40Value:0, Ctrl_WSSTelltaleOpArray41Value:0, Ctrl_WSSTelltaleOpArray42Value:0, Ctrl_WSSTelltaleOpArray43Value:0, Ctrl_WSSTelltaleOpArray44Value:0, Ctrl_WSSTelltaleOpArray45Value:0, Ctrl_WSSTelltaleOpArray46Value:0, Ctrl_WSSTelltaleOpArray47Value:0, Ctrl_WSSTelltaleOpArray48Value:0, Ctrl_WSSTelltaleOpArray49Value:0, Ctrl_WSSTelltaleOpArray50Value:0, Ctrl_WSSTelltaleOpArray51Value:0, Ctrl_WSSTelltaleOpArray52Value:0, Ctrl_WSSTelltaleOpArray53Value:0, Ctrl_WSSTelltaleOpArray54Value:0, Ctrl_WSSTelltaleOpArray55Value:0, Ctrl_WSSTelltaleOpArray56Value:0, Ctrl_WSSTelltaleOpArray57Value:0, Ctrl_WSSTelltaleOpArray58Value:0, Ctrl_WSSTelltaleOpArray59Value:0, Ctrl_WSSTelltaleOpArray60Value:0, Ctrl_WSSTelltaleOpArray61Value:0, Ctrl_WSSTelltaleOpArray62Value:0, Ctrl_WSSTelltaleOpArray63Value:0, Ctrl_WSSTelltaleOpArray64Value:0, Ctrl_WSSTelltaleOpArray65Value:0, Ctrl_WSSTelltaleOpArray66Value:0, Ctrl_WSSTelltaleOpArray67Value:0, Ctrl_WSSTelltaleOpArray68Value:0, Ctrl_WSSTelltaleOpArray69Value:0, Ctrl_WSSTelltaleOpArray70Value:0, Ctrl_WSSTelltaleOpArray71Value:0, Ctrl_WSSTelltaleOpArray72Value:0, Ctrl_WSSTelltaleOpArray73Value:0, Ctrl_WSSTelltaleOpArray74Value:0, Ctrl_WSSTelltaleOpArray75Value:0, Ctrl_WSSTelltaleOpArray76Value:0, Ctrl_WSSTelltaleOpArray77Value:0, Ctrl_WSSTelltaleOpArray78Value:0, Ctrl_WSSTelltaleOpArray79Value:0, Ctrl_WSSTelltaleOpArray80Value:0, Ctrl_WSSTelltaleOpArray81Value:0, Ctrl_WSSTelltaleOpArray82Value:0, Ctrl_WSSTelltaleOpArray83Value:0, Ctrl_WSSTelltaleOpArray84Value:0, Ctrl_WSSTelltaleOpArray85Value:0, Ctrl_WSSTelltaleOpArray86Value:0, Ctrl_WSSTelltaleOpArray87Value:0, Ctrl_WSSTelltaleOpArray88Value:0, Ctrl_WSSTelltaleOpArray89Value:0, Ctrl_WSSTelltaleOpArray90Value:0, Ctrl_WSSTelltaleOpArray91Value:0]
    Ctrl_WSSTTBlinkStatusArrayValue0: value-spec=Ctrl_WSSTTBlinkStatusArrayValue0:[Ctrl_WSSTTBlinkStatusArray0Value:0, Ctrl_WSSTTBlinkStatusArray1Value:0, Ctrl_WSSTTBlinkStatusArray2Value:0, Ctrl_WSSTTBlinkStatusArray3Value:0, Ctrl_WSSTTBlinkStatusArray4Value:0, Ctrl_WSSTTBlinkStatusArray5Value:0, Ctrl_WSSTTBlinkStatusArray6Value:0, Ctrl_WSSTTBlinkStatusArray7Value:0, Ctrl_WSSTTBlinkStatusArray8Value:0, Ctrl_WSSTTBlinkStatusArray9Value:0, Ctrl_WSSTTBlinkStatusArray10Value:0, Ctrl_WSSTTBlinkStatusArray11Value:0, Ctrl_WSSTTBlinkStatusArray12Value:0, Ctrl_WSSTTBlinkStatusArray13Value:0, Ctrl_WSSTTBlinkStatusArray14Value:0, Ctrl_WSSTTBlinkStatusArray15Value:0]
    Ctrl_WSSTTdummyDataForTypesValue0: value-spec=Ctrl_WSSTTdummyDataForTypesValue0:0
    Ctrl_WSSHMI_OdoTypeValue0: value-spec=Ctrl_WSSHMI_OdoTypeValue0:0
    Ctrl_WSSHMIScreenMode_StatusValue0: value-spec=Ctrl_WSSHMIScreenMode_StatusValue0:0
    Ctrl_WSSHead_Lamp_stValue0: value-spec=Ctrl_WSSHead_Lamp_stValue0:0
    Ctrl_WSSillumDNStatusValue0: value-spec=Ctrl_WSSillumDNStatusValue0:0
    Ctrl_WSSPWMOut_TC_DbcValue0: value-spec=Ctrl_WSSPWMOut_TC_DbcValue0:0
    Ctrl_WSSShiftPositionDisplayValue0: value-spec=Ctrl_WSSShiftPositionDisplayValue0:0
    Ctrl_WSSTail_Light_stValue0: value-spec=Ctrl_WSSTail_Light_stValue0:0
    Ctrl_WSSLeftIndicatorStsValue0: value-spec=Ctrl_WSSLeftIndicatorStsValue0:0
    Ctrl_WSSRightIndicatorStsValue0: value-spec=Ctrl_WSSRightIndicatorStsValue0:0
    Mdl_DimTrans_StepvlaueValue0: value-spec=Mdl_DimTrans_StepvlaueValue0:0
    Mdl_DimDutyValueValue0: value-spec=Mdl_DimDutyValueValue0:0
    Mdl_DimilumDNRequiredValue0: value-spec=Mdl_DimilumDNRequiredValue0:0
    Mdl_DimillumDNStatusValue0: value-spec=Mdl_DimillumDNStatusValue0:0
    Mdl_DimIllumStepValueValue0: value-spec=Mdl_DimIllumStepValueValue0:0
    Mdl_DimRGBStepValueValue0: value-spec=Mdl_DimRGBStepValueValue0:0
    Mdl_DimRHDW_DbcValue0: value-spec=Mdl_DimRHDW_DbcValue0:0
    Mdl_DimRHUP_DbcValue0: value-spec=Mdl_DimRHUP_DbcValue0:0
    Mdl_DimRawdataStatusValue0: value-spec=Mdl_DimRawdataStatusValue0:0
    Mdl_DimSwitchStatusValue0: value-spec=Mdl_DimSwitchStatusValue0:0
    Mdl_DimRheostatDayStepValue0: value-spec=Mdl_DimRheostatDayStepValue0:0
    Mdl_DimRheostatNightStepValue0: value-spec=Mdl_DimRheostatNightStepValue0:0
    Mdl_DimRheostatONSStatusValue0: value-spec=Mdl_DimRheostatONSStatusValue0:0
    Mdl_DimRheostatSwTypeValue0: value-spec=Mdl_DimRheostatSwTypeValue0:0
    Mdl_DimRheostat_OnSTimeValue0: value-spec=Mdl_DimRheostat_OnSTimeValue0:0
    Mdl_DimStarterStatus_OutValue0: value-spec=Mdl_DimStarterStatus_OutValue0:0
    Mdl_DimRheoUpdateValValue0: value-spec=Mdl_DimRheoUpdateValValue0:0
    Mdl_DimIllum_StatusValue0: value-spec=Mdl_DimIllum_StatusValue0:0
    Mdl_DimIllumStatusValue0: value-spec=Mdl_DimIllumStatusValue0:0
    Mdl_DimIgnitionSubstateValue0: value-spec=Mdl_DimIgnitionSubstateValue0:0
    Mdl_DimWSSCurrentVehicleStateValue0: value-spec=Mdl_DimWSSCurrentVehicleStateValue0:0
    Mdl_DimWSSCurrentClusterModeValue0: value-spec=Mdl_DimWSSCurrentClusterModeValue0:0
    Mdl_DimReady_to_SleepValue0: value-spec=Mdl_DimReady_to_SleepValue0:false
    Mdl_DimAppIdValue0: value-spec=Mdl_DimAppIdValue0:0
    Mdl_DimDiag_RheoStatValue0: value-spec=Mdl_DimDiag_RheoStatValue0:0
    Mdl_DimEcoRunPresenceFlagValue0: value-spec=Mdl_DimEcoRunPresenceFlagValue0:0
    Mdl_DimIlumDayNightRequiredValue0: value-spec=Mdl_DimIlumDayNightRequiredValue0:0
    Mdl_DimDay_Night_StatusValue0: value-spec=Mdl_DimDay_Night_StatusValue0:0
    Mdl_DimPowerTrain_FlagValue0: value-spec=Mdl_DimPowerTrain_FlagValue0:0
    Mdl_Dimchannel_idValue0: value-spec=Mdl_Dimchannel_idValue0:0
    Mdl_DimTFTDisplayOnValue0: value-spec=Mdl_DimTFTDisplayOnValue0:0
    Mdl_DimCurrentUserIDValue0: value-spec=Mdl_DimCurrentUserIDValue0:0
    Mdl_DimCustomizeResetValue0: value-spec=Mdl_DimCustomizeResetValue0:0
    Mdl_DimSettingResetResultValue0: value-spec=Mdl_DimSettingResetResultValue0:0
    Ctrl_DimIlluminationDataDataValue0: value-spec={short-label=Ctrl_DimIlluminationDataDataValue0, fields=[Ctrl_DimIlluminationDataDataValue_0:0, Ctrl_DimIlluminationDataDataValue_1:0, Ctrl_DimIlluminationDataDataValue_2:0, Ctrl_DimIlluminationDataDataValue_3:0]}
    Ctrl_DimILL_DutyValue0: value-spec=Ctrl_DimILL_DutyValue0:0
    Ctrl_DimRGB_DimmingValue0: value-spec=Ctrl_DimRGB_DimmingValue0:0
    Ctrl_DimStarter_StatusValue0: value-spec=Ctrl_DimStarter_StatusValue0:false
    Ctrl_DimReady_to_SleepValue0: value-spec=Ctrl_DimReady_to_SleepValue0:false
    Ctrl_DimIlumDayNightRequiredValue0: value-spec=Ctrl_DimIlumDayNightRequiredValue0:0
    Ctrl_DimDay_Night_StatusValue0: value-spec=Ctrl_DimDay_Night_StatusValue0:0
    Ctrl_DimBL_DimmingValue0: value-spec=Ctrl_DimBL_DimmingValue0:0
    Ctrl_Dimchannel_idValue0: value-spec=Ctrl_Dimchannel_idValue0:0
    Ctrl_DimIllumStatusValue0: value-spec=Ctrl_DimIllumStatusValue0:0
    Ctrl_DimIgnitionSubstateValue0: value-spec=Ctrl_DimIgnitionSubstateValue0:0
    Ctrl_DimHVP0FlagValue0: value-spec=Ctrl_DimHVP0FlagValue0:false
    Ctrl_DimHVSD{0..4}FlagValue0: value-spec=Ctrl_DimHVSD{0..4}FlagValue0:false
    Ctrl_DimLVP0FlagValue0: value-spec=Ctrl_DimLVP0FlagValue0:false
    Ctrl_DimLVP1FlagValue0: value-spec=Ctrl_DimLVP1FlagValue0:false
    Ctrl_DimLVSD{0..4}FlagValue0: value-spec=Ctrl_DimLVSD{0..4}FlagValue0:false
    Ctrl_DimSVPFlagValue0: value-spec=Ctrl_DimSVPFlagValue0:false
    Ctrl_DimWSSCurrentVehicleStateValue0: value-spec=Ctrl_DimWSSCurrentVehicleStateValue0:0
    Ctrl_DimWSSCurrentClusterModeValue0: value-spec=Ctrl_DimWSSCurrentClusterModeValue0:0
    Ctrl_DimDay_Night_mode_CtrlValue0: value-spec=Ctrl_DimDay_Night_mode_CtrlValue0:0
    Ctrl_DimEcoRunSystem_FlagValue0: value-spec=Ctrl_DimEcoRunSystem_FlagValue0:0
    Ctrl_DimIllumStepValueValue0: value-spec=Ctrl_DimIllumStepValueValue0:0
    Ctrl_DimRheostatDayStepValue0: value-spec=Ctrl_DimRheostatDayStepValue0:0
    Ctrl_DimRheostatNightStepValue0: value-spec=Ctrl_DimRheostatNightStepValue0:0
    Ctrl_DimRheoUpdateValValue0: value-spec=Ctrl_DimRheoUpdateValValue0:0
    Ctrl_DimTFTDisplayOnValue0: value-spec=Ctrl_DimTFTDisplayOnValue0:0
    Ctrl_warningIgnitionSubstateValue0: value-spec=Ctrl_warningIgnitionSubstateValue0:0
    Ctrl_warningWSSCurrentClusterModeValue0: value-spec=Ctrl_warningWSSCurrentClusterModeValue0:0
    CWarnMsg_Core_ObserverHudWarningDisplayDataValue0: value-spec={short-label=CWarnMsg_Core_ObserverHudWarningDisplayDataValue0, fields=[CWarnMsg_Core_ObserverHudWarningDisplayDataValue_0:0, CWarnMsg_Core_ObserverHudWarningDisplayDataValue_1:0, CWarnMsg_Core_ObserverHudWarningDisplayDataValue_2:[CWarnMsg_Core_ObserverdynData0Value:0, CWarnMsg_Core_ObserverdynData1Value:0, CWarnMsg_Core_ObserverdynData2Value:0, CWarnMsg_Core_ObserverdynData3Value:0, CWarnMsg_Core_ObserverdynData4Value:0, CWarnMsg_Core_ObserverdynData5Value:0, CWarnMsg_Core_ObserverdynData6Value:0, CWarnMsg_Core_ObserverdynData7Value:0]]}
    CWarnMsg_Core_ObserverTpmsWarningDataDataValue0: value-spec={short-label=CWarnMsg_Core_ObserverTpmsWarningDataDataValue0, fields=CWarnMsg_Core_ObserverTpmsWarningDataDataValue_0:[CWarnMsg_Core_ObservertpmsWarndata0Value:0, CWarnMsg_Core_ObservertpmsWarndata1Value:0, CWarnMsg_Core_ObservertpmsWarndata2Value:0, CWarnMsg_Core_ObservertpmsWarndata3Value:0, CWarnMsg_Core_ObservertpmsWarndata4Value:0]}
    CWarnMsg_Core_ObserverWarningHighInterrupt_StateValue0: value-spec=CWarnMsg_Core_ObserverWarningHighInterrupt_StateValue0:0
    CWarnMsg_Core_ObserverWarningInterrupt_StateValue0: value-spec=CWarnMsg_Core_ObserverWarningInterrupt_StateValue0:0
    CWarnMsg_Core_ObserverWarningDisplayDataValue0: value-spec={short-label=CWarnMsg_Core_ObserverWarningDisplayDataValue0, fields=[CWarnMsg_Core_ObserverWarningDisplayDataValue_0:0, CWarnMsg_Core_ObserverWarningDisplayDataValue_1:0, CWarnMsg_Core_ObserverWarningDisplayDataValue_2:[CWarnMsg_Core_ObserverdynData0Value:0, CWarnMsg_Core_ObserverdynData1Value:0, CWarnMsg_Core_ObserverdynData2Value:0, CWarnMsg_Core_ObserverdynData3Value:0, CWarnMsg_Core_ObserverdynData4Value:0, CWarnMsg_Core_ObserverdynData5Value:0, CWarnMsg_Core_ObserverdynData6Value:0, CWarnMsg_Core_ObserverdynData7Value:0]]}
    CWarnMsg_Core_ObserverChime_RequestValue0: value-spec=CWarnMsg_Core_ObserverChime_RequestValue0:0
    CWarnMsg_Core_ObserverChime_StatusValue0: value-spec=CWarnMsg_Core_ObserverChime_StatusValue0:0
    CWarnMsg_Core_ObserverIgnitionSubstateValue0: value-spec=CWarnMsg_Core_ObserverIgnitionSubstateValue0:0
    CWarnMsg_Core_ObserverWSSCurrentClusterModeValue0: value-spec=CWarnMsg_Core_ObserverWSSCurrentClusterModeValue0:0
    CWarnMsg_Core_ObserverFactoryModeValue0: value-spec=CWarnMsg_Core_ObserverFactoryModeValue0:0
    CWarnMsg_Core_ObserverFactoryModeStatusValue0: value-spec=CWarnMsg_Core_ObserverFactoryModeStatusValue0:0
    CWarnMsg_Core_ObserverHMI_ReadyStatusValue0: value-spec=CWarnMsg_Core_ObserverHMI_ReadyStatusValue0:0
    CWarnMsg_Core_ObserverHMIScreenMode_StatusValue0: value-spec=CWarnMsg_Core_ObserverHMIScreenMode_StatusValue0:0
    CWarnMsg_Core_ObserverWakeType_HwValue0: value-spec=CWarnMsg_Core_ObserverWakeType_HwValue0:0
    CWarnMsg_Core_ObserverWakeType_IntValue0: value-spec=CWarnMsg_Core_ObserverWakeType_IntValue0:0
    CWarnMsg_Core_ObserverHudWarningStatusDataValue0: value-spec={short-label=CWarnMsg_Core_ObserverHudWarningStatusDataValue0, fields=[CWarnMsg_Core_ObserverHudWarningStatusDataValue_0:0, CWarnMsg_Core_ObserverHudWarningStatusDataValue_1:0, CWarnMsg_Core_ObserverHudWarningStatusDataValue_2:[CWarnMsg_Core_ObserverdynData0Value:0, CWarnMsg_Core_ObserverdynData1Value:0, CWarnMsg_Core_ObserverdynData2Value:0, CWarnMsg_Core_ObserverdynData3Value:0, CWarnMsg_Core_ObserverdynData4Value:0, CWarnMsg_Core_ObserverdynData5Value:0, CWarnMsg_Core_ObserverdynData6Value:0, CWarnMsg_Core_ObserverdynData7Value:0, CWarnMsg_Core_ObserverdynData8Value:0, CWarnMsg_Core_ObserverdynData9Value:0]]}
    CWarnMsg_Core_ObserverStarterStatus_OutValue0: value-spec=CWarnMsg_Core_ObserverStarterStatus_OutValue0:0
    CWarnMsg_Core_ObserverNvmDataValue0: value-spec=CWarnMsg_Core_ObserverNvmDataValue0:0
    CWarnMsg_Core_ObserverTpms_PayloadValue0: value-spec=CWarnMsg_Core_ObserverTpms_PayloadValue0:[CWarnMsg_Core_ObserverTpms_Payload0Value:0, CWarnMsg_Core_ObserverTpms_Payload1Value:0, CWarnMsg_Core_ObserverTpms_Payload2Value:0, CWarnMsg_Core_ObserverTpms_Payload3Value:0, CWarnMsg_Core_ObserverTpms_Payload4Value:0]
    CWarnMsg_Core_ObserverTargetSwValue0: value-spec=CWarnMsg_Core_ObserverTargetSwValue0:0
    CWarnMsg_Core_ObserverWarningStatusDataValue0: value-spec={short-label=CWarnMsg_Core_ObserverWarningStatusDataValue0, fields=[CWarnMsg_Core_ObserverWarningStatusDataValue_0:0, CWarnMsg_Core_ObserverWarningStatusDataValue_1:0, CWarnMsg_Core_ObserverWarningStatusDataValue_2:[CWarnMsg_Core_ObserverdynData0Value:0, CWarnMsg_Core_ObserverdynData1Value:0, CWarnMsg_Core_ObserverdynData2Value:0, CWarnMsg_Core_ObserverdynData3Value:0, CWarnMsg_Core_ObserverdynData4Value:0, CWarnMsg_Core_ObserverdynData5Value:0, CWarnMsg_Core_ObserverdynData6Value:0, CWarnMsg_Core_ObserverdynData7Value:0, CWarnMsg_Core_ObserverdynData8Value:0, CWarnMsg_Core_ObserverdynData9Value:0]]}
    UclProxyCddHudWarningStatusDataValue0: value-spec={short-label=UclProxyCddHudWarningStatusDataValue0, fields=[UclProxyCddHudWarningStatusDataValue_0:0, UclProxyCddHudWarningStatusDataValue_1:0, UclProxyCddHudWarningStatusDataValue_2:[UclProxyCdddynData0Value:0, UclProxyCdddynData1Value:0, UclProxyCdddynData2Value:0, UclProxyCdddynData3Value:0, UclProxyCdddynData4Value:0, UclProxyCdddynData5Value:0, UclProxyCdddynData6Value:0, UclProxyCdddynData7Value:0, UclProxyCdddynData8Value:0, UclProxyCdddynData9Value:0]]}
    UclProxyCddWarningStatusDataValue0: value-spec={short-label=UclProxyCddWarningStatusDataValue0, fields=[UclProxyCddWarningStatusDataValue_0:0, UclProxyCddWarningStatusDataValue_1:0, UclProxyCddWarningStatusDataValue_2:[UclProxyCdddynData0Value:0, UclProxyCdddynData1Value:0, UclProxyCdddynData2Value:0, UclProxyCdddynData3Value:0, UclProxyCdddynData4Value:0, UclProxyCdddynData5Value:0, UclProxyCdddynData6Value:0, UclProxyCdddynData7Value:0, UclProxyCdddynData8Value:0, UclProxyCdddynData9Value:0]]}
    UclProxyCddFastGaugeInfoDataValue0: value-spec={short-label=UclProxyCddFastGaugeInfoDataValue0, fields={short-label=UclProxyCddFastGaugeInfoDataValue_0, fields=[UclProxyCddgaugeInfoValue_0:0, UclProxyCddgaugeInfoValue_1:0, UclProxyCddgaugeInfoValue_2:0, UclProxyCddgaugeInfoValue_3:0, UclProxyCddgaugeInfoValue_4:0]}}
    UclProxyCddHudWarningDisplayDataValue0: value-spec={short-label=UclProxyCddHudWarningDisplayDataValue0, fields=[UclProxyCddHudWarningDisplayDataValue_0:0, UclProxyCddHudWarningDisplayDataValue_1:0, UclProxyCddHudWarningDisplayDataValue_2:[UclProxyCdddynData0Value:0, UclProxyCdddynData1Value:0, UclProxyCdddynData2Value:0, UclProxyCdddynData3Value:0, UclProxyCdddynData4Value:0, UclProxyCdddynData5Value:0, UclProxyCdddynData6Value:0, UclProxyCdddynData7Value:0]]}
    UclProxyCddIlluminationDataDataValue0: value-spec={short-label=UclProxyCddIlluminationDataDataValue0, fields=[UclProxyCddIlluminationDataDataValue_0:0, UclProxyCddIlluminationDataDataValue_1:0, UclProxyCddIlluminationDataDataValue_2:0, UclProxyCddIlluminationDataDataValue_3:0]}
    UclProxyCddShiftPosIndStatusDataValue0: value-spec={short-label=UclProxyCddShiftPosIndStatusDataValue0, fields={short-label=UclProxyCddShiftPosIndStatusDataValue_0, fields=[UclProxyCddstatusValue_0:0, UclProxyCddstatusValue_1:0, UclProxyCddstatusValue_2:0, UclProxyCddstatusValue_3:0, UclProxyCddstatusValue_4:0, UclProxyCddstatusValue_5:0]}}
    UclProxyCddSlowGaugeInfoDataValue0: value-spec={short-label=UclProxyCddSlowGaugeInfoDataValue0, fields={short-label=UclProxyCddSlowGaugeInfoDataValue_0, fields=[UclProxyCddgaugeInfoValue_0:0, UclProxyCddgaugeInfoValue_1:0, UclProxyCddgaugeInfoValue_2:0, UclProxyCddgaugeInfoValue_3:0, UclProxyCddgaugeInfoValue_4:0]}}
    UclProxyCddTT_StatusDataValue0: value-spec={short-label=UclProxyCddTT_StatusDataValue0, fields=UclProxyCddTT_StatusDataValue_0:[UclProxyCddmask0Value:0, UclProxyCddmask1Value:0, UclProxyCddmask2Value:0, UclProxyCddmask3Value:0, UclProxyCddmask4Value:0, UclProxyCddmask5Value:0, UclProxyCddmask6Value:0, UclProxyCddmask7Value:0, UclProxyCddmask8Value:0, UclProxyCddmask9Value:0, UclProxyCddmask10Value:0, UclProxyCddmask11Value:0, UclProxyCddmask12Value:0, UclProxyCddmask13Value:0, UclProxyCddmask14Value:0]}
    UclProxyCddTpmsWarningDataDataValue0: value-spec={short-label=UclProxyCddTpmsWarningDataDataValue0, fields=UclProxyCddTpmsWarningDataDataValue_0:[UclProxyCddtpmsWarndata0Value:0, UclProxyCddtpmsWarndata1Value:0, UclProxyCddtpmsWarndata2Value:0, UclProxyCddtpmsWarndata3Value:0, UclProxyCddtpmsWarndata4Value:0]}
    UclProxyCddWarningDisplayDataValue0: value-spec={short-label=UclProxyCddWarningDisplayDataValue0, fields=[UclProxyCddWarningDisplayDataValue_0:0, UclProxyCddWarningDisplayDataValue_1:0, UclProxyCddWarningDisplayDataValue_2:[UclProxyCdddynData0Value:0, UclProxyCdddynData1Value:0, UclProxyCdddynData2Value:0, UclProxyCdddynData3Value:0, UclProxyCdddynData4Value:0, UclProxyCdddynData5Value:0, UclProxyCdddynData6Value:0, UclProxyCdddynData7Value:0]]}
    Mdl_GearShiftPositionDisplayValue0: value-spec=Mdl_GearShiftPositionDisplayValue0:0
    Mdl_GearShiftModeIndicatorValue0: value-spec=Mdl_GearShiftModeIndicatorValue0:0
    Mdl_GearShiftPositionValue0: value-spec=Mdl_GearShiftPositionValue0:0
    Mdl_GearShiftPosIndStatusDataValue0: value-spec={short-label=Mdl_GearShiftPosIndStatusDataValue0, fields={short-label=Mdl_GearShiftPosIndStatusDataValue_0, fields=[Mdl_GearstatusValue_0:0, Mdl_GearstatusValue_1:0, Mdl_GearstatusValue_2:0, Mdl_GearstatusValue_3:0, Mdl_GearstatusValue_4:0, Mdl_GearstatusValue_5:0]}}
    Mdl_GearShiftPos_DataValue0: value-spec={short-label=Mdl_GearShiftPos_DataValue0, fields=[Mdl_GearShiftPos_DataValue_0:0, Mdl_GearShiftPos_DataValue_1:0, Mdl_GearShiftPos_DataValue_2:0, Mdl_GearShiftPos_DataValue_3:0, Mdl_GearShiftPos_DataValue_4:0]}
    Mdl_GearIgnitionSubstateValue0: value-spec=Mdl_GearIgnitionSubstateValue0:0
    Mdl_GearWSSCurrentVehicleStateValue0: value-spec=Mdl_GearWSSCurrentVehicleStateValue0:0
    Mdl_GearWSSCurrentClusterModeValue0: value-spec=Mdl_GearWSSCurrentClusterModeValue0:0
    Mdl_GearHMI_ReadyStatusValue0: value-spec=Mdl_GearHMI_ReadyStatusValue0:0
    Mdl_GearPowerTrain_FlagValue0: value-spec=Mdl_GearPowerTrain_FlagValue0:0
    Mdl_GearTIUpdateIndicatorStatusValue0: value-spec=Mdl_GearTIUpdateIndicatorStatusValue0:0
    CView_TelltaleTT_StatusDataValue0: value-spec={short-label=CView_TelltaleTT_StatusDataValue0, fields=CView_TelltaleTT_StatusDataValue_0:[CView_Telltalemask0Value:0, CView_Telltalemask1Value:0, CView_Telltalemask2Value:0, CView_Telltalemask3Value:0, CView_Telltalemask4Value:0, CView_Telltalemask5Value:0, CView_Telltalemask6Value:0, CView_Telltalemask7Value:0, CView_Telltalemask8Value:0, CView_Telltalemask9Value:0, CView_Telltalemask10Value:0, CView_Telltalemask11Value:0, CView_Telltalemask12Value:0, CView_Telltalemask13Value:0, CView_Telltalemask14Value:0]}
    CView_TelltaleTTBlinkStatusArrayValue0: value-spec=CView_TelltaleTTBlinkStatusArrayValue0:[CView_TelltaleTTBlinkStatusArray0Value:0, CView_TelltaleTTBlinkStatusArray1Value:0, CView_TelltaleTTBlinkStatusArray2Value:0, CView_TelltaleTTBlinkStatusArray3Value:0, CView_TelltaleTTBlinkStatusArray4Value:0, CView_TelltaleTTBlinkStatusArray5Value:0, CView_TelltaleTTBlinkStatusArray6Value:0, CView_TelltaleTTBlinkStatusArray7Value:0, CView_TelltaleTTBlinkStatusArray8Value:0, CView_TelltaleTTBlinkStatusArray9Value:0, CView_TelltaleTTBlinkStatusArray10Value:0, CView_TelltaleTTBlinkStatusArray11Value:0, CView_TelltaleTTBlinkStatusArray12Value:0, CView_TelltaleTTBlinkStatusArray13Value:0, CView_TelltaleTTBlinkStatusArray14Value:0, CView_TelltaleTTBlinkStatusArray15Value:0]
    CView_TelltaleTTdummyDataForTypesValue0: value-spec=CView_TelltaleTTdummyDataForTypesValue0:0
    CView_TelltaleTelltaleOpArrayValue0: value-spec=CView_TelltaleTelltaleOpArrayValue0:[CView_TelltaleTelltaleOpArray0Value:0, CView_TelltaleTelltaleOpArray1Value:0, CView_TelltaleTelltaleOpArray2Value:0, CView_TelltaleTelltaleOpArray3Value:0, CView_TelltaleTelltaleOpArray4Value:0, CView_TelltaleTelltaleOpArray5Value:0, CView_TelltaleTelltaleOpArray6Value:0, CView_TelltaleTelltaleOpArray7Value:0, CView_TelltaleTelltaleOpArray8Value:0, CView_TelltaleTelltaleOpArray9Value:0, CView_TelltaleTelltaleOpArray10Value:0, CView_TelltaleTelltaleOpArray11Value:0, CView_TelltaleTelltaleOpArray12Value:0, CView_TelltaleTelltaleOpArray13Value:0, CView_TelltaleTelltaleOpArray14Value:0, CView_TelltaleTelltaleOpArray15Value:0, CView_TelltaleTelltaleOpArray16Value:0, CView_TelltaleTelltaleOpArray17Value:0, CView_TelltaleTelltaleOpArray18Value:0, CView_TelltaleTelltaleOpArray19Value:0, CView_TelltaleTelltaleOpArray20Value:0, CView_TelltaleTelltaleOpArray21Value:0, CView_TelltaleTelltaleOpArray22Value:0, CView_TelltaleTelltaleOpArray23Value:0, CView_TelltaleTelltaleOpArray24Value:0, CView_TelltaleTelltaleOpArray25Value:0, CView_TelltaleTelltaleOpArray26Value:0, CView_TelltaleTelltaleOpArray27Value:0, CView_TelltaleTelltaleOpArray28Value:0, CView_TelltaleTelltaleOpArray29Value:0, CView_TelltaleTelltaleOpArray30Value:0, CView_TelltaleTelltaleOpArray31Value:0, CView_TelltaleTelltaleOpArray32Value:0, CView_TelltaleTelltaleOpArray33Value:0, CView_TelltaleTelltaleOpArray34Value:0, CView_TelltaleTelltaleOpArray35Value:0, CView_TelltaleTelltaleOpArray36Value:0, CView_TelltaleTelltaleOpArray37Value:0, CView_TelltaleTelltaleOpArray38Value:0, CView_TelltaleTelltaleOpArray39Value:0, CView_TelltaleTelltaleOpArray40Value:0, CView_TelltaleTelltaleOpArray41Value:0, CView_TelltaleTelltaleOpArray42Value:0, CView_TelltaleTelltaleOpArray43Value:0, CView_TelltaleTelltaleOpArray44Value:0, CView_TelltaleTelltaleOpArray45Value:0, CView_TelltaleTelltaleOpArray46Value:0, CView_TelltaleTelltaleOpArray47Value:0, CView_TelltaleTelltaleOpArray48Value:0, CView_TelltaleTelltaleOpArray49Value:0, CView_TelltaleTelltaleOpArray50Value:0, CView_TelltaleTelltaleOpArray51Value:0, CView_TelltaleTelltaleOpArray52Value:0, CView_TelltaleTelltaleOpArray53Value:0, CView_TelltaleTelltaleOpArray54Value:0, CView_TelltaleTelltaleOpArray55Value:0, CView_TelltaleTelltaleOpArray56Value:0, CView_TelltaleTelltaleOpArray57Value:0, CView_TelltaleTelltaleOpArray58Value:0, CView_TelltaleTelltaleOpArray59Value:0, CView_TelltaleTelltaleOpArray60Value:0, CView_TelltaleTelltaleOpArray61Value:0, CView_TelltaleTelltaleOpArray62Value:0, CView_TelltaleTelltaleOpArray63Value:0, CView_TelltaleTelltaleOpArray64Value:0, CView_TelltaleTelltaleOpArray65Value:0, CView_TelltaleTelltaleOpArray66Value:0, CView_TelltaleTelltaleOpArray67Value:0, CView_TelltaleTelltaleOpArray68Value:0, CView_TelltaleTelltaleOpArray69Value:0, CView_TelltaleTelltaleOpArray70Value:0, CView_TelltaleTelltaleOpArray71Value:0, CView_TelltaleTelltaleOpArray72Value:0, CView_TelltaleTelltaleOpArray73Value:0, CView_TelltaleTelltaleOpArray74Value:0, CView_TelltaleTelltaleOpArray75Value:0, CView_TelltaleTelltaleOpArray76Value:0, CView_TelltaleTelltaleOpArray77Value:0, CView_TelltaleTelltaleOpArray78Value:0, CView_TelltaleTelltaleOpArray79Value:0, CView_TelltaleTelltaleOpArray80Value:0, CView_TelltaleTelltaleOpArray81Value:0, CView_TelltaleTelltaleOpArray82Value:0, CView_TelltaleTelltaleOpArray83Value:0, CView_TelltaleTelltaleOpArray84Value:0, CView_TelltaleTelltaleOpArray85Value:0, CView_TelltaleTelltaleOpArray86Value:0, CView_TelltaleTelltaleOpArray87Value:0, CView_TelltaleTelltaleOpArray88Value:0, CView_TelltaleTelltaleOpArray89Value:0, CView_TelltaleTelltaleOpArray90Value:0, CView_TelltaleTelltaleOpArray91Value:0]
    CView_TelltaleCurrentTelltaleStatusValue0: value-spec=CView_TelltaleCurrentTelltaleStatusValue0:0
    CView_TelltaleWSSCurrentClusterModeValue0: value-spec=CView_TelltaleWSSCurrentClusterModeValue0:0
    CView_TelltaleHMI_ReadyStatusValue0: value-spec=CView_TelltaleHMI_ReadyStatusValue0:0
    Mdl_AirbagCurrentTelltaleStatusValue0: value-spec=Mdl_AirbagCurrentTelltaleStatusValue0:0
    Mdl_AirbagSafetyAdapter_Ign_SubstateValue0: value-spec=Mdl_AirbagSafetyAdapter_Ign_SubstateValue0:0
    Mdl_AirbagWSSCurrentClusterModeValue0: value-spec=Mdl_AirbagWSSCurrentClusterModeValue0:0
    Mdl_AirbagSafetyAdapter_AppModeValue0: value-spec=Mdl_AirbagSafetyAdapter_AppModeValue0:0
    Mdl_SafetyAdapterSafetyAdapter_AppModeValue0: value-spec=Mdl_SafetyAdapterSafetyAdapter_AppModeValue0:0
    Mdl_SafetyAdapterSafetyAdapter_CurrentClusterModeValue0: value-spec=Mdl_SafetyAdapterSafetyAdapter_CurrentClusterModeValue0:0
    Mdl_SafetyAdapterSafetyAdapter_Ign_SubstateValue0: value-spec=Mdl_SafetyAdapterSafetyAdapter_Ign_SubstateValue0:0
    Mdl_SafetyAdapterSafetyAdapter_HVSD1Value0: value-spec=Mdl_SafetyAdapterSafetyAdapter_HVSD1Value0:0
    Mdl_SafetyAdapterSafetyAdapter_LVSD1Value0: value-spec=Mdl_SafetyAdapterSafetyAdapter_LVSD1Value0:0
    Mdl_SafetyAdapterABValue0: value-spec=Mdl_SafetyAdapterABValue0:0
    Mdl_SafetyAdapterABS_MIDValue0: value-spec=Mdl_SafetyAdapterABS_MIDValue0:0
    Mdl_SafetyAdapterBHEXISTValue0: value-spec=Mdl_SafetyAdapterBHEXISTValue0:0
    Mdl_SafetyAdapterBRK_MIDValue0: value-spec=Mdl_SafetyAdapterBRK_MIDValue0:0
    Mdl_SafetyAdapterB_ABSValue0: value-spec=Mdl_SafetyAdapterB_ABSValue0:0
    Mdl_SafetyAdapterB_ALSDValue0: value-spec=Mdl_SafetyAdapterB_ALSDValue0:0
    Mdl_SafetyAdapterB_BRKWValue0: value-spec=Mdl_SafetyAdapterB_BRKWValue0:0
    Mdl_SafetyAdapterB_BRKW2Value0: value-spec=Mdl_SafetyAdapterB_BRKW2Value0:0
    Mdl_SafetyAdapterB_BRLVValue0: value-spec=Mdl_SafetyAdapterB_BRLVValue0:0
    Mdl_SafetyAdapterB_BRLV2Value0: value-spec=Mdl_SafetyAdapterB_BRLV2Value0:0
    Mdl_SafetyAdapterB_BUZZE2Value0: value-spec=Mdl_SafetyAdapterB_BUZZE2Value0:0
    Mdl_SafetyAdapterB_BUZZERValue0: value-spec=Mdl_SafetyAdapterB_BUZZERValue0:0
    Mdl_SafetyAdapterB_CPKBValue0: value-spec=Mdl_SafetyAdapterB_CPKBValue0:0
    Mdl_SafetyAdapterB_DACINDValue0: value-spec=Mdl_SafetyAdapterB_DACINDValue0:0
    Mdl_SafetyAdapterB_DAINDCValue0: value-spec=Mdl_SafetyAdapterB_DAINDCValue0:0
    Mdl_SafetyAdapterB_DAINDPValue0: value-spec=Mdl_SafetyAdapterB_DAINDPValue0:0
    Mdl_SafetyAdapterB_EBWValue0: value-spec=Mdl_SafetyAdapterB_EBWValue0:0
    Mdl_SafetyAdapterB_EBW2Value0: value-spec=Mdl_SafetyAdapterB_EBW2Value0:0
    Mdl_SafetyAdapterB_EPBMIDValue0: value-spec=Mdl_SafetyAdapterB_EPBMIDValue0:0
    Mdl_SafetyAdapterB_EPBWLValue0: value-spec=Mdl_SafetyAdapterB_EPBWLValue0:0
    Mdl_SafetyAdapterB_PKBLPValue0: value-spec=Mdl_SafetyAdapterB_PKBLPValue0:0
    Mdl_SafetyAdapterDBKLABValue0: value-spec=Mdl_SafetyAdapterDBKLABValue0:0
    Mdl_SafetyAdapterEBW_MIDValue0: value-spec=Mdl_SafetyAdapterEBW_MIDValue0:0
    Mdl_SafetyAdapterECBEXISTValue0: value-spec=Mdl_SafetyAdapterECBEXISTValue0:0
    Mdl_SafetyAdapterMCBWValue0: value-spec=Mdl_SafetyAdapterMCBWValue0:0
    Mdl_SafetyAdapterPBKLABValue0: value-spec=Mdl_SafetyAdapterPBKLABValue0:0
    Mdl_SafetyAdapterPWIINFOValue0: value-spec=Mdl_SafetyAdapterPWIINFOValue0:0
    Mdl_SafetyAdapterSCSACCELValue0: value-spec=Mdl_SafetyAdapterSCSACCELValue0:0
    Mdl_SafetyAdapterSCSBZRValue0: value-spec=Mdl_SafetyAdapterSCSBZRValue0:0
    Mdl_SafetyAdapterSLP_WLValue0: value-spec=Mdl_SafetyAdapterSLP_WLValue0:0
    Mdl_SafetyAdapterTRCCONFLValue0: value-spec=Mdl_SafetyAdapterTRCCONFLValue0:0
    Mdl_SafetyAdapterTRCCONFRValue0: value-spec=Mdl_SafetyAdapterTRCCONFRValue0:0
    Mdl_SafetyAdapterTRCCONRLValue0: value-spec=Mdl_SafetyAdapterTRCCONRLValue0:0
    Mdl_SafetyAdapterTRCCONRRValue0: value-spec=Mdl_SafetyAdapterTRCCONRRValue0:0
    Mdl_SafetyAdapterTRCOFFValue0: value-spec=Mdl_SafetyAdapterTRCOFFValue0:0
    Mdl_SafetyAdapterVSCEXISTValue0: value-spec=Mdl_SafetyAdapterVSCEXISTValue0:0
    Mdl_SafetyAdapterVSCOFFValue0: value-spec=Mdl_SafetyAdapterVSCOFFValue0:0
    Mdl_SafetyAdapterWSSCurrentClusterModeValue0: value-spec=Mdl_SafetyAdapterWSSCurrentClusterModeValue0:0
    Mdl_TurnHazardCurrentTelltaleStatusValue0: value-spec=Mdl_TurnHazardCurrentTelltaleStatusValue0:0
    Mdl_TurnHazardLeftIndicatorStsValue0: value-spec=Mdl_TurnHazardLeftIndicatorStsValue0:0
    Mdl_TurnHazardRightIndicatorStsValue0: value-spec=Mdl_TurnHazardRightIndicatorStsValue0:0
    Mdl_TurnHazardChime_RequestValue0: value-spec=Mdl_TurnHazardChime_RequestValue0:0
    Mdl_TurnHazardUpdateChimeVolumeValue0: value-spec=Mdl_TurnHazardUpdateChimeVolumeValue0:0
    Mdl_TurnHazardNvmdataValue0: value-spec=Mdl_TurnHazardNvmdataValue0:0
    Mdl_TurnHazardWSSCurrentClusterModeValue0: value-spec=Mdl_TurnHazardWSSCurrentClusterModeValue0:0
    FastGaugeAdapterFastGaugeInfoDataValue0: value-spec={short-label=FastGaugeAdapterFastGaugeInfoDataValue0, fields={short-label=FastGaugeAdapterFastGaugeInfoDataValue_0, fields=[FastGaugeAdaptergaugeInfoValue_0:0, FastGaugeAdaptergaugeInfoValue_1:0, FastGaugeAdaptergaugeInfoValue_2:0, FastGaugeAdaptergaugeInfoValue_3:0, FastGaugeAdaptergaugeInfoValue_4:0]}}
    FastGaugeAdapterIgnitionSubstateValue0: value-spec=FastGaugeAdapterIgnitionSubstateValue0:0
    FastGaugeAdapterAnalog_TachoValue0: value-spec=FastGaugeAdapterAnalog_TachoValue0:0
    FastGaugeAdapterWSSCurrentClusterModeValue0: value-spec=FastGaugeAdapterWSSCurrentClusterModeValue0:0
    FastGaugeAdapterAppIdValue0: value-spec=FastGaugeAdapterAppIdValue0:0
    FastGaugeAdapterDiag_Digital_Speed_ValueValue0: value-spec=FastGaugeAdapterDiag_Digital_Speed_ValueValue0:0
    FastGaugeAdapterDigital_TachoValue0: value-spec=FastGaugeAdapterDigital_TachoValue0:0
    FastGaugeAdapterDisplayUnitValue0: value-spec=FastGaugeAdapterDisplayUnitValue0:0
    FastGaugeAdapterDispSpeedValValue0: value-spec=FastGaugeAdapterDispSpeedValValue0:0
    FastGaugeAdapterDigital_Speed_ValueValue0: value-spec=FastGaugeAdapterDigital_Speed_ValueValue0:0
    FastGaugeAdapterHMI_ReadyStatusValue0: value-spec=FastGaugeAdapterHMI_ReadyStatusValue0:0
    FastGaugeAdapterNeedle_TRValue0: value-spec=FastGaugeAdapterNeedle_TRValue0:0
    FastGaugeAdapterPowerTrain_FlagValue0: value-spec=FastGaugeAdapterPowerTrain_FlagValue0:0
    FastGaugeAdapterSubDispSpeedValValue0: value-spec=FastGaugeAdapterSubDispSpeedValValue0:0
    FastGaugeAdapterDigital_TachoUnitValue0: value-spec=FastGaugeAdapterDigital_TachoUnitValue0:false
    FastGaugeAdapterRED_Start_RPMValue0: value-spec=FastGaugeAdapterRED_Start_RPMValue0:0
    FastGaugeAdapterREVP_RPM_MAXValue0: value-spec=FastGaugeAdapterREVP_RPM_MAXValue0:0
    View_SpeedDigital_Speed_ValueValue0: value-spec=View_SpeedDigital_Speed_ValueValue0:0
    View_SpeedSubDispSpeedValValue0: value-spec=View_SpeedSubDispSpeedValValue0:0
    View_SpeedSubSpeedunitValue0: value-spec=View_SpeedSubSpeedunitValue0:0
    View_SpeedIgnitionSubstateValue0: value-spec=View_SpeedIgnitionSubstateValue0:0
    View_SpeedWSSCurrentClusterModeValue0: value-spec=View_SpeedWSSCurrentClusterModeValue0:0
    View_SpeedCountryCode_FuncValue0: value-spec=View_SpeedCountryCode_FuncValue0:0
    View_SpeedAppIdValue0: value-spec=View_SpeedAppIdValue0:0
    View_SpeedDiag_Digital_Speed_ValueValue0: value-spec=View_SpeedDiag_Digital_Speed_ValueValue0:0
    View_SpeedDisplayUnitValue0: value-spec=View_SpeedDisplayUnitValue0:0
    View_SpeedSP1_In_StatusValue0: value-spec=View_SpeedSP1_In_StatusValue0:0
    View_SpeedSpeed_Selection_TableValue0: value-spec=View_SpeedSpeed_Selection_TableValue0:0
    View_SpeedSpd_Target2_StatusValue0: value-spec=View_SpeedSpd_Target2_StatusValue0:0
    View_SpeedSpd_Target_StatusValue0: value-spec=View_SpeedSpd_Target_StatusValue0:0
    View_SpeedSpd_Trim2_StatusValue0: value-spec=View_SpeedSpd_Trim2_StatusValue0:0
    View_SpeedSpd_Trim_StatusValue0: value-spec=View_SpeedSpd_Trim_StatusValue0:0
    Mdl_SpeedSP1_In_StatusValue0: value-spec=Mdl_SpeedSP1_In_StatusValue0:0
    Mdl_SpeedSpeed_Selection_TableValue0: value-spec=Mdl_SpeedSpeed_Selection_TableValue0:0
    Mdl_SpeedSpd_Target2_StatusValue0: value-spec=Mdl_SpeedSpd_Target2_StatusValue0:0
    Mdl_SpeedSpd_Target_StatusValue0: value-spec=Mdl_SpeedSpd_Target_StatusValue0:0
    Mdl_SpeedSpd_Trim2_StatusValue0: value-spec=Mdl_SpeedSpd_Trim2_StatusValue0:0
    Mdl_SpeedSpd_Trim_StatusValue0: value-spec=Mdl_SpeedSpd_Trim_StatusValue0:0
    Mdl_SpeedIgnitionSubstateValue0: value-spec=Mdl_SpeedIgnitionSubstateValue0:0
    Mdl_SpeedWSSCurrentClusterModeValue0: value-spec=Mdl_SpeedWSSCurrentClusterModeValue0:0
    Mdl_SpeedCountryCode_FuncValue0: value-spec=Mdl_SpeedCountryCode_FuncValue0:0
    Mdl_SpeedAppIdValue0: value-spec=Mdl_SpeedAppIdValue0:0
    Mdl_SpeedDiag_Digital_Speed_ValueValue0: value-spec=Mdl_SpeedDiag_Digital_Speed_ValueValue0:0
    Mdl_SpeedDisplayUnitValue0: value-spec=Mdl_SpeedDisplayUnitValue0:0
    Mdl_TachoAnalog_TachoValue0: value-spec=Mdl_TachoAnalog_TachoValue0:0
    Mdl_TachoDigital_TachoValue0: value-spec=Mdl_TachoDigital_TachoValue0:0
    Mdl_TachoCalTachoValueValue0: value-spec=Mdl_TachoCalTachoValueValue0:0
    Mdl_TachoNeedle_TRValue0: value-spec=Mdl_TachoNeedle_TRValue0:0
    Mdl_TachoREVP_DISPValue0: value-spec=Mdl_TachoREVP_DISPValue0:false
    Mdl_TachoDigital_TachoUnitValue0: value-spec=Mdl_TachoDigital_TachoUnitValue0:false
    Mdl_TachoRED_Start_RPMValue0: value-spec=Mdl_TachoRED_Start_RPMValue0:0
    Mdl_TachoREVP_RPM_MAXValue0: value-spec=Mdl_TachoREVP_RPM_MAXValue0:0
    Mdl_TachoREVP_RPMValue0: value-spec=Mdl_TachoREVP_RPMValue0:0
    Mdl_TachoIgnitionSubstateValue0: value-spec=Mdl_TachoIgnitionSubstateValue0:0
    Mdl_TachoWSSCurrentClusterModeValue0: value-spec=Mdl_TachoWSSCurrentClusterModeValue0:0
    Mdl_TachoCountryCode_FuncValue0: value-spec=Mdl_TachoCountryCode_FuncValue0:0
    Mdl_TachoAppIdValue0: value-spec=Mdl_TachoAppIdValue0:0
    Mdl_TachoPowerTrain_FlagValue0: value-spec=Mdl_TachoPowerTrain_FlagValue0:0
    Mdl_TachoSP1_In_StatusValue0: value-spec=Mdl_TachoSP1_In_StatusValue0:0
    SlowGaugeAdapterSlowGaugeInfoDataValue0: value-spec={short-label=SlowGaugeAdapterSlowGaugeInfoDataValue0, fields={short-label=SlowGaugeAdapterSlowGaugeInfoDataValue_0, fields=[SlowGaugeAdaptergaugeInfoValue_0:0, SlowGaugeAdaptergaugeInfoValue_1:0, SlowGaugeAdaptergaugeInfoValue_2:0, SlowGaugeAdaptergaugeInfoValue_3:0, SlowGaugeAdaptergaugeInfoValue_4:0]}}
    SlowGaugeAdapterIgnitionSubstateValue0: value-spec=SlowGaugeAdapterIgnitionSubstateValue0:0
    SlowGaugeAdapterWSSCurrentClusterModeValue0: value-spec=SlowGaugeAdapterWSSCurrentClusterModeValue0:0
    SlowGaugeAdapterAppIdValue0: value-spec=SlowGaugeAdapterAppIdValue0:0
    SlowGaugeAdapterDiag_Digital_Speed_ValueValue0: value-spec=SlowGaugeAdapterDiag_Digital_Speed_ValueValue0:0
    SlowGaugeAdapterDisplayUnitValue0: value-spec=SlowGaugeAdapterDisplayUnitValue0:0
    SlowGaugeAdapterHMI_ReadyStatusValue0: value-spec=SlowGaugeAdapterHMI_ReadyStatusValue0:0
    Mdl_wAirbagIgnitionSubstateValue0: value-spec=Mdl_wAirbagIgnitionSubstateValue0:0
    Mdl_wAirbagWSSCurrentClusterModeValue0: value-spec=Mdl_wAirbagWSSCurrentClusterModeValue0:0
    Mdl_wAirbagWSSCurrentVehicleStateValue0: value-spec=Mdl_wAirbagWSSCurrentVehicleStateValue0:0
    Mdl_wFuelLidOpenIgnitionSubstateValue0: value-spec=Mdl_wFuelLidOpenIgnitionSubstateValue0:0
    Mdl_wFuelLidOpenWSSCurrentClusterModeValue0: value-spec=Mdl_wFuelLidOpenWSSCurrentClusterModeValue0:0
    MemAbstractMdlJobStatus_BsFuSa_FeatureData_Audio_ElementValue0: value-spec=MemAbstractMdlJobStatus_BsFuSa_FeatureData_Audio_ElementValue0:0
    MemAbstractMdlJobStatus_BsFuSa_FeatureData_Communication_ElementValue0: value-spec=MemAbstractMdlJobStatus_BsFuSa_FeatureData_Communication_ElementValue0:0
    MemAbstractMdlJobStatus_BsFuSa_FeatureData_Display_ElementValue0: value-spec=MemAbstractMdlJobStatus_BsFuSa_FeatureData_Display_ElementValue0:0
    MemAbstractMdlJobStatus_BsFuSa_FeatureData_Fota_ElementValue0: value-spec=MemAbstractMdlJobStatus_BsFuSa_FeatureData_Fota_ElementValue0:0
    MemAbstractMdlJobStatus_BsFuSa_FeatureData_Power_ElementValue0: value-spec=MemAbstractMdlJobStatus_BsFuSa_FeatureData_Power_ElementValue0:0
    MemAbstractMdlJobStatus_BsFuSa_FeatureData_Warning_ElementValue0: value-spec=MemAbstractMdlJobStatus_BsFuSa_FeatureData_Warning_ElementValue0:0
    Mdl_AirbagIgnitionSubstateValue0: value-spec=Mdl_AirbagIgnitionSubstateValue0:0
    Mdl_AirbagWSSCurrentVehicleStateValue0: value-spec=Mdl_AirbagWSSCurrentVehicleStateValue0:0
    CDisplayCddDisplaySetPowerDataValue0: value-spec={short-label=CDisplayCddDisplaySetPowerDataValue0, fields=[CDisplayCddDisplaySetPowerDataValue_0:0, CDisplayCddDisplaySetPowerDataValue_1:0]}
    CDisplayCddDisplayCurrentStateDataValue0: value-spec={short-label=CDisplayCddDisplayCurrentStateDataValue0, fields=[CDisplayCddDisplayCurrentStateDataValue_0:0, CDisplayCddDisplayCurrentStateDataValue_1:0]}
    CMeetCddJobStatus_BsFuSa_FeatureData_Audio_ElementValue0: value-spec=CMeetCddJobStatus_BsFuSa_FeatureData_Audio_ElementValue0:0
    CMeetCddJobStatus_BsFuSa_FeatureData_Communication_ElementValue0: value-spec=CMeetCddJobStatus_BsFuSa_FeatureData_Communication_ElementValue0:0
    CMeetCddJobStatus_BsFuSa_FeatureData_Display_ElementValue0: value-spec=CMeetCddJobStatus_BsFuSa_FeatureData_Display_ElementValue0:0
    CMeetCddJobStatus_BsFuSa_FeatureData_Fota_ElementValue0: value-spec=CMeetCddJobStatus_BsFuSa_FeatureData_Fota_ElementValue0:0
    CMeetCddJobStatus_BsFuSa_FeatureData_Power_ElementValue0: value-spec=CMeetCddJobStatus_BsFuSa_FeatureData_Power_ElementValue0:0
    CMeetCddJobStatus_BsFuSa_FeatureData_Warning_ElementValue0: value-spec=CMeetCddJobStatus_BsFuSa_FeatureData_Warning_ElementValue0:0
    DcmExtJobStatus_BsFuSa_FeatureData_Audio_ElementValue0: value-spec=DcmExtJobStatus_BsFuSa_FeatureData_Audio_ElementValue0:0
    DcmExtJobStatus_BsFuSa_FeatureData_Communication_ElementValue0: value-spec=DcmExtJobStatus_BsFuSa_FeatureData_Communication_ElementValue0:0
    DcmExtJobStatus_BsFuSa_FeatureData_Display_ElementValue0: value-spec=DcmExtJobStatus_BsFuSa_FeatureData_Display_ElementValue0:0
    DcmExtJobStatus_BsFuSa_FeatureData_Fota_ElementValue0: value-spec=DcmExtJobStatus_BsFuSa_FeatureData_Fota_ElementValue0:0
    DcmExtJobStatus_BsFuSa_FeatureData_Power_ElementValue0: value-spec=DcmExtJobStatus_BsFuSa_FeatureData_Power_ElementValue0:0
    DcmExtJobStatus_BsFuSa_FeatureData_Warning_ElementValue0: value-spec=DcmExtJobStatus_BsFuSa_FeatureData_Warning_ElementValue0:0
    Ctrl_WSSMainHMIReadyStatusDataValue0: value-spec={short-label=Ctrl_WSSMainHMIReadyStatusDataValue0, fields=Ctrl_WSSMainHMIReadyStatusDataValue_0:0}
    UclProxyCddMainHMIReadyStatusDataValue0: value-spec={short-label=UclProxyCddMainHMIReadyStatusDataValue0, fields=UclProxyCddMainHMIReadyStatusDataValue_0:0}
    UclProxyCddSafeHMIReadyStatusDataValue0: value-spec={short-label=UclProxyCddSafeHMIReadyStatusDataValue0, fields=UclProxyCddSafeHMIReadyStatusDataValue_0:0}
    UclProxyCddUpdateShortServiceRespValue0: value-spec={short-label=UclProxyCddUpdateShortServiceRespValue0, fields=[UclProxyCddUpdateShortServiceRespValue_0:0, UclProxyCddUpdateShortServiceRespValue_1:0, UclProxyCddUpdateShortServiceRespValue_2:0, UclProxyCddUpdateShortServiceRespValue_3:0, UclProxyCddUpdateShortServiceRespValue_4:0, UclProxyCddUpdateShortServiceRespValue_5:0, UclProxyCddUpdateShortServiceRespValue_6:[UclProxyCdddata0Value:0, UclProxyCdddata1Value:0, UclProxyCdddata2Value:0, UclProxyCdddata3Value:0, UclProxyCdddata4Value:0, UclProxyCdddata5Value:0, UclProxyCdddata6Value:0, UclProxyCdddata7Value:0, UclProxyCdddata8Value:0, UclProxyCdddata9Value:0, UclProxyCdddata10Value:0, UclProxyCdddata11Value:0, UclProxyCdddata12Value:0, UclProxyCdddata13Value:0, UclProxyCdddata14Value:0, UclProxyCdddata15Value:0, UclProxyCdddata16Value:0, UclProxyCdddata17Value:0, UclProxyCdddata18Value:0, UclProxyCdddata19Value:0, UclProxyCdddata20Value:0, UclProxyCdddata21Value:0, UclProxyCdddata22Value:0, UclProxyCdddata23Value:0, UclProxyCdddata24Value:0, UclProxyCdddata25Value:0, UclProxyCdddata26Value:0, UclProxyCdddata27Value:0, UclProxyCdddata28Value:0, UclProxyCdddata29Value:0, UclProxyCdddata30Value:0, UclProxyCdddata31Value:0, UclProxyCdddata32Value:0, UclProxyCdddata33Value:0, UclProxyCdddata34Value:0, UclProxyCdddata35Value:0, UclProxyCdddata36Value:0, UclProxyCdddata37Value:0, UclProxyCdddata38Value:0, UclProxyCdddata39Value:0, UclProxyCdddata40Value:0, UclProxyCdddata41Value:0, UclProxyCdddata42Value:0, UclProxyCdddata43Value:0, UclProxyCdddata44Value:0, UclProxyCdddata45Value:0, UclProxyCdddata46Value:0, UclProxyCdddata47Value:0, UclProxyCdddata48Value:0, UclProxyCdddata49Value:0, UclProxyCdddata50Value:0, UclProxyCdddata51Value:0, UclProxyCdddata52Value:0, UclProxyCdddata53Value:0, UclProxyCdddata54Value:0, UclProxyCdddata55Value:0, UclProxyCdddata56Value:0, UclProxyCdddata57Value:0, UclProxyCdddata58Value:0, UclProxyCdddata59Value:0, UclProxyCdddata60Value:0, UclProxyCdddata61Value:0, UclProxyCdddata62Value:0, UclProxyCdddata63Value:0]]}
    UclProxyCddWarningDisplayAvailableDataValue0: value-spec={short-label=UclProxyCddWarningDisplayAvailableDataValue0, fields=UclProxyCddWarningDisplayAvailableDataValue_0:0}
    UclProxyCddFRTT_StatusDataValue0: value-spec={short-label=UclProxyCddFRTT_StatusDataValue0, fields=UclProxyCddFRTT_StatusDataValue_0:[UclProxyCddmask0Value:0, UclProxyCddmask1Value:0]}
    UclProxyCddRTT_IconDataValue0: value-spec={short-label=UclProxyCddRTT_IconDataValue0, fields=UclProxyCddRTT_IconDataValue_0:[UclProxyCddicon0Value:0, UclProxyCddicon1Value:0]}
    UclProxyCddRTT_StatusDataValue0: value-spec={short-label=UclProxyCddRTT_StatusDataValue0, fields=UclProxyCddRTT_StatusDataValue_0:[UclProxyCddmask0Value:0, UclProxyCddmask1Value:0]}
    UclProxyCddRTT_ToggleDataValue0: value-spec={short-label=UclProxyCddRTT_ToggleDataValue0, fields=[UclProxyCddRTT_ToggleDataValue_0:0, UclProxyCddRTT_ToggleDataValue_1:0]}
    UclProxyCddUpdateLongServiceReqValue0: value-spec={short-label=UclProxyCddUpdateLongServiceReqValue0, fields=[UclProxyCddUpdateLongServiceReqValue_0:0, UclProxyCddUpdateLongServiceReqValue_1:0, UclProxyCddUpdateLongServiceReqValue_2:0, UclProxyCddUpdateLongServiceReqValue_3:0, UclProxyCddUpdateLongServiceReqValue_4:0, UclProxyCddUpdateLongServiceReqValue_5:0, UclProxyCddUpdateLongServiceReqValue_6:[UclProxyCdddata0Value:0, UclProxyCdddata1Value:0, UclProxyCdddata2Value:0, UclProxyCdddata3Value:0, UclProxyCdddata4Value:0, UclProxyCdddata5Value:0, UclProxyCdddata6Value:0, UclProxyCdddata7Value:0, UclProxyCdddata8Value:0, UclProxyCdddata9Value:0, UclProxyCdddata10Value:0, UclProxyCdddata11Value:0, UclProxyCdddata12Value:0, UclProxyCdddata13Value:0, UclProxyCdddata14Value:0, UclProxyCdddata15Value:0, UclProxyCdddata16Value:0, UclProxyCdddata17Value:0, UclProxyCdddata18Value:0, UclProxyCdddata19Value:0, UclProxyCdddata20Value:0, UclProxyCdddata21Value:0, UclProxyCdddata22Value:0, UclProxyCdddata23Value:0, UclProxyCdddata24Value:0, UclProxyCdddata25Value:0, UclProxyCdddata26Value:0, UclProxyCdddata27Value:0, UclProxyCdddata28Value:0, UclProxyCdddata29Value:0, UclProxyCdddata30Value:0, UclProxyCdddata31Value:0, UclProxyCdddata32Value:0, UclProxyCdddata33Value:0, UclProxyCdddata34Value:0, UclProxyCdddata35Value:0, UclProxyCdddata36Value:0, UclProxyCdddata37Value:0, UclProxyCdddata38Value:0, UclProxyCdddata39Value:0, UclProxyCdddata40Value:0, UclProxyCdddata41Value:0, UclProxyCdddata42Value:0, UclProxyCdddata43Value:0, UclProxyCdddata44Value:0, UclProxyCdddata45Value:0, UclProxyCdddata46Value:0, UclProxyCdddata47Value:0, UclProxyCdddata48Value:0, UclProxyCdddata49Value:0, UclProxyCdddata50Value:0, UclProxyCdddata51Value:0, UclProxyCdddata52Value:0, UclProxyCdddata53Value:0, UclProxyCdddata54Value:0, UclProxyCdddata55Value:0, UclProxyCdddata56Value:0, UclProxyCdddata57Value:0, UclProxyCdddata58Value:0, UclProxyCdddata59Value:0, UclProxyCdddata60Value:0, UclProxyCdddata61Value:0, UclProxyCdddata62Value:0, UclProxyCdddata63Value:0, UclProxyCdddata64Value:0, UclProxyCdddata65Value:0, UclProxyCdddata66Value:0, UclProxyCdddata67Value:0, UclProxyCdddata68Value:0, UclProxyCdddata69Value:0, UclProxyCdddata70Value:0, UclProxyCdddata71Value:0, UclProxyCdddata72Value:0, UclProxyCdddata73Value:0, UclProxyCdddata74Value:0, UclProxyCdddata75Value:0, UclProxyCdddata76Value:0, UclProxyCdddata77Value:0, UclProxyCdddata78Value:0, UclProxyCdddata79Value:0, UclProxyCdddata80Value:0, UclProxyCdddata81Value:0, UclProxyCdddata82Value:0, UclProxyCdddata83Value:0, UclProxyCdddata84Value:0, UclProxyCdddata85Value:0, UclProxyCdddata86Value:0, UclProxyCdddata87Value:0, UclProxyCdddata88Value:0, UclProxyCdddata89Value:0, UclProxyCdddata90Value:0, UclProxyCdddata91Value:0, UclProxyCdddata92Value:0, UclProxyCdddata93Value:0, UclProxyCdddata94Value:0, UclProxyCdddata95Value:0, UclProxyCdddata96Value:0, UclProxyCdddata97Value:0, UclProxyCdddata98Value:0, UclProxyCdddata99Value:0, UclProxyCdddata100Value:0, UclProxyCdddata101Value:0, UclProxyCdddata102Value:0, UclProxyCdddata103Value:0, UclProxyCdddata104Value:0, UclProxyCdddata105Value:0, UclProxyCdddata106Value:0, UclProxyCdddata107Value:0, UclProxyCdddata108Value:0, UclProxyCdddata109Value:0, UclProxyCdddata110Value:0, UclProxyCdddata111Value:0, UclProxyCdddata112Value:0, UclProxyCdddata113Value:0, UclProxyCdddata114Value:0, UclProxyCdddata115Value:0, UclProxyCdddata116Value:0, UclProxyCdddata117Value:0, UclProxyCdddata118Value:0, UclProxyCdddata119Value:0, UclProxyCdddata120Value:0, UclProxyCdddata121Value:0, UclProxyCdddata122Value:0, UclProxyCdddata123Value:0, UclProxyCdddata124Value:0, UclProxyCdddata125Value:0, UclProxyCdddata126Value:0, UclProxyCdddata127Value:0, UclProxyCdddata128Value:0, UclProxyCdddata129Value:0, UclProxyCdddata130Value:0, UclProxyCdddata131Value:0, UclProxyCdddata132Value:0, UclProxyCdddata133Value:0, UclProxyCdddata134Value:0, UclProxyCdddata135Value:0, UclProxyCdddata136Value:0, UclProxyCdddata137Value:0, UclProxyCdddata138Value:0, UclProxyCdddata139Value:0, UclProxyCdddata140Value:0, UclProxyCdddata141Value:0, UclProxyCdddata142Value:0, UclProxyCdddata143Value:0, UclProxyCdddata144Value:0, UclProxyCdddata145Value:0, UclProxyCdddata146Value:0, UclProxyCdddata147Value:0, UclProxyCdddata148Value:0, UclProxyCdddata149Value:0, UclProxyCdddata150Value:0, UclProxyCdddata151Value:0, UclProxyCdddata152Value:0, UclProxyCdddata153Value:0, UclProxyCdddata154Value:0, UclProxyCdddata155Value:0, UclProxyCdddata156Value:0, UclProxyCdddata157Value:0, UclProxyCdddata158Value:0, UclProxyCdddata159Value:0, UclProxyCdddata160Value:0, UclProxyCdddata161Value:0, UclProxyCdddata162Value:0, UclProxyCdddata163Value:0, UclProxyCdddata164Value:0, UclProxyCdddata165Value:0, UclProxyCdddata166Value:0, UclProxyCdddata167Value:0, UclProxyCdddata168Value:0, UclProxyCdddata169Value:0, UclProxyCdddata170Value:0, UclProxyCdddata171Value:0, UclProxyCdddata172Value:0, UclProxyCdddata173Value:0, UclProxyCdddata174Value:0, UclProxyCdddata175Value:0, UclProxyCdddata176Value:0, UclProxyCdddata177Value:0, UclProxyCdddata178Value:0, UclProxyCdddata179Value:0, UclProxyCdddata180Value:0, UclProxyCdddata181Value:0, UclProxyCdddata182Value:0, UclProxyCdddata183Value:0, UclProxyCdddata184Value:0, UclProxyCdddata185Value:0, UclProxyCdddata186Value:0, UclProxyCdddata187Value:0, UclProxyCdddata188Value:0, UclProxyCdddata189Value:0, UclProxyCdddata190Value:0, UclProxyCdddata191Value:0, UclProxyCdddata192Value:0, UclProxyCdddata193Value:0, UclProxyCdddata194Value:0, UclProxyCdddata195Value:0, UclProxyCdddata196Value:0, UclProxyCdddata197Value:0, UclProxyCdddata198Value:0, UclProxyCdddata199Value:0, UclProxyCdddata200Value:0, UclProxyCdddata201Value:0, UclProxyCdddata202Value:0, UclProxyCdddata203Value:0, UclProxyCdddata204Value:0, UclProxyCdddata205Value:0, UclProxyCdddata206Value:0, UclProxyCdddata207Value:0, UclProxyCdddata208Value:0, UclProxyCdddata209Value:0, UclProxyCdddata210Value:0, UclProxyCdddata211Value:0, UclProxyCdddata212Value:0, UclProxyCdddata213Value:0, UclProxyCdddata214Value:0, UclProxyCdddata215Value:0, UclProxyCdddata216Value:0, UclProxyCdddata217Value:0, UclProxyCdddata218Value:0, UclProxyCdddata219Value:0, UclProxyCdddata220Value:0, UclProxyCdddata221Value:0, UclProxyCdddata222Value:0, UclProxyCdddata223Value:0, UclProxyCdddata224Value:0, UclProxyCdddata225Value:0, UclProxyCdddata226Value:0, UclProxyCdddata227Value:0, UclProxyCdddata228Value:0, UclProxyCdddata229Value:0, UclProxyCdddata230Value:0, UclProxyCdddata231Value:0, UclProxyCdddata232Value:0, UclProxyCdddata233Value:0, UclProxyCdddata234Value:0, UclProxyCdddata235Value:0, UclProxyCdddata236Value:0, UclProxyCdddata237Value:0, UclProxyCdddata238Value:0, UclProxyCdddata239Value:0, UclProxyCdddata240Value:0, UclProxyCdddata241Value:0, UclProxyCdddata242Value:0, UclProxyCdddata243Value:0, UclProxyCdddata244Value:0, UclProxyCdddata245Value:0, UclProxyCdddata246Value:0, UclProxyCdddata247Value:0, UclProxyCdddata248Value:0, UclProxyCdddata249Value:0, UclProxyCdddata250Value:0, UclProxyCdddata251Value:0, UclProxyCdddata252Value:0, UclProxyCdddata253Value:0, UclProxyCdddata254Value:0, UclProxyCdddata255Value:0, UclProxyCdddata256Value:0, UclProxyCdddata257Value:0, UclProxyCdddata258Value:0, UclProxyCdddata259Value:0, UclProxyCdddata260Value:0, UclProxyCdddata261Value:0, UclProxyCdddata262Value:0, UclProxyCdddata263Value:0, UclProxyCdddata264Value:0, UclProxyCdddata265Value:0, UclProxyCdddata266Value:0, UclProxyCdddata267Value:0, UclProxyCdddata268Value:0, UclProxyCdddata269Value:0, UclProxyCdddata270Value:0, UclProxyCdddata271Value:0, UclProxyCdddata272Value:0, UclProxyCdddata273Value:0, UclProxyCdddata274Value:0, UclProxyCdddata275Value:0, UclProxyCdddata276Value:0, UclProxyCdddata277Value:0, UclProxyCdddata278Value:0, UclProxyCdddata279Value:0, UclProxyCdddata280Value:0, UclProxyCdddata281Value:0, UclProxyCdddata282Value:0, UclProxyCdddata283Value:0, UclProxyCdddata284Value:0, UclProxyCdddata285Value:0, UclProxyCdddata286Value:0, UclProxyCdddata287Value:0, UclProxyCdddata288Value:0, UclProxyCdddata289Value:0, UclProxyCdddata290Value:0, UclProxyCdddata291Value:0, UclProxyCdddata292Value:0, UclProxyCdddata293Value:0, UclProxyCdddata294Value:0, UclProxyCdddata295Value:0, UclProxyCdddata296Value:0, UclProxyCdddata297Value:0, UclProxyCdddata298Value:0, UclProxyCdddata299Value:0, UclProxyCdddata300Value:0, UclProxyCdddata301Value:0, UclProxyCdddata302Value:0, UclProxyCdddata303Value:0, UclProxyCdddata304Value:0, UclProxyCdddata305Value:0, UclProxyCdddata306Value:0, UclProxyCdddata307Value:0, UclProxyCdddata308Value:0, UclProxyCdddata309Value:0, UclProxyCdddata310Value:0, UclProxyCdddata311Value:0, UclProxyCdddata312Value:0, UclProxyCdddata313Value:0, UclProxyCdddata314Value:0, UclProxyCdddata315Value:0, UclProxyCdddata316Value:0, UclProxyCdddata317Value:0, UclProxyCdddata318Value:0, UclProxyCdddata319Value:0, UclProxyCdddata320Value:0, UclProxyCdddata321Value:0, UclProxyCdddata322Value:0, UclProxyCdddata323Value:0, UclProxyCdddata324Value:0, UclProxyCdddata325Value:0, UclProxyCdddata326Value:0, UclProxyCdddata327Value:0, UclProxyCdddata328Value:0, UclProxyCdddata329Value:0, UclProxyCdddata330Value:0, UclProxyCdddata331Value:0, UclProxyCdddata332Value:0, UclProxyCdddata333Value:0, UclProxyCdddata334Value:0, UclProxyCdddata335Value:0, UclProxyCdddata336Value:0, UclProxyCdddata337Value:0, UclProxyCdddata338Value:0, UclProxyCdddata339Value:0, UclProxyCdddata340Value:0, UclProxyCdddata341Value:0, UclProxyCdddata342Value:0, UclProxyCdddata343Value:0, UclProxyCdddata344Value:0, UclProxyCdddata345Value:0, UclProxyCdddata346Value:0, UclProxyCdddata347Value:0, UclProxyCdddata348Value:0, UclProxyCdddata349Value:0, UclProxyCdddata350Value:0, UclProxyCdddata351Value:0, UclProxyCdddata352Value:0, UclProxyCdddata353Value:0, UclProxyCdddata354Value:0, UclProxyCdddata355Value:0, UclProxyCdddata356Value:0, UclProxyCdddata357Value:0, UclProxyCdddata358Value:0, UclProxyCdddata359Value:0, UclProxyCdddata360Value:0, UclProxyCdddata361Value:0, UclProxyCdddata362Value:0, UclProxyCdddata363Value:0, UclProxyCdddata364Value:0, UclProxyCdddata365Value:0, UclProxyCdddata366Value:0, UclProxyCdddata367Value:0, UclProxyCdddata368Value:0, UclProxyCdddata369Value:0, UclProxyCdddata370Value:0, UclProxyCdddata371Value:0, UclProxyCdddata372Value:0, UclProxyCdddata373Value:0, UclProxyCdddata374Value:0, UclProxyCdddata375Value:0, UclProxyCdddata376Value:0, UclProxyCdddata377Value:0, UclProxyCdddata378Value:0, UclProxyCdddata379Value:0, UclProxyCdddata380Value:0, UclProxyCdddata381Value:0, UclProxyCdddata382Value:0, UclProxyCdddata383Value:0, UclProxyCdddata384Value:0, UclProxyCdddata385Value:0, UclProxyCdddata386Value:0, UclProxyCdddata387Value:0, UclProxyCdddata388Value:0, UclProxyCdddata389Value:0, UclProxyCdddata390Value:0, UclProxyCdddata391Value:0, UclProxyCdddata392Value:0, UclProxyCdddata393Value:0, UclProxyCdddata394Value:0, UclProxyCdddata395Value:0, UclProxyCdddata396Value:0, UclProxyCdddata397Value:0, UclProxyCdddata398Value:0, UclProxyCdddata399Value:0, UclProxyCdddata400Value:0, UclProxyCdddata401Value:0, UclProxyCdddata402Value:0, UclProxyCdddata403Value:0, UclProxyCdddata404Value:0, UclProxyCdddata405Value:0, UclProxyCdddata406Value:0, UclProxyCdddata407Value:0, UclProxyCdddata408Value:0, UclProxyCdddata409Value:0, UclProxyCdddata410Value:0, UclProxyCdddata411Value:0, UclProxyCdddata412Value:0, UclProxyCdddata413Value:0, UclProxyCdddata414Value:0, UclProxyCdddata415Value:0, UclProxyCdddata416Value:0, UclProxyCdddata417Value:0, UclProxyCdddata418Value:0, UclProxyCdddata419Value:0, UclProxyCdddata420Value:0, UclProxyCdddata421Value:0, UclProxyCdddata422Value:0, UclProxyCdddata423Value:0, UclProxyCdddata424Value:0, UclProxyCdddata425Value:0, UclProxyCdddata426Value:0, UclProxyCdddata427Value:0, UclProxyCdddata428Value:0, UclProxyCdddata429Value:0, UclProxyCdddata430Value:0, UclProxyCdddata431Value:0, UclProxyCdddata432Value:0, UclProxyCdddata433Value:0, UclProxyCdddata434Value:0, UclProxyCdddata435Value:0, UclProxyCdddata436Value:0, UclProxyCdddata437Value:0, UclProxyCdddata438Value:0, UclProxyCdddata439Value:0, UclProxyCdddata440Value:0, UclProxyCdddata441Value:0, UclProxyCdddata442Value:0, UclProxyCdddata443Value:0, UclProxyCdddata444Value:0, UclProxyCdddata445Value:0, UclProxyCdddata446Value:0, UclProxyCdddata447Value:0, UclProxyCdddata448Value:0, UclProxyCdddata449Value:0, UclProxyCdddata450Value:0, UclProxyCdddata451Value:0, UclProxyCdddata452Value:0, UclProxyCdddata453Value:0, UclProxyCdddata454Value:0, UclProxyCdddata455Value:0, UclProxyCdddata456Value:0, UclProxyCdddata457Value:0, UclProxyCdddata458Value:0, UclProxyCdddata459Value:0, UclProxyCdddata460Value:0, UclProxyCdddata461Value:0, UclProxyCdddata462Value:0, UclProxyCdddata463Value:0, UclProxyCdddata464Value:0, UclProxyCdddata465Value:0, UclProxyCdddata466Value:0, UclProxyCdddata467Value:0, UclProxyCdddata468Value:0, UclProxyCdddata469Value:0, UclProxyCdddata470Value:0, UclProxyCdddata471Value:0, UclProxyCdddata472Value:0, UclProxyCdddata473Value:0, UclProxyCdddata474Value:0, UclProxyCdddata475Value:0, UclProxyCdddata476Value:0, UclProxyCdddata477Value:0, UclProxyCdddata478Value:0, UclProxyCdddata479Value:0, UclProxyCdddata480Value:0, UclProxyCdddata481Value:0, UclProxyCdddata482Value:0, UclProxyCdddata483Value:0, UclProxyCdddata484Value:0, UclProxyCdddata485Value:0, UclProxyCdddata486Value:0, UclProxyCdddata487Value:0, UclProxyCdddata488Value:0, UclProxyCdddata489Value:0, UclProxyCdddata490Value:0, UclProxyCdddata491Value:0, UclProxyCdddata492Value:0, UclProxyCdddata493Value:0, UclProxyCdddata494Value:0, UclProxyCdddata495Value:0, UclProxyCdddata496Value:0, UclProxyCdddata497Value:0, UclProxyCdddata498Value:0, UclProxyCdddata499Value:0, UclProxyCdddata500Value:0, UclProxyCdddata501Value:0, UclProxyCdddata502Value:0, UclProxyCdddata503Value:0, UclProxyCdddata504Value:0, UclProxyCdddata505Value:0, UclProxyCdddata506Value:0, UclProxyCdddata507Value:0, UclProxyCdddata508Value:0, UclProxyCdddata509Value:0, UclProxyCdddata510Value:0, UclProxyCdddata511Value:0]]}
    UclProxyCddUpdateShortServiceReqValue0: value-spec={short-label=UclProxyCddUpdateShortServiceReqValue0, fields=[UclProxyCddUpdateShortServiceReqValue_0:0, UclProxyCddUpdateShortServiceReqValue_1:0, UclProxyCddUpdateShortServiceReqValue_2:0, UclProxyCddUpdateShortServiceReqValue_3:0, UclProxyCddUpdateShortServiceReqValue_4:0, UclProxyCddUpdateShortServiceReqValue_5:0, UclProxyCddUpdateShortServiceReqValue_6:[UclProxyCdddata0Value:0, UclProxyCdddata1Value:0, UclProxyCdddata2Value:0, UclProxyCdddata3Value:0, UclProxyCdddata4Value:0, UclProxyCdddata5Value:0, UclProxyCdddata6Value:0, UclProxyCdddata7Value:0, UclProxyCdddata8Value:0, UclProxyCdddata9Value:0, UclProxyCdddata10Value:0, UclProxyCdddata11Value:0, UclProxyCdddata12Value:0, UclProxyCdddata13Value:0, UclProxyCdddata14Value:0, UclProxyCdddata15Value:0, UclProxyCdddata16Value:0, UclProxyCdddata17Value:0, UclProxyCdddata18Value:0, UclProxyCdddata19Value:0, UclProxyCdddata20Value:0, UclProxyCdddata21Value:0, UclProxyCdddata22Value:0, UclProxyCdddata23Value:0, UclProxyCdddata24Value:0, UclProxyCdddata25Value:0, UclProxyCdddata26Value:0, UclProxyCdddata27Value:0, UclProxyCdddata28Value:0, UclProxyCdddata29Value:0, UclProxyCdddata30Value:0, UclProxyCdddata31Value:0, UclProxyCdddata32Value:0, UclProxyCdddata33Value:0, UclProxyCdddata34Value:0, UclProxyCdddata35Value:0, UclProxyCdddata36Value:0, UclProxyCdddata37Value:0, UclProxyCdddata38Value:0, UclProxyCdddata39Value:0, UclProxyCdddata40Value:0, UclProxyCdddata41Value:0, UclProxyCdddata42Value:0, UclProxyCdddata43Value:0, UclProxyCdddata44Value:0, UclProxyCdddata45Value:0, UclProxyCdddata46Value:0, UclProxyCdddata47Value:0, UclProxyCdddata48Value:0, UclProxyCdddata49Value:0, UclProxyCdddata50Value:0, UclProxyCdddata51Value:0, UclProxyCdddata52Value:0, UclProxyCdddata53Value:0, UclProxyCdddata54Value:0, UclProxyCdddata55Value:0, UclProxyCdddata56Value:0, UclProxyCdddata57Value:0, UclProxyCdddata58Value:0, UclProxyCdddata59Value:0, UclProxyCdddata60Value:0, UclProxyCdddata61Value:0, UclProxyCdddata62Value:0, UclProxyCdddata63Value:0]]}
    UclProxyCddWarningExtDisplayDataValue0: value-spec={short-label=UclProxyCddWarningExtDisplayDataValue0, fields=[UclProxyCddWarningExtDisplayDataValue_0:0, UclProxyCddWarningExtDisplayDataValue_1:0, UclProxyCddWarningExtDisplayDataValue_2:[UclProxyCdddynData0Value:0, UclProxyCdddynData1Value:0, UclProxyCdddynData2Value:0, UclProxyCdddynData3Value:0, UclProxyCdddynData4Value:0, UclProxyCdddynData5Value:0, UclProxyCdddynData6Value:0, UclProxyCdddynData7Value:0]]}
    CUpdateCddUpdateLongServiceReqValue0: value-spec={short-label=CUpdateCddUpdateLongServiceReqValue0, fields=[CUpdateCddUpdateLongServiceReqValue_0:0, CUpdateCddUpdateLongServiceReqValue_1:0, CUpdateCddUpdateLongServiceReqValue_2:0, CUpdateCddUpdateLongServiceReqValue_3:0, CUpdateCddUpdateLongServiceReqValue_4:0, CUpdateCddUpdateLongServiceReqValue_5:0, CUpdateCddUpdateLongServiceReqValue_6:[CUpdateCdddata0Value:0, CUpdateCdddata1Value:0, CUpdateCdddata2Value:0, CUpdateCdddata3Value:0, CUpdateCdddata4Value:0, CUpdateCdddata5Value:0, CUpdateCdddata6Value:0, CUpdateCdddata7Value:0, CUpdateCdddata8Value:0, CUpdateCdddata9Value:0, CUpdateCdddata10Value:0, CUpdateCdddata11Value:0, CUpdateCdddata12Value:0, CUpdateCdddata13Value:0, CUpdateCdddata14Value:0, CUpdateCdddata15Value:0, CUpdateCdddata16Value:0, CUpdateCdddata17Value:0, CUpdateCdddata18Value:0, CUpdateCdddata19Value:0, CUpdateCdddata20Value:0, CUpdateCdddata21Value:0, CUpdateCdddata22Value:0, CUpdateCdddata23Value:0, CUpdateCdddata24Value:0, CUpdateCdddata25Value:0, CUpdateCdddata26Value:0, CUpdateCdddata27Value:0, CUpdateCdddata28Value:0, CUpdateCdddata29Value:0, CUpdateCdddata30Value:0, CUpdateCdddata31Value:0, CUpdateCdddata32Value:0, CUpdateCdddata33Value:0, CUpdateCdddata34Value:0, CUpdateCdddata35Value:0, CUpdateCdddata36Value:0, CUpdateCdddata37Value:0, CUpdateCdddata38Value:0, CUpdateCdddata39Value:0, CUpdateCdddata40Value:0, CUpdateCdddata41Value:0, CUpdateCdddata42Value:0, CUpdateCdddata43Value:0, CUpdateCdddata44Value:0, CUpdateCdddata45Value:0, CUpdateCdddata46Value:0, CUpdateCdddata47Value:0, CUpdateCdddata48Value:0, CUpdateCdddata49Value:0, CUpdateCdddata50Value:0, CUpdateCdddata51Value:0, CUpdateCdddata52Value:0, CUpdateCdddata53Value:0, CUpdateCdddata54Value:0, CUpdateCdddata55Value:0, CUpdateCdddata56Value:0, CUpdateCdddata57Value:0, CUpdateCdddata58Value:0, CUpdateCdddata59Value:0, CUpdateCdddata60Value:0, CUpdateCdddata61Value:0, CUpdateCdddata62Value:0, CUpdateCdddata63Value:0, CUpdateCdddata64Value:0, CUpdateCdddata65Value:0, CUpdateCdddata66Value:0, CUpdateCdddata67Value:0, CUpdateCdddata68Value:0, CUpdateCdddata69Value:0, CUpdateCdddata70Value:0, CUpdateCdddata71Value:0, CUpdateCdddata72Value:0, CUpdateCdddata73Value:0, CUpdateCdddata74Value:0, CUpdateCdddata75Value:0, CUpdateCdddata76Value:0, CUpdateCdddata77Value:0, CUpdateCdddata78Value:0, CUpdateCdddata79Value:0, CUpdateCdddata80Value:0, CUpdateCdddata81Value:0, CUpdateCdddata82Value:0, CUpdateCdddata83Value:0, CUpdateCdddata84Value:0, CUpdateCdddata85Value:0, CUpdateCdddata86Value:0, CUpdateCdddata87Value:0, CUpdateCdddata88Value:0, CUpdateCdddata89Value:0, CUpdateCdddata90Value:0, CUpdateCdddata91Value:0, CUpdateCdddata92Value:0, CUpdateCdddata93Value:0, CUpdateCdddata94Value:0, CUpdateCdddata95Value:0, CUpdateCdddata96Value:0, CUpdateCdddata97Value:0, CUpdateCdddata98Value:0, CUpdateCdddata99Value:0, CUpdateCdddata100Value:0, CUpdateCdddata101Value:0, CUpdateCdddata102Value:0, CUpdateCdddata103Value:0, CUpdateCdddata104Value:0, CUpdateCdddata105Value:0, CUpdateCdddata106Value:0, CUpdateCdddata107Value:0, CUpdateCdddata108Value:0, CUpdateCdddata109Value:0, CUpdateCdddata110Value:0, CUpdateCdddata111Value:0, CUpdateCdddata112Value:0, CUpdateCdddata113Value:0, CUpdateCdddata114Value:0, CUpdateCdddata115Value:0, CUpdateCdddata116Value:0, CUpdateCdddata117Value:0, CUpdateCdddata118Value:0, CUpdateCdddata119Value:0, CUpdateCdddata120Value:0, CUpdateCdddata121Value:0, CUpdateCdddata122Value:0, CUpdateCdddata123Value:0, CUpdateCdddata124Value:0, CUpdateCdddata125Value:0, CUpdateCdddata126Value:0, CUpdateCdddata127Value:0, CUpdateCdddata128Value:0, CUpdateCdddata129Value:0, CUpdateCdddata130Value:0, CUpdateCdddata131Value:0, CUpdateCdddata132Value:0, CUpdateCdddata133Value:0, CUpdateCdddata134Value:0, CUpdateCdddata135Value:0, CUpdateCdddata136Value:0, CUpdateCdddata137Value:0, CUpdateCdddata138Value:0, CUpdateCdddata139Value:0, CUpdateCdddata140Value:0, CUpdateCdddata141Value:0, CUpdateCdddata142Value:0, CUpdateCdddata143Value:0, CUpdateCdddata144Value:0, CUpdateCdddata145Value:0, CUpdateCdddata146Value:0, CUpdateCdddata147Value:0, CUpdateCdddata148Value:0, CUpdateCdddata149Value:0, CUpdateCdddata150Value:0, CUpdateCdddata151Value:0, CUpdateCdddata152Value:0, CUpdateCdddata153Value:0, CUpdateCdddata154Value:0, CUpdateCdddata155Value:0, CUpdateCdddata156Value:0, CUpdateCdddata157Value:0, CUpdateCdddata158Value:0, CUpdateCdddata159Value:0, CUpdateCdddata160Value:0, CUpdateCdddata161Value:0, CUpdateCdddata162Value:0, CUpdateCdddata163Value:0, CUpdateCdddata164Value:0, CUpdateCdddata165Value:0, CUpdateCdddata166Value:0, CUpdateCdddata167Value:0, CUpdateCdddata168Value:0, CUpdateCdddata169Value:0, CUpdateCdddata170Value:0, CUpdateCdddata171Value:0, CUpdateCdddata172Value:0, CUpdateCdddata173Value:0, CUpdateCdddata174Value:0, CUpdateCdddata175Value:0, CUpdateCdddata176Value:0, CUpdateCdddata177Value:0, CUpdateCdddata178Value:0, CUpdateCdddata179Value:0, CUpdateCdddata180Value:0, CUpdateCdddata181Value:0, CUpdateCdddata182Value:0, CUpdateCdddata183Value:0, CUpdateCdddata184Value:0, CUpdateCdddata185Value:0, CUpdateCdddata186Value:0, CUpdateCdddata187Value:0, CUpdateCdddata188Value:0, CUpdateCdddata189Value:0, CUpdateCdddata190Value:0, CUpdateCdddata191Value:0, CUpdateCdddata192Value:0, CUpdateCdddata193Value:0, CUpdateCdddata194Value:0, CUpdateCdddata195Value:0, CUpdateCdddata196Value:0, CUpdateCdddata197Value:0, CUpdateCdddata198Value:0, CUpdateCdddata199Value:0, CUpdateCdddata200Value:0, CUpdateCdddata201Value:0, CUpdateCdddata202Value:0, CUpdateCdddata203Value:0, CUpdateCdddata204Value:0, CUpdateCdddata205Value:0, CUpdateCdddata206Value:0, CUpdateCdddata207Value:0, CUpdateCdddata208Value:0, CUpdateCdddata209Value:0, CUpdateCdddata210Value:0, CUpdateCdddata211Value:0, CUpdateCdddata212Value:0, CUpdateCdddata213Value:0, CUpdateCdddata214Value:0, CUpdateCdddata215Value:0, CUpdateCdddata216Value:0, CUpdateCdddata217Value:0, CUpdateCdddata218Value:0, CUpdateCdddata219Value:0, CUpdateCdddata220Value:0, CUpdateCdddata221Value:0, CUpdateCdddata222Value:0, CUpdateCdddata223Value:0, CUpdateCdddata224Value:0, CUpdateCdddata225Value:0, CUpdateCdddata226Value:0, CUpdateCdddata227Value:0, CUpdateCdddata228Value:0, CUpdateCdddata229Value:0, CUpdateCdddata230Value:0, CUpdateCdddata231Value:0, CUpdateCdddata232Value:0, CUpdateCdddata233Value:0, CUpdateCdddata234Value:0, CUpdateCdddata235Value:0, CUpdateCdddata236Value:0, CUpdateCdddata237Value:0, CUpdateCdddata238Value:0, CUpdateCdddata239Value:0, CUpdateCdddata240Value:0, CUpdateCdddata241Value:0, CUpdateCdddata242Value:0, CUpdateCdddata243Value:0, CUpdateCdddata244Value:0, CUpdateCdddata245Value:0, CUpdateCdddata246Value:0, CUpdateCdddata247Value:0, CUpdateCdddata248Value:0, CUpdateCdddata249Value:0, CUpdateCdddata250Value:0, CUpdateCdddata251Value:0, CUpdateCdddata252Value:0, CUpdateCdddata253Value:0, CUpdateCdddata254Value:0, CUpdateCdddata255Value:0, CUpdateCdddata256Value:0, CUpdateCdddata257Value:0, CUpdateCdddata258Value:0, CUpdateCdddata259Value:0, CUpdateCdddata260Value:0, CUpdateCdddata261Value:0, CUpdateCdddata262Value:0, CUpdateCdddata263Value:0, CUpdateCdddata264Value:0, CUpdateCdddata265Value:0, CUpdateCdddata266Value:0, CUpdateCdddata267Value:0, CUpdateCdddata268Value:0, CUpdateCdddata269Value:0, CUpdateCdddata270Value:0, CUpdateCdddata271Value:0, CUpdateCdddata272Value:0, CUpdateCdddata273Value:0, CUpdateCdddata274Value:0, CUpdateCdddata275Value:0, CUpdateCdddata276Value:0, CUpdateCdddata277Value:0, CUpdateCdddata278Value:0, CUpdateCdddata279Value:0, CUpdateCdddata280Value:0, CUpdateCdddata281Value:0, CUpdateCdddata282Value:0, CUpdateCdddata283Value:0, CUpdateCdddata284Value:0, CUpdateCdddata285Value:0, CUpdateCdddata286Value:0, CUpdateCdddata287Value:0, CUpdateCdddata288Value:0, CUpdateCdddata289Value:0, CUpdateCdddata290Value:0, CUpdateCdddata291Value:0, CUpdateCdddata292Value:0, CUpdateCdddata293Value:0, CUpdateCdddata294Value:0, CUpdateCdddata295Value:0, CUpdateCdddata296Value:0, CUpdateCdddata297Value:0, CUpdateCdddata298Value:0, CUpdateCdddata299Value:0, CUpdateCdddata300Value:0, CUpdateCdddata301Value:0, CUpdateCdddata302Value:0, CUpdateCdddata303Value:0, CUpdateCdddata304Value:0, CUpdateCdddata305Value:0, CUpdateCdddata306Value:0, CUpdateCdddata307Value:0, CUpdateCdddata308Value:0, CUpdateCdddata309Value:0, CUpdateCdddata310Value:0, CUpdateCdddata311Value:0, CUpdateCdddata312Value:0, CUpdateCdddata313Value:0, CUpdateCdddata314Value:0, CUpdateCdddata315Value:0, CUpdateCdddata316Value:0, CUpdateCdddata317Value:0, CUpdateCdddata318Value:0, CUpdateCdddata319Value:0, CUpdateCdddata320Value:0, CUpdateCdddata321Value:0, CUpdateCdddata322Value:0, CUpdateCdddata323Value:0, CUpdateCdddata324Value:0, CUpdateCdddata325Value:0, CUpdateCdddata326Value:0, CUpdateCdddata327Value:0, CUpdateCdddata328Value:0, CUpdateCdddata329Value:0, CUpdateCdddata330Value:0, CUpdateCdddata331Value:0, CUpdateCdddata332Value:0, CUpdateCdddata333Value:0, CUpdateCdddata334Value:0, CUpdateCdddata335Value:0, CUpdateCdddata336Value:0, CUpdateCdddata337Value:0, CUpdateCdddata338Value:0, CUpdateCdddata339Value:0, CUpdateCdddata340Value:0, CUpdateCdddata341Value:0, CUpdateCdddata342Value:0, CUpdateCdddata343Value:0, CUpdateCdddata344Value:0, CUpdateCdddata345Value:0, CUpdateCdddata346Value:0, CUpdateCdddata347Value:0, CUpdateCdddata348Value:0, CUpdateCdddata349Value:0, CUpdateCdddata350Value:0, CUpdateCdddata351Value:0, CUpdateCdddata352Value:0, CUpdateCdddata353Value:0, CUpdateCdddata354Value:0, CUpdateCdddata355Value:0, CUpdateCdddata356Value:0, CUpdateCdddata357Value:0, CUpdateCdddata358Value:0, CUpdateCdddata359Value:0, CUpdateCdddata360Value:0, CUpdateCdddata361Value:0, CUpdateCdddata362Value:0, CUpdateCdddata363Value:0, CUpdateCdddata364Value:0, CUpdateCdddata365Value:0, CUpdateCdddata366Value:0, CUpdateCdddata367Value:0, CUpdateCdddata368Value:0, CUpdateCdddata369Value:0, CUpdateCdddata370Value:0, CUpdateCdddata371Value:0, CUpdateCdddata372Value:0, CUpdateCdddata373Value:0, CUpdateCdddata374Value:0, CUpdateCdddata375Value:0, CUpdateCdddata376Value:0, CUpdateCdddata377Value:0, CUpdateCdddata378Value:0, CUpdateCdddata379Value:0, CUpdateCdddata380Value:0, CUpdateCdddata381Value:0, CUpdateCdddata382Value:0, CUpdateCdddata383Value:0, CUpdateCdddata384Value:0, CUpdateCdddata385Value:0, CUpdateCdddata386Value:0, CUpdateCdddata387Value:0, CUpdateCdddata388Value:0, CUpdateCdddata389Value:0, CUpdateCdddata390Value:0, CUpdateCdddata391Value:0, CUpdateCdddata392Value:0, CUpdateCdddata393Value:0, CUpdateCdddata394Value:0, CUpdateCdddata395Value:0, CUpdateCdddata396Value:0, CUpdateCdddata397Value:0, CUpdateCdddata398Value:0, CUpdateCdddata399Value:0, CUpdateCdddata400Value:0, CUpdateCdddata401Value:0, CUpdateCdddata402Value:0, CUpdateCdddata403Value:0, CUpdateCdddata404Value:0, CUpdateCdddata405Value:0, CUpdateCdddata406Value:0, CUpdateCdddata407Value:0, CUpdateCdddata408Value:0, CUpdateCdddata409Value:0, CUpdateCdddata410Value:0, CUpdateCdddata411Value:0, CUpdateCdddata412Value:0, CUpdateCdddata413Value:0, CUpdateCdddata414Value:0, CUpdateCdddata415Value:0, CUpdateCdddata416Value:0, CUpdateCdddata417Value:0, CUpdateCdddata418Value:0, CUpdateCdddata419Value:0, CUpdateCdddata420Value:0, CUpdateCdddata421Value:0, CUpdateCdddata422Value:0, CUpdateCdddata423Value:0, CUpdateCdddata424Value:0, CUpdateCdddata425Value:0, CUpdateCdddata426Value:0, CUpdateCdddata427Value:0, CUpdateCdddata428Value:0, CUpdateCdddata429Value:0, CUpdateCdddata430Value:0, CUpdateCdddata431Value:0, CUpdateCdddata432Value:0, CUpdateCdddata433Value:0, CUpdateCdddata434Value:0, CUpdateCdddata435Value:0, CUpdateCdddata436Value:0, CUpdateCdddata437Value:0, CUpdateCdddata438Value:0, CUpdateCdddata439Value:0, CUpdateCdddata440Value:0, CUpdateCdddata441Value:0, CUpdateCdddata442Value:0, CUpdateCdddata443Value:0, CUpdateCdddata444Value:0, CUpdateCdddata445Value:0, CUpdateCdddata446Value:0, CUpdateCdddata447Value:0, CUpdateCdddata448Value:0, CUpdateCdddata449Value:0, CUpdateCdddata450Value:0, CUpdateCdddata451Value:0, CUpdateCdddata452Value:0, CUpdateCdddata453Value:0, CUpdateCdddata454Value:0, CUpdateCdddata455Value:0, CUpdateCdddata456Value:0, CUpdateCdddata457Value:0, CUpdateCdddata458Value:0, CUpdateCdddata459Value:0, CUpdateCdddata460Value:0, CUpdateCdddata461Value:0, CUpdateCdddata462Value:0, CUpdateCdddata463Value:0, CUpdateCdddata464Value:0, CUpdateCdddata465Value:0, CUpdateCdddata466Value:0, CUpdateCdddata467Value:0, CUpdateCdddata468Value:0, CUpdateCdddata469Value:0, CUpdateCdddata470Value:0, CUpdateCdddata471Value:0, CUpdateCdddata472Value:0, CUpdateCdddata473Value:0, CUpdateCdddata474Value:0, CUpdateCdddata475Value:0, CUpdateCdddata476Value:0, CUpdateCdddata477Value:0, CUpdateCdddata478Value:0, CUpdateCdddata479Value:0, CUpdateCdddata480Value:0, CUpdateCdddata481Value:0, CUpdateCdddata482Value:0, CUpdateCdddata483Value:0, CUpdateCdddata484Value:0, CUpdateCdddata485Value:0, CUpdateCdddata486Value:0, CUpdateCdddata487Value:0, CUpdateCdddata488Value:0, CUpdateCdddata489Value:0, CUpdateCdddata490Value:0, CUpdateCdddata491Value:0, CUpdateCdddata492Value:0, CUpdateCdddata493Value:0, CUpdateCdddata494Value:0, CUpdateCdddata495Value:0, CUpdateCdddata496Value:0, CUpdateCdddata497Value:0, CUpdateCdddata498Value:0, CUpdateCdddata499Value:0, CUpdateCdddata500Value:0, CUpdateCdddata501Value:0, CUpdateCdddata502Value:0, CUpdateCdddata503Value:0, CUpdateCdddata504Value:0, CUpdateCdddata505Value:0, CUpdateCdddata506Value:0, CUpdateCdddata507Value:0, CUpdateCdddata508Value:0, CUpdateCdddata509Value:0, CUpdateCdddata510Value:0, CUpdateCdddata511Value:0]]}
    CUpdateCddUpdateShortServiceReqValue0: value-spec={short-label=CUpdateCddUpdateShortServiceReqValue0, fields=[CUpdateCddUpdateShortServiceReqValue_0:0, CUpdateCddUpdateShortServiceReqValue_1:0, CUpdateCddUpdateShortServiceReqValue_2:0, CUpdateCddUpdateShortServiceReqValue_3:0, CUpdateCddUpdateShortServiceReqValue_4:0, CUpdateCddUpdateShortServiceReqValue_5:0, CUpdateCddUpdateShortServiceReqValue_6:[CUpdateCdddata0Value:0, CUpdateCdddata1Value:0, CUpdateCdddata2Value:0, CUpdateCdddata3Value:0, CUpdateCdddata4Value:0, CUpdateCdddata5Value:0, CUpdateCdddata6Value:0, CUpdateCdddata7Value:0, CUpdateCdddata8Value:0, CUpdateCdddata9Value:0, CUpdateCdddata10Value:0, CUpdateCdddata11Value:0, CUpdateCdddata12Value:0, CUpdateCdddata13Value:0, CUpdateCdddata14Value:0, CUpdateCdddata15Value:0, CUpdateCdddata16Value:0, CUpdateCdddata17Value:0, CUpdateCdddata18Value:0, CUpdateCdddata19Value:0, CUpdateCdddata20Value:0, CUpdateCdddata21Value:0, CUpdateCdddata22Value:0, CUpdateCdddata23Value:0, CUpdateCdddata24Value:0, CUpdateCdddata25Value:0, CUpdateCdddata26Value:0, CUpdateCdddata27Value:0, CUpdateCdddata28Value:0, CUpdateCdddata29Value:0, CUpdateCdddata30Value:0, CUpdateCdddata31Value:0, CUpdateCdddata32Value:0, CUpdateCdddata33Value:0, CUpdateCdddata34Value:0, CUpdateCdddata35Value:0, CUpdateCdddata36Value:0, CUpdateCdddata37Value:0, CUpdateCdddata38Value:0, CUpdateCdddata39Value:0, CUpdateCdddata40Value:0, CUpdateCdddata41Value:0, CUpdateCdddata42Value:0, CUpdateCdddata43Value:0, CUpdateCdddata44Value:0, CUpdateCdddata45Value:0, CUpdateCdddata46Value:0, CUpdateCdddata47Value:0, CUpdateCdddata48Value:0, CUpdateCdddata49Value:0, CUpdateCdddata50Value:0, CUpdateCdddata51Value:0, CUpdateCdddata52Value:0, CUpdateCdddata53Value:0, CUpdateCdddata54Value:0, CUpdateCdddata55Value:0, CUpdateCdddata56Value:0, CUpdateCdddata57Value:0, CUpdateCdddata58Value:0, CUpdateCdddata59Value:0, CUpdateCdddata60Value:0, CUpdateCdddata61Value:0, CUpdateCdddata62Value:0, CUpdateCdddata63Value:0]]}
    CUpdateCddUpdateShortServiceRespValue0: value-spec={short-label=CUpdateCddUpdateShortServiceRespValue0, fields=[CUpdateCddUpdateShortServiceRespValue_0:0, CUpdateCddUpdateShortServiceRespValue_1:0, CUpdateCddUpdateShortServiceRespValue_2:0, CUpdateCddUpdateShortServiceRespValue_3:0, CUpdateCddUpdateShortServiceRespValue_4:0, CUpdateCddUpdateShortServiceRespValue_5:0, CUpdateCddUpdateShortServiceRespValue_6:[CUpdateCdddata0Value:0, CUpdateCdddata1Value:0, CUpdateCdddata2Value:0, CUpdateCdddata3Value:0, CUpdateCdddata4Value:0, CUpdateCdddata5Value:0, CUpdateCdddata6Value:0, CUpdateCdddata7Value:0, CUpdateCdddata8Value:0, CUpdateCdddata9Value:0, CUpdateCdddata10Value:0, CUpdateCdddata11Value:0, CUpdateCdddata12Value:0, CUpdateCdddata13Value:0, CUpdateCdddata14Value:0, CUpdateCdddata15Value:0, CUpdateCdddata16Value:0, CUpdateCdddata17Value:0, CUpdateCdddata18Value:0, CUpdateCdddata19Value:0, CUpdateCdddata20Value:0, CUpdateCdddata21Value:0, CUpdateCdddata22Value:0, CUpdateCdddata23Value:0, CUpdateCdddata24Value:0, CUpdateCdddata25Value:0, CUpdateCdddata26Value:0, CUpdateCdddata27Value:0, CUpdateCdddata28Value:0, CUpdateCdddata29Value:0, CUpdateCdddata30Value:0, CUpdateCdddata31Value:0, CUpdateCdddata32Value:0, CUpdateCdddata33Value:0, CUpdateCdddata34Value:0, CUpdateCdddata35Value:0, CUpdateCdddata36Value:0, CUpdateCdddata37Value:0, CUpdateCdddata38Value:0, CUpdateCdddata39Value:0, CUpdateCdddata40Value:0, CUpdateCdddata41Value:0, CUpdateCdddata42Value:0, CUpdateCdddata43Value:0, CUpdateCdddata44Value:0, CUpdateCdddata45Value:0, CUpdateCdddata46Value:0, CUpdateCdddata47Value:0, CUpdateCdddata48Value:0, CUpdateCdddata49Value:0, CUpdateCdddata50Value:0, CUpdateCdddata51Value:0, CUpdateCdddata52Value:0, CUpdateCdddata53Value:0, CUpdateCdddata54Value:0, CUpdateCdddata55Value:0, CUpdateCdddata56Value:0, CUpdateCdddata57Value:0, CUpdateCdddata58Value:0, CUpdateCdddata59Value:0, CUpdateCdddata60Value:0, CUpdateCdddata61Value:0, CUpdateCdddata62Value:0, CUpdateCdddata63Value:0]]}
    MemAbstractMdlJobStatus_BsConst_BsConst_Illumination_ReservedByteValue0: value-spec=MemAbstractMdlJobStatus_BsConst_BsConst_Illumination_ReservedByteValue0:0
    MemAbstractMdlJobStatus_BsConst_BsConst_Illumination_ReservedByte_SafeCopy1Value0: value-spec=MemAbstractMdlJobStatus_BsConst_BsConst_Illumination_ReservedByte_SafeCopy1Value0:0
    MemAbstractMdlJobStatus_BsConst_BsConst_Illumination_ReservedByte_SafeCopy2Value0: value-spec=MemAbstractMdlJobStatus_BsConst_BsConst_Illumination_ReservedByte_SafeCopy2Value0:0
    MemAbstractMdlJobStatus_BsConst_Compensation_Line_Shift_bValue0: value-spec=MemAbstractMdlJobStatus_BsConst_Compensation_Line_Shift_bValue0:0
    MemAbstractMdlJobStatus_BsConst_Compensation_Line_Shift_b_SafeCopy1Value0: value-spec=MemAbstractMdlJobStatus_BsConst_Compensation_Line_Shift_b_SafeCopy1Value0:0
    MemAbstractMdlJobStatus_BsConst_Compensation_Line_Shift_b_SafeCopy2Value0: value-spec=MemAbstractMdlJobStatus_BsConst_Compensation_Line_Shift_b_SafeCopy2Value0:0
    MemAbstractMdlJobStatus_BsConst_Compensation_Line_Slope_mValue0: value-spec=MemAbstractMdlJobStatus_BsConst_Compensation_Line_Slope_mValue0:0
    MemAbstractMdlJobStatus_BsConst_Compensation_Line_Slope_m_SafeCopy1Value0: value-spec=MemAbstractMdlJobStatus_BsConst_Compensation_Line_Slope_m_SafeCopy1Value0:0
    MemAbstractMdlJobStatus_BsConst_Compensation_Line_Slope_m_SafeCopy2Value0: value-spec=MemAbstractMdlJobStatus_BsConst_Compensation_Line_Slope_m_SafeCopy2Value0:0
    MemAbstractMdlJobStatus_BsConst_Derating_Backlight_DisableValue0: value-spec=MemAbstractMdlJobStatus_BsConst_Derating_Backlight_DisableValue0:0
    MemAbstractMdlJobStatus_BsConst_Derating_Backlight_Disable_SafeCopy1Value0: value-spec=MemAbstractMdlJobStatus_BsConst_Derating_Backlight_Disable_SafeCopy1Value0:0
    MemAbstractMdlJobStatus_BsConst_Derating_Backlight_Disable_SafeCopy2Value0: value-spec=MemAbstractMdlJobStatus_BsConst_Derating_Backlight_Disable_SafeCopy2Value0:0
    MemAbstractMdlJobStatus_BsConst_Display_Illum_Max_LevelValue0: value-spec=MemAbstractMdlJobStatus_BsConst_Display_Illum_Max_LevelValue0:0
    MemAbstractMdlJobStatus_BsConst_Display_Illum_Max_Level_SafeCopy1Value0: value-spec=MemAbstractMdlJobStatus_BsConst_Display_Illum_Max_Level_SafeCopy1Value0:0
    MemAbstractMdlJobStatus_BsConst_Display_Illum_Max_Level_SafeCopy2Value0: value-spec=MemAbstractMdlJobStatus_BsConst_Display_Illum_Max_Level_SafeCopy2Value0:0
    MemAbstractMdlJobStatus_BsConst_Lookup_Curve_HotSpot_Coef_XValue0: value-spec=MemAbstractMdlJobStatus_BsConst_Lookup_Curve_HotSpot_Coef_XValue0:0
    MemAbstractMdlJobStatus_BsConst_Lookup_Curve_HotSpot_Coef_X_SafeCopy1Value0: value-spec=MemAbstractMdlJobStatus_BsConst_Lookup_Curve_HotSpot_Coef_X_SafeCopy1Value0:0
    MemAbstractMdlJobStatus_BsConst_Lookup_Curve_HotSpot_Coef_X_SafeCopy2Value0: value-spec=MemAbstractMdlJobStatus_BsConst_Lookup_Curve_HotSpot_Coef_X_SafeCopy2Value0:0
    MemAbstractMdlJobStatus_BsConst_Lookup_Curve_HotSpot_Coef_YValue0: value-spec=MemAbstractMdlJobStatus_BsConst_Lookup_Curve_HotSpot_Coef_YValue0:0
    MemAbstractMdlJobStatus_BsConst_Lookup_Curve_HotSpot_Coef_Y_SafeCopy1Value0: value-spec=MemAbstractMdlJobStatus_BsConst_Lookup_Curve_HotSpot_Coef_Y_SafeCopy1Value0:0
    MemAbstractMdlJobStatus_BsConst_Lookup_Curve_HotSpot_Coef_Y_SafeCopy2Value0: value-spec=MemAbstractMdlJobStatus_BsConst_Lookup_Curve_HotSpot_Coef_Y_SafeCopy2Value0:0
    MemAbstractMdlJobStatus_BsConst_PCB_Temperature_Sensor_ConvValue0: value-spec=MemAbstractMdlJobStatus_BsConst_PCB_Temperature_Sensor_ConvValue0:0
    MemAbstractMdlJobStatus_BsConst_PCB_Temperature_Sensor_Conv_SafeCopy1Value0: value-spec=MemAbstractMdlJobStatus_BsConst_PCB_Temperature_Sensor_Conv_SafeCopy1Value0:0
    MemAbstractMdlJobStatus_BsConst_PCB_Temperature_Sensor_Conv_SafeCopy2Value0: value-spec=MemAbstractMdlJobStatus_BsConst_PCB_Temperature_Sensor_Conv_SafeCopy2Value0:0
    MemAbstractMdlJobStatus_BsConst_PWM_boost_bypass_dutyValue0: value-spec=MemAbstractMdlJobStatus_BsConst_PWM_boost_bypass_dutyValue0:0
    MemAbstractMdlJobStatus_BsConst_PWM_boost_bypass_duty_SafeCopy1Value0: value-spec=MemAbstractMdlJobStatus_BsConst_PWM_boost_bypass_duty_SafeCopy1Value0:0
    MemAbstractMdlJobStatus_BsConst_PWM_boost_bypass_duty_SafeCopy2Value0: value-spec=MemAbstractMdlJobStatus_BsConst_PWM_boost_bypass_duty_SafeCopy2Value0:0
    MemAbstractMdlJobStatus_BsConst_Temp_Threshold_Hysteresis_DeratingValue0: value-spec=MemAbstractMdlJobStatus_BsConst_Temp_Threshold_Hysteresis_DeratingValue0:0
    MemAbstractMdlJobStatus_BsConst_Temp_Threshold_Hysteresis_Derating_SafeCopy1Value0: value-spec=MemAbstractMdlJobStatus_BsConst_Temp_Threshold_Hysteresis_Derating_SafeCopy1Value0:0
    MemAbstractMdlJobStatus_BsConst_Temp_Threshold_Hysteresis_Derating_SafeCopy2Value0: value-spec=MemAbstractMdlJobStatus_BsConst_Temp_Threshold_Hysteresis_Derating_SafeCopy2Value0:0
    MemAbstractMdlJobStatus_BsConst_Temperature_Sensor_ConvValue0: value-spec=MemAbstractMdlJobStatus_BsConst_Temperature_Sensor_ConvValue0:0
    MemAbstractMdlJobStatus_BsConst_Temperature_Sensor_Conv_SafeCopy1Value0: value-spec=MemAbstractMdlJobStatus_BsConst_Temperature_Sensor_Conv_SafeCopy1Value0:0
    MemAbstractMdlJobStatus_BsConst_Temperature_Sensor_Conv_SafeCopy2Value0: value-spec=MemAbstractMdlJobStatus_BsConst_Temperature_Sensor_Conv_SafeCopy2Value0:0
    CMeetCddJobStatus_BsConst_BsConst_Illumination_ReservedByteValue0: value-spec=CMeetCddJobStatus_BsConst_BsConst_Illumination_ReservedByteValue0:0
    CMeetCddJobStatus_BsConst_BsConst_Illumination_ReservedByte_SafeCopy1Value0: value-spec=CMeetCddJobStatus_BsConst_BsConst_Illumination_ReservedByte_SafeCopy1Value0:0
    CMeetCddJobStatus_BsConst_BsConst_Illumination_ReservedByte_SafeCopy2Value0: value-spec=CMeetCddJobStatus_BsConst_BsConst_Illumination_ReservedByte_SafeCopy2Value0:0
    CMeetCddJobStatus_BsConst_Compensation_Line_Shift_bValue0: value-spec=CMeetCddJobStatus_BsConst_Compensation_Line_Shift_bValue0:0
    CMeetCddJobStatus_BsConst_Compensation_Line_Shift_b_SafeCopy1Value0: value-spec=CMeetCddJobStatus_BsConst_Compensation_Line_Shift_b_SafeCopy1Value0:0
    CMeetCddJobStatus_BsConst_Compensation_Line_Shift_b_SafeCopy2Value0: value-spec=CMeetCddJobStatus_BsConst_Compensation_Line_Shift_b_SafeCopy2Value0:0
    CMeetCddJobStatus_BsConst_Compensation_Line_Slope_mValue0: value-spec=CMeetCddJobStatus_BsConst_Compensation_Line_Slope_mValue0:0
    CMeetCddJobStatus_BsConst_Compensation_Line_Slope_m_SafeCopy1Value0: value-spec=CMeetCddJobStatus_BsConst_Compensation_Line_Slope_m_SafeCopy1Value0:0
    CMeetCddJobStatus_BsConst_Compensation_Line_Slope_m_SafeCopy2Value0: value-spec=CMeetCddJobStatus_BsConst_Compensation_Line_Slope_m_SafeCopy2Value0:0
    CMeetCddJobStatus_BsConst_Derating_Backlight_DisableValue0: value-spec=CMeetCddJobStatus_BsConst_Derating_Backlight_DisableValue0:0
    CMeetCddJobStatus_BsConst_Derating_Backlight_Disable_SafeCopy1Value0: value-spec=CMeetCddJobStatus_BsConst_Derating_Backlight_Disable_SafeCopy1Value0:0
    CMeetCddJobStatus_BsConst_Derating_Backlight_Disable_SafeCopy2Value0: value-spec=CMeetCddJobStatus_BsConst_Derating_Backlight_Disable_SafeCopy2Value0:0
    CMeetCddJobStatus_BsConst_Display_Illum_Max_LevelValue0: value-spec=CMeetCddJobStatus_BsConst_Display_Illum_Max_LevelValue0:0
    CMeetCddJobStatus_BsConst_Display_Illum_Max_Level_SafeCopy1Value0: value-spec=CMeetCddJobStatus_BsConst_Display_Illum_Max_Level_SafeCopy1Value0:0
    CMeetCddJobStatus_BsConst_Display_Illum_Max_Level_SafeCopy2Value0: value-spec=CMeetCddJobStatus_BsConst_Display_Illum_Max_Level_SafeCopy2Value0:0
    CMeetCddJobStatus_BsConst_Lookup_Curve_HotSpot_Coef_XValue0: value-spec=CMeetCddJobStatus_BsConst_Lookup_Curve_HotSpot_Coef_XValue0:0
    CMeetCddJobStatus_BsConst_Lookup_Curve_HotSpot_Coef_X_SafeCopy1Value0: value-spec=CMeetCddJobStatus_BsConst_Lookup_Curve_HotSpot_Coef_X_SafeCopy1Value0:0
    CMeetCddJobStatus_BsConst_Lookup_Curve_HotSpot_Coef_X_SafeCopy2Value0: value-spec=CMeetCddJobStatus_BsConst_Lookup_Curve_HotSpot_Coef_X_SafeCopy2Value0:0
    CMeetCddJobStatus_BsConst_Lookup_Curve_HotSpot_Coef_YValue0: value-spec=CMeetCddJobStatus_BsConst_Lookup_Curve_HotSpot_Coef_YValue0:0
    CMeetCddJobStatus_BsConst_Lookup_Curve_HotSpot_Coef_Y_SafeCopy1Value0: value-spec=CMeetCddJobStatus_BsConst_Lookup_Curve_HotSpot_Coef_Y_SafeCopy1Value0:0
    CMeetCddJobStatus_BsConst_Lookup_Curve_HotSpot_Coef_Y_SafeCopy2Value0: value-spec=CMeetCddJobStatus_BsConst_Lookup_Curve_HotSpot_Coef_Y_SafeCopy2Value0:0
    CMeetCddJobStatus_BsConst_PCB_Temperature_Sensor_ConvValue0: value-spec=CMeetCddJobStatus_BsConst_PCB_Temperature_Sensor_ConvValue0:0
    CMeetCddJobStatus_BsConst_PCB_Temperature_Sensor_Conv_SafeCopy1Value0: value-spec=CMeetCddJobStatus_BsConst_PCB_Temperature_Sensor_Conv_SafeCopy1Value0:0
    CMeetCddJobStatus_BsConst_PCB_Temperature_Sensor_Conv_SafeCopy2Value0: value-spec=CMeetCddJobStatus_BsConst_PCB_Temperature_Sensor_Conv_SafeCopy2Value0:0
    CMeetCddJobStatus_BsConst_PWM_boost_bypass_dutyValue0: value-spec=CMeetCddJobStatus_BsConst_PWM_boost_bypass_dutyValue0:0
    CMeetCddJobStatus_BsConst_PWM_boost_bypass_duty_SafeCopy1Value0: value-spec=CMeetCddJobStatus_BsConst_PWM_boost_bypass_duty_SafeCopy1Value0:0
    CMeetCddJobStatus_BsConst_PWM_boost_bypass_duty_SafeCopy2Value0: value-spec=CMeetCddJobStatus_BsConst_PWM_boost_bypass_duty_SafeCopy2Value0:0
    CMeetCddJobStatus_BsConst_Temp_Threshold_Hysteresis_DeratingValue0: value-spec=CMeetCddJobStatus_BsConst_Temp_Threshold_Hysteresis_DeratingValue0:0
    CMeetCddJobStatus_BsConst_Temp_Threshold_Hysteresis_Derating_SafeCopy1Value0: value-spec=CMeetCddJobStatus_BsConst_Temp_Threshold_Hysteresis_Derating_SafeCopy1Value0:0
    CMeetCddJobStatus_BsConst_Temp_Threshold_Hysteresis_Derating_SafeCopy2Value0: value-spec=CMeetCddJobStatus_BsConst_Temp_Threshold_Hysteresis_Derating_SafeCopy2Value0:0
    CMeetCddJobStatus_BsConst_Temperature_Sensor_ConvValue0: value-spec=CMeetCddJobStatus_BsConst_Temperature_Sensor_ConvValue0:0
    CMeetCddJobStatus_BsConst_Temperature_Sensor_Conv_SafeCopy1Value0: value-spec=CMeetCddJobStatus_BsConst_Temperature_Sensor_Conv_SafeCopy1Value0:0
    CMeetCddJobStatus_BsConst_Temperature_Sensor_Conv_SafeCopy2Value0: value-spec=CMeetCddJobStatus_BsConst_Temperature_Sensor_Conv_SafeCopy2Value0:0
    DcmExtJobStatus_BsConst_BsConst_Illumination_ReservedByteValue0: value-spec=DcmExtJobStatus_BsConst_BsConst_Illumination_ReservedByteValue0:0
    DcmExtJobStatus_BsConst_BsConst_Illumination_ReservedByte_SafeCopy1Value0: value-spec=DcmExtJobStatus_BsConst_BsConst_Illumination_ReservedByte_SafeCopy1Value0:0
    DcmExtJobStatus_BsConst_BsConst_Illumination_ReservedByte_SafeCopy2Value0: value-spec=DcmExtJobStatus_BsConst_BsConst_Illumination_ReservedByte_SafeCopy2Value0:0
    DcmExtJobStatus_BsConst_Compensation_Line_Shift_bValue0: value-spec=DcmExtJobStatus_BsConst_Compensation_Line_Shift_bValue0:0
    DcmExtJobStatus_BsConst_Compensation_Line_Shift_b_SafeCopy1Value0: value-spec=DcmExtJobStatus_BsConst_Compensation_Line_Shift_b_SafeCopy1Value0:0
    DcmExtJobStatus_BsConst_Compensation_Line_Shift_b_SafeCopy2Value0: value-spec=DcmExtJobStatus_BsConst_Compensation_Line_Shift_b_SafeCopy2Value0:0
    DcmExtJobStatus_BsConst_Compensation_Line_Slope_mValue0: value-spec=DcmExtJobStatus_BsConst_Compensation_Line_Slope_mValue0:0
    DcmExtJobStatus_BsConst_Compensation_Line_Slope_m_SafeCopy1Value0: value-spec=DcmExtJobStatus_BsConst_Compensation_Line_Slope_m_SafeCopy1Value0:0
    DcmExtJobStatus_BsConst_Compensation_Line_Slope_m_SafeCopy2Value0: value-spec=DcmExtJobStatus_BsConst_Compensation_Line_Slope_m_SafeCopy2Value0:0
    DcmExtJobStatus_BsConst_Derating_Backlight_DisableValue0: value-spec=DcmExtJobStatus_BsConst_Derating_Backlight_DisableValue0:0
    DcmExtJobStatus_BsConst_Derating_Backlight_Disable_SafeCopy1Value0: value-spec=DcmExtJobStatus_BsConst_Derating_Backlight_Disable_SafeCopy1Value0:0
    DcmExtJobStatus_BsConst_Derating_Backlight_Disable_SafeCopy2Value0: value-spec=DcmExtJobStatus_BsConst_Derating_Backlight_Disable_SafeCopy2Value0:0
    DcmExtJobStatus_BsConst_Display_Illum_Max_LevelValue0: value-spec=DcmExtJobStatus_BsConst_Display_Illum_Max_LevelValue0:0
    DcmExtJobStatus_BsConst_Display_Illum_Max_Level_SafeCopy1Value0: value-spec=DcmExtJobStatus_BsConst_Display_Illum_Max_Level_SafeCopy1Value0:0
    DcmExtJobStatus_BsConst_Display_Illum_Max_Level_SafeCopy2Value0: value-spec=DcmExtJobStatus_BsConst_Display_Illum_Max_Level_SafeCopy2Value0:0
    DcmExtJobStatus_BsConst_Lookup_Curve_HotSpot_Coef_XValue0: value-spec=DcmExtJobStatus_BsConst_Lookup_Curve_HotSpot_Coef_XValue0:0
    DcmExtJobStatus_BsConst_Lookup_Curve_HotSpot_Coef_X_SafeCopy1Value0: value-spec=DcmExtJobStatus_BsConst_Lookup_Curve_HotSpot_Coef_X_SafeCopy1Value0:0
    DcmExtJobStatus_BsConst_Lookup_Curve_HotSpot_Coef_X_SafeCopy2Value0: value-spec=DcmExtJobStatus_BsConst_Lookup_Curve_HotSpot_Coef_X_SafeCopy2Value0:0
    DcmExtJobStatus_BsConst_Lookup_Curve_HotSpot_Coef_YValue0: value-spec=DcmExtJobStatus_BsConst_Lookup_Curve_HotSpot_Coef_YValue0:0
    DcmExtJobStatus_BsConst_Lookup_Curve_HotSpot_Coef_Y_SafeCopy1Value0: value-spec=DcmExtJobStatus_BsConst_Lookup_Curve_HotSpot_Coef_Y_SafeCopy1Value0:0
    DcmExtJobStatus_BsConst_Lookup_Curve_HotSpot_Coef_Y_SafeCopy2Value0: value-spec=DcmExtJobStatus_BsConst_Lookup_Curve_HotSpot_Coef_Y_SafeCopy2Value0:0
    DcmExtJobStatus_BsConst_PCB_Temperature_Sensor_ConvValue0: value-spec=DcmExtJobStatus_BsConst_PCB_Temperature_Sensor_ConvValue0:0
    DcmExtJobStatus_BsConst_PCB_Temperature_Sensor_Conv_SafeCopy1Value0: value-spec=DcmExtJobStatus_BsConst_PCB_Temperature_Sensor_Conv_SafeCopy1Value0:0
    DcmExtJobStatus_BsConst_PCB_Temperature_Sensor_Conv_SafeCopy2Value0: value-spec=DcmExtJobStatus_BsConst_PCB_Temperature_Sensor_Conv_SafeCopy2Value0:0
    DcmExtJobStatus_BsConst_PWM_boost_bypass_dutyValue0: value-spec=DcmExtJobStatus_BsConst_PWM_boost_bypass_dutyValue0:0
    DcmExtJobStatus_BsConst_PWM_boost_bypass_duty_SafeCopy1Value0: value-spec=DcmExtJobStatus_BsConst_PWM_boost_bypass_duty_SafeCopy1Value0:0
    DcmExtJobStatus_BsConst_PWM_boost_bypass_duty_SafeCopy2Value0: value-spec=DcmExtJobStatus_BsConst_PWM_boost_bypass_duty_SafeCopy2Value0:0
    DcmExtJobStatus_BsConst_Temp_Threshold_Hysteresis_DeratingValue0: value-spec=DcmExtJobStatus_BsConst_Temp_Threshold_Hysteresis_DeratingValue0:0
    DcmExtJobStatus_BsConst_Temp_Threshold_Hysteresis_Derating_SafeCopy1Value0: value-spec=DcmExtJobStatus_BsConst_Temp_Threshold_Hysteresis_Derating_SafeCopy1Value0:0
    DcmExtJobStatus_BsConst_Temp_Threshold_Hysteresis_Derating_SafeCopy2Value0: value-spec=DcmExtJobStatus_BsConst_Temp_Threshold_Hysteresis_Derating_SafeCopy2Value0:0
    DcmExtJobStatus_BsConst_Temperature_Sensor_ConvValue0: value-spec=DcmExtJobStatus_BsConst_Temperature_Sensor_ConvValue0:0
    DcmExtJobStatus_BsConst_Temperature_Sensor_Conv_SafeCopy1Value0: value-spec=DcmExtJobStatus_BsConst_Temperature_Sensor_Conv_SafeCopy1Value0:0
    DcmExtJobStatus_BsConst_Temperature_Sensor_Conv_SafeCopy2Value0: value-spec=DcmExtJobStatus_BsConst_Temperature_Sensor_Conv_SafeCopy2Value0:0
    UclProxyCddUpdateShortServiceRespDataValue0: value-spec={short-label=UclProxyCddUpdateShortServiceRespDataValue0, fields=[UclProxyCddUpdateShortServiceRespDataValue_0:0, UclProxyCddUpdateShortServiceRespDataValue_1:0, UclProxyCddUpdateShortServiceRespDataValue_2:0, UclProxyCddUpdateShortServiceRespDataValue_3:0, UclProxyCddUpdateShortServiceRespDataValue_4:0, UclProxyCddUpdateShortServiceRespDataValue_5:0, UclProxyCddUpdateShortServiceRespDataValue_6:[UclProxyCdddata0Value:0, UclProxyCdddata1Value:0, UclProxyCdddata2Value:0, UclProxyCdddata3Value:0, UclProxyCdddata4Value:0, UclProxyCdddata5Value:0, UclProxyCdddata6Value:0, UclProxyCdddata7Value:0, UclProxyCdddata8Value:0, UclProxyCdddata9Value:0, UclProxyCdddata10Value:0, UclProxyCdddata11Value:0, UclProxyCdddata12Value:0, UclProxyCdddata13Value:0, UclProxyCdddata14Value:0, UclProxyCdddata15Value:0, UclProxyCdddata16Value:0, UclProxyCdddata17Value:0, UclProxyCdddata18Value:0, UclProxyCdddata19Value:0, UclProxyCdddata20Value:0, UclProxyCdddata21Value:0, UclProxyCdddata22Value:0, UclProxyCdddata23Value:0, UclProxyCdddata24Value:0, UclProxyCdddata25Value:0, UclProxyCdddata26Value:0, UclProxyCdddata27Value:0, UclProxyCdddata28Value:0, UclProxyCdddata29Value:0, UclProxyCdddata30Value:0, UclProxyCdddata31Value:0, UclProxyCdddata32Value:0, UclProxyCdddata33Value:0, UclProxyCdddata34Value:0, UclProxyCdddata35Value:0, UclProxyCdddata36Value:0, UclProxyCdddata37Value:0, UclProxyCdddata38Value:0, UclProxyCdddata39Value:0, UclProxyCdddata40Value:0, UclProxyCdddata41Value:0, UclProxyCdddata42Value:0, UclProxyCdddata43Value:0, UclProxyCdddata44Value:0, UclProxyCdddata45Value:0, UclProxyCdddata46Value:0, UclProxyCdddata47Value:0, UclProxyCdddata48Value:0, UclProxyCdddata49Value:0, UclProxyCdddata50Value:0, UclProxyCdddata51Value:0, UclProxyCdddata52Value:0, UclProxyCdddata53Value:0, UclProxyCdddata54Value:0, UclProxyCdddata55Value:0, UclProxyCdddata56Value:0, UclProxyCdddata57Value:0, UclProxyCdddata58Value:0, UclProxyCdddata59Value:0, UclProxyCdddata60Value:0, UclProxyCdddata61Value:0, UclProxyCdddata62Value:0, UclProxyCdddata63Value:0]]}
    UclProxyCddUpdateLongServiceReqDataValue0: value-spec={short-label=UclProxyCddUpdateLongServiceReqDataValue0, fields=[UclProxyCddUpdateLongServiceReqDataValue_0:0, UclProxyCddUpdateLongServiceReqDataValue_1:0, UclProxyCddUpdateLongServiceReqDataValue_2:0, UclProxyCddUpdateLongServiceReqDataValue_3:0, UclProxyCddUpdateLongServiceReqDataValue_4:0, UclProxyCddUpdateLongServiceReqDataValue_5:0, UclProxyCddUpdateLongServiceReqDataValue_6:[UclProxyCdddata0Value:0, UclProxyCdddata1Value:0, UclProxyCdddata2Value:0, UclProxyCdddata3Value:0, UclProxyCdddata4Value:0, UclProxyCdddata5Value:0, UclProxyCdddata6Value:0, UclProxyCdddata7Value:0, UclProxyCdddata8Value:0, UclProxyCdddata9Value:0, UclProxyCdddata10Value:0, UclProxyCdddata11Value:0, UclProxyCdddata12Value:0, UclProxyCdddata13Value:0, UclProxyCdddata14Value:0, UclProxyCdddata15Value:0, UclProxyCdddata16Value:0, UclProxyCdddata17Value:0, UclProxyCdddata18Value:0, UclProxyCdddata19Value:0, UclProxyCdddata20Value:0, UclProxyCdddata21Value:0, UclProxyCdddata22Value:0, UclProxyCdddata23Value:0, UclProxyCdddata24Value:0, UclProxyCdddata25Value:0, UclProxyCdddata26Value:0, UclProxyCdddata27Value:0, UclProxyCdddata28Value:0, UclProxyCdddata29Value:0, UclProxyCdddata30Value:0, UclProxyCdddata31Value:0, UclProxyCdddata32Value:0, UclProxyCdddata33Value:0, UclProxyCdddata34Value:0, UclProxyCdddata35Value:0, UclProxyCdddata36Value:0, UclProxyCdddata37Value:0, UclProxyCdddata38Value:0, UclProxyCdddata39Value:0, UclProxyCdddata40Value:0, UclProxyCdddata41Value:0, UclProxyCdddata42Value:0, UclProxyCdddata43Value:0, UclProxyCdddata44Value:0, UclProxyCdddata45Value:0, UclProxyCdddata46Value:0, UclProxyCdddata47Value:0, UclProxyCdddata48Value:0, UclProxyCdddata49Value:0, UclProxyCdddata50Value:0, UclProxyCdddata51Value:0, UclProxyCdddata52Value:0, UclProxyCdddata53Value:0, UclProxyCdddata54Value:0, UclProxyCdddata55Value:0, UclProxyCdddata56Value:0, UclProxyCdddata57Value:0, UclProxyCdddata58Value:0, UclProxyCdddata59Value:0, UclProxyCdddata60Value:0, UclProxyCdddata61Value:0, UclProxyCdddata62Value:0, UclProxyCdddata63Value:0, UclProxyCdddata64Value:0, UclProxyCdddata65Value:0, UclProxyCdddata66Value:0, UclProxyCdddata67Value:0, UclProxyCdddata68Value:0, UclProxyCdddata69Value:0, UclProxyCdddata70Value:0, UclProxyCdddata71Value:0, UclProxyCdddata72Value:0, UclProxyCdddata73Value:0, UclProxyCdddata74Value:0, UclProxyCdddata75Value:0, UclProxyCdddata76Value:0, UclProxyCdddata77Value:0, UclProxyCdddata78Value:0, UclProxyCdddata79Value:0, UclProxyCdddata80Value:0, UclProxyCdddata81Value:0, UclProxyCdddata82Value:0, UclProxyCdddata83Value:0, UclProxyCdddata84Value:0, UclProxyCdddata85Value:0, UclProxyCdddata86Value:0, UclProxyCdddata87Value:0, UclProxyCdddata88Value:0, UclProxyCdddata89Value:0, UclProxyCdddata90Value:0, UclProxyCdddata91Value:0, UclProxyCdddata92Value:0, UclProxyCdddata93Value:0, UclProxyCdddata94Value:0, UclProxyCdddata95Value:0, UclProxyCdddata96Value:0, UclProxyCdddata97Value:0, UclProxyCdddata98Value:0, UclProxyCdddata99Value:0, UclProxyCdddata100Value:0, UclProxyCdddata101Value:0, UclProxyCdddata102Value:0, UclProxyCdddata103Value:0, UclProxyCdddata104Value:0, UclProxyCdddata105Value:0, UclProxyCdddata106Value:0, UclProxyCdddata107Value:0, UclProxyCdddata108Value:0, UclProxyCdddata109Value:0, UclProxyCdddata110Value:0, UclProxyCdddata111Value:0, UclProxyCdddata112Value:0, UclProxyCdddata113Value:0, UclProxyCdddata114Value:0, UclProxyCdddata115Value:0, UclProxyCdddata116Value:0, UclProxyCdddata117Value:0, UclProxyCdddata118Value:0, UclProxyCdddata119Value:0, UclProxyCdddata120Value:0, UclProxyCdddata121Value:0, UclProxyCdddata122Value:0, UclProxyCdddata123Value:0, UclProxyCdddata124Value:0, UclProxyCdddata125Value:0, UclProxyCdddata126Value:0, UclProxyCdddata127Value:0, UclProxyCdddata128Value:0, UclProxyCdddata129Value:0, UclProxyCdddata130Value:0, UclProxyCdddata131Value:0, UclProxyCdddata132Value:0, UclProxyCdddata133Value:0, UclProxyCdddata134Value:0, UclProxyCdddata135Value:0, UclProxyCdddata136Value:0, UclProxyCdddata137Value:0, UclProxyCdddata138Value:0, UclProxyCdddata139Value:0, UclProxyCdddata140Value:0, UclProxyCdddata141Value:0, UclProxyCdddata142Value:0, UclProxyCdddata143Value:0, UclProxyCdddata144Value:0, UclProxyCdddata145Value:0, UclProxyCdddata146Value:0, UclProxyCdddata147Value:0, UclProxyCdddata148Value:0, UclProxyCdddata149Value:0, UclProxyCdddata150Value:0, UclProxyCdddata151Value:0, UclProxyCdddata152Value:0, UclProxyCdddata153Value:0, UclProxyCdddata154Value:0, UclProxyCdddata155Value:0, UclProxyCdddata156Value:0, UclProxyCdddata157Value:0, UclProxyCdddata158Value:0, UclProxyCdddata159Value:0, UclProxyCdddata160Value:0, UclProxyCdddata161Value:0, UclProxyCdddata162Value:0, UclProxyCdddata163Value:0, UclProxyCdddata164Value:0, UclProxyCdddata165Value:0, UclProxyCdddata166Value:0, UclProxyCdddata167Value:0, UclProxyCdddata168Value:0, UclProxyCdddata169Value:0, UclProxyCdddata170Value:0, UclProxyCdddata171Value:0, UclProxyCdddata172Value:0, UclProxyCdddata173Value:0, UclProxyCdddata174Value:0, UclProxyCdddata175Value:0, UclProxyCdddata176Value:0, UclProxyCdddata177Value:0, UclProxyCdddata178Value:0, UclProxyCdddata179Value:0, UclProxyCdddata180Value:0, UclProxyCdddata181Value:0, UclProxyCdddata182Value:0, UclProxyCdddata183Value:0, UclProxyCdddata184Value:0, UclProxyCdddata185Value:0, UclProxyCdddata186Value:0, UclProxyCdddata187Value:0, UclProxyCdddata188Value:0, UclProxyCdddata189Value:0, UclProxyCdddata190Value:0, UclProxyCdddata191Value:0, UclProxyCdddata192Value:0, UclProxyCdddata193Value:0, UclProxyCdddata194Value:0, UclProxyCdddata195Value:0, UclProxyCdddata196Value:0, UclProxyCdddata197Value:0, UclProxyCdddata198Value:0, UclProxyCdddata199Value:0, UclProxyCdddata200Value:0, UclProxyCdddata201Value:0, UclProxyCdddata202Value:0, UclProxyCdddata203Value:0, UclProxyCdddata204Value:0, UclProxyCdddata205Value:0, UclProxyCdddata206Value:0, UclProxyCdddata207Value:0, UclProxyCdddata208Value:0, UclProxyCdddata209Value:0, UclProxyCdddata210Value:0, UclProxyCdddata211Value:0, UclProxyCdddata212Value:0, UclProxyCdddata213Value:0, UclProxyCdddata214Value:0, UclProxyCdddata215Value:0, UclProxyCdddata216Value:0, UclProxyCdddata217Value:0, UclProxyCdddata218Value:0, UclProxyCdddata219Value:0, UclProxyCdddata220Value:0, UclProxyCdddata221Value:0, UclProxyCdddata222Value:0, UclProxyCdddata223Value:0, UclProxyCdddata224Value:0, UclProxyCdddata225Value:0, UclProxyCdddata226Value:0, UclProxyCdddata227Value:0, UclProxyCdddata228Value:0, UclProxyCdddata229Value:0, UclProxyCdddata230Value:0, UclProxyCdddata231Value:0, UclProxyCdddata232Value:0, UclProxyCdddata233Value:0, UclProxyCdddata234Value:0, UclProxyCdddata235Value:0, UclProxyCdddata236Value:0, UclProxyCdddata237Value:0, UclProxyCdddata238Value:0, UclProxyCdddata239Value:0, UclProxyCdddata240Value:0, UclProxyCdddata241Value:0, UclProxyCdddata242Value:0, UclProxyCdddata243Value:0, UclProxyCdddata244Value:0, UclProxyCdddata245Value:0, UclProxyCdddata246Value:0, UclProxyCdddata247Value:0, UclProxyCdddata248Value:0, UclProxyCdddata249Value:0, UclProxyCdddata250Value:0, UclProxyCdddata251Value:0, UclProxyCdddata252Value:0, UclProxyCdddata253Value:0, UclProxyCdddata254Value:0, UclProxyCdddata255Value:0, UclProxyCdddata256Value:0, UclProxyCdddata257Value:0, UclProxyCdddata258Value:0, UclProxyCdddata259Value:0, UclProxyCdddata260Value:0, UclProxyCdddata261Value:0, UclProxyCdddata262Value:0, UclProxyCdddata263Value:0, UclProxyCdddata264Value:0, UclProxyCdddata265Value:0, UclProxyCdddata266Value:0, UclProxyCdddata267Value:0, UclProxyCdddata268Value:0, UclProxyCdddata269Value:0, UclProxyCdddata270Value:0, UclProxyCdddata271Value:0, UclProxyCdddata272Value:0, UclProxyCdddata273Value:0, UclProxyCdddata274Value:0, UclProxyCdddata275Value:0, UclProxyCdddata276Value:0, UclProxyCdddata277Value:0, UclProxyCdddata278Value:0, UclProxyCdddata279Value:0, UclProxyCdddata280Value:0, UclProxyCdddata281Value:0, UclProxyCdddata282Value:0, UclProxyCdddata283Value:0, UclProxyCdddata284Value:0, UclProxyCdddata285Value:0, UclProxyCdddata286Value:0, UclProxyCdddata287Value:0, UclProxyCdddata288Value:0, UclProxyCdddata289Value:0, UclProxyCdddata290Value:0, UclProxyCdddata291Value:0, UclProxyCdddata292Value:0, UclProxyCdddata293Value:0, UclProxyCdddata294Value:0, UclProxyCdddata295Value:0, UclProxyCdddata296Value:0, UclProxyCdddata297Value:0, UclProxyCdddata298Value:0, UclProxyCdddata299Value:0, UclProxyCdddata300Value:0, UclProxyCdddata301Value:0, UclProxyCdddata302Value:0, UclProxyCdddata303Value:0, UclProxyCdddata304Value:0, UclProxyCdddata305Value:0, UclProxyCdddata306Value:0, UclProxyCdddata307Value:0, UclProxyCdddata308Value:0, UclProxyCdddata309Value:0, UclProxyCdddata310Value:0, UclProxyCdddata311Value:0, UclProxyCdddata312Value:0, UclProxyCdddata313Value:0, UclProxyCdddata314Value:0, UclProxyCdddata315Value:0, UclProxyCdddata316Value:0, UclProxyCdddata317Value:0, UclProxyCdddata318Value:0, UclProxyCdddata319Value:0, UclProxyCdddata320Value:0, UclProxyCdddata321Value:0, UclProxyCdddata322Value:0, UclProxyCdddata323Value:0, UclProxyCdddata324Value:0, UclProxyCdddata325Value:0, UclProxyCdddata326Value:0, UclProxyCdddata327Value:0, UclProxyCdddata328Value:0, UclProxyCdddata329Value:0, UclProxyCdddata330Value:0, UclProxyCdddata331Value:0, UclProxyCdddata332Value:0, UclProxyCdddata333Value:0, UclProxyCdddata334Value:0, UclProxyCdddata335Value:0, UclProxyCdddata336Value:0, UclProxyCdddata337Value:0, UclProxyCdddata338Value:0, UclProxyCdddata339Value:0, UclProxyCdddata340Value:0, UclProxyCdddata341Value:0, UclProxyCdddata342Value:0, UclProxyCdddata343Value:0, UclProxyCdddata344Value:0, UclProxyCdddata345Value:0, UclProxyCdddata346Value:0, UclProxyCdddata347Value:0, UclProxyCdddata348Value:0, UclProxyCdddata349Value:0, UclProxyCdddata350Value:0, UclProxyCdddata351Value:0, UclProxyCdddata352Value:0, UclProxyCdddata353Value:0, UclProxyCdddata354Value:0, UclProxyCdddata355Value:0, UclProxyCdddata356Value:0, UclProxyCdddata357Value:0, UclProxyCdddata358Value:0, UclProxyCdddata359Value:0, UclProxyCdddata360Value:0, UclProxyCdddata361Value:0, UclProxyCdddata362Value:0, UclProxyCdddata363Value:0, UclProxyCdddata364Value:0, UclProxyCdddata365Value:0, UclProxyCdddata366Value:0, UclProxyCdddata367Value:0, UclProxyCdddata368Value:0, UclProxyCdddata369Value:0, UclProxyCdddata370Value:0, UclProxyCdddata371Value:0, UclProxyCdddata372Value:0, UclProxyCdddata373Value:0, UclProxyCdddata374Value:0, UclProxyCdddata375Value:0, UclProxyCdddata376Value:0, UclProxyCdddata377Value:0, UclProxyCdddata378Value:0, UclProxyCdddata379Value:0, UclProxyCdddata380Value:0, UclProxyCdddata381Value:0, UclProxyCdddata382Value:0, UclProxyCdddata383Value:0, UclProxyCdddata384Value:0, UclProxyCdddata385Value:0, UclProxyCdddata386Value:0, UclProxyCdddata387Value:0, UclProxyCdddata388Value:0, UclProxyCdddata389Value:0, UclProxyCdddata390Value:0, UclProxyCdddata391Value:0, UclProxyCdddata392Value:0, UclProxyCdddata393Value:0, UclProxyCdddata394Value:0, UclProxyCdddata395Value:0, UclProxyCdddata396Value:0, UclProxyCdddata397Value:0, UclProxyCdddata398Value:0, UclProxyCdddata399Value:0, UclProxyCdddata400Value:0, UclProxyCdddata401Value:0, UclProxyCdddata402Value:0, UclProxyCdddata403Value:0, UclProxyCdddata404Value:0, UclProxyCdddata405Value:0, UclProxyCdddata406Value:0, UclProxyCdddata407Value:0, UclProxyCdddata408Value:0, UclProxyCdddata409Value:0, UclProxyCdddata410Value:0, UclProxyCdddata411Value:0, UclProxyCdddata412Value:0, UclProxyCdddata413Value:0, UclProxyCdddata414Value:0, UclProxyCdddata415Value:0, UclProxyCdddata416Value:0, UclProxyCdddata417Value:0, UclProxyCdddata418Value:0, UclProxyCdddata419Value:0, UclProxyCdddata420Value:0, UclProxyCdddata421Value:0, UclProxyCdddata422Value:0, UclProxyCdddata423Value:0, UclProxyCdddata424Value:0, UclProxyCdddata425Value:0, UclProxyCdddata426Value:0, UclProxyCdddata427Value:0, UclProxyCdddata428Value:0, UclProxyCdddata429Value:0, UclProxyCdddata430Value:0, UclProxyCdddata431Value:0, UclProxyCdddata432Value:0, UclProxyCdddata433Value:0, UclProxyCdddata434Value:0, UclProxyCdddata435Value:0, UclProxyCdddata436Value:0, UclProxyCdddata437Value:0, UclProxyCdddata438Value:0, UclProxyCdddata439Value:0, UclProxyCdddata440Value:0, UclProxyCdddata441Value:0, UclProxyCdddata442Value:0, UclProxyCdddata443Value:0, UclProxyCdddata444Value:0, UclProxyCdddata445Value:0, UclProxyCdddata446Value:0, UclProxyCdddata447Value:0, UclProxyCdddata448Value:0, UclProxyCdddata449Value:0, UclProxyCdddata450Value:0, UclProxyCdddata451Value:0, UclProxyCdddata452Value:0, UclProxyCdddata453Value:0, UclProxyCdddata454Value:0, UclProxyCdddata455Value:0, UclProxyCdddata456Value:0, UclProxyCdddata457Value:0, UclProxyCdddata458Value:0, UclProxyCdddata459Value:0, UclProxyCdddata460Value:0, UclProxyCdddata461Value:0, UclProxyCdddata462Value:0, UclProxyCdddata463Value:0, UclProxyCdddata464Value:0, UclProxyCdddata465Value:0, UclProxyCdddata466Value:0, UclProxyCdddata467Value:0, UclProxyCdddata468Value:0, UclProxyCdddata469Value:0, UclProxyCdddata470Value:0, UclProxyCdddata471Value:0, UclProxyCdddata472Value:0, UclProxyCdddata473Value:0, UclProxyCdddata474Value:0, UclProxyCdddata475Value:0, UclProxyCdddata476Value:0, UclProxyCdddata477Value:0, UclProxyCdddata478Value:0, UclProxyCdddata479Value:0, UclProxyCdddata480Value:0, UclProxyCdddata481Value:0, UclProxyCdddata482Value:0, UclProxyCdddata483Value:0, UclProxyCdddata484Value:0, UclProxyCdddata485Value:0, UclProxyCdddata486Value:0, UclProxyCdddata487Value:0, UclProxyCdddata488Value:0, UclProxyCdddata489Value:0, UclProxyCdddata490Value:0, UclProxyCdddata491Value:0, UclProxyCdddata492Value:0, UclProxyCdddata493Value:0, UclProxyCdddata494Value:0, UclProxyCdddata495Value:0, UclProxyCdddata496Value:0, UclProxyCdddata497Value:0, UclProxyCdddata498Value:0, UclProxyCdddata499Value:0, UclProxyCdddata500Value:0, UclProxyCdddata501Value:0, UclProxyCdddata502Value:0, UclProxyCdddata503Value:0, UclProxyCdddata504Value:0, UclProxyCdddata505Value:0, UclProxyCdddata506Value:0, UclProxyCdddata507Value:0, UclProxyCdddata508Value:0, UclProxyCdddata509Value:0, UclProxyCdddata510Value:0, UclProxyCdddata511Value:0]]}
    UclProxyCddUpdateShortServiceReqDataValue0: value-spec={short-label=UclProxyCddUpdateShortServiceReqDataValue0, fields=[UclProxyCddUpdateShortServiceReqDataValue_0:0, UclProxyCddUpdateShortServiceReqDataValue_1:0, UclProxyCddUpdateShortServiceReqDataValue_2:0, UclProxyCddUpdateShortServiceReqDataValue_3:0, UclProxyCddUpdateShortServiceReqDataValue_4:0, UclProxyCddUpdateShortServiceReqDataValue_5:0, UclProxyCddUpdateShortServiceReqDataValue_6:[UclProxyCdddata0Value:0, UclProxyCdddata1Value:0, UclProxyCdddata2Value:0, UclProxyCdddata3Value:0, UclProxyCdddata4Value:0, UclProxyCdddata5Value:0, UclProxyCdddata6Value:0, UclProxyCdddata7Value:0, UclProxyCdddata8Value:0, UclProxyCdddata9Value:0, UclProxyCdddata10Value:0, UclProxyCdddata11Value:0, UclProxyCdddata12Value:0, UclProxyCdddata13Value:0, UclProxyCdddata14Value:0, UclProxyCdddata15Value:0, UclProxyCdddata16Value:0, UclProxyCdddata17Value:0, UclProxyCdddata18Value:0, UclProxyCdddata19Value:0, UclProxyCdddata20Value:0, UclProxyCdddata21Value:0, UclProxyCdddata22Value:0, UclProxyCdddata23Value:0, UclProxyCdddata24Value:0, UclProxyCdddata25Value:0, UclProxyCdddata26Value:0, UclProxyCdddata27Value:0, UclProxyCdddata28Value:0, UclProxyCdddata29Value:0, UclProxyCdddata30Value:0, UclProxyCdddata31Value:0, UclProxyCdddata32Value:0, UclProxyCdddata33Value:0, UclProxyCdddata34Value:0, UclProxyCdddata35Value:0, UclProxyCdddata36Value:0, UclProxyCdddata37Value:0, UclProxyCdddata38Value:0, UclProxyCdddata39Value:0, UclProxyCdddata40Value:0, UclProxyCdddata41Value:0, UclProxyCdddata42Value:0, UclProxyCdddata43Value:0, UclProxyCdddata44Value:0, UclProxyCdddata45Value:0, UclProxyCdddata46Value:0, UclProxyCdddata47Value:0, UclProxyCdddata48Value:0, UclProxyCdddata49Value:0, UclProxyCdddata50Value:0, UclProxyCdddata51Value:0, UclProxyCdddata52Value:0, UclProxyCdddata53Value:0, UclProxyCdddata54Value:0, UclProxyCdddata55Value:0, UclProxyCdddata56Value:0, UclProxyCdddata57Value:0, UclProxyCdddata58Value:0, UclProxyCdddata59Value:0, UclProxyCdddata60Value:0, UclProxyCdddata61Value:0, UclProxyCdddata62Value:0, UclProxyCdddata63Value:0]]}
    CUpdateCddUpdateLongServiceReqDataValue0: value-spec={short-label=CUpdateCddUpdateLongServiceReqDataValue0, fields=[CUpdateCddUpdateLongServiceReqDataValue_0:0, CUpdateCddUpdateLongServiceReqDataValue_1:0, CUpdateCddUpdateLongServiceReqDataValue_2:0, CUpdateCddUpdateLongServiceReqDataValue_3:0, CUpdateCddUpdateLongServiceReqDataValue_4:0, CUpdateCddUpdateLongServiceReqDataValue_5:0, CUpdateCddUpdateLongServiceReqDataValue_6:[CUpdateCdddata0Value:0, CUpdateCdddata1Value:0, CUpdateCdddata2Value:0, CUpdateCdddata3Value:0, CUpdateCdddata4Value:0, CUpdateCdddata5Value:0, CUpdateCdddata6Value:0, CUpdateCdddata7Value:0, CUpdateCdddata8Value:0, CUpdateCdddata9Value:0, CUpdateCdddata10Value:0, CUpdateCdddata11Value:0, CUpdateCdddata12Value:0, CUpdateCdddata13Value:0, CUpdateCdddata14Value:0, CUpdateCdddata15Value:0, CUpdateCdddata16Value:0, CUpdateCdddata17Value:0, CUpdateCdddata18Value:0, CUpdateCdddata19Value:0, CUpdateCdddata20Value:0, CUpdateCdddata21Value:0, CUpdateCdddata22Value:0, CUpdateCdddata23Value:0, CUpdateCdddata24Value:0, CUpdateCdddata25Value:0, CUpdateCdddata26Value:0, CUpdateCdddata27Value:0, CUpdateCdddata28Value:0, CUpdateCdddata29Value:0, CUpdateCdddata30Value:0, CUpdateCdddata31Value:0, CUpdateCdddata32Value:0, CUpdateCdddata33Value:0, CUpdateCdddata34Value:0, CUpdateCdddata35Value:0, CUpdateCdddata36Value:0, CUpdateCdddata37Value:0, CUpdateCdddata38Value:0, CUpdateCdddata39Value:0, CUpdateCdddata40Value:0, CUpdateCdddata41Value:0, CUpdateCdddata42Value:0, CUpdateCdddata43Value:0, CUpdateCdddata44Value:0, CUpdateCdddata45Value:0, CUpdateCdddata46Value:0, CUpdateCdddata47Value:0, CUpdateCdddata48Value:0, CUpdateCdddata49Value:0, CUpdateCdddata50Value:0, CUpdateCdddata51Value:0, CUpdateCdddata52Value:0, CUpdateCdddata53Value:0, CUpdateCdddata54Value:0, CUpdateCdddata55Value:0, CUpdateCdddata56Value:0, CUpdateCdddata57Value:0, CUpdateCdddata58Value:0, CUpdateCdddata59Value:0, CUpdateCdddata60Value:0, CUpdateCdddata61Value:0, CUpdateCdddata62Value:0, CUpdateCdddata63Value:0, CUpdateCdddata64Value:0, CUpdateCdddata65Value:0, CUpdateCdddata66Value:0, CUpdateCdddata67Value:0, CUpdateCdddata68Value:0, CUpdateCdddata69Value:0, CUpdateCdddata70Value:0, CUpdateCdddata71Value:0, CUpdateCdddata72Value:0, CUpdateCdddata73Value:0, CUpdateCdddata74Value:0, CUpdateCdddata75Value:0, CUpdateCdddata76Value:0, CUpdateCdddata77Value:0, CUpdateCdddata78Value:0, CUpdateCdddata79Value:0, CUpdateCdddata80Value:0, CUpdateCdddata81Value:0, CUpdateCdddata82Value:0, CUpdateCdddata83Value:0, CUpdateCdddata84Value:0, CUpdateCdddata85Value:0, CUpdateCdddata86Value:0, CUpdateCdddata87Value:0, CUpdateCdddata88Value:0, CUpdateCdddata89Value:0, CUpdateCdddata90Value:0, CUpdateCdddata91Value:0, CUpdateCdddata92Value:0, CUpdateCdddata93Value:0, CUpdateCdddata94Value:0, CUpdateCdddata95Value:0, CUpdateCdddata96Value:0, CUpdateCdddata97Value:0, CUpdateCdddata98Value:0, CUpdateCdddata99Value:0, CUpdateCdddata100Value:0, CUpdateCdddata101Value:0, CUpdateCdddata102Value:0, CUpdateCdddata103Value:0, CUpdateCdddata104Value:0, CUpdateCdddata105Value:0, CUpdateCdddata106Value:0, CUpdateCdddata107Value:0, CUpdateCdddata108Value:0, CUpdateCdddata109Value:0, CUpdateCdddata110Value:0, CUpdateCdddata111Value:0, CUpdateCdddata112Value:0, CUpdateCdddata113Value:0, CUpdateCdddata114Value:0, CUpdateCdddata115Value:0, CUpdateCdddata116Value:0, CUpdateCdddata117Value:0, CUpdateCdddata118Value:0, CUpdateCdddata119Value:0, CUpdateCdddata120Value:0, CUpdateCdddata121Value:0, CUpdateCdddata122Value:0, CUpdateCdddata123Value:0, CUpdateCdddata124Value:0, CUpdateCdddata125Value:0, CUpdateCdddata126Value:0, CUpdateCdddata127Value:0, CUpdateCdddata128Value:0, CUpdateCdddata129Value:0, CUpdateCdddata130Value:0, CUpdateCdddata131Value:0, CUpdateCdddata132Value:0, CUpdateCdddata133Value:0, CUpdateCdddata134Value:0, CUpdateCdddata135Value:0, CUpdateCdddata136Value:0, CUpdateCdddata137Value:0, CUpdateCdddata138Value:0, CUpdateCdddata139Value:0, CUpdateCdddata140Value:0, CUpdateCdddata141Value:0, CUpdateCdddata142Value:0, CUpdateCdddata143Value:0, CUpdateCdddata144Value:0, CUpdateCdddata145Value:0, CUpdateCdddata146Value:0, CUpdateCdddata147Value:0, CUpdateCdddata148Value:0, CUpdateCdddata149Value:0, CUpdateCdddata150Value:0, CUpdateCdddata151Value:0, CUpdateCdddata152Value:0, CUpdateCdddata153Value:0, CUpdateCdddata154Value:0, CUpdateCdddata155Value:0, CUpdateCdddata156Value:0, CUpdateCdddata157Value:0, CUpdateCdddata158Value:0, CUpdateCdddata159Value:0, CUpdateCdddata160Value:0, CUpdateCdddata161Value:0, CUpdateCdddata162Value:0, CUpdateCdddata163Value:0, CUpdateCdddata164Value:0, CUpdateCdddata165Value:0, CUpdateCdddata166Value:0, CUpdateCdddata167Value:0, CUpdateCdddata168Value:0, CUpdateCdddata169Value:0, CUpdateCdddata170Value:0, CUpdateCdddata171Value:0, CUpdateCdddata172Value:0, CUpdateCdddata173Value:0, CUpdateCdddata174Value:0, CUpdateCdddata175Value:0, CUpdateCdddata176Value:0, CUpdateCdddata177Value:0, CUpdateCdddata178Value:0, CUpdateCdddata179Value:0, CUpdateCdddata180Value:0, CUpdateCdddata181Value:0, CUpdateCdddata182Value:0, CUpdateCdddata183Value:0, CUpdateCdddata184Value:0, CUpdateCdddata185Value:0, CUpdateCdddata186Value:0, CUpdateCdddata187Value:0, CUpdateCdddata188Value:0, CUpdateCdddata189Value:0, CUpdateCdddata190Value:0, CUpdateCdddata191Value:0, CUpdateCdddata192Value:0, CUpdateCdddata193Value:0, CUpdateCdddata194Value:0, CUpdateCdddata195Value:0, CUpdateCdddata196Value:0, CUpdateCdddata197Value:0, CUpdateCdddata198Value:0, CUpdateCdddata199Value:0, CUpdateCdddata200Value:0, CUpdateCdddata201Value:0, CUpdateCdddata202Value:0, CUpdateCdddata203Value:0, CUpdateCdddata204Value:0, CUpdateCdddata205Value:0, CUpdateCdddata206Value:0, CUpdateCdddata207Value:0, CUpdateCdddata208Value:0, CUpdateCdddata209Value:0, CUpdateCdddata210Value:0, CUpdateCdddata211Value:0, CUpdateCdddata212Value:0, CUpdateCdddata213Value:0, CUpdateCdddata214Value:0, CUpdateCdddata215Value:0, CUpdateCdddata216Value:0, CUpdateCdddata217Value:0, CUpdateCdddata218Value:0, CUpdateCdddata219Value:0, CUpdateCdddata220Value:0, CUpdateCdddata221Value:0, CUpdateCdddata222Value:0, CUpdateCdddata223Value:0, CUpdateCdddata224Value:0, CUpdateCdddata225Value:0, CUpdateCdddata226Value:0, CUpdateCdddata227Value:0, CUpdateCdddata228Value:0, CUpdateCdddata229Value:0, CUpdateCdddata230Value:0, CUpdateCdddata231Value:0, CUpdateCdddata232Value:0, CUpdateCdddata233Value:0, CUpdateCdddata234Value:0, CUpdateCdddata235Value:0, CUpdateCdddata236Value:0, CUpdateCdddata237Value:0, CUpdateCdddata238Value:0, CUpdateCdddata239Value:0, CUpdateCdddata240Value:0, CUpdateCdddata241Value:0, CUpdateCdddata242Value:0, CUpdateCdddata243Value:0, CUpdateCdddata244Value:0, CUpdateCdddata245Value:0, CUpdateCdddata246Value:0, CUpdateCdddata247Value:0, CUpdateCdddata248Value:0, CUpdateCdddata249Value:0, CUpdateCdddata250Value:0, CUpdateCdddata251Value:0, CUpdateCdddata252Value:0, CUpdateCdddata253Value:0, CUpdateCdddata254Value:0, CUpdateCdddata255Value:0, CUpdateCdddata256Value:0, CUpdateCdddata257Value:0, CUpdateCdddata258Value:0, CUpdateCdddata259Value:0, CUpdateCdddata260Value:0, CUpdateCdddata261Value:0, CUpdateCdddata262Value:0, CUpdateCdddata263Value:0, CUpdateCdddata264Value:0, CUpdateCdddata265Value:0, CUpdateCdddata266Value:0, CUpdateCdddata267Value:0, CUpdateCdddata268Value:0, CUpdateCdddata269Value:0, CUpdateCdddata270Value:0, CUpdateCdddata271Value:0, CUpdateCdddata272Value:0, CUpdateCdddata273Value:0, CUpdateCdddata274Value:0, CUpdateCdddata275Value:0, CUpdateCdddata276Value:0, CUpdateCdddata277Value:0, CUpdateCdddata278Value:0, CUpdateCdddata279Value:0, CUpdateCdddata280Value:0, CUpdateCdddata281Value:0, CUpdateCdddata282Value:0, CUpdateCdddata283Value:0, CUpdateCdddata284Value:0, CUpdateCdddata285Value:0, CUpdateCdddata286Value:0, CUpdateCdddata287Value:0, CUpdateCdddata288Value:0, CUpdateCdddata289Value:0, CUpdateCdddata290Value:0, CUpdateCdddata291Value:0, CUpdateCdddata292Value:0, CUpdateCdddata293Value:0, CUpdateCdddata294Value:0, CUpdateCdddata295Value:0, CUpdateCdddata296Value:0, CUpdateCdddata297Value:0, CUpdateCdddata298Value:0, CUpdateCdddata299Value:0, CUpdateCdddata300Value:0, CUpdateCdddata301Value:0, CUpdateCdddata302Value:0, CUpdateCdddata303Value:0, CUpdateCdddata304Value:0, CUpdateCdddata305Value:0, CUpdateCdddata306Value:0, CUpdateCdddata307Value:0, CUpdateCdddata308Value:0, CUpdateCdddata309Value:0, CUpdateCdddata310Value:0, CUpdateCdddata311Value:0, CUpdateCdddata312Value:0, CUpdateCdddata313Value:0, CUpdateCdddata314Value:0, CUpdateCdddata315Value:0, CUpdateCdddata316Value:0, CUpdateCdddata317Value:0, CUpdateCdddata318Value:0, CUpdateCdddata319Value:0, CUpdateCdddata320Value:0, CUpdateCdddata321Value:0, CUpdateCdddata322Value:0, CUpdateCdddata323Value:0, CUpdateCdddata324Value:0, CUpdateCdddata325Value:0, CUpdateCdddata326Value:0, CUpdateCdddata327Value:0, CUpdateCdddata328Value:0, CUpdateCdddata329Value:0, CUpdateCdddata330Value:0, CUpdateCdddata331Value:0, CUpdateCdddata332Value:0, CUpdateCdddata333Value:0, CUpdateCdddata334Value:0, CUpdateCdddata335Value:0, CUpdateCdddata336Value:0, CUpdateCdddata337Value:0, CUpdateCdddata338Value:0, CUpdateCdddata339Value:0, CUpdateCdddata340Value:0, CUpdateCdddata341Value:0, CUpdateCdddata342Value:0, CUpdateCdddata343Value:0, CUpdateCdddata344Value:0, CUpdateCdddata345Value:0, CUpdateCdddata346Value:0, CUpdateCdddata347Value:0, CUpdateCdddata348Value:0, CUpdateCdddata349Value:0, CUpdateCdddata350Value:0, CUpdateCdddata351Value:0, CUpdateCdddata352Value:0, CUpdateCdddata353Value:0, CUpdateCdddata354Value:0, CUpdateCdddata355Value:0, CUpdateCdddata356Value:0, CUpdateCdddata357Value:0, CUpdateCdddata358Value:0, CUpdateCdddata359Value:0, CUpdateCdddata360Value:0, CUpdateCdddata361Value:0, CUpdateCdddata362Value:0, CUpdateCdddata363Value:0, CUpdateCdddata364Value:0, CUpdateCdddata365Value:0, CUpdateCdddata366Value:0, CUpdateCdddata367Value:0, CUpdateCdddata368Value:0, CUpdateCdddata369Value:0, CUpdateCdddata370Value:0, CUpdateCdddata371Value:0, CUpdateCdddata372Value:0, CUpdateCdddata373Value:0, CUpdateCdddata374Value:0, CUpdateCdddata375Value:0, CUpdateCdddata376Value:0, CUpdateCdddata377Value:0, CUpdateCdddata378Value:0, CUpdateCdddata379Value:0, CUpdateCdddata380Value:0, CUpdateCdddata381Value:0, CUpdateCdddata382Value:0, CUpdateCdddata383Value:0, CUpdateCdddata384Value:0, CUpdateCdddata385Value:0, CUpdateCdddata386Value:0, CUpdateCdddata387Value:0, CUpdateCdddata388Value:0, CUpdateCdddata389Value:0, CUpdateCdddata390Value:0, CUpdateCdddata391Value:0, CUpdateCdddata392Value:0, CUpdateCdddata393Value:0, CUpdateCdddata394Value:0, CUpdateCdddata395Value:0, CUpdateCdddata396Value:0, CUpdateCdddata397Value:0, CUpdateCdddata398Value:0, CUpdateCdddata399Value:0, CUpdateCdddata400Value:0, CUpdateCdddata401Value:0, CUpdateCdddata402Value:0, CUpdateCdddata403Value:0, CUpdateCdddata404Value:0, CUpdateCdddata405Value:0, CUpdateCdddata406Value:0, CUpdateCdddata407Value:0, CUpdateCdddata408Value:0, CUpdateCdddata409Value:0, CUpdateCdddata410Value:0, CUpdateCdddata411Value:0, CUpdateCdddata412Value:0, CUpdateCdddata413Value:0, CUpdateCdddata414Value:0, CUpdateCdddata415Value:0, CUpdateCdddata416Value:0, CUpdateCdddata417Value:0, CUpdateCdddata418Value:0, CUpdateCdddata419Value:0, CUpdateCdddata420Value:0, CUpdateCdddata421Value:0, CUpdateCdddata422Value:0, CUpdateCdddata423Value:0, CUpdateCdddata424Value:0, CUpdateCdddata425Value:0, CUpdateCdddata426Value:0, CUpdateCdddata427Value:0, CUpdateCdddata428Value:0, CUpdateCdddata429Value:0, CUpdateCdddata430Value:0, CUpdateCdddata431Value:0, CUpdateCdddata432Value:0, CUpdateCdddata433Value:0, CUpdateCdddata434Value:0, CUpdateCdddata435Value:0, CUpdateCdddata436Value:0, CUpdateCdddata437Value:0, CUpdateCdddata438Value:0, CUpdateCdddata439Value:0, CUpdateCdddata440Value:0, CUpdateCdddata441Value:0, CUpdateCdddata442Value:0, CUpdateCdddata443Value:0, CUpdateCdddata444Value:0, CUpdateCdddata445Value:0, CUpdateCdddata446Value:0, CUpdateCdddata447Value:0, CUpdateCdddata448Value:0, CUpdateCdddata449Value:0, CUpdateCdddata450Value:0, CUpdateCdddata451Value:0, CUpdateCdddata452Value:0, CUpdateCdddata453Value:0, CUpdateCdddata454Value:0, CUpdateCdddata455Value:0, CUpdateCdddata456Value:0, CUpdateCdddata457Value:0, CUpdateCdddata458Value:0, CUpdateCdddata459Value:0, CUpdateCdddata460Value:0, CUpdateCdddata461Value:0, CUpdateCdddata462Value:0, CUpdateCdddata463Value:0, CUpdateCdddata464Value:0, CUpdateCdddata465Value:0, CUpdateCdddata466Value:0, CUpdateCdddata467Value:0, CUpdateCdddata468Value:0, CUpdateCdddata469Value:0, CUpdateCdddata470Value:0, CUpdateCdddata471Value:0, CUpdateCdddata472Value:0, CUpdateCdddata473Value:0, CUpdateCdddata474Value:0, CUpdateCdddata475Value:0, CUpdateCdddata476Value:0, CUpdateCdddata477Value:0, CUpdateCdddata478Value:0, CUpdateCdddata479Value:0, CUpdateCdddata480Value:0, CUpdateCdddata481Value:0, CUpdateCdddata482Value:0, CUpdateCdddata483Value:0, CUpdateCdddata484Value:0, CUpdateCdddata485Value:0, CUpdateCdddata486Value:0, CUpdateCdddata487Value:0, CUpdateCdddata488Value:0, CUpdateCdddata489Value:0, CUpdateCdddata490Value:0, CUpdateCdddata491Value:0, CUpdateCdddata492Value:0, CUpdateCdddata493Value:0, CUpdateCdddata494Value:0, CUpdateCdddata495Value:0, CUpdateCdddata496Value:0, CUpdateCdddata497Value:0, CUpdateCdddata498Value:0, CUpdateCdddata499Value:0, CUpdateCdddata500Value:0, CUpdateCdddata501Value:0, CUpdateCdddata502Value:0, CUpdateCdddata503Value:0, CUpdateCdddata504Value:0, CUpdateCdddata505Value:0, CUpdateCdddata506Value:0, CUpdateCdddata507Value:0, CUpdateCdddata508Value:0, CUpdateCdddata509Value:0, CUpdateCdddata510Value:0, CUpdateCdddata511Value:0]]}
    CUpdateCddUpdateShortServiceReqDataValue0: value-spec={short-label=CUpdateCddUpdateShortServiceReqDataValue0, fields=[CUpdateCddUpdateShortServiceReqDataValue_0:0, CUpdateCddUpdateShortServiceReqDataValue_1:0, CUpdateCddUpdateShortServiceReqDataValue_2:0, CUpdateCddUpdateShortServiceReqDataValue_3:0, CUpdateCddUpdateShortServiceReqDataValue_4:0, CUpdateCddUpdateShortServiceReqDataValue_5:0, CUpdateCddUpdateShortServiceReqDataValue_6:[CUpdateCdddata0Value:0, CUpdateCdddata1Value:0, CUpdateCdddata2Value:0, CUpdateCdddata3Value:0, CUpdateCdddata4Value:0, CUpdateCdddata5Value:0, CUpdateCdddata6Value:0, CUpdateCdddata7Value:0, CUpdateCdddata8Value:0, CUpdateCdddata9Value:0, CUpdateCdddata10Value:0, CUpdateCdddata11Value:0, CUpdateCdddata12Value:0, CUpdateCdddata13Value:0, CUpdateCdddata14Value:0, CUpdateCdddata15Value:0, CUpdateCdddata16Value:0, CUpdateCdddata17Value:0, CUpdateCdddata18Value:0, CUpdateCdddata19Value:0, CUpdateCdddata20Value:0, CUpdateCdddata21Value:0, CUpdateCdddata22Value:0, CUpdateCdddata23Value:0, CUpdateCdddata24Value:0, CUpdateCdddata25Value:0, CUpdateCdddata26Value:0, CUpdateCdddata27Value:0, CUpdateCdddata28Value:0, CUpdateCdddata29Value:0, CUpdateCdddata30Value:0, CUpdateCdddata31Value:0, CUpdateCdddata32Value:0, CUpdateCdddata33Value:0, CUpdateCdddata34Value:0, CUpdateCdddata35Value:0, CUpdateCdddata36Value:0, CUpdateCdddata37Value:0, CUpdateCdddata38Value:0, CUpdateCdddata39Value:0, CUpdateCdddata40Value:0, CUpdateCdddata41Value:0, CUpdateCdddata42Value:0, CUpdateCdddata43Value:0, CUpdateCdddata44Value:0, CUpdateCdddata45Value:0, CUpdateCdddata46Value:0, CUpdateCdddata47Value:0, CUpdateCdddata48Value:0, CUpdateCdddata49Value:0, CUpdateCdddata50Value:0, CUpdateCdddata51Value:0, CUpdateCdddata52Value:0, CUpdateCdddata53Value:0, CUpdateCdddata54Value:0, CUpdateCdddata55Value:0, CUpdateCdddata56Value:0, CUpdateCdddata57Value:0, CUpdateCdddata58Value:0, CUpdateCdddata59Value:0, CUpdateCdddata60Value:0, CUpdateCdddata61Value:0, CUpdateCdddata62Value:0, CUpdateCdddata63Value:0]]}
    CUpdateCddUpdateShortServiceRespDataValue0: value-spec={short-label=CUpdateCddUpdateShortServiceRespDataValue0, fields=[CUpdateCddUpdateShortServiceRespDataValue_0:0, CUpdateCddUpdateShortServiceRespDataValue_1:0, CUpdateCddUpdateShortServiceRespDataValue_2:0, CUpdateCddUpdateShortServiceRespDataValue_3:0, CUpdateCddUpdateShortServiceRespDataValue_4:0, CUpdateCddUpdateShortServiceRespDataValue_5:0, CUpdateCddUpdateShortServiceRespDataValue_6:[CUpdateCdddata0Value:0, CUpdateCdddata1Value:0, CUpdateCdddata2Value:0, CUpdateCdddata3Value:0, CUpdateCdddata4Value:0, CUpdateCdddata5Value:0, CUpdateCdddata6Value:0, CUpdateCdddata7Value:0, CUpdateCdddata8Value:0, CUpdateCdddata9Value:0, CUpdateCdddata10Value:0, CUpdateCdddata11Value:0, CUpdateCdddata12Value:0, CUpdateCdddata13Value:0, CUpdateCdddata14Value:0, CUpdateCdddata15Value:0, CUpdateCdddata16Value:0, CUpdateCdddata17Value:0, CUpdateCdddata18Value:0, CUpdateCdddata19Value:0, CUpdateCdddata20Value:0, CUpdateCdddata21Value:0, CUpdateCdddata22Value:0, CUpdateCdddata23Value:0, CUpdateCdddata24Value:0, CUpdateCdddata25Value:0, CUpdateCdddata26Value:0, CUpdateCdddata27Value:0, CUpdateCdddata28Value:0, CUpdateCdddata29Value:0, CUpdateCdddata30Value:0, CUpdateCdddata31Value:0, CUpdateCdddata32Value:0, CUpdateCdddata33Value:0, CUpdateCdddata34Value:0, CUpdateCdddata35Value:0, CUpdateCdddata36Value:0, CUpdateCdddata37Value:0, CUpdateCdddata38Value:0, CUpdateCdddata39Value:0, CUpdateCdddata40Value:0, CUpdateCdddata41Value:0, CUpdateCdddata42Value:0, CUpdateCdddata43Value:0, CUpdateCdddata44Value:0, CUpdateCdddata45Value:0, CUpdateCdddata46Value:0, CUpdateCdddata47Value:0, CUpdateCdddata48Value:0, CUpdateCdddata49Value:0, CUpdateCdddata50Value:0, CUpdateCdddata51Value:0, CUpdateCdddata52Value:0, CUpdateCdddata53Value:0, CUpdateCdddata54Value:0, CUpdateCdddata55Value:0, CUpdateCdddata56Value:0, CUpdateCdddata57Value:0, CUpdateCdddata58Value:0, CUpdateCdddata59Value:0, CUpdateCdddata60Value:0, CUpdateCdddata61Value:0, CUpdateCdddata62Value:0, CUpdateCdddata63Value:0]]}
    CComAbsMdlAlive_101Value0: value-spec=CComAbsMdlAlive_101Value0:0
    CComAbsMdlCRC_101Value0: value-spec=CComAbsMdlCRC_101Value0:0
    ComCalloutABS0x102_StatusValue0: value-spec=ComCalloutABS0x102_StatusValue0:false
    Mdl_DimIllumCtrl_Ip_DataValue0: value-spec={short-label=Mdl_DimIllumCtrl_Ip_DataValue0, fields=[Mdl_DimIllumCtrl_Ip_DataValue_0:0, Mdl_DimIllumCtrl_Ip_DataValue_1:0, Mdl_DimIllumCtrl_Ip_DataValue_2:0, Mdl_DimIllumCtrl_Ip_DataValue_3:0, Mdl_DimIllumCtrl_Ip_DataValue_4:0, Mdl_DimIllumCtrl_Ip_DataValue_5:0, Mdl_DimIllumCtrl_Ip_DataValue_6:0, Mdl_DimIllumCtrl_Ip_DataValue_7:0]}
    Ctrl_IlluminationILL_DutyValue0: value-spec=Ctrl_IlluminationILL_DutyValue0:0
    Ctrl_IlluminationRGB_DimmingValue0: value-spec=Ctrl_IlluminationRGB_DimmingValue0:0
    Ctrl_IlluminationStarter_StatusValue0: value-spec=Ctrl_IlluminationStarter_StatusValue0:false
    Ctrl_IlluminationReady_to_SleepValue0: value-spec=Ctrl_IlluminationReady_to_SleepValue0:false
    Ctrl_IlluminationIllumCtrl_Op_DataValue0: value-spec={short-label=Ctrl_IlluminationIllumCtrl_Op_DataValue0, fields=[Ctrl_IlluminationIllumCtrl_Op_DataValue_0:0, Ctrl_IlluminationIllumCtrl_Op_DataValue_1:0, Ctrl_IlluminationIllumCtrl_Op_DataValue_2:0, Ctrl_IlluminationIllumCtrl_Op_DataValue_3:0, Ctrl_IlluminationIllumCtrl_Op_DataValue_4:0, Ctrl_IlluminationIllumCtrl_Op_DataValue_5:0, Ctrl_IlluminationIllumCtrl_Op_DataValue_6:0, Ctrl_IlluminationIllumCtrl_Op_DataValue_7:0]}
    Ctrl_IlluminationIlumDayNightRequiredValue0: value-spec=Ctrl_IlluminationIlumDayNightRequiredValue0:0
    Ctrl_IlluminationDay_Night_StatusValue0: value-spec=Ctrl_IlluminationDay_Night_StatusValue0:0
    Ctrl_IlluminationBL_DimmingValue0: value-spec=Ctrl_IlluminationBL_DimmingValue0:0
    Ctrl_Illuminationchannel_idValue0: value-spec=Ctrl_Illuminationchannel_idValue0:0
    Ctrl_IlluminationIllumStatusValue0: value-spec=Ctrl_IlluminationIllumStatusValue0:0
    Ctrl_IlluminationIgnitionSubstateValue0: value-spec=Ctrl_IlluminationIgnitionSubstateValue0:0
    Ctrl_IlluminationHVP0FlagValue0: value-spec=Ctrl_IlluminationHVP0FlagValue0:false
    Ctrl_IlluminationHVSD{0..4}FlagValue0: value-spec=Ctrl_IlluminationHVSD{0..4}FlagValue0:false
    Ctrl_IlluminationLVP0FlagValue0: value-spec=Ctrl_IlluminationLVP0FlagValue0:false
    Ctrl_IlluminationLVP1FlagValue0: value-spec=Ctrl_IlluminationLVP1FlagValue0:false
    Ctrl_IlluminationLVSD{0..4}FlagValue0: value-spec=Ctrl_IlluminationLVSD{0..4}FlagValue0:false
    Ctrl_IlluminationSVPFlagValue0: value-spec=Ctrl_IlluminationSVPFlagValue0:false
    Ctrl_IlluminationWSSCurrentVehicleStateValue0: value-spec=Ctrl_IlluminationWSSCurrentVehicleStateValue0:0
    Ctrl_IlluminationWSSCurrentClusterModeValue0: value-spec=Ctrl_IlluminationWSSCurrentClusterModeValue0:0
    Ctrl_IlluminationDay_Night_mode_CtrlValue0: value-spec=Ctrl_IlluminationDay_Night_mode_CtrlValue0:0
    Ctrl_IlluminationEcoRunSystem_FlagValue0: value-spec=Ctrl_IlluminationEcoRunSystem_FlagValue0:0
    Ctrl_IlluminationIllumCtrl_Ip_DataValue0: value-spec={short-label=Ctrl_IlluminationIllumCtrl_Ip_DataValue0, fields=[Ctrl_IlluminationIllumCtrl_Ip_DataValue_0:0, Ctrl_IlluminationIllumCtrl_Ip_DataValue_1:0, Ctrl_IlluminationIllumCtrl_Ip_DataValue_2:0, Ctrl_IlluminationIllumCtrl_Ip_DataValue_3:0, Ctrl_IlluminationIllumCtrl_Ip_DataValue_4:0, Ctrl_IlluminationIllumCtrl_Ip_DataValue_5:0, Ctrl_IlluminationIllumCtrl_Ip_DataValue_6:0, Ctrl_IlluminationIllumCtrl_Ip_DataValue_7:0]}
    Ctrl_IlluminationIllumStepValueValue0: value-spec=Ctrl_IlluminationIllumStepValueValue0:0
    Ctrl_IlluminationRheostatDayStepValue0: value-spec=Ctrl_IlluminationRheostatDayStepValue0:0
    Ctrl_IlluminationRheostatNightStepValue0: value-spec=Ctrl_IlluminationRheostatNightStepValue0:0
    Ctrl_IlluminationRheoUpdateValValue0: value-spec=Ctrl_IlluminationRheoUpdateValValue0:0
    Ctrl_IlluminationTFTDisplayOnValue0: value-spec=Ctrl_IlluminationTFTDisplayOnValue0:0
    View_IlluminationIlluminationDataDataValue0: value-spec={short-label=View_IlluminationIlluminationDataDataValue0, fields=[View_IlluminationIlluminationDataDataValue_0:0, View_IlluminationIlluminationDataDataValue_1:0, View_IlluminationIlluminationDataDataValue_2:0, View_IlluminationIlluminationDataDataValue_3:0]}
    View_IlluminationIllumStatusValue0: value-spec=View_IlluminationIllumStatusValue0:0
    View_IlluminationIgnitionSubstateValue0: value-spec=View_IlluminationIgnitionSubstateValue0:0
    View_IlluminationHVP0FlagValue0: value-spec=View_IlluminationHVP0FlagValue0:false
    View_IlluminationHVSD{0..4}FlagValue0: value-spec=View_IlluminationHVSD{0..4}FlagValue0:false
    View_IlluminationLVP0FlagValue0: value-spec=View_IlluminationLVP0FlagValue0:false
    View_IlluminationLVP1FlagValue0: value-spec=View_IlluminationLVP1FlagValue0:false
    View_IlluminationLVSD{0..4}FlagValue0: value-spec=View_IlluminationLVSD{0..4}FlagValue0:false
    View_IlluminationSVPFlagValue0: value-spec=View_IlluminationSVPFlagValue0:false
    View_IlluminationWSSCurrentVehicleStateValue0: value-spec=View_IlluminationWSSCurrentVehicleStateValue0:0
    View_IlluminationEcoRunSystem_FlagValue0: value-spec=View_IlluminationEcoRunSystem_FlagValue0:0
    View_IlluminationIllumCtrl_Op_DataValue0: value-spec={short-label=View_IlluminationIllumCtrl_Op_DataValue0, fields=[View_IlluminationIllumCtrl_Op_DataValue_0:0, View_IlluminationIllumCtrl_Op_DataValue_1:0, View_IlluminationIllumCtrl_Op_DataValue_2:0, View_IlluminationIllumCtrl_Op_DataValue_3:0, View_IlluminationIllumCtrl_Op_DataValue_4:0, View_IlluminationIllumCtrl_Op_DataValue_5:0, View_IlluminationIllumCtrl_Op_DataValue_6:0, View_IlluminationIllumCtrl_Op_DataValue_7:0]}
    View_IlluminationRheostatDayStepValue0: value-spec=View_IlluminationRheostatDayStepValue0:0
    View_IlluminationRheostatNightStepValue0: value-spec=View_IlluminationRheostatNightStepValue0:0
    View_IlluminationRheoUpdateValValue0: value-spec=View_IlluminationRheoUpdateValValue0:0
    View_IlluminationTFTDisplayOnValue0: value-spec=View_IlluminationTFTDisplayOnValue0:0
    CFltMExtHVP0FlagValue0: value-spec=CFltMExtHVP0FlagValue0:false
    CFltMExtHVSD{0..4}FlagValue0: value-spec=CFltMExtHVSD{0..4}FlagValue0:false
    CFltMExtLVP0FlagValue0: value-spec=CFltMExtLVP0FlagValue0:false
    CFltMExtLVP1FlagValue0: value-spec=CFltMExtLVP1FlagValue0:false
    CFltMExtLVSD{0..4}FlagValue0: value-spec=CFltMExtLVSD{0..4}FlagValue0:false
    CFltMExtSVPFlagValue0: value-spec=CFltMExtSVPFlagValue0:false
    EcuAppMPhasedRead_Status_phase1readcompletedValue0: value-spec=EcuAppMPhasedRead_Status_phase1readcompletedValue0:false
    EcuAppMPhasedRead_Status_phase2readcompletedValue0: value-spec=EcuAppMPhasedRead_Status_phase2readcompletedValue0:false
    Ctrl_WSSPhasedRead_Status_phase3readcompletedValue0: value-spec=Ctrl_WSSPhasedRead_Status_phase3readcompletedValue0:false
    NvMExtPhasedRead_Status_phase{1..3}readcompletedValue0: value-spec=NvMExtPhasedRead_Status_phase{1..3}readcompletedValue0:false
    SFastGaugeInfo_InitValue: value-spec={short-label=SFastGaugeInfo_InitValue, fields=[fields=[0, 0, 0, 0, 0], fields=[0, 0, 0, 0, 0]]}
    UclProxyCddDLTControlMessageRequestDataValue0: value-spec={short-label=UclProxyCddDLTControlMessageRequestDataValue0, fields=UclProxyCddDLTControlMessageRequestDataValue_0:0}
    UclProxyCddDLTMessageReadAcktDataValue0: value-spec={short-label=UclProxyCddDLTMessageReadAcktDataValue0, fields=UclProxyCddDLTMessageReadAcktDataValue_0:0}
    UclProxyCddDLTControlMessageReponseDataValue0: value-spec={short-label=UclProxyCddDLTControlMessageReponseDataValue0, fields=UclProxyCddDLTControlMessageReponseDataValue_0:0}
    UclProxyCddDLTMessageReadRequestDataValue0: value-spec={short-label=UclProxyCddDLTMessageReadRequestDataValue0, fields=UclProxyCddDLTMessageReadRequestDataValue_0:0}
    DltExtDLTControlMessageReponseDataValue0: value-spec={short-label=DltExtDLTControlMessageReponseDataValue0, fields=DltExtDLTControlMessageReponseDataValue_0:0}
    DltExtDLTMessageReadRequestDataValue0: value-spec={short-label=DltExtDLTMessageReadRequestDataValue0, fields=DltExtDLTMessageReadRequestDataValue_0:0}
    DltExtDLTControlMessageRequestDataValue0: value-spec={short-label=DltExtDLTControlMessageRequestDataValue0, fields=DltExtDLTControlMessageRequestDataValue_0:0}
    DltExtDLTMessageReadAcktDataValue0: value-spec={short-label=DltExtDLTMessageReadAcktDataValue0, fields=DltExtDLTMessageReadAcktDataValue_0:0}
    UclProxyCddDLTMessageReadAckDataValue0: value-spec={short-label=UclProxyCddDLTMessageReadAckDataValue0, fields=UclProxyCddDLTMessageReadAckDataValue_0:0}
    DltExtDLTMessageReadAckDataValue0: value-spec={short-label=DltExtDLTMessageReadAckDataValue0, fields=DltExtDLTMessageReadAckDataValue_0:0}
    CSigCddwin_violation_outputValue0: value-spec=CSigCddwin_violation_outputValue0:0
    CSigCddsig0_portValue0: value-spec={short-label=CSigCddsig0_portValue0, fields=[CSigCddsig0_portValue_0:0, CSigCddsig0_portValue_1:0, CSigCddsig0_portValue_2:0, CSigCddsig0_portValue_3:0, CSigCddsig0_portValue_4:0, CSigCddsig0_portValue_5:0]}
    CSwcDispMonSfsig0_portValue0: value-spec={short-label=CSwcDispMonSfsig0_portValue0, fields=[CSwcDispMonSfsig0_portValue_0:0, CSwcDispMonSfsig0_portValue_1:0, CSwcDispMonSfsig0_portValue_2:0, CSwcDispMonSfsig0_portValue_3:0, CSwcDispMonSfsig0_portValue_4:0, CSwcDispMonSfsig0_portValue_5:0]}
    CSwcDispMonSfwin_violation_outputValue0: value-spec=CSwcDispMonSfwin_violation_outputValue0:0
