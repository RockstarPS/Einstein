AUTOSAR XML (schema 00044)
package /MICROSAR/EcuM_swc
  mode declaration group EcuM_Mode: initial-mode=EcuM_Mode/STARTUP
    6 x mode:
      STARTUP
      RUN
      POST_RUN
      SLEEP
      WAKE_SLEEP
      SHUTDOWN
package /MICROSAR/EcuM_swc/Interfaces
  client server interface EcuM_ShutdownTarget: is-service=true, service-kind=ECU-MANAGER  # A SW-C can select a shutdown target using this interface.
    5 x operation, all with possible-error=EcuM_ShutdownTarget/E_NOT_OK:
      SelectShutdownTarget  # The SW-C selects the cause corresponding to the next shutdown target.
        arg targetState: type=EcuM_StateType, direction=IN, server-argument-impl-policy=USE-ARGUMENT-TYPE  # The selected shutdown cause.
        arg resetSleepMode: type=EcuM_ModeType, direction=IN, server-argument-impl-policy=USE-ARGUMENT-TYPE  # The sleep mode (if target is ECUM_STATE_SLEEP) or the reset mechanism (if target is ECUM_STATE_RESET) of the shutdown.
      GetShutdownTarget  # Returns the currently selected shutdown target for the next shutdown as set by the operation SelectShutdownTarget.
        arg target: type=EcuM_StateType, direction=OUT, server-argument-impl-policy=USE-ARGUMENT-TYPE  # The shutdown target of the next shutdown.
        arg resetSleepMode: type=EcuM_ModeType, direction=OUT, server-argument-impl-policy=USE-ARGUMENT-TYPE  # The sleep mode (if target is ECUM_STATE_SLEEP) or the reset mechanism (if target is ECUM_STATE_RESET) of the shutdown.
      GetLastShutdownTarget  # Returns the shutdown target of the previous shutdown.
        arg target: type=EcuM_StateType, direction=OUT, server-argument-impl-policy=USE-ARGUMENT-TYPE  # The shutdown target of the previous shutdown.
        arg resetSleepMode: type=EcuM_ModeType, direction=OUT, server-argument-impl-policy=USE-ARGUMENT-TYPE  # The sleep mode (if target is ECUM_STATE_SLEEP) or the reset mechanism (if target is ECUM_STATE_RESET) of the shutdown.
      SelectShutdownCause  # The SW-C selects the cause corresponding to the next shutdown target.
        arg shutdownCause: type=EcuM_ShutdownCauseType, direction=IN, server-argument-impl-policy=USE-ARGUMENT-TYPE  # The selected shutdown cause.
      GetShutdownCause  # Returns the selected shutdown cause as set by the operation SelectShutdownCause.
        arg shutdownCause: type=EcuM_ShutdownCauseType, direction=OUT, server-argument-impl-policy=USE-ARGUMENT-TYPE  # The selected cause of the next shutdown.
    error E_NOT_OK: error-code=1  # The new shutdown target was not set
  client server interface EcuM_BootTarget: is-service=true, service-kind=ECU-MANAGER
    operation SelectBootTarget: possible-error=EcuM_BootTarget/E_NOT_OK  # The SW-C selects a boot target.
      arg BootTarget: type=EcuM_BootTargetType, direction=IN, server-argument-impl-policy=USE-ARGUMENT-TYPE  # The selected boot target.
    operation GetBootTarget: possible-error=EcuM_BootTarget/E_NOT_OK  # Returns the current boot target.
      arg BootTarget: type=EcuM_BootTargetType, direction=OUT, server-argument-impl-policy=USE-ARGUMENT-TYPE  # The currently selected boot target.
    error E_NOT_OK: error-code=1  # The new boot target was not accepted by EcuM
  mode switch interface EcuM_CurrentMode: is-service=true, service-kind=ECU-MANAGER  # Interface to read the current ECU mode
    mode group currentMode: type=EcuM_swc/EcuM_Mode
  client server interface EcuM_StateRequest: is-service=true, service-kind=ECU-MANAGER  # A SW-C which wants to keep the ECU alive shall require the client-server interface EcuM_StateRequest.
    5 x operation, all with possible-error=EcuM_StateRequest/E_NOT_OK:
      ReleasePOSTRUN  # Release of the POST_RUN state.
      ReleaseRUN  # Release of the RUN state.
      RequestPOSTRUN  # Request for the POST_RUN state.
      RequestRUN  # Request for the RUN state.
      GetStateWrapper  # Returns the current module state of the ECUM.
        arg state: type=EcuM_StateType, direction=OUT, server-argument-impl-policy=USE-ARGUMENT-TYPE  # Reference to the actually EcuM state.
    error E_NOT_OK: error-code=1  # The request was not accepted by EcuM, a detailed error condition was sent to DET
package /MICROSAR/ComM_swc
  mode declaration group ComMMode: category=ALPHABETIC_ORDER, initial-mode=COMM_NO_COMMUNICATION
    mode COMM_NO_COMMUNICATION
    mode COMM_SILENT_COMMUNICATION
    mode COMM_FULL_COMMUNICATION
package /MICROSAR/ComM_swc/Interfaces
  4 x client server interface, all with is-service=true, service-kind=COM-MANAGER:
    ComM_ChannelLimitation
      operation GetInhibitionStatus: possible-error=ComM_ChannelLimitation/E_NOT_OK
        arg Status: type=ComM_InhibitionStatusType, direction=OUT, server-argument-impl-policy=USE-ARGUMENT-TYPE
      operation LimitChannelToNoComMode: possible-error=ComM_ChannelLimitation/E_NOT_OK
        arg Status: type=Boolean, direction=IN, server-argument-impl-policy=USE-ARGUMENT-TYPE
      error E_NOT_OK: error-code=1
    ComM_ChannelWakeUp
      operation GetInhibitionStatus: possible-error=ComM_ChannelWakeUp/E_NOT_OK
        arg Status: type=ComM_InhibitionStatusType, direction=OUT, server-argument-impl-policy=USE-ARGUMENT-TYPE
      operation PreventWakeUp: possible-error=ComM_ChannelWakeUp/E_NOT_OK
        arg Status: type=Boolean, direction=IN, server-argument-impl-policy=USE-ARGUMENT-TYPE
      error E_NOT_OK: error-code=1
    ComM_ECUModeLimitation
      4 x operation, all with possible-error=ComM_ECUModeLimitation/E_NOT_OK:
        LimitECUToNoComMode
          arg Status: type=Boolean, direction=IN, server-argument-impl-policy=USE-ARGUMENT-TYPE
        ReadInhibitCounter
          arg CounterValue: type=UInt16, direction=OUT, server-argument-impl-policy=USE-ARGUMENT-TYPE
        ResetInhibitCounter
        SetECUGroupClassification
          arg Status: type=ComM_InhibitionStatusType, direction=IN, server-argument-impl-policy=USE-ARGUMENT-TYPE
      error E_NOT_OK: error-code=1
    ComM_UserRequest
      4 x operation:
        GetCurrentComMode: possible-error=ComM_UserRequest/E_NOT_OK
          arg ComMode: type=ComM_ModeType, direction=OUT, server-argument-impl-policy=USE-ARGUMENT-TYPE
        GetMaxComMode: possible-error=ComM_UserRequest/E_NOT_OK
          arg ComMode: type=ComM_ModeType, direction=OUT, server-argument-impl-policy=USE-ARGUMENT-TYPE
        GetRequestedComMode: possible-error=ComM_UserRequest/E_NOT_OK
          arg ComMode: type=ComM_ModeType, direction=OUT, server-argument-impl-policy=USE-ARGUMENT-TYPE
        RequestComMode: possible-error=[E_MODE_LIMITATION, ComM_UserRequest/E_NOT_OK]
          arg ComMode: type=ComM_ModeType, direction=IN, server-argument-impl-policy=USE-ARGUMENT-TYPE
      error E_MODE_LIMITATION: error-code=2
      error E_NOT_OK: error-code=1
  mode switch interface ComM_CurrentMode: is-service=true, service-kind=COM-MANAGER
    mode group currentMode: type=ComMMode
package /MICROSAR/BswM_swc
  mode declaration group MDG_Sfd_NvmBlockStatus: category=ALPHABETIC_ORDER, initial-mode=SFD_BLOCKS_NOT_INITIALIZED
    mode SFD_BLOCKS_INITIALIZED
    mode SFD_BLOCKS_NOT_INITIALIZED
package /MICROSAR/BswM_swc/Interfaces
  sender receiver interface BswM_SRI_BswM_MSI_MDG_Sfd_NvmBlockStatus_BswM_MDGP_MDG_Sfd_NvmBlockStatus: is-service=true, service-kind=BASIC-SOFTWARE-MODE-MANAGER
    data requestedMode: type=BswM_MDG_Sfd_NvmBlockStatus
package /E40_Platform_System_SystemPackage/Types
  12 x client server interface:
    TI_Backlight_NotifyDispaly
      operation NotifyDisplayPowerState: possible-error=TI_Backlight_NotifyDispaly/E_NOT_OK
        arg DeviceId: type=EDisplayType, direction=IN, server-argument-impl-policy=USE-ARGUMENT-TYPE
        arg CompletedPowerState: type=EDisplayPowerState, direction=IN, server-argument-impl-policy=USE-ARGUMENT-TYPE
      error E_NOT_OK: error-code=1
    TI_Backlight_Status
      operation GetStatus: possible-error=TI_Backlight_Status/E_NOT_OK
        arg DeviceName: type=EDisplayType, direction=IN, server-argument-impl-policy=USE-ARGUMENT-TYPE
        arg DeviceStatus: type=EDeviceStatus, direction=OUT, server-argument-impl-policy=USE-ARGUMENT-TYPE
      error E_NOT_OK: error-code=1
    TI_Backlight_Service
      operation GetBrightnessValue: possible-error=TI_Backlight_Service/E_NOT_OK
        arg DeviceName: type=EDisplayType, direction=IN, server-argument-impl-policy=USE-ARGUMENT-TYPE
        arg BrightnessPercentValue: type=UInt16, direction=OUT, server-argument-impl-policy=USE-ARGUMENT-TYPE
      operation GetThermalValue: possible-error=TI_Backlight_Service/E_NOT_OK
        arg DeviceName: type=EDisplayType, direction=IN, server-argument-impl-policy=USE-ARGUMENT-TYPE
        arg TempValueInMilliCelsius: type=UInt32, direction=OUT, server-argument-impl-policy=USE-ARGUMENT-TYPE
      operation SetBrightnessValue: possible-error=TI_Backlight_Service/E_NOT_OK
        arg DeviceName: type=EDisplayType, direction=IN, server-argument-impl-policy=USE-ARGUMENT-TYPE
        arg BrightnessPercentValue: type=UInt16, direction=IN, server-argument-impl-policy=USE-ARGUMENT-TYPE
      error E_NOT_OK: error-code=1
    if_CS_ModeOnCommand
      operation Impl_OnCommand: possible-error=if_CS_ModeOnCommand/E_NOT_OK
        arg cmdP: type=ECmpCmd, direction=IN, server-argument-impl-policy=USE-ARGUMENT-TYPE
      error E_NOT_OK: error-code=1
    TI_IOHWAB_SetDout
      operation SetOutputGroup: possible-error=TI_IOHWAB_SetDout/E_NOT_OK
        arg InputId: type=IoHwAb_DOutGroupIdType, direction=IN, server-argument-impl-policy=USE-ARGUMENT-TYPE
        arg OutputGroup: type=UInt32, direction=IN, server-argument-impl-policy=USE-ARGUMENT-TYPE
        arg ErrorStatus: type=IoHwAb_ErrorType, direction=OUT, server-argument-impl-policy=USE-ARGUMENT-TYPE
      operation SetOutputPin: possible-error=TI_IOHWAB_SetDout/E_NOT_OK
        arg InputId: type=IoHwAb_DOutSignalIdType, direction=IN, server-argument-impl-policy=USE-ARGUMENT-TYPE
        arg OutputSignal: type=Boolean, direction=IN, server-argument-impl-policy=USE-ARGUMENT-TYPE
        arg ErrorStatus: type=IoHwAb_ErrorType, direction=OUT, server-argument-impl-policy=USE-ARGUMENT-TYPE
      error E_NOT_OK: error-code=1
    TI_IOHWAB_GetDIn
      4 x operation, all with possible-error=TI_IOHWAB_GetDIn/E_NOT_OK:
        GetAsyncRawInput
          arg InputId: type=IoHwAb_DInSignalIdType, direction=IN, server-argument-impl-policy=USE-ARGUMENT-TYPE
          arg AsyncInput: type=Boolean, direction=OUT, server-argument-impl-policy=USE-ARGUMENT-TYPE
          arg ErrorStatus: type=IoHwAb_ErrorType, direction=OUT, server-argument-impl-policy=USE-ARGUMENT-TYPE
        GetInputGroup
          arg InputId: type=IoHwAb_DInGroupIdType, direction=IN, server-argument-impl-policy=USE-ARGUMENT-TYPE
          arg SyncInput: type=UInt32, direction=OUT, server-argument-impl-policy=USE-ARGUMENT-TYPE
          arg ErrorStatus: type=IoHwAb_ErrorType, direction=OUT, server-argument-impl-policy=USE-ARGUMENT-TYPE
        GetProcessedInput
          arg InputId: type=IoHwAb_DInSignalIdType, direction=IN, server-argument-impl-policy=USE-ARGUMENT-TYPE
          arg InputSignal: type=Boolean, direction=OUT, server-argument-impl-policy=USE-ARGUMENT-TYPE
          arg ErrorStatus: type=IoHwAb_ErrorType, direction=OUT, server-argument-impl-policy=USE-ARGUMENT-TYPE
        GetSyncRawInput
          arg InputId: type=IoHwAb_DInSignalIdType, direction=IN, server-argument-impl-policy=USE-ARGUMENT-TYPE
          arg SyncInput: type=Boolean, direction=OUT, server-argument-impl-policy=USE-ARGUMENT-TYPE
          arg ErrorStatus: type=IoHwAb_ErrorType, direction=OUT, server-argument-impl-policy=USE-ARGUMENT-TYPE
      error E_NOT_OK: error-code=1
    TI_IOHWAB_PWM
      operation PwmSetDuty: possible-error=TI_IOHWAB_PWM/E_NOT_OK
        arg PwmId: type=IoHwAb_PwmSignalIdType, direction=IN, server-argument-impl-policy=USE-ARGUMENT-TYPE
        arg Pwm_Duty: type=UInt16, direction=IN, server-argument-impl-policy=USE-ARGUMENT-TYPE
        arg ErrorStatus: type=IoHwAb_ErrorType, direction=OUT, server-argument-impl-policy=USE-ARGUMENT-TYPE
      operation PwmSetDutyAndPeriod: possible-error=TI_IOHWAB_PWM/E_NOT_OK
        4 x arg, all with server-argument-impl-policy=USE-ARGUMENT-TYPE:
          PwmId: type=IoHwAb_PwmSignalIdType, direction=IN
          Pwm_Period: type=UInt32, direction=IN
          Pwm_Duty: type=UInt16, direction=IN
          ErrorStatus: type=IoHwAb_ErrorType, direction=OUT
      operation PwmSetIdeal: possible-error=TI_IOHWAB_PWM/E_NOT_OK
        arg PwmId: type=IoHwAb_PwmSignalIdType, direction=IN, server-argument-impl-policy=USE-ARGUMENT-TYPE
        arg ErrorStatus: type=IoHwAb_ErrorType, direction=OUT, server-argument-impl-policy=USE-ARGUMENT-TYPE
      error E_NOT_OK: error-code=1
    TI_IOHWAB_GetAdc
      operation GetAsyncRawAdc: possible-error=TI_IOHWAB_GetAdc/E_NOT_OK
        arg AdcId: type=IoHwAb_AdcSignalIdType, direction=IN, server-argument-impl-policy=USE-ARGUMENT-TYPE
        arg AsyncRawAdc: type=UInt16, direction=OUT, server-argument-impl-policy=USE-ARGUMENT-TYPE
        arg ErrorStatus: type=IoHwAb_ErrorType, direction=OUT, server-argument-impl-policy=USE-ARGUMENT-TYPE
      operation GetProcessedAdc: possible-error=TI_IOHWAB_GetAdc/E_NOT_OK
        arg AdcId: type=IoHwAb_AdcSignalIdType, direction=IN, server-argument-impl-policy=USE-ARGUMENT-TYPE
        arg ProcessedAdc: type=SInt32, direction=OUT, server-argument-impl-policy=USE-ARGUMENT-TYPE
        arg ErrorStatus: type=IoHwAb_ErrorType, direction=OUT, server-argument-impl-policy=USE-ARGUMENT-TYPE
      operation GetSyncRawAdc: possible-error=TI_IOHWAB_GetAdc/E_NOT_OK
        arg AdcId: type=IoHwAb_AdcSignalIdType, direction=IN, server-argument-impl-policy=USE-ARGUMENT-TYPE
        arg SyncRawAdc: type=UInt16, direction=OUT, server-argument-impl-policy=USE-ARGUMENT-TYPE
        arg ErrorStatus: type=IoHwAb_ErrorType, direction=OUT, server-argument-impl-policy=USE-ARGUMENT-TYPE
      error E_NOT_OK: error-code=1
    TI_IOHWAB_Pulse
      7 x operation, all with possible-error=TI_IOHWAB_Pulse/E_NOT_OK:
        GetCurrentSignalStatus_PulseInput
          arg PulseInputId: type=eIOPulseInputId, direction=IN, server-argument-impl-policy=USE-ARGUMENT-TYPE
          arg SignalStatus: type=UInt16, direction=OUT, server-argument-impl-policy=USE-ARGUMENT-TYPE
          arg ErrorStatus: type=IoHwAb_ErrorType, direction=OUT, server-argument-impl-policy=USE-ARGUMENT-TYPE
        GetCurrentSpeed_PulseInput
          arg PulseInputId: type=eIOPulseInputId, direction=IN, server-argument-impl-policy=USE-ARGUMENT-TYPE
          arg SpeedVal: type=UInt32, direction=OUT, server-argument-impl-policy=USE-ARGUMENT-TYPE
          arg ErrorStatus: type=IoHwAb_ErrorType, direction=OUT, server-argument-impl-policy=USE-ARGUMENT-TYPE
        GetRollingCount_PulseInput
          arg PulseInputId: type=eIOPulseInputId, direction=IN, server-argument-impl-policy=USE-ARGUMENT-TYPE
          arg EdgeCount: type=UInt8, direction=OUT, server-argument-impl-policy=USE-ARGUMENT-TYPE
          arg ErrorStatus: type=IoHwAb_ErrorType, direction=OUT, server-argument-impl-policy=USE-ARGUMENT-TYPE
        ResetRollingCount_PulseInput
          arg PulseInputId: type=eIOPulseInputId, direction=IN, server-argument-impl-policy=USE-ARGUMENT-TYPE
          arg ErrorStatus: type=IoHwAb_ErrorType, direction=OUT, server-argument-impl-policy=USE-ARGUMENT-TYPE
        Start_Signal_Measurement_PulseInput
          4 x arg, all with server-argument-impl-policy=USE-ARGUMENT-TYPE:
            PulseInputId: type=eIOPulseInputId, direction=IN
            PulseInputChnlCfgParam: type=SPulseInputConfigParam, direction=OUT
            SpdCalParam: type=SSpeedCalcParam, direction=OUT
            ErrorStatus: type=IoHwAb_ErrorType, direction=OUT
        Stop_Signal_Measurement_PulseInput
          arg PulseInputId: type=eIOPulseInputId, direction=IN, server-argument-impl-policy=USE-ARGUMENT-TYPE
          arg ErrorStatus: type=IoHwAb_ErrorType, direction=OUT, server-argument-impl-policy=USE-ARGUMENT-TYPE
        Update_CalibParam_PulseInput
          arg PulseInputId: type=eIOPulseInputId, direction=IN, server-argument-impl-policy=USE-ARGUMENT-TYPE
          arg SpdCalParam: type=SSpeedCalcParam, direction=OUT, server-argument-impl-policy=USE-ARGUMENT-TYPE
          arg ErrorStatus: type=IoHwAb_ErrorType, direction=OUT, server-argument-impl-policy=USE-ARGUMENT-TYPE
      error E_NOT_OK: error-code=1
    TI_Display_I2cSeqCallback
      operation I2cSeqEndCallback
    TI_Display_GammaCorrection
      operation GetGammaCorrectionStatus
        arg GmaCrStatus: type=EGammaCorrectionStatus, direction=OUT, server-argument-impl-policy=USE-ARGUMENT-TYPE
      operation SetGammaCorrection: possible-error=TI_Display_GammaCorrection/E_NOT_OK
        arg GmaSetPtr: type=UInt8, direction=OUT, server-argument-impl-policy=USE-ARGUMENT-TYPE
        arg datalength: type=UInt8, direction=IN, server-argument-impl-policy=USE-ARGUMENT-TYPE
      error E_NOT_OK: error-code=1
    TI_Display_Status
      operation GetStatus: possible-error=TI_Display_Status/E_NOT_OK
        arg DeviceId: type=EDisplayType, direction=IN, server-argument-impl-policy=USE-ARGUMENT-TYPE
        arg DeviceStatus: type=EDisplayCddStatus, direction=OUT, server-argument-impl-policy=USE-ARGUMENT-TYPE
        arg DisplayPowerState: type=EDisplayPowerState, direction=OUT, server-argument-impl-policy=USE-ARGUMENT-TYPE
      operation SetState: possible-error=TI_Display_Status/E_NOT_OK
        arg DeviceID: type=EDisplayType, direction=IN, server-argument-impl-policy=USE-ARGUMENT-TYPE
        arg PowerState: type=EDisplayPowerState, direction=IN, server-argument-impl-policy=USE-ARGUMENT-TYPE
      error E_NOT_OK: error-code=1
  sender receiver interface If_SR_SleepStatus
    data SleepManager_SleepStatus: type=UInt8
  7 x client server interface:
    if_CS_EcuAppM
      operation EcuAppM_SetWakeupSources
        arg WakeupSource: type=UInt32, direction=IN, server-argument-impl-policy=USE-ARGUMENT-TYPE
      operation Init
    TI_EcuMExt_ReleaseRUN
      operation ReleaseRUN: possible-error=TI_EcuMExt_ReleaseRUN/E_NOT_OK
        arg user: type=EcuM_UserType, direction=IN, server-argument-impl-policy=USE-ARGUMENT-TYPE
      error E_NOT_OK: error-code=1
    TI_EcuMExt_RequestRUN
      operation RequestRUN: possible-error=TI_EcuMExt_RequestRUN/E_NOT_OK
        arg user: type=EcuM_UserType, direction=IN, server-argument-impl-policy=USE-ARGUMENT-TYPE
      error E_NOT_OK: error-code=1
    if_CS_MemAbsGet
      94 x operation, all with possible-error=if_CS_MemAbsGet/E_NOT_OK:
        Get_BsConst_Audio_Element
          arg Ptr: type=Arr_u8_128, direction=OUT, server-argument-impl-policy=USE-ARGUMENT-TYPE
        Get_BsConst_Communication_Element
          arg Ptr: type=Arr_u8_64, direction=OUT, server-argument-impl-policy=USE-ARGUMENT-TYPE
        Get_BsConst_EngOffTimer_Element
          arg Ptr: type=Arr_u8_32, direction=OUT, server-argument-impl-policy=USE-ARGUMENT-TYPE
        Get_BsConst_FuelGauge_Element
          arg Ptr: type=Arr_u8_128, direction=OUT, server-argument-impl-policy=USE-ARGUMENT-TYPE
        Get_BsConst_OilGauge_Element
          arg Ptr: type=Arr_u8_64, direction=OUT, server-argument-impl-policy=USE-ARGUMENT-TYPE
        Get_BsConst_PowerGauge_Element
          arg Ptr: type=Arr_u8_64, direction=OUT, server-argument-impl-policy=USE-ARGUMENT-TYPE
        Get_BsConst_Power_Element
          arg Ptr: type=Arr_u8_32, direction=OUT, server-argument-impl-policy=USE-ARGUMENT-TYPE
        Get_BsConst_RealTimeClock_Element
          arg Ptr: type=Arr_u8_48, direction=OUT, server-argument-impl-policy=USE-ARGUMENT-TYPE
        Get_BsConst_ServiceReminder_Element
          arg Ptr: type=Arr_u8_48, direction=OUT, server-argument-impl-policy=USE-ARGUMENT-TYPE
        Get_BsConst_SpeedoGauge_Element
          arg Ptr: type=Arr_u8_64, direction=OUT, server-argument-impl-policy=USE-ARGUMENT-TYPE
        Get_BsConst_TachoGauge_Element
          arg Ptr: type=Arr_u8_64, direction=OUT, server-argument-impl-policy=USE-ARGUMENT-TYPE
        Get_BsConst_TempGauge_Element
          arg Ptr: type=Arr_u8_64, direction=OUT, server-argument-impl-policy=USE-ARGUMENT-TYPE
        Get_BsConst_TripComputer_Element
          arg Ptr: type=Arr_u8_64, direction=OUT, server-argument-impl-policy=USE-ARGUMENT-TYPE
        Get_BsConst_Warning_Element
          arg Ptr: type=Arr_u8_64, direction=OUT, server-argument-impl-policy=USE-ARGUMENT-TYPE
        Get_BsCys_Certicificate_Element
          arg Ptr: type=Arr_u8_64, direction=OUT, server-argument-impl-policy=USE-ARGUMENT-TYPE
        Get_BsDiag_Dtc_Element
          arg Ptr: type=Arr_u8_2048, direction=OUT, server-argument-impl-policy=USE-ARGUMENT-TYPE
        Get_BsDiag_ErrorRecord_Element
          arg Ptr: type=Arr_u8_1024, direction=OUT, server-argument-impl-policy=USE-ARGUMENT-TYPE
        Get_BsReten_Audio_Element
          arg Ptr: type=Arr_u8_100, direction=OUT, server-argument-impl-policy=USE-ARGUMENT-TYPE
        Get_BsReten_Communication_Element
          arg Ptr: type=Arr_u8_100, direction=OUT, server-argument-impl-policy=USE-ARGUMENT-TYPE
        Get_BsReten_Display_Element
          arg Ptr: type=Arr_u8_100, direction=OUT, server-argument-impl-policy=USE-ARGUMENT-TYPE
        Get_BsReten_Gauges_Element
          arg Ptr: type=Arr_u8_100, direction=OUT, server-argument-impl-policy=USE-ARGUMENT-TYPE
        Get_BsReten_Illumination_Element
          arg Ptr: type=Arr_u8_100, direction=OUT, server-argument-impl-policy=USE-ARGUMENT-TYPE
        Get_BsReten_Odometer_Element
          arg Ptr: type=Arr_u8_100, direction=OUT, server-argument-impl-policy=USE-ARGUMENT-TYPE
        Get_BsReten_Personalization_Element
          arg Ptr: type=Arr_u8_100, direction=OUT, server-argument-impl-policy=USE-ARGUMENT-TYPE
        Get_BsReten_Power_Element
          arg Ptr: type=Arr_u8_100, direction=OUT, server-argument-impl-policy=USE-ARGUMENT-TYPE
        Get_BsReten_RealTimeClock_Element
          arg Ptr: type=Arr_u8_100, direction=OUT, server-argument-impl-policy=USE-ARGUMENT-TYPE
        Get_BsReten_Tripcomputer_Element
          arg Ptr: type=Arr_u8_100, direction=OUT, server-argument-impl-policy=USE-ARGUMENT-TYPE
        Get_BsReten_Warning_Element
          arg Ptr: type=Arr_u8_100, direction=OUT, server-argument-impl-policy=USE-ARGUMENT-TYPE
        Get_BsRt_CusDlt_Element
          arg Ptr: type=Arr_u8_128, direction=OUT, server-argument-impl-policy=USE-ARGUMENT-TYPE
        Get_BsRt_FuelGauge_Element
          arg Ptr: type=Arr_u8_32, direction=OUT, server-argument-impl-policy=USE-ARGUMENT-TYPE
        Get_BsRt_Illumination_Element
          arg Ptr: type=Arr_u8_100, direction=OUT, server-argument-impl-policy=USE-ARGUMENT-TYPE
        Get_BsRt_Odometer_Element
          arg Ptr: type=Arr_u8_128, direction=OUT, server-argument-impl-policy=USE-ARGUMENT-TYPE
        Get_BsRt_OilGauge_Element
          arg Ptr: type=Arr_u8_8, direction=OUT, server-argument-impl-policy=USE-ARGUMENT-TYPE
        Get_BsRt_Personalization_Element
          arg Ptr: type=Arr_u8_128, direction=OUT, server-argument-impl-policy=USE-ARGUMENT-TYPE
        Get_BsRt_PowerGauge_Element
          arg Ptr: type=Arr_u8_32, direction=OUT, server-argument-impl-policy=USE-ARGUMENT-TYPE
        Get_BsRt_RealTimeClock_Element
          arg Ptr: type=Arr_u8_48, direction=OUT, server-argument-impl-policy=USE-ARGUMENT-TYPE
        Get_BsRt_SpeedoGauge_Element
          arg Ptr: type=Arr_u8_8, direction=OUT, server-argument-impl-policy=USE-ARGUMENT-TYPE
        Get_BsRt_TachoGauge_Element
          arg Ptr: type=Arr_u8_16, direction=OUT, server-argument-impl-policy=USE-ARGUMENT-TYPE
        Get_BsRt_TempGauge_Element
          arg Ptr: type=Arr_u8_32, direction=OUT, server-argument-impl-policy=USE-ARGUMENT-TYPE
        Get_BsRt_TripComputer_Element
          arg Ptr: type=Arr_u8_64, direction=OUT, server-argument-impl-policy=USE-ARGUMENT-TYPE
        Get_BsRt_Warning_Element
          arg Ptr: type=Arr_u8_32, direction=OUT, server-argument-impl-policy=USE-ARGUMENT-TYPE
        Get_BsShare_EcuPartNumber_Element
          arg Ptr: type=Arr_u8_61, direction=OUT, server-argument-impl-policy=USE-ARGUMENT-TYPE
        Get_BsShare_SwUpdFotaFinPrint_Element
          arg Ptr: type=Arr_u8_32, direction=OUT, server-argument-impl-policy=USE-ARGUMENT-TYPE
        Get_BsShare_SwUpdFotaMode_Element
          arg Ptr: type=Arr_u8_16, direction=OUT, server-argument-impl-policy=USE-ARGUMENT-TYPE
        Get_BsShare_SwUpdFotaStatus_Element
          arg Ptr: type=Arr_u8_48, direction=OUT, server-argument-impl-policy=USE-ARGUMENT-TYPE
        Get_BsShare_SwUpdFotadecrypt_Element
          arg Ptr: type=Arr_u8_64, direction=OUT, server-argument-impl-policy=USE-ARGUMENT-TYPE
        Get_BsShare_SwUpdReflash_Element
          arg Ptr: type=Arr_u8_8, direction=OUT, server-argument-impl-policy=USE-ARGUMENT-TYPE
        Get_BsShare_VehicleConfig_Element
          arg Ptr: type=Arr_u8_256, direction=OUT, server-argument-impl-policy=USE-ARGUMENT-TYPE
        Get_BsShare_VisMeet_Element
          arg Ptr: type=Arr_u8_46, direction=OUT, server-argument-impl-policy=USE-ARGUMENT-TYPE
        Get_RefCys_Certicificate1_Element
          arg Ptr: type=Arr_u8_64, direction=OUT, server-argument-impl-policy=USE-ARGUMENT-TYPE
        Get_RefCys_Certicificate_Element
          arg Ptr: type=Arr_u8_64, direction=OUT, server-argument-impl-policy=USE-ARGUMENT-TYPE
        Get_BsShare_VisMeet_EOLEntry_Element
          arg Ptr: type=UInt16, direction=OUT, server-argument-impl-policy=USE-ARGUMENT-TYPE
        Get_BsShare_AssemblyManufacturingDate
          arg Ptr: type=Arr_u8_3, direction=OUT, server-argument-impl-policy=USE-ARGUMENT-TYPE
        Get_BsShare_AssemblyPlantNumber
          arg Ptr: type=Arr_u8_3, direction=OUT, server-argument-impl-policy=USE-ARGUMENT-TYPE
        Get_BsShare_HWModification
          arg Ptr: type=UInt16, direction=OUT, server-argument-impl-policy=USE-ARGUMENT-TYPE
        Get_BsShare_PCBSerialNumber
          arg Ptr: type=Arr_u8_9, direction=OUT, server-argument-impl-policy=USE-ARGUMENT-TYPE
        Get_BsShare_ProductSerialNumber
          arg Ptr: type=Arr_u8_10, direction=OUT, server-argument-impl-policy=USE-ARGUMENT-TYPE
        Get_BsShare_SMTManufacturingDate
          arg Ptr: type=Arr_u8_3, direction=OUT, server-argument-impl-policy=USE-ARGUMENT-TYPE
        Get_BsShare_SMTPlantNumber
          arg Ptr: type=Arr_u8_3, direction=OUT, server-argument-impl-policy=USE-ARGUMENT-TYPE
        Get_BsShare_VisteonPCBPartNumber
          arg Ptr: type=Arr_u8_17, direction=OUT, server-argument-impl-policy=USE-ARGUMENT-TYPE
        Get_BsShare_VisteonPartNumber
          arg Ptr: type=Arr_u8_17, direction=OUT, server-argument-impl-policy=USE-ARGUMENT-TYPE
        Get_BsConst_BsConst_Illumination_ReservedByte
          arg Ptr: type=Arr_u8_28, direction=OUT, server-argument-impl-policy=USE-ARGUMENT-TYPE
        Get_BsConst_BsConst_Illumination_ReservedByte_SafeCopy1
          arg Ptr: type=Arr_u8_28, direction=OUT, server-argument-impl-policy=USE-ARGUMENT-TYPE
        Get_BsConst_BsConst_Illumination_ReservedByte_SafeCopy2
          arg Ptr: type=Arr_u8_28, direction=OUT, server-argument-impl-policy=USE-ARGUMENT-TYPE
        Get_BsConst_Compensation_Line_Shift_b
          arg Ptr: type=UInt32, direction=OUT, server-argument-impl-policy=USE-ARGUMENT-TYPE
        Get_BsConst_Compensation_Line_Shift_b_SafeCopy1
          arg Ptr: type=UInt32, direction=OUT, server-argument-impl-policy=USE-ARGUMENT-TYPE
        Get_BsConst_Compensation_Line_Shift_b_SafeCopy2
          arg Ptr: type=UInt32, direction=OUT, server-argument-impl-policy=USE-ARGUMENT-TYPE
        Get_BsConst_Compensation_Line_Slope_m
          arg Ptr: type=UInt32, direction=OUT, server-argument-impl-policy=USE-ARGUMENT-TYPE
        Get_BsConst_Compensation_Line_Slope_m_SafeCopy1
          arg Ptr: type=UInt32, direction=OUT, server-argument-impl-policy=USE-ARGUMENT-TYPE
        Get_BsConst_Compensation_Line_Slope_m_SafeCopy2
          arg Ptr: type=UInt32, direction=OUT, server-argument-impl-policy=USE-ARGUMENT-TYPE
        Get_BsConst_Derating_Backlight_Disable
          arg Ptr: type=UInt8, direction=OUT, server-argument-impl-policy=USE-ARGUMENT-TYPE
        Get_BsConst_Derating_Backlight_Disable_SafeCopy1
          arg Ptr: type=UInt8, direction=OUT, server-argument-impl-policy=USE-ARGUMENT-TYPE
        Get_BsConst_Derating_Backlight_Disable_SafeCopy2
          arg Ptr: type=UInt8, direction=OUT, server-argument-impl-policy=USE-ARGUMENT-TYPE
        Get_BsConst_Display_Illum_Max_Level
          arg Ptr: type=UInt16, direction=OUT, server-argument-impl-policy=USE-ARGUMENT-TYPE
        Get_BsConst_Display_Illum_Max_Level_SafeCopy1
          arg Ptr: type=UInt16, direction=OUT, server-argument-impl-policy=USE-ARGUMENT-TYPE
        Get_BsConst_Display_Illum_Max_Level_SafeCopy2
          arg Ptr: type=UInt16, direction=OUT, server-argument-impl-policy=USE-ARGUMENT-TYPE
        Get_BsConst_Lookup_Curve_HotSpot_Coef_X
          arg Ptr: type=Arr_u16_7, direction=OUT, server-argument-impl-policy=USE-ARGUMENT-TYPE
        Get_BsConst_Lookup_Curve_HotSpot_Coef_X_SafeCopy1
          arg Ptr: type=Arr_u16_7, direction=OUT, server-argument-impl-policy=USE-ARGUMENT-TYPE
        Get_BsConst_Lookup_Curve_HotSpot_Coef_X_SafeCopy2
          arg Ptr: type=Arr_u16_7, direction=OUT, server-argument-impl-policy=USE-ARGUMENT-TYPE
        Get_BsConst_Lookup_Curve_HotSpot_Coef_Y
          arg Ptr: type=Arr_u16_7, direction=OUT, server-argument-impl-policy=USE-ARGUMENT-TYPE
        Get_BsConst_Lookup_Curve_HotSpot_Coef_Y_SafeCopy1
          arg Ptr: type=Arr_u16_7, direction=OUT, server-argument-impl-policy=USE-ARGUMENT-TYPE
        Get_BsConst_Lookup_Curve_HotSpot_Coef_Y_SafeCopy2
          arg Ptr: type=Arr_u16_7, direction=OUT, server-argument-impl-policy=USE-ARGUMENT-TYPE
        Get_BsConst_PCB_Temperature_Sensor_Conv
          arg Ptr: type=T_NV_Temperature_Conversion, direction=OUT, server-argument-impl-policy=USE-ARGUMENT-TYPE
        Get_BsConst_PCB_Temperature_Sensor_Conv_SafeCopy1
          arg Ptr: type=T_NV_Temperature_Conversion, direction=OUT, server-argument-impl-policy=USE-ARGUMENT-TYPE
        Get_BsConst_PCB_Temperature_Sensor_Conv_SafeCopy2
          arg Ptr: type=T_NV_Temperature_Conversion, direction=OUT, server-argument-impl-policy=USE-ARGUMENT-TYPE
        Get_BsConst_PWM_boost_bypass_duty
          arg Ptr: type=UInt8, direction=OUT, server-argument-impl-policy=USE-ARGUMENT-TYPE
        Get_BsConst_PWM_boost_bypass_duty_SafeCopy1
          arg Ptr: type=UInt8, direction=OUT, server-argument-impl-policy=USE-ARGUMENT-TYPE
        Get_BsConst_PWM_boost_bypass_duty_SafeCopy2
          arg Ptr: type=UInt8, direction=OUT, server-argument-impl-policy=USE-ARGUMENT-TYPE
        Get_BsConst_Temp_Threshold_Hysteresis_Derating
          arg Ptr: type=UInt8, direction=OUT, server-argument-impl-policy=USE-ARGUMENT-TYPE
        Get_BsConst_Temp_Threshold_Hysteresis_Derating_SafeCopy1
          arg Ptr: type=UInt8, direction=OUT, server-argument-impl-policy=USE-ARGUMENT-TYPE
        Get_BsConst_Temp_Threshold_Hysteresis_Derating_SafeCopy2
          arg Ptr: type=UInt8, direction=OUT, server-argument-impl-policy=USE-ARGUMENT-TYPE
        Get_BsConst_Temperature_Sensor_Conv
          arg Ptr: type=T_NV_Temperature_Conversion, direction=OUT, server-argument-impl-policy=USE-ARGUMENT-TYPE
        Get_BsConst_Temperature_Sensor_Conv_SafeCopy1
          arg Ptr: type=T_NV_Temperature_Conversion, direction=OUT, server-argument-impl-policy=USE-ARGUMENT-TYPE
        Get_BsConst_Temperature_Sensor_Conv_SafeCopy2
          arg Ptr: type=T_NV_Temperature_Conversion, direction=OUT, server-argument-impl-policy=USE-ARGUMENT-TYPE
      error E_NOT_OK: error-code=1
    if_CS_MemAbsGetDefault
      94 x operation, all with possible-error=if_CS_MemAbsGetDefault/E_NOT_OK:
        Get_Default_BsConst_Audio_Element
          arg Ptr: type=Arr_u8_128, direction=OUT, server-argument-impl-policy=USE-ARGUMENT-TYPE
        Get_Default_BsConst_Communication_Element
          arg Ptr: type=Arr_u8_64, direction=OUT, server-argument-impl-policy=USE-ARGUMENT-TYPE
        Get_Default_BsConst_EngOffTimer_Element
          arg Ptr: type=Arr_u8_32, direction=OUT, server-argument-impl-policy=USE-ARGUMENT-TYPE
        Get_Default_BsConst_FuelGauge_Element
          arg Ptr: type=Arr_u8_128, direction=OUT, server-argument-impl-policy=USE-ARGUMENT-TYPE
        Get_Default_BsConst_OilGauge_Element
          arg Ptr: type=Arr_u8_64, direction=OUT, server-argument-impl-policy=USE-ARGUMENT-TYPE
        Get_Default_BsConst_PowerGauge_Element
          arg Ptr: type=Arr_u8_64, direction=OUT, server-argument-impl-policy=USE-ARGUMENT-TYPE
        Get_Default_BsConst_Power_Element
          arg Ptr: type=Arr_u8_32, direction=OUT, server-argument-impl-policy=USE-ARGUMENT-TYPE
        Get_Default_BsConst_RealTimeClock_Element
          arg Ptr: type=Arr_u8_48, direction=OUT, server-argument-impl-policy=USE-ARGUMENT-TYPE
        Get_Default_BsConst_ServiceReminder_Element
          arg Ptr: type=Arr_u8_48, direction=OUT, server-argument-impl-policy=USE-ARGUMENT-TYPE
        Get_Default_BsConst_SpeedoGauge_Element
          arg Ptr: type=Arr_u8_64, direction=OUT, server-argument-impl-policy=USE-ARGUMENT-TYPE
        Get_Default_BsConst_TachoGauge_Element
          arg Ptr: type=Arr_u8_64, direction=OUT, server-argument-impl-policy=USE-ARGUMENT-TYPE
        Get_Default_BsConst_TempGauge_Element
          arg Ptr: type=Arr_u8_64, direction=OUT, server-argument-impl-policy=USE-ARGUMENT-TYPE
        Get_Default_BsConst_TripComputer_Element
          arg Ptr: type=Arr_u8_64, direction=OUT, server-argument-impl-policy=USE-ARGUMENT-TYPE
        Get_Default_BsConst_Warning_Element
          arg Ptr: type=Arr_u8_64, direction=OUT, server-argument-impl-policy=USE-ARGUMENT-TYPE
        Get_Default_BsCys_Certicificate_Element
          arg Ptr: type=Arr_u8_64, direction=OUT, server-argument-impl-policy=USE-ARGUMENT-TYPE
        Get_Default_BsDiag_Dtc_Element
          arg Ptr: type=Arr_u8_2048, direction=OUT, server-argument-impl-policy=USE-ARGUMENT-TYPE
        Get_Default_BsDiag_ErrorRecord_Element
          arg Ptr: type=Arr_u8_1024, direction=OUT, server-argument-impl-policy=USE-ARGUMENT-TYPE
        Get_Default_BsReten_Audio_Element
          arg Ptr: type=Arr_u8_100, direction=OUT, server-argument-impl-policy=USE-ARGUMENT-TYPE
        Get_Default_BsReten_Communication_Element
          arg Ptr: type=Arr_u8_100, direction=OUT, server-argument-impl-policy=USE-ARGUMENT-TYPE
        Get_Default_BsReten_Display_Element
          arg Ptr: type=Arr_u8_100, direction=OUT, server-argument-impl-policy=USE-ARGUMENT-TYPE
        Get_Default_BsReten_Gauges_Element
          arg Ptr: type=Arr_u8_100, direction=OUT, server-argument-impl-policy=USE-ARGUMENT-TYPE
        Get_Default_BsReten_Illumination_Element
          arg Ptr: type=Arr_u8_100, direction=OUT, server-argument-impl-policy=USE-ARGUMENT-TYPE
        Get_Default_BsReten_Odometer_Element
          arg Ptr: type=Arr_u8_100, direction=OUT, server-argument-impl-policy=USE-ARGUMENT-TYPE
        Get_Default_BsReten_Personalization_Element
          arg Ptr: type=Arr_u8_100, direction=OUT, server-argument-impl-policy=USE-ARGUMENT-TYPE
        Get_Default_BsReten_Power_Element
          arg Ptr: type=Arr_u8_100, direction=OUT, server-argument-impl-policy=USE-ARGUMENT-TYPE
        Get_Default_BsReten_RealTimeClock_Element
          arg Ptr: type=Arr_u8_100, direction=OUT, server-argument-impl-policy=USE-ARGUMENT-TYPE
        Get_Default_BsReten_Tripcomputer_Element
          arg Ptr: type=Arr_u8_100, direction=OUT, server-argument-impl-policy=USE-ARGUMENT-TYPE
        Get_Default_BsReten_Warning_Element
          arg Ptr: type=Arr_u8_100, direction=OUT, server-argument-impl-policy=USE-ARGUMENT-TYPE
        Get_Default_BsRt_CusDlt_Element
          arg Ptr: type=Arr_u8_128, direction=OUT, server-argument-impl-policy=USE-ARGUMENT-TYPE
        Get_Default_BsRt_FuelGauge_Element
          arg Ptr: type=Arr_u8_32, direction=OUT, server-argument-impl-policy=USE-ARGUMENT-TYPE
        Get_Default_BsRt_Illumination_Element
          arg Ptr: type=Arr_u8_100, direction=OUT, server-argument-impl-policy=USE-ARGUMENT-TYPE
        Get_Default_BsRt_Odometer_Element
          arg Ptr: type=Arr_u8_128, direction=OUT, server-argument-impl-policy=USE-ARGUMENT-TYPE
        Get_Default_BsRt_OilGauge_Element
          arg Ptr: type=Arr_u8_8, direction=OUT, server-argument-impl-policy=USE-ARGUMENT-TYPE
        Get_Default_BsRt_Personalization_Element
          arg Ptr: type=Arr_u8_128, direction=OUT, server-argument-impl-policy=USE-ARGUMENT-TYPE
        Get_Default_BsRt_PowerGauge_Element
          arg Ptr: type=Arr_u8_32, direction=OUT, server-argument-impl-policy=USE-ARGUMENT-TYPE
        Get_Default_BsRt_RealTimeClock_Element
          arg Ptr: type=Arr_u8_48, direction=OUT, server-argument-impl-policy=USE-ARGUMENT-TYPE
        Get_Default_BsRt_SpeedoGauge_Element
          arg Ptr: type=Arr_u8_8, direction=OUT, server-argument-impl-policy=USE-ARGUMENT-TYPE
        Get_Default_BsRt_TachoGauge_Element
          arg Ptr: type=Arr_u8_16, direction=OUT, server-argument-impl-policy=USE-ARGUMENT-TYPE
        Get_Default_BsRt_TempGauge_Element
          arg Ptr: type=Arr_u8_32, direction=OUT, server-argument-impl-policy=USE-ARGUMENT-TYPE
        Get_Default_BsRt_TripComputer_Element
          arg Ptr: type=Arr_u8_64, direction=OUT, server-argument-impl-policy=USE-ARGUMENT-TYPE
        Get_Default_BsRt_Warning_Element
          arg Ptr: type=Arr_u8_32, direction=OUT, server-argument-impl-policy=USE-ARGUMENT-TYPE
        Get_Default_BsShare_EcuPartNumber_Element
          arg Ptr: type=Arr_u8_61, direction=OUT, server-argument-impl-policy=USE-ARGUMENT-TYPE
        Get_Default_BsShare_SwUpdFotaFinPrint_Element
          arg Ptr: type=Arr_u8_32, direction=OUT, server-argument-impl-policy=USE-ARGUMENT-TYPE
        Get_Default_BsShare_SwUpdFotaMode_Element
          arg Ptr: type=Arr_u8_16, direction=OUT, server-argument-impl-policy=USE-ARGUMENT-TYPE
        Get_Default_BsShare_SwUpdFotaStatus_Element
          arg Ptr: type=Arr_u8_48, direction=OUT, server-argument-impl-policy=USE-ARGUMENT-TYPE
        Get_Default_BsShare_SwUpdFotadecrypt_Element
          arg Ptr: type=Arr_u8_64, direction=OUT, server-argument-impl-policy=USE-ARGUMENT-TYPE
        Get_Default_BsShare_SwUpdReflash_Element
          arg Ptr: type=Arr_u8_8, direction=OUT, server-argument-impl-policy=USE-ARGUMENT-TYPE
        Get_Default_BsShare_VehicleConfig_Element
          arg Ptr: type=Arr_u8_256, direction=OUT, server-argument-impl-policy=USE-ARGUMENT-TYPE
        Get_Default_BsShare_VisMeet_EOLEntry_Element
          arg Ptr: type=UInt16, direction=OUT, server-argument-impl-policy=USE-ARGUMENT-TYPE
        Get_Default_BsShare_VisMeet_Element
          arg Ptr: type=Arr_u8_46, direction=OUT, server-argument-impl-policy=USE-ARGUMENT-TYPE
        Get_Default_RefCys_Certicificate1_Element
          arg Ptr: type=Arr_u8_64, direction=OUT, server-argument-impl-policy=USE-ARGUMENT-TYPE
        Get_Default_RefCys_Certicificate_Element
          arg Ptr: type=Arr_u8_64, direction=OUT, server-argument-impl-policy=USE-ARGUMENT-TYPE
        Get_Default_BsShare_AssemblyManufacturingDate
          arg Ptr: type=Arr_u8_3, direction=OUT, server-argument-impl-policy=USE-ARGUMENT-TYPE
        Get_Default_BsShare_AssemblyPlantNumber
          arg Ptr: type=Arr_u8_3, direction=OUT, server-argument-impl-policy=USE-ARGUMENT-TYPE
        Get_Default_BsShare_HWModification
          arg Ptr: type=UInt16, direction=OUT, server-argument-impl-policy=USE-ARGUMENT-TYPE
        Get_Default_BsShare_PCBSerialNumber
          arg Ptr: type=Arr_u8_9, direction=OUT, server-argument-impl-policy=USE-ARGUMENT-TYPE
        Get_Default_BsShare_ProductSerialNumber
          arg Ptr: type=Arr_u8_10, direction=OUT, server-argument-impl-policy=USE-ARGUMENT-TYPE
        Get_Default_BsShare_SMTManufacturingDate
          arg Ptr: type=Arr_u8_3, direction=OUT, server-argument-impl-policy=USE-ARGUMENT-TYPE
        Get_Default_BsShare_SMTPlantNumber
          arg Ptr: type=Arr_u8_3, direction=OUT, server-argument-impl-policy=USE-ARGUMENT-TYPE
        Get_Default_BsShare_VisteonPCBPartNumber
          arg Ptr: type=Arr_u8_17, direction=OUT, server-argument-impl-policy=USE-ARGUMENT-TYPE
        Get_Default_BsShare_VisteonPartNumber
          arg Ptr: type=Arr_u8_17, direction=OUT, server-argument-impl-policy=USE-ARGUMENT-TYPE
        Get_Default_BsConst_BsConst_Illumination_ReservedByte
          arg Ptr: type=Arr_u8_28, direction=OUT, server-argument-impl-policy=USE-ARGUMENT-TYPE
        Get_Default_BsConst_BsConst_Illumination_ReservedByte_SafeCopy1
          arg Ptr: type=Arr_u8_28, direction=OUT, server-argument-impl-policy=USE-ARGUMENT-TYPE
        Get_Default_BsConst_BsConst_Illumination_ReservedByte_SafeCopy2
          arg Ptr: type=Arr_u8_28, direction=OUT, server-argument-impl-policy=USE-ARGUMENT-TYPE
        Get_Default_BsConst_Compensation_Line_Shift_b
          arg Ptr: type=UInt32, direction=OUT, server-argument-impl-policy=USE-ARGUMENT-TYPE
        Get_Default_BsConst_Compensation_Line_Shift_b_SafeCopy1
          arg Ptr: type=UInt32, direction=OUT, server-argument-impl-policy=USE-ARGUMENT-TYPE
        Get_Default_BsConst_Compensation_Line_Shift_b_SafeCopy2
          arg Ptr: type=UInt32, direction=OUT, server-argument-impl-policy=USE-ARGUMENT-TYPE
        Get_Default_BsConst_Compensation_Line_Slope_m
          arg Ptr: type=UInt32, direction=OUT, server-argument-impl-policy=USE-ARGUMENT-TYPE
        Get_Default_BsConst_Compensation_Line_Slope_m_SafeCopy1
          arg Ptr: type=UInt32, direction=OUT, server-argument-impl-policy=USE-ARGUMENT-TYPE
        Get_Default_BsConst_Compensation_Line_Slope_m_SafeCopy2
          arg Ptr: type=UInt32, direction=OUT, server-argument-impl-policy=USE-ARGUMENT-TYPE
        Get_Default_BsConst_Derating_Backlight_Disable
          arg Ptr: type=UInt8, direction=OUT, server-argument-impl-policy=USE-ARGUMENT-TYPE
        Get_Default_BsConst_Derating_Backlight_Disable_SafeCopy1
          arg Ptr: type=UInt8, direction=OUT, server-argument-impl-policy=USE-ARGUMENT-TYPE
        Get_Default_BsConst_Derating_Backlight_Disable_SafeCopy2
          arg Ptr: type=UInt8, direction=OUT, server-argument-impl-policy=USE-ARGUMENT-TYPE
        Get_Default_BsConst_Display_Illum_Max_Level
          arg Ptr: type=UInt16, direction=OUT, server-argument-impl-policy=USE-ARGUMENT-TYPE
        Get_Default_BsConst_Display_Illum_Max_Level_SafeCopy1
          arg Ptr: type=UInt16, direction=OUT, server-argument-impl-policy=USE-ARGUMENT-TYPE
        Get_Default_BsConst_Display_Illum_Max_Level_SafeCopy2
          arg Ptr: type=UInt16, direction=OUT, server-argument-impl-policy=USE-ARGUMENT-TYPE
        Get_Default_BsConst_Lookup_Curve_HotSpot_Coef_X
          arg Ptr: type=Arr_u16_7, direction=OUT, server-argument-impl-policy=USE-ARGUMENT-TYPE
        Get_Default_BsConst_Lookup_Curve_HotSpot_Coef_X_SafeCopy1
          arg Ptr: type=Arr_u16_7, direction=OUT, server-argument-impl-policy=USE-ARGUMENT-TYPE
        Get_Default_BsConst_Lookup_Curve_HotSpot_Coef_X_SafeCopy2
          arg Ptr: type=Arr_u16_7, direction=OUT, server-argument-impl-policy=USE-ARGUMENT-TYPE
        Get_Default_BsConst_Lookup_Curve_HotSpot_Coef_Y
          arg Ptr: type=Arr_u16_7, direction=OUT, server-argument-impl-policy=USE-ARGUMENT-TYPE
        Get_Default_BsConst_Lookup_Curve_HotSpot_Coef_Y_SafeCopy1
          arg Ptr: type=Arr_u16_7, direction=OUT, server-argument-impl-policy=USE-ARGUMENT-TYPE
        Get_Default_BsConst_Lookup_Curve_HotSpot_Coef_Y_SafeCopy2
          arg Ptr: type=Arr_u16_7, direction=OUT, server-argument-impl-policy=USE-ARGUMENT-TYPE
        Get_Default_BsConst_PCB_Temperature_Sensor_Conv
          arg Ptr: type=T_NV_Temperature_Conversion, direction=OUT, server-argument-impl-policy=USE-ARGUMENT-TYPE
        Get_Default_BsConst_PCB_Temperature_Sensor_Conv_SafeCopy1
          arg Ptr: type=T_NV_Temperature_Conversion, direction=OUT, server-argument-impl-policy=USE-ARGUMENT-TYPE
        Get_Default_BsConst_PCB_Temperature_Sensor_Conv_SafeCopy2
          arg Ptr: type=T_NV_Temperature_Conversion, direction=OUT, server-argument-impl-policy=USE-ARGUMENT-TYPE
        Get_Default_BsConst_PWM_boost_bypass_duty
          arg Ptr: type=UInt8, direction=OUT, server-argument-impl-policy=USE-ARGUMENT-TYPE
        Get_Default_BsConst_PWM_boost_bypass_duty_SafeCopy1
          arg Ptr: type=UInt8, direction=OUT, server-argument-impl-policy=USE-ARGUMENT-TYPE
        Get_Default_BsConst_PWM_boost_bypass_duty_SafeCopy2
          arg Ptr: type=UInt8, direction=OUT, server-argument-impl-policy=USE-ARGUMENT-TYPE
        Get_Default_BsConst_Temp_Threshold_Hysteresis_Derating
          arg Ptr: type=UInt8, direction=OUT, server-argument-impl-policy=USE-ARGUMENT-TYPE
        Get_Default_BsConst_Temp_Threshold_Hysteresis_Derating_SafeCopy1
          arg Ptr: type=UInt8, direction=OUT, server-argument-impl-policy=USE-ARGUMENT-TYPE
        Get_Default_BsConst_Temp_Threshold_Hysteresis_Derating_SafeCopy2
          arg Ptr: type=UInt8, direction=OUT, server-argument-impl-policy=USE-ARGUMENT-TYPE
        Get_Default_BsConst_Temperature_Sensor_Conv
          arg Ptr: type=T_NV_Temperature_Conversion, direction=OUT, server-argument-impl-policy=USE-ARGUMENT-TYPE
        Get_Default_BsConst_Temperature_Sensor_Conv_SafeCopy1
          arg Ptr: type=T_NV_Temperature_Conversion, direction=OUT, server-argument-impl-policy=USE-ARGUMENT-TYPE
        Get_Default_BsConst_Temperature_Sensor_Conv_SafeCopy2
          arg Ptr: type=T_NV_Temperature_Conversion, direction=OUT, server-argument-impl-policy=USE-ARGUMENT-TYPE
      error E_NOT_OK: error-code=1
    if_CS_MemAbsSet
      94 x operation:
        Set_BsConst_Audio_Element
          arg BsConst_Audio_Element: type=Arr_u8_128, direction=IN, server-argument-impl-policy=USE-ARGUMENT-TYPE
        Set_BsConst_Communication_Element
          arg BsConst_Communication_Element: type=Arr_u8_64, direction=IN, server-argument-impl-policy=USE-ARGUMENT-TYPE
        Set_BsConst_EngOffTimer_Element
          arg BsConst_EngOffTimer_Element: type=Arr_u8_32, direction=IN, server-argument-impl-policy=USE-ARGUMENT-TYPE
        Set_BsConst_FuelGauge_Element
          arg BsConst_FuelGauge_Element: type=Arr_u8_128, direction=IN, server-argument-impl-policy=USE-ARGUMENT-TYPE
        Set_BsConst_OilGauge_Element
          arg BsConst_OilGauge_Element: type=Arr_u8_64, direction=IN, server-argument-impl-policy=USE-ARGUMENT-TYPE
        Set_BsConst_PowerGauge_Element
          arg BsConst_PowerGauge_Element: type=Arr_u8_64, direction=IN, server-argument-impl-policy=USE-ARGUMENT-TYPE
        Set_BsConst_Power_Element
          arg BsConst_Power_Element: type=Arr_u8_32, direction=IN, server-argument-impl-policy=USE-ARGUMENT-TYPE
        Set_BsConst_RealTimeClock_Element
          arg BsConst_RealTimeClock_Element: type=Arr_u8_48, direction=IN, server-argument-impl-policy=USE-ARGUMENT-TYPE
        Set_BsConst_ServiceReminder_Element
          arg BsConst_ServiceReminder_Element: type=Arr_u8_48, direction=IN, server-argument-impl-policy=USE-ARGUMENT-TYPE
        Set_BsConst_SpeedoGauge_Element
          arg BsConst_SpeedoGauge_Element: type=Arr_u8_64, direction=IN, server-argument-impl-policy=USE-ARGUMENT-TYPE
        Set_BsConst_TachoGauge_Element
          arg BsConst_TachoGauge_Element: type=Arr_u8_64, direction=IN, server-argument-impl-policy=USE-ARGUMENT-TYPE
        Set_BsConst_TempGauge_Element
          arg BsConst_TempGauge_Element: type=Arr_u8_64, direction=IN, server-argument-impl-policy=USE-ARGUMENT-TYPE
        Set_BsConst_TripComputer_Element
          arg BsConst_TripComputer_Element: type=Arr_u8_64, direction=IN, server-argument-impl-policy=USE-ARGUMENT-TYPE
        Set_BsConst_Warning_Element
          arg BsConst_Warning_Element: type=Arr_u8_64, direction=IN, server-argument-impl-policy=USE-ARGUMENT-TYPE
        Set_BsCys_Certicificate_Element
          arg BsCys_Certicificate_Element: type=Arr_u8_64, direction=IN, server-argument-impl-policy=USE-ARGUMENT-TYPE
        Set_BsDiag_Dtc_Element
          arg BsDiag_Dtc_Element: type=Arr_u8_2048, direction=IN, server-argument-impl-policy=USE-ARGUMENT-TYPE
        Set_BsDiag_ErrorRecord_Element
          arg BsDiag_ErrorRecord_Element: type=Arr_u8_1024, direction=IN, server-argument-impl-policy=USE-ARGUMENT-TYPE
        Set_BsReten_Audio_Element
          arg BsReten_Audio_Element: type=Arr_u8_100, direction=IN, server-argument-impl-policy=USE-ARGUMENT-TYPE
        Set_BsReten_Communication_Element
          arg BsReten_Communication_Element: type=Arr_u8_100, direction=IN, server-argument-impl-policy=USE-ARGUMENT-TYPE
        Set_BsReten_Display_Element
          arg BsReten_Display_Element: type=Arr_u8_100, direction=IN, server-argument-impl-policy=USE-ARGUMENT-TYPE
        Set_BsReten_Gauges_Element
          arg BsReten_Gauges_Element: type=Arr_u8_100, direction=IN, server-argument-impl-policy=USE-ARGUMENT-TYPE
        Set_BsReten_Illumination_Element
          arg BsReten_Illumination_Element: type=Arr_u8_100, direction=IN, server-argument-impl-policy=USE-ARGUMENT-TYPE
        Set_BsReten_Odometer_Element
          arg BsReten_Odometer_Element: type=Arr_u8_100, direction=IN, server-argument-impl-policy=USE-ARGUMENT-TYPE
        Set_BsReten_Personalization_Element
          arg BsReten_Personalization_Element: type=Arr_u8_100, direction=IN, server-argument-impl-policy=USE-ARGUMENT-TYPE
        Set_BsReten_Power_Element
          arg BsReten_Power_Element: type=Arr_u8_100, direction=IN, server-argument-impl-policy=USE-ARGUMENT-TYPE
        Set_BsReten_RealTimeClock_Element
          arg BsReten_RealTimeClock_Element: type=Arr_u8_100, direction=IN, server-argument-impl-policy=USE-ARGUMENT-TYPE
        Set_BsReten_Tripcomputer_Element
          arg BsReten_Tripcomputer_Element: type=Arr_u8_100, direction=IN, server-argument-impl-policy=USE-ARGUMENT-TYPE
        Set_BsReten_Warning_Element
          arg BsReten_Warning_Element: type=Arr_u8_100, direction=IN, server-argument-impl-policy=USE-ARGUMENT-TYPE
        Set_BsRt_CusDlt_Element
          arg BsRt_CusDlt_Element: type=Arr_u8_128, direction=IN, server-argument-impl-policy=USE-ARGUMENT-TYPE
        Set_BsRt_FuelGauge_Element
          arg BsRt_FuelGauge_Element: type=Arr_u8_32, direction=IN, server-argument-impl-policy=USE-ARGUMENT-TYPE
        Set_BsRt_Illumination_Element
          arg BsRt_Illumination_Element: type=Arr_u8_100, direction=IN, server-argument-impl-policy=USE-ARGUMENT-TYPE
        Set_BsRt_Odometer_Element
          arg BsRt_Odometer_Element: type=Arr_u8_128, direction=IN, server-argument-impl-policy=USE-ARGUMENT-TYPE
        Set_BsRt_OilGauge_Element
          arg BsRt_OilGauge_Element: type=Arr_u8_8, direction=IN, server-argument-impl-policy=USE-ARGUMENT-TYPE
        Set_BsRt_Personalization_Element
          arg BsRt_Personalization_Element: type=Arr_u8_128, direction=IN, server-argument-impl-policy=USE-ARGUMENT-TYPE
        Set_BsRt_PowerGauge_Element
          arg BsRt_PowerGauge_Element: type=Arr_u8_32, direction=IN, server-argument-impl-policy=USE-ARGUMENT-TYPE
        Set_BsRt_RealTimeClock_Element
          arg BsRt_RealTimeClock_Element: type=Arr_u8_48, direction=IN, server-argument-impl-policy=USE-ARGUMENT-TYPE
        Set_BsRt_SpeedoGauge_Element
          arg BsRt_SpeedoGauge_Element: type=Arr_u8_8, direction=IN, server-argument-impl-policy=USE-ARGUMENT-TYPE
        Set_BsRt_TachoGauge_Element
          arg BsRt_TachoGauge_Element: type=Arr_u8_16, direction=IN, server-argument-impl-policy=USE-ARGUMENT-TYPE
        Set_BsRt_TempGauge_Element
          arg BsRt_TempGauge_Element: type=Arr_u8_32, direction=IN, server-argument-impl-policy=USE-ARGUMENT-TYPE
        Set_BsRt_TripComputer_Element
          arg BsRt_TripComputer_Element: type=Arr_u8_64, direction=IN, server-argument-impl-policy=USE-ARGUMENT-TYPE
        Set_BsRt_Warning_Element
          arg BsRt_Warning_Element: type=Arr_u8_32, direction=IN, server-argument-impl-policy=USE-ARGUMENT-TYPE
        Set_BsShare_EcuPartNumber_Element
          arg BsShare_EcuPartNumber_Element: type=Arr_u8_61, direction=IN, server-argument-impl-policy=USE-ARGUMENT-TYPE
        Set_BsShare_SwUpdFotaFinPrint_Element
          arg BsShare_SwUpdFotaFinPrint_Element: type=Arr_u8_32, direction=IN, server-argument-impl-policy=USE-ARGUMENT-TYPE
        Set_BsShare_SwUpdFotaMode_Element
          arg BsShare_SwUpdFotaMode_Element: type=Arr_u8_16, direction=IN, server-argument-impl-policy=USE-ARGUMENT-TYPE
        Set_BsShare_SwUpdFotaStatus_Element
          arg BsShare_SwUpdFotaStatus_Element: type=Arr_u8_48, direction=IN, server-argument-impl-policy=USE-ARGUMENT-TYPE
        Set_BsShare_SwUpdFotadecrypt_Element
          arg BsShare_SwUpdFotadecrypt_Element: type=Arr_u8_64, direction=IN, server-argument-impl-policy=USE-ARGUMENT-TYPE
        Set_BsShare_SwUpdReflash_Element
          arg BsShare_SwUpdReflash_Element: type=Arr_u8_8, direction=IN, server-argument-impl-policy=USE-ARGUMENT-TYPE
        Set_BsShare_VehicleConfig_Element
          arg BsShare_VehicleConfig_Element: type=Arr_u8_256, direction=IN, server-argument-impl-policy=USE-ARGUMENT-TYPE
        Set_BsShare_VisMeet_Element
          arg BsShare_VisMeet_Element: type=Arr_u8_46, direction=IN, server-argument-impl-policy=USE-ARGUMENT-TYPE
        Set_RefCys_Certicificate1_Element
          arg RefCys_Certicificate1_Element: type=Arr_u8_64, direction=IN, server-argument-impl-policy=USE-ARGUMENT-TYPE
        Set_RefCys_Certicificate_Element
          arg RefCys_Certicificate_Element: type=Arr_u8_64, direction=IN, server-argument-impl-policy=USE-ARGUMENT-TYPE
        Set_BsShare_VisMeet_EOLEntry_Element
          arg BsShare_VisMeet_EOLEntry_Element: type=UInt16, direction=IN, server-argument-impl-policy=USE-ARGUMENT-TYPE
        Set_BsShare_AssemblyManufacturingDate
          arg BsShare_AssemblyManufacturingDate: type=Arr_u8_3, direction=IN, server-argument-impl-policy=USE-ARGUMENT-TYPE
        Set_BsShare_AssemblyPlantNumber
          arg BsShare_AssemblyPlantNumber: type=Arr_u8_3, direction=IN, server-argument-impl-policy=USE-ARGUMENT-TYPE
        Set_BsShare_HWModification
          arg BsShare_HWModification: type=UInt16, direction=IN, server-argument-impl-policy=USE-ARGUMENT-TYPE
        Set_BsShare_PCBSerialNumber
          arg BsShare_PCBSerialNumber: type=Arr_u8_9, direction=IN, server-argument-impl-policy=USE-ARGUMENT-TYPE
        Set_BsShare_ProductSerialNumber
          arg BsShare_ProductSerialNumber: type=Arr_u8_10, direction=IN, server-argument-impl-policy=USE-ARGUMENT-TYPE
        Set_BsShare_SMTManufacturingDate
          arg BsShare_SMTManufacturingDate: type=Arr_u8_3, direction=IN, server-argument-impl-policy=USE-ARGUMENT-TYPE
        Set_BsShare_SMTPlantNumber
          arg BsShare_SMTPlantNumber: type=Arr_u8_3, direction=IN, server-argument-impl-policy=USE-ARGUMENT-TYPE
        Set_BsShare_VisteonPCBPartNumber
          arg BsShare_VisteonPCBPartNumber: type=Arr_u8_17, direction=IN, server-argument-impl-policy=USE-ARGUMENT-TYPE
        Set_BsShare_VisteonPartNumber
          arg BsShare_VisteonPartNumber: type=Arr_u8_17, direction=IN, server-argument-impl-policy=USE-ARGUMENT-TYPE
        Set_BsConst_BsConst_Illumination_ReservedByte
          arg BsConst_BsConst_Illumination_ReservedByte: type=Arr_u8_28, direction=IN, server-argument-impl-policy=USE-ARGUMENT-TYPE
        Set_BsConst_BsConst_Illumination_ReservedByte_SafeCopy1
          arg BsConst_BsConst_Illumination_ReservedByte_SafeCopy1: type=Arr_u8_28, direction=IN, server-argument-impl-policy=USE-ARGUMENT-TYPE
        Set_BsConst_BsConst_Illumination_ReservedByte_SafeCopy2
          arg BsConst_BsConst_Illumination_ReservedByte_SafeCopy2: type=Arr_u8_28, direction=IN, server-argument-impl-policy=USE-ARGUMENT-TYPE
        Set_BsConst_Compensation_Line_Shift_b
          arg BsConst_Compensation_Line_Shift_b: type=UInt32, direction=IN, server-argument-impl-policy=USE-ARGUMENT-TYPE
        Set_BsConst_Compensation_Line_Shift_b_SafeCopy1
          arg BsConst_Compensation_Line_Shift_b_SafeCopy1: type=UInt32, direction=IN, server-argument-impl-policy=USE-ARGUMENT-TYPE
        Set_BsConst_Compensation_Line_Shift_b_SafeCopy2
          arg BsConst_Compensation_Line_Shift_b_SafeCopy2: type=UInt32, direction=IN, server-argument-impl-policy=USE-ARGUMENT-TYPE
        Set_BsConst_Compensation_Line_Slope_m
          arg BsConst_Compensation_Line_Slope_m: type=UInt32, direction=IN, server-argument-impl-policy=USE-ARGUMENT-TYPE
        Set_BsConst_Compensation_Line_Slope_m_SafeCopy1
          arg BsConst_Compensation_Line_Slope_m_SafeCopy1: type=UInt32, direction=IN, server-argument-impl-policy=USE-ARGUMENT-TYPE
        Set_BsConst_Compensation_Line_Slope_m_SafeCopy2
          arg BsConst_Compensation_Line_Slope_m_SafeCopy2: type=UInt32, direction=IN, server-argument-impl-policy=USE-ARGUMENT-TYPE
        Set_BsConst_Derating_Backlight_Disable
          arg BsConst_Derating_Backlight_Disable: type=UInt8, direction=IN, server-argument-impl-policy=USE-ARGUMENT-TYPE
        Set_BsConst_Derating_Backlight_Disable_SafeCopy1
          arg BsConst_Derating_Backlight_Disable_SafeCopy1: type=UInt8, direction=IN, server-argument-impl-policy=USE-ARGUMENT-TYPE
        Set_BsConst_Derating_Backlight_Disable_SafeCopy2
          arg BsConst_Derating_Backlight_Disable_SafeCopy2: type=UInt8, direction=IN, server-argument-impl-policy=USE-ARGUMENT-TYPE
        Set_BsConst_Display_Illum_Max_Level
          arg BsConst_Display_Illum_Max_Level: type=UInt16, direction=IN, server-argument-impl-policy=USE-ARGUMENT-TYPE
        Set_BsConst_Display_Illum_Max_Level_SafeCopy1
          arg BsConst_Display_Illum_Max_Level_SafeCopy1: type=UInt16, direction=IN, server-argument-impl-policy=USE-ARGUMENT-TYPE
        Set_BsConst_Display_Illum_Max_Level_SafeCopy2
          arg BsConst_Display_Illum_Max_Level_SafeCopy2: type=UInt16, direction=IN, server-argument-impl-policy=USE-ARGUMENT-TYPE
        Set_BsConst_Lookup_Curve_HotSpot_Coef_X
          arg BsConst_Lookup_Curve_HotSpot_Coef_X: type=Arr_u16_7, direction=IN, server-argument-impl-policy=USE-ARGUMENT-TYPE
        Set_BsConst_Lookup_Curve_HotSpot_Coef_X_SafeCopy1
          arg BsConst_Lookup_Curve_HotSpot_Coef_X_SafeCopy1: type=Arr_u16_7, direction=IN, server-argument-impl-policy=USE-ARGUMENT-TYPE
        Set_BsConst_Lookup_Curve_HotSpot_Coef_X_SafeCopy2
          arg BsConst_Lookup_Curve_HotSpot_Coef_X_SafeCopy2: type=Arr_u16_7, direction=IN, server-argument-impl-policy=USE-ARGUMENT-TYPE
        Set_BsConst_Lookup_Curve_HotSpot_Coef_Y
          arg BsConst_Lookup_Curve_HotSpot_Coef_Y: type=Arr_u16_7, direction=IN, server-argument-impl-policy=USE-ARGUMENT-TYPE
        Set_BsConst_Lookup_Curve_HotSpot_Coef_Y_SafeCopy1
          arg BsConst_Lookup_Curve_HotSpot_Coef_Y_SafeCopy1: type=Arr_u16_7, direction=IN, server-argument-impl-policy=USE-ARGUMENT-TYPE
        Set_BsConst_Lookup_Curve_HotSpot_Coef_Y_SafeCopy2
          arg BsConst_Lookup_Curve_HotSpot_Coef_Y_SafeCopy2: type=Arr_u16_7, direction=IN, server-argument-impl-policy=USE-ARGUMENT-TYPE
        Set_BsConst_PCB_Temperature_Sensor_Conv
          arg BsConst_PCB_Temperature_Sensor_Conv: type=T_NV_Temperature_Conversion, direction=IN, server-argument-impl-policy=USE-ARGUMENT-TYPE
        Set_BsConst_PCB_Temperature_Sensor_Conv_SafeCopy1
          arg BsConst_PCB_Temperature_Sensor_Conv_SafeCopy1: type=T_NV_Temperature_Conversion, direction=IN, server-argument-impl-policy=USE-ARGUMENT-TYPE
        Set_BsConst_PCB_Temperature_Sensor_Conv_SafeCopy2
          arg BsConst_PCB_Temperature_Sensor_Conv_SafeCopy2: type=T_NV_Temperature_Conversion, direction=IN, server-argument-impl-policy=USE-ARGUMENT-TYPE
        Set_BsConst_PWM_boost_bypass_duty
          arg BsConst_PWM_boost_bypass_duty: type=UInt8, direction=IN, server-argument-impl-policy=USE-ARGUMENT-TYPE
        Set_BsConst_PWM_boost_bypass_duty_SafeCopy1
          arg BsConst_PWM_boost_bypass_duty_SafeCopy1: type=UInt8, direction=IN, server-argument-impl-policy=USE-ARGUMENT-TYPE
        Set_BsConst_PWM_boost_bypass_duty_SafeCopy2
          arg BsConst_PWM_boost_bypass_duty_SafeCopy2: type=UInt8, direction=IN, server-argument-impl-policy=USE-ARGUMENT-TYPE
        Set_BsConst_Temp_Threshold_Hysteresis_Derating
          arg BsConst_Temp_Threshold_Hysteresis_Derating: type=UInt8, direction=IN, server-argument-impl-policy=USE-ARGUMENT-TYPE
        Set_BsConst_Temp_Threshold_Hysteresis_Derating_SafeCopy1
          arg BsConst_Temp_Threshold_Hysteresis_Derating_SafeCopy1: type=UInt8, direction=IN, server-argument-impl-policy=USE-ARGUMENT-TYPE
        Set_BsConst_Temp_Threshold_Hysteresis_Derating_SafeCopy2
          arg BsConst_Temp_Threshold_Hysteresis_Derating_SafeCopy2: type=UInt8, direction=IN, server-argument-impl-policy=USE-ARGUMENT-TYPE
        Set_BsConst_Temperature_Sensor_Conv
          arg BsConst_Temperature_Sensor_Conv: type=T_NV_Temperature_Conversion, direction=IN, server-argument-impl-policy=USE-ARGUMENT-TYPE
        Set_BsConst_Temperature_Sensor_Conv_SafeCopy1
          arg BsConst_Temperature_Sensor_Conv_SafeCopy1: type=T_NV_Temperature_Conversion, direction=IN, server-argument-impl-policy=USE-ARGUMENT-TYPE
        Set_BsConst_Temperature_Sensor_Conv_SafeCopy2
          arg BsConst_Temperature_Sensor_Conv_SafeCopy2: type=T_NV_Temperature_Conversion, direction=IN, server-argument-impl-policy=USE-ARGUMENT-TYPE
    if_CS_MemAbs_NvMWriteStatus
      operation NvmWriteStatus: possible-error=if_CS_MemAbs_NvMWriteStatus/E_NOT_OK
      error E_NOT_OK: error-code=1
  sender receiver interface if_SR_JobStatus
    94 x data, all with type=UInt8:
      JobStatus_BsConst_Audio_Element
      JobStatus_BsConst_Communication_Element
      JobStatus_BsConst_EngOffTimer_Element
      JobStatus_BsConst_FuelGauge_Element
      JobStatus_BsConst_OilGauge_Element
      JobStatus_BsConst_PowerGauge_Element
      JobStatus_BsConst_Power_Element
      JobStatus_BsConst_RealTimeClock_Element
      JobStatus_BsConst_ServiceReminder_Element
      JobStatus_BsConst_SpeedoGauge_Element
      JobStatus_BsConst_TachoGauge_Element
      JobStatus_BsConst_TempGauge_Element
      JobStatus_BsConst_TripComputer_Element
      JobStatus_BsConst_Warning_Element
      JobStatus_BsCys_Certicificate_Element
      JobStatus_BsDiag_Dtc_Element
      JobStatus_BsDiag_ErrorRecord_Element
      JobStatus_BsReten_Audio_Element
      JobStatus_BsReten_Communication_Element
      JobStatus_BsReten_Display_Element
      JobStatus_BsReten_Gauges_Element
      JobStatus_BsReten_Illumination_Element
      JobStatus_BsReten_Odometer_Element
      JobStatus_BsReten_Personalization_Element
      JobStatus_BsReten_Power_Element
      JobStatus_BsReten_RealTimeClock_Element
      JobStatus_BsReten_Tripcomputer_Element
      JobStatus_BsReten_Warning_Element
      JobStatus_BsRt_CusDlt_Element
      JobStatus_BsRt_FuelGauge_Element
      JobStatus_BsRt_Illumination_Element
      JobStatus_BsRt_Odometer_Element
      JobStatus_BsRt_OilGauge_Element
      JobStatus_BsRt_Personalization_Element
      JobStatus_BsRt_PowerGauge_Element
      JobStatus_BsRt_RealTimeClock_Element
      JobStatus_BsRt_SpeedoGauge_Element
      JobStatus_BsRt_TachoGauge_Element
      JobStatus_BsRt_TempGauge_Element
      JobStatus_BsRt_TripComputer_Element
      JobStatus_BsRt_Warning_Element
      JobStatus_BsShare_EcuPartNumber_Element
      JobStatus_BsShare_SwUpdFotaFinPrint_Element
      JobStatus_BsShare_SwUpdFotaMode_Element
      JobStatus_BsShare_SwUpdFotaStatus_Element
      JobStatus_BsShare_SwUpdFotadecrypt_Element
      JobStatus_BsShare_SwUpdReflash_Element
      JobStatus_BsShare_VehicleConfig_Element
      JobStatus_BsShare_VisMeet_Element
      JobStatus_RefCys_Certicificate1_Element
      JobStatus_RefCys_Certicificate_Element
      JobStatus_BsShare_VisMeet_EOLEntry_Element
      JobStatus_BsShare_AssemblyManufacturingDate
      JobStatus_BsShare_AssemblyPlantNumber
      JobStatus_BsShare_HWModification
      JobStatus_BsShare_PCBSerialNumber
      JobStatus_BsShare_ProductSerialNumber
      JobStatus_BsShare_SMTManufacturingDate
      JobStatus_BsShare_SMTPlantNumber
      JobStatus_BsShare_VisteonPCBPartNumber
      JobStatus_BsShare_VisteonPartNumber
      JobStatus_BsConst_BsConst_Illumination_ReservedByte
      JobStatus_BsConst_BsConst_Illumination_ReservedByte_SafeCopy1
      JobStatus_BsConst_BsConst_Illumination_ReservedByte_SafeCopy2
      JobStatus_BsConst_Compensation_Line_Shift_b
      JobStatus_BsConst_Compensation_Line_Shift_b_SafeCopy1
      JobStatus_BsConst_Compensation_Line_Shift_b_SafeCopy2
      JobStatus_BsConst_Compensation_Line_Slope_m
      JobStatus_BsConst_Compensation_Line_Slope_m_SafeCopy1
      JobStatus_BsConst_Compensation_Line_Slope_m_SafeCopy2
      JobStatus_BsConst_Derating_Backlight_Disable
      JobStatus_BsConst_Derating_Backlight_Disable_SafeCopy1
      JobStatus_BsConst_Derating_Backlight_Disable_SafeCopy2
      JobStatus_BsConst_Display_Illum_Max_Level
      JobStatus_BsConst_Display_Illum_Max_Level_SafeCopy1
      JobStatus_BsConst_Display_Illum_Max_Level_SafeCopy2
      JobStatus_BsConst_Lookup_Curve_HotSpot_Coef_X
      JobStatus_BsConst_Lookup_Curve_HotSpot_Coef_X_SafeCopy1
      JobStatus_BsConst_Lookup_Curve_HotSpot_Coef_X_SafeCopy2
      JobStatus_BsConst_Lookup_Curve_HotSpot_Coef_Y
      JobStatus_BsConst_Lookup_Curve_HotSpot_Coef_Y_SafeCopy1
      JobStatus_BsConst_Lookup_Curve_HotSpot_Coef_Y_SafeCopy2
      JobStatus_BsConst_PCB_Temperature_Sensor_Conv
      JobStatus_BsConst_PCB_Temperature_Sensor_Conv_SafeCopy1
      JobStatus_BsConst_PCB_Temperature_Sensor_Conv_SafeCopy2
      JobStatus_BsConst_PWM_boost_bypass_duty
      JobStatus_BsConst_PWM_boost_bypass_duty_SafeCopy1
      JobStatus_BsConst_PWM_boost_bypass_duty_SafeCopy2
      JobStatus_BsConst_Temp_Threshold_Hysteresis_Derating
      JobStatus_BsConst_Temp_Threshold_Hysteresis_Derating_SafeCopy1
      JobStatus_BsConst_Temp_Threshold_Hysteresis_Derating_SafeCopy2
      JobStatus_BsConst_Temperature_Sensor_Conv
      JobStatus_BsConst_Temperature_Sensor_Conv_SafeCopy1
      JobStatus_BsConst_Temperature_Sensor_Conv_SafeCopy2
  8 x client server interface:
    TI_NvMExt_GetErrorStatus
      operation NvMExt_GetErrorStatus: possible-error=TI_NvMExt_GetErrorStatus/E_NOT_OK
        arg NvmBlockId: type=NvM_BlockIdType, direction=IN, server-argument-impl-policy=USE-ARGUMENT-TYPE
        arg RequestResultPtr: type=NvM_RequestResultType, direction=INOUT, server-argument-impl-policy=USE-ARGUMENT-TYPE
      error E_NOT_OK: error-code=1
    TI_NvMExt_GetReadAllStatus
      operation NvmExt_GetNvMReadAllStatus
        arg Status: type=Boolean, direction=OUT, server-argument-impl-policy=USE-ARGUMENT-TYPE
    TI_NvMExt_ReadBlock
      operation NvMExt_ReadBlock: possible-error=TI_NvMExt_ReadBlock/E_NOT_OK
        arg NvmBlockId: type=NvM_BlockIdType, direction=IN, server-argument-impl-policy=USE-ARGUMENT-TYPE
        arg NvMDstPtr: type=UInt8, direction=INOUT, server-argument-impl-policy=USE-ARGUMENT-TYPE
      error E_NOT_OK: error-code=1
    TI_NvMExt_RestoreBlockDefaults
      operation NvMExt_RestoreBlockDefaults: possible-error=TI_NvMExt_RestoreBlockDefaults/E_NOT_OK
        arg NvmBlockId: type=NvM_BlockIdType, direction=IN, server-argument-impl-policy=USE-ARGUMENT-TYPE
        arg NvMDstPtr: type=UInt8, direction=INOUT, server-argument-impl-policy=USE-ARGUMENT-TYPE
      error E_NOT_OK: error-code=1
    TI_NvMExt_SleepOperations
      operation NvMExt_CancelSleep: possible-error=TI_NvMExt_SleepOperations/E_NOT_OK
      operation NvMExt_ReadytoSleep: possible-error=TI_NvMExt_SleepOperations/E_NOT_OK
      operation NvMExt_RequestSleep: possible-error=TI_NvMExt_SleepOperations/E_NOT_OK
      error E_NOT_OK: error-code=1
    TI_NvMExt_WriteBlock
      operation NvMExt_WriteBlock: possible-error=TI_NvMExt_WriteBlock/E_NOT_OK
        arg NvmBlockId: type=NvM_BlockIdType, direction=IN, server-argument-impl-policy=USE-ARGUMENT-TYPE
        arg NvM_SrcPtr: type=UInt8, direction=INOUT, server-argument-impl-policy=USE-ARGUMENT-TYPE
      error E_NOT_OK: error-code=1
    TI_NvmExt_StartNvmReadAll
      operation NvMExt_ReadAll
    TI_NvmExt_GetPendingStatus
      operation NvMExt_GetPendingStatus: possible-error=TI_NvmExt_GetPendingStatus/E_NOT_OK
        arg NvmBlockID: type=UInt8, direction=IN, server-argument-impl-policy=USE-ARGUMENT-TYPE
        arg Status: type=UInt8, direction=OUT, server-argument-impl-policy=USE-ARGUMENT-TYPE
      error E_NOT_OK: error-code=1
  sender receiver interface TI_NvMExt_WakeupStatus
    data WakeupFlag: type=Boolean
  5 x client server interface:
    TI_If_TmExt_Timer_GetElapsedTime
      operation Timer_GetElapsedTime
        arg hTimer: type=HTimer, direction=IN, server-argument-impl-policy=USE-ARGUMENT-TYPE
        arg ElapsedTime: type=UInt32, direction=OUT, server-argument-impl-policy=USE-ARGUMENT-TYPE
    TI_If_TmExt_Timer_IsElapsed
      operation Timer_IsElapsed
        arg hTimer: type=HTimer, direction=IN, server-argument-impl-policy=USE-ARGUMENT-TYPE
        arg Timeout: type=UInt32, direction=IN, server-argument-impl-policy=USE-ARGUMENT-TYPE
        arg IsElapsed: type=Boolean, direction=OUT, server-argument-impl-policy=USE-ARGUMENT-TYPE
    TI_If_TmExt_Timer_IsStarted
      operation Timer_IsStarted
        arg hTimer: type=HTimer, direction=IN, server-argument-impl-policy=USE-ARGUMENT-TYPE
        arg IsStarted: type=Boolean, direction=OUT, server-argument-impl-policy=USE-ARGUMENT-TYPE
    TI_If_TmExt_Timer_Start
      operation Timer_Start
        arg hTimer: type=HTimer, direction=IN, server-argument-impl-policy=USE-ARGUMENT-TYPE
    TI_If_TmExt_Timer_Stop
      operation Timer_Stop
        arg hTimer: type=HTimer, direction=IN, server-argument-impl-policy=USE-ARGUMENT-TYPE
  sender receiver interface HealthDumpGetData_Q
    data HealthDumpGetDataData: sw-impl-policy=QUEUED, type=SHealthDumpGetData
  sender receiver interface HealthDumpGetHdr_Q
    data HealthDumpGetHdrData: sw-impl-policy=QUEUED, type=SHealthDumpGetHdr
  sender receiver interface PowerSystemStateReqChange
    data PowerSystemStateReqChangeData: type=SPowerSystemStateReqChange
  client server interface if_CS_DmnSystemStateChange
    operation DmnSystemStateChangeReq: possible-error=if_CS_DmnSystemStateChange/E_NOT_OK
      arg DmnId: type=EDomainId, direction=IN, server-argument-impl-policy=USE-ARGUMENT-TYPE
      arg DmnState: type=ESystemState, direction=IN, server-argument-impl-policy=USE-ARGUMENT-TYPE
    operation DmnSystemStateChangeStatus
      arg DmnId: type=EDomainId, direction=IN, server-argument-impl-policy=USE-ARGUMENT-TYPE
      arg DmnStatus: type=EDmnChangeReqStatus_t, direction=OUT, server-argument-impl-policy=USE-ARGUMENT-TYPE
    error E_NOT_OK: error-code=1
  client server interface if_CS_DmnMonitoring
    operation StartDomainMonitoring: possible-error=if_CS_DmnMonitoring/E_NOT_OK
      arg DmnID: type=EDomainId, direction=IN, server-argument-impl-policy=USE-ARGUMENT-TYPE
    operation StopDomainMonitoring: possible-error=if_CS_DmnMonitoring/E_NOT_OK
      arg DmnID: type=EDomainId, direction=IN, server-argument-impl-policy=USE-ARGUMENT-TYPE
    error E_NOT_OK: error-code=1
  client server interface UclSystemCallbacks
    operation ErrorNotification
      arg DLInst: type=UInt8, direction=IN, server-argument-impl-policy=USE-ARGUMENT-TYPE
      arg ErrorCode: type=SInt32, direction=IN, server-argument-impl-policy=USE-ARGUMENT-TYPE
    operation LinkStatusChanged
      arg DLInst: type=UInt8, direction=IN, server-argument-impl-policy=USE-ARGUMENT-TYPE
      arg Status: type=SInt32, direction=IN, server-argument-impl-policy=USE-ARGUMENT-TYPE
  8 x sender receiver interface:
    if_SR_DmnInfo
      data SDmnStatus: type=SDmnStatus
    HealthDomainFatalError_Q
      data HealthDomainFatalErrorData: sw-impl-policy=QUEUED, type=SHealthDomainFatalError
    HealthDomainHeartbeat_Q
      data HealthDomainHeartbeatData: sw-impl-policy=QUEUED, type=SHealthDomainHeartbeat
    HealthDumpData_Q
      data HealthDumpDataData: sw-impl-policy=QUEUED, type=SHealthDumpData
    HealthDumpHdrInfo_Q
      data HealthDumpHdrInfoData: sw-impl-policy=QUEUED, type=SHealthDumpHdrInfo
    PowerExtendShutdownTime_Q
      data PowerExtendShutdownTimeData: sw-impl-policy=QUEUED, type=SPowerExtendShutdownTime
    PowerKeepSystemAwake_Q
      data PowerKeepSystemAwakeData: sw-impl-policy=QUEUED, type=SPowerKeepSystemAwake
    PowerSystemState
      data PowerSystemStateData: type=SPowerSystemState
  client server interface UclInitShutdown
    operation Impl_Initialize: possible-error=UclInitShutdown/E_NOT_OK
    operation Impl_Shutdown: possible-error=UclInitShutdown/E_NOT_OK
    error E_NOT_OK: error-code=1
  7 x sender receiver interface:
    HealthEventRecord_Q
      data HealthEventRecordData: sw-impl-policy=QUEUED, type=SHealthEventRecord
    DiagDIDRequest_Q
      data DiagDIDRequestData: sw-impl-policy=QUEUED, type=SDiagDIDRequest
    DiagIOCtrlRequest_Q
      data DiagIOCtrlRequestData: sw-impl-policy=QUEUED, type=SDiagIOCtrlRequest
    DiagRoutineRequest_Q
      data DiagRoutineRequestData: sw-impl-policy=QUEUED, type=SDiagRoutineRequest
    IgnState_Q
      data IgnStateData: sw-impl-policy=QUEUED, type=SIgnState
    TI_BattMdl_AVP
      14 x data, all with type=Boolean:
        HVP0Flag
        HVSD{0..4}Flag
        LVP0Flag
        LVP1Flag
        LVSD{0..4}Flag
        SVPFlag
    TI_BattMdl_Voltage
      data OverVoltageInterruptFlag: type=Boolean
  34 x client server interface:
    TI_EcuPowerM
      operation EcuPowerM_GetDeviceStatus: possible-error=TI_EcuPowerM/E_NOT_OK
        arg device: type=UInt8, direction=IN, server-argument-impl-policy=USE-ARGUMENT-TYPE
        arg status: type=UInt8, direction=OUT, server-argument-impl-policy=USE-ARGUMENT-TYPE
      operation EcuPowerM_RequestPower: possible-error=TI_EcuPowerM/E_NOT_OK
        arg device: type=UInt8, direction=IN, server-argument-impl-policy=USE-ARGUMENT-TYPE
        arg request: type=UInt8, direction=IN, server-argument-impl-policy=USE-ARGUMENT-TYPE
      error E_NOT_OK: error-code=1
    If_CS_Dlt_DetForwardErrorTrace
      operation DetForwardErrorTrace
        4 x arg, all with direction=IN, server-argument-impl-policy=USE-ARGUMENT-TYPE:
          moduleId: type=UInt16
          instanceId: type=UInt8
          apiId: type=UInt8
          errorId: type=UInt8
    If_CS_Dlt_GetDefaultLogLevel
      operation GetDefaultLogLevel: possible-error=If_CS_Dlt_GetDefaultLogLevel/E_NOT_OK
        arg defaultLogLevel: type=Dlt_MessageLogLevelType, direction=OUT, server-argument-impl-policy=USE-ARGUMENT-TYPE
      error E_NOT_OK: error-code=1
    If_CS_Dlt_GetDefaultTraceStatus
      operation GetDefaultTraceStatus: possible-error=If_CS_Dlt_GetDefaultTraceStatus/E_NOT_OK
        arg logChannelName: type=Dlt_LogChannelNameType, direction=OUT, server-argument-impl-policy=USE-ARGUMENT-TYPE
        arg traceStatus: type=Boolean, direction=OUT, server-argument-impl-policy=USE-ARGUMENT-TYPE
      error E_NOT_OK: error-code=1
    If_CS_Dlt_GetLogChannelNames
      operation GetLogChannelNames: possible-error=If_CS_Dlt_GetLogChannelNames/E_NOT_OK
        arg numberOfLogChannels: type=UInt8, direction=OUT, server-argument-impl-policy=USE-ARGUMENT-TYPE
        arg logChannelNames: type=Dlt_LogChannelNameType, direction=OUT, server-argument-impl-policy=USE-ARGUMENT-TYPE
      error E_NOT_OK: error-code=1
    If_CS_Dlt_GetLogChannelThreshold
      operation GetLogChannelThreshold: possible-error=If_CS_Dlt_GetLogChannelThreshold/E_NOT_OK
        arg logChannelName: type=Dlt_LogChannelNameType, direction=OUT, server-argument-impl-policy=USE-ARGUMENT-TYPE
        arg logChannelThreshold: type=Dlt_MessageLogLevelType, direction=OUT, server-argument-impl-policy=USE-ARGUMENT-TYPE
        arg traceStatus: type=Boolean, direction=OUT, server-argument-impl-policy=USE-ARGUMENT-TYPE
      error E_NOT_OK: error-code=1
    If_CS_Dlt_GetLogInfo
      operation GetLogInfo: possible-error=If_CS_Dlt_GetLogInfo/E_NOT_OK
        5 x arg, all with server-argument-impl-policy=USE-ARGUMENT-TYPE:
          options: type=UInt8, direction=IN
          appId: type=Dlt_ApplicationIDType, direction=OUT
          contextId: type=Dlt_ContextIDType, direction=OUT
          status: type=UInt8, direction=OUT
          logInfo: type=Dlt_LogInfoType, direction=OUT
      error E_NOT_OK: error-code=1
    If_CS_Dlt_GetTraceStatus
      operation GetTraceStatus: possible-error=If_CS_Dlt_GetTraceStatus/E_NOT_OK
        arg appId: type=Dlt_ApplicationIDType, direction=OUT, server-argument-impl-policy=USE-ARGUMENT-TYPE
        arg contextId: type=Dlt_ContextIDType, direction=OUT, server-argument-impl-policy=USE-ARGUMENT-TYPE
        arg traceStatus: type=Boolean, direction=OUT, server-argument-impl-policy=USE-ARGUMENT-TYPE
      error E_NOT_OK: error-code=1
    If_CS_Dlt_InjectCall_SESSION
      operation InjectCall_SESSION
        5 x arg, all with server-argument-impl-policy=USE-ARGUMENT-TYPE:
          appId: type=Dlt_ApplicationIDType, direction=OUT
          contextId: type=Dlt_ContextIDType, direction=OUT
          serviceId: type=UInt32, direction=IN
          dataLength: type=UInt32, direction=IN
          data: type=UInt8, direction=OUT
    If_CS_Dlt_RegisterContext
      operation RegisterContext: possible-error=If_CS_Dlt_RegisterContext/E_NOT_OK
        7 x arg, all with server-argument-impl-policy=USE-ARGUMENT-TYPE:
          sessionId: type=Dlt_SessionIDType, direction=IN
          appId: type=Dlt_ApplicationIDType, direction=OUT
          contextId: type=Dlt_ContextIDType, direction=OUT
          appDescription: type=UInt8, direction=OUT
          lenAppDescription: type=UInt8, direction=IN
          contextDescription: type=UInt8, direction=OUT
          lenContextDescription: type=UInt8, direction=IN
      error E_NOT_OK: error-code=1
    If_CS_Dlt_ResetToFactoryDefault
      operation ResetToFactoryDefault: possible-error=If_CS_Dlt_ResetToFactoryDefault/E_NOT_OK
      error E_NOT_OK: error-code=1
    If_CS_Dlt_SendLogMessage
      operation SendLogMessage: possible-error=If_CS_Dlt_SendLogMessage/E_NOT_OK
        4 x arg, all with server-argument-impl-policy=USE-ARGUMENT-TYPE:
          sessionId: type=Dlt_SessionIDType, direction=IN
          logInfo: type=Dlt_MessageLogInfoType, direction=IN
          logData: type=UInt8, direction=OUT
          logDataLength: type=UInt16, direction=IN
      error E_NOT_OK: error-code=1
    If_CS_Dlt_SendTraceMessage
      operation SendTraceMessage: possible-error=If_CS_Dlt_SendTraceMessage/E_NOT_OK
        4 x arg, all with server-argument-impl-policy=USE-ARGUMENT-TYPE:
          sessionId: type=Dlt_SessionIDType, direction=IN
          traceInfo: type=Dlt_MessageTraceInfoType, direction=IN
          traceData: type=UInt8, direction=OUT
          traceDataLength: type=UInt16, direction=IN
      error E_NOT_OK: error-code=1
    If_CS_Dlt_SetDefaultLogLevel
      operation SetDefaultLogLevel: possible-error=If_CS_Dlt_SetDefaultLogLevel/E_NOT_OK
        arg newLogLevel: type=Dlt_MessageLogLevelType, direction=IN, server-argument-impl-policy=USE-ARGUMENT-TYPE
      error E_NOT_OK: error-code=1
    If_CS_Dlt_SetDefaultTraceStatus
      operation SetDefaultTraceStatus: possible-error=If_CS_Dlt_SetDefaultTraceStatus/E_NOT_OK
        arg newTraceStatus: type=Boolean, direction=IN, server-argument-impl-policy=USE-ARGUMENT-TYPE
        arg logChannelName: type=Dlt_LogChannelNameType, direction=OUT, server-argument-impl-policy=USE-ARGUMENT-TYPE
      error E_NOT_OK: error-code=1
    If_CS_Dlt_SetLogChannelAssignment
      operation SetLogChannelAssignment: possible-error=If_CS_Dlt_SetLogChannelAssignment/E_NOT_OK
        4 x arg, all with server-argument-impl-policy=USE-ARGUMENT-TYPE:
          appId: type=Dlt_ApplicationIDType, direction=OUT
          contextId: type=Dlt_ContextIDType, direction=OUT
          logChannelName: type=Dlt_LogChannelNameType, direction=OUT
          addRemoveOp: type=Dlt_AssignmentOperation, direction=IN
      error E_NOT_OK: error-code=1
    If_CS_Dlt_SetLogChannelThreshold
      operation SetLogChannelThreshold: possible-error=If_CS_Dlt_SetLogChannelThreshold/E_NOT_OK
        arg logChannelName: type=Dlt_LogChannelNameType, direction=OUT, server-argument-impl-policy=USE-ARGUMENT-TYPE
        arg newThreshold: type=Dlt_MessageLogLevelType, direction=IN, server-argument-impl-policy=USE-ARGUMENT-TYPE
        arg newTraceStatus: type=Boolean, direction=IN, server-argument-impl-policy=USE-ARGUMENT-TYPE
      error E_NOT_OK: error-code=1
    If_CS_Dlt_SetLogLevel
      operation SetLogLevel: possible-error=If_CS_Dlt_SetLogLevel/E_NOT_OK
        arg appId: type=Dlt_ApplicationIDType, direction=OUT, server-argument-impl-policy=USE-ARGUMENT-TYPE
        arg contextId: type=Dlt_ContextIDType, direction=OUT, server-argument-impl-policy=USE-ARGUMENT-TYPE
        arg newLogLevel: type=Dlt_MessageLogLevelType, direction=IN, server-argument-impl-policy=USE-ARGUMENT-TYPE
      error E_NOT_OK: error-code=1
    If_CS_Dlt_SetMessageFiltering
      operation SetMessageFiltering: possible-error=If_CS_Dlt_SetMessageFiltering/E_NOT_OK
        arg MessageFilteringStatus: type=Boolean, direction=IN, server-argument-impl-policy=USE-ARGUMENT-TYPE
      error E_NOT_OK: error-code=1
    If_CS_Dlt_SetTraceStatus
      operation SetTraceStatus: possible-error=If_CS_Dlt_SetTraceStatus/E_NOT_OK
        arg appId: type=Dlt_ApplicationIDType, direction=OUT, server-argument-impl-policy=USE-ARGUMENT-TYPE
        arg contextId: type=Dlt_ContextIDType, direction=OUT, server-argument-impl-policy=USE-ARGUMENT-TYPE
        arg newTraceStatus: type=Boolean, direction=IN, server-argument-impl-policy=USE-ARGUMENT-TYPE
      error E_NOT_OK: error-code=1
    If_CS_Dlt_StoreConfiguration
      operation StoreConfiguration: possible-error=If_CS_Dlt_StoreConfiguration/E_NOT_OK
      error E_NOT_OK: error-code=1
    If_CS_Dlt_UnregisterContext
      operation UnregisterContext: possible-error=If_CS_Dlt_UnregisterContext/E_NOT_OK
        arg sessionId: type=Dlt_SessionIDType, direction=IN, server-argument-impl-policy=USE-ARGUMENT-TYPE
        arg appId: type=Dlt_ApplicationIDType, direction=OUT, server-argument-impl-policy=USE-ARGUMENT-TYPE
        arg contextId: type=Dlt_ContextIDType, direction=OUT, server-argument-impl-policy=USE-ARGUMENT-TYPE
      error E_NOT_OK: error-code=1
    If_CS_DltExt_SendLogMessage
      operation SendLogMessage: possible-error=If_CS_DltExt_SendLogMessage/E_NOT_OK
        5 x arg, all with server-argument-impl-policy=USE-ARGUMENT-TYPE:
          payLoadHeader: type=UInt8, direction=OUT
          payLoad: type=UInt8, direction=OUT
          payLoadHeaderLength: type=UInt16, direction=IN
          payLoadLength: type=UInt16, direction=IN
          logLevel: type=UInt8, direction=IN
      error E_NOT_OK: error-code=1
    If_CS_SetCounterToDefault
      operation SetCounterToDefault
    If_CS_SetLogsToDefault
      operation SetLogsToDefault
    TI_EcuMExt_GetResetReason
      operation GetResetReason: possible-error=TI_EcuMExt_GetResetReason/E_NOT_OK
      error E_NOT_OK: error-code=1
    if_CS_TIRtcServices
      4 x operation, all with possible-error=if_CS_TIRtcServices/E_NOT_OK:
        RtcCdd_ClearAlarm
        RtcCdd_GetTime
          arg p_time: type=Rtc_TimeType, direction=OUT, server-argument-impl-policy=USE-ARGUMENT-TYPE
        RtcCdd_SetAlarm
          arg p_alarm: type=Rtc_AlarmType, direction=IN, server-argument-impl-policy=USE-ARGUMENT-TYPE
        RtcCdd_SetTime
          arg p_time: type=Rtc_TimeType, direction=IN, server-argument-impl-policy=USE-ARGUMENT-TYPE
      error E_NOT_OK: error-code=1
    if_CS_TIBattMdl
      operation BattMdl_GetSvpState
      operation BattMdl_OverVoltageISRFlagProcess
    if_CS_SndCdd_AmpDiag
      operation GetSpeaker_status: possible-error=if_CS_SndCdd_AmpDiag/E_NOT_OK
        arg SpkrState: type=UInt8, direction=OUT, server-argument-impl-policy=USE-ARGUMENT-TYPE
        arg SpkrDiagStatus: type=UInt8, direction=OUT, server-argument-impl-policy=USE-ARGUMENT-TYPE
      operation SpkrAmp_Recovery: possible-error=if_CS_SndCdd_AmpDiag/E_NOT_OK
      error E_NOT_OK: error-code=1
    TI_DID_DiagAction
      operation DID_DiagAction: possible-error=TI_DID_DiagAction/E_NOT_OK
        5 x arg, all with server-argument-impl-policy=USE-ARGUMENT-TYPE:
          OpStatus: type=teDiagOpStatus, direction=IN
          DIDNum: type=UInt16, direction=IN
          Data: type=UInt8, direction=OUT
          pNrc: type=UInt8, direction=OUT
          eOperation: type=teDIDOperation, direction=IN
      error E_NOT_OK: error-code=1
    TI_Meet_Mgrdiagcdd_Action
      operation Meet_Mgrdiagcdd_Action: possible-error=TI_Meet_Mgrdiagcdd_Action/E_NOT_OK
        4 x arg, all with direction=OUT, server-argument-impl-policy=USE-ARGUMENT-TYPE:
          Action: type=EDcmExtAction
          Data: type=UInt8
          Length: type=UInt8
          DID: type=UInt32
      error E_NOT_OK: error-code=1
    TI_RID_DiagAction
      operation RID_DiagAction: possible-error=TI_RID_DiagAction/E_NOT_OK
        7 x arg, all with server-argument-impl-policy=USE-ARGUMENT-TYPE:
          OpStatus: type=teDiagOpStatus, direction=IN
          RIDNum: type=UInt16, direction=IN
          Out_RoutineInfo: type=UInt8, direction=OUT
          Data: type=UInt8, direction=OUT
          DataLength: type=UInt16, direction=OUT
          pNrc: type=UInt8, direction=OUT
          eOperation: type=teRoutineOperation, direction=IN
      error E_NOT_OK: error-code=1
    TI_Read_ManufModeStatus
      operation Read_ManufModeStatus: possible-error=TI_Read_ManufModeStatus/E_NOT_OK
        arg currentstate: type=EMeetModeStatus, direction=OUT, server-argument-impl-policy=USE-ARGUMENT-TYPE
      error E_NOT_OK: error-code=1
    TI_Write_Mfg_Flag
      operation Write_Mfg_Flag: possible-error=TI_Write_Mfg_Flag/E_NOT_OK
        arg pdata: type=UInt16, direction=OUT, server-argument-impl-policy=USE-ARGUMENT-TYPE
      error E_NOT_OK: error-code=1
  sender receiver interface TI_SleepReq
    data SleepReqData: type=Boolean
  26 x client server interface:
    TI_DcmExt_Confirmation
      operation DcmExt_Confirmation
        arg Result: type=UInt8, direction=IN, server-argument-impl-policy=USE-ARGUMENT-TYPE
    TI_DcmExt_Service_Iocontrol
      operation DcmExt_Service_Iocontrol: possible-error=TI_DcmExt_Service_Iocontrol/E_NOT_OK
        4 x arg, all with server-argument-impl-policy=USE-ARGUMENT-TYPE:
          OpStatus: type=Dcm_OpStatusType, direction=IN
          DataPointer: type=UInt8, direction=INOUT
          pNrc: type=Dcm_NegativeResponseCodeType, direction=INOUT
          did: type=Dcm_DspDidIdentifierTableType, direction=IN
      error E_NOT_OK: error-code=1
    TI_DcmExt_Services_CndChk
      operation DcmExt_Services_CndChk: possible-error=TI_DcmExt_Services_CndChk/E_NOT_OK
        arg OpStatus: type=Dcm_OpStatusType, direction=IN, server-argument-impl-policy=USE-ARGUMENT-TYPE
        arg pNrc: type=Dcm_NegativeResponseCodeType, direction=INOUT, server-argument-impl-policy=USE-ARGUMENT-TYPE
        arg did: type=Dcm_DspDidIdentifierTableType, direction=IN, server-argument-impl-policy=USE-ARGUMENT-TYPE
      error E_NOT_OK: error-code=1
    TI_DcmExt_Services_DataRead
      operation DcmExt_Services_DataRead: possible-error=TI_DcmExt_Services_DataRead/E_NOT_OK
        4 x arg, all with server-argument-impl-policy=USE-ARGUMENT-TYPE:
          OpStatus: type=Dcm_OpStatusType, direction=IN
          pDataPointer: type=UInt8, direction=INOUT
          did: type=Dcm_DspDidIdentifierTableType, direction=IN
          pNrc: type=Dcm_NegativeResponseCodeType, direction=INOUT
      error E_NOT_OK: error-code=1
    TI_DcmExt_Services_DataWrite
      operation DcmExt_Services_DataWrite: possible-error=TI_DcmExt_Services_DataWrite/E_NOT_OK
        5 x arg, all with server-argument-impl-policy=USE-ARGUMENT-TYPE:
          OpStatus: type=Dcm_OpStatusType, direction=IN
          DataPointer: type=UInt8, direction=INOUT
          pNrc: type=Dcm_NegativeResponseCodeType, direction=INOUT
          did: type=Dcm_DspDidIdentifierTableType, direction=IN
          index: type=UInt16, direction=IN
      error E_NOT_OK: error-code=1
    TI_DcmExt_Services_LenChk
      operation DcmExt_Services_LenChk: possible-error=TI_DcmExt_Services_LenChk/E_NOT_OK
        4 x arg, all with server-argument-impl-policy=USE-ARGUMENT-TYPE:
          OpStatus: type=Dcm_OpStatusType, direction=IN
          pNrc: type=Dcm_NegativeResponseCodeType, direction=INOUT
          Length: type=Dcm_MsgLenType, direction=INOUT
          did: type=Dcm_DspDidIdentifierTableType, direction=IN
      error E_NOT_OK: error-code=1
    TI_DcmExt_Services_RoutineResults
      operation DcmExt_Services_RoutineResults: possible-error=TI_DcmExt_Services_RoutineResults/E_NOT_OK
        6 x arg, all with server-argument-impl-policy=USE-ARGUMENT-TYPE:
          OpStatus: type=Dcm_OpStatusType, direction=IN
          pOut_RoutineInfo: type=UInt8, direction=INOUT
          Out_Results_Response: type=UInt8, direction=INOUT
          DataLength: type=UInt32, direction=INOUT
          pNrc: type=Dcm_NegativeResponseCodeType, direction=INOUT
          Rid: type=Dcm_DspRidIdentifierTableType, direction=IN
      error E_NOT_OK: error-code=1
    TI_DcmExt_Services_RoutineStart
      operation DcmExt_Services_RoutineStart: possible-error=TI_DcmExt_Services_RoutineStart/E_NOT_OK
        5 x arg, all with server-argument-impl-policy=USE-ARGUMENT-TYPE:
          OpStatus: type=Dcm_OpStatusType, direction=IN
          pOut_RoutineInfo: type=UInt8, direction=INOUT
          DataLength: type=UInt32, direction=INOUT
          pNrc: type=Dcm_NegativeResponseCodeType, direction=INOUT
          Rid: type=Dcm_DspRidIdentifierTableType, direction=IN
      error E_NOT_OK: error-code=1
    TI_DcmExt_Services_RoutineStop
      operation DcmExt_Services_RoutineStop: possible-error=TI_DcmExt_Services_RoutineStop/E_NOT_OK
        5 x arg, all with server-argument-impl-policy=USE-ARGUMENT-TYPE:
          OpStatus: type=Dcm_OpStatusType, direction=IN
          pOut_RoutineInfo: type=UInt8, direction=INOUT
          DataLength: type=UInt32, direction=INOUT
          pNrc: type=Dcm_NegativeResponseCodeType, direction=INOUT
          Rid: type=Dcm_DspRidIdentifierTableType, direction=IN
      error E_NOT_OK: error-code=1
    TI_DemExt_ClearDTC
      operation DemExt_ClearDTC: possible-error=TI_DemExt_ClearDTC/E_NOT_OK
        arg ClientId: type=UInt8, direction=IN, server-argument-impl-policy=USE-ARGUMENT-TYPE
      error E_NOT_OK: error-code=1
    TI_DemExt_GetDTCOfEvent
      operation DemExt_GetDTCOfEvent: possible-error=TI_DemExt_GetDTCOfEvent/E_NOT_OK
        arg EventId: type=Dem_EventIdType, direction=IN, server-argument-impl-policy=USE-ARGUMENT-TYPE
        arg DTCFormat: type=Dem_DTCFormatType, direction=IN, server-argument-impl-policy=USE-ARGUMENT-TYPE
        arg DTCOfEvent: type=UInt32, direction=OUT, server-argument-impl-policy=USE-ARGUMENT-TYPE
      error E_NOT_OK: error-code=1
    TI_DemExt_GetDTCSelectionResult
      operation DemExt_GetDTCSelectionResult: possible-error=TI_DemExt_GetDTCSelectionResult/E_NOT_OK
        arg ClientId: type=UInt8, direction=IN, server-argument-impl-policy=USE-ARGUMENT-TYPE
      error E_NOT_OK: error-code=1
    TI_DemExt_GetDTCSelectionResultForClearDTC
      operation DemExt_GetDTCSelectionResultForClearDTC: possible-error=TI_DemExt_GetDTCSelectionResultForClearDTC/E_NOT_OK
        arg ClientId: type=UInt8, direction=IN, server-argument-impl-policy=USE-ARGUMENT-TYPE
      error E_NOT_OK: error-code=1
    TI_DemExt_GetDebouncingOfEvent
      operation DemExt_GetDebouncingOfEvent: possible-error=TI_DemExt_GetDebouncingOfEvent/E_NOT_OK
        arg EventId: type=Dem_EventIdType, direction=IN, server-argument-impl-policy=USE-ARGUMENT-TYPE
        arg DebouncingState: type=Dem_DebouncingStateType, direction=OUT, server-argument-impl-policy=USE-ARGUMENT-TYPE
      error E_NOT_OK: error-code=1
    TI_DemExt_GetEventExtendedDataRecordEx
      operation DemExt_GetEventExtendedDataRecordEx: possible-error=TI_DemExt_GetEventExtendedDataRecordEx/E_NOT_OK
        4 x arg, all with server-argument-impl-policy=USE-ARGUMENT-TYPE:
          EventId: type=Dem_EventIdType, direction=IN
          RecordNumber: type=UInt8, direction=IN
          DestBuffer: type=UInt8, direction=OUT
          BufSize: type=UInt16, direction=INOUT
      error E_NOT_OK: error-code=1
    TI_DemExt_GetEventFreezeFrameDataEx
      operation DemExt_GetEventFreezeFrameDataEx: possible-error=TI_DemExt_GetEventFreezeFrameDataEx/E_NOT_OK
        5 x arg, all with server-argument-impl-policy=USE-ARGUMENT-TYPE:
          EventId: type=Dem_EventIdType, direction=IN
          RecordNumber: type=UInt8, direction=IN
          DataId: type=UInt16, direction=IN
          DestBuffer: type=UInt8, direction=OUT
          BufSize: type=UInt16, direction=INOUT
      error E_NOT_OK: error-code=1
    TI_DemExt_GetEventUdsStatus
      operation DemExt_GetEventUdsStatus: possible-error=TI_DemExt_GetEventUdsStatus/E_NOT_OK
        arg EventId: type=Dem_EventIdType, direction=IN, server-argument-impl-policy=USE-ARGUMENT-TYPE
        arg UDSStatusByte: type=Dem_UdsStatusByteType, direction=OUT, server-argument-impl-policy=USE-ARGUMENT-TYPE
      error E_NOT_OK: error-code=1
    TI_DemExt_GetFaultDetectionCounter
      operation DemExt_GetFaultDetectionCounter: possible-error=TI_DemExt_GetFaultDetectionCounter/E_NOT_OK
        arg EventId: type=Dem_EventIdType, direction=IN, server-argument-impl-policy=USE-ARGUMENT-TYPE
        arg FaultDetectionCounter: type=SInt8, direction=OUT, server-argument-impl-policy=USE-ARGUMENT-TYPE
      error E_NOT_OK: error-code=1
    TI_DemExt_GetNumberOfEventMemoryEntries
      operation DemExt_GetNumberOfEventMemoryEntries: possible-error=TI_DemExt_GetNumberOfEventMemoryEntries/E_NOT_OK
        arg ClientId: type=UInt8, direction=IN, server-argument-impl-policy=USE-ARGUMENT-TYPE
        arg DTCOrigin: type=Dem_DTCOriginType, direction=IN, server-argument-impl-policy=USE-ARGUMENT-TYPE
        arg NumberOfEventMemoryEntries: type=UInt8, direction=OUT, server-argument-impl-policy=USE-ARGUMENT-TYPE
      error E_NOT_OK: error-code=1
    TI_DemExt_GetOperationCycleState
      operation DemExt_GetOperationCycleState: possible-error=TI_DemExt_GetOperationCycleState/E_NOT_OK
        arg OperationCycleId: type=UInt8, direction=IN, server-argument-impl-policy=USE-ARGUMENT-TYPE
        arg CycleState: type=Dem_OperationCycleStateType, direction=OUT, server-argument-impl-policy=USE-ARGUMENT-TYPE
      error E_NOT_OK: error-code=1
    TI_DemExt_SelectDTC
      operation DemExt_SelectDTC: possible-error=TI_DemExt_SelectDTC/E_NOT_OK
        4 x arg, all with direction=IN, server-argument-impl-policy=USE-ARGUMENT-TYPE:
          ClientId: type=UInt8
          DTC: type=UInt32
          DTCFormat: type=Dem_DTCFormatType
          DTCOrigin: type=Dem_DTCOriginType
      error E_NOT_OK: error-code=1
    TI_DemExt_SetEnableCondition
      operation DemExt_SetEnableCondition: possible-error=TI_DemExt_SetEnableCondition/E_NOT_OK
        arg EnableConditionID: type=UInt8, direction=IN, server-argument-impl-policy=USE-ARGUMENT-TYPE
        arg ConditionFulfilled: type=Boolean, direction=IN, server-argument-impl-policy=USE-ARGUMENT-TYPE
      error E_NOT_OK: error-code=1
    TI_DemExt_SetEventAvailable
      operation DemExt_SetEventAvailable: possible-error=TI_DemExt_SetEventAvailable/E_NOT_OK
        arg EventId: type=Dem_EventIdType, direction=IN, server-argument-impl-policy=USE-ARGUMENT-TYPE
        arg AvailableStatus: type=Boolean, direction=IN, server-argument-impl-policy=USE-ARGUMENT-TYPE
      error E_NOT_OK: error-code=1
    TI_DemExt_SetEventStatus
      operation DemExt_SetEventStatus: possible-error=TI_DemExt_SetEventStatus/E_NOT_OK
        arg EventId: type=Dem_EventIdType, direction=IN, server-argument-impl-policy=USE-ARGUMENT-TYPE
        arg EventStatus: type=Dem_EventStatusType, direction=IN, server-argument-impl-policy=USE-ARGUMENT-TYPE
      error E_NOT_OK: error-code=1
    TI_DemExt_SetOperationCycleState
      operation DemExt_SetOperationCycleState: possible-error=TI_DemExt_SetOperationCycleState/E_NOT_OK
        arg OperationCycleId: type=UInt8, direction=IN, server-argument-impl-policy=USE-ARGUMENT-TYPE
        arg CycleState: type=Dem_OperationCycleStateType, direction=IN, server-argument-impl-policy=USE-ARGUMENT-TYPE
      error E_NOT_OK: error-code=1
    TI_DemExt_SetStorageCondition
      operation DemExt_SetStorageCondition: possible-error=TI_DemExt_SetStorageCondition/E_NOT_OK
        arg StorageConditionID: type=UInt8, direction=IN, server-argument-impl-policy=USE-ARGUMENT-TYPE
        arg ConditionFulfilled: type=Boolean, direction=IN, server-argument-impl-policy=USE-ARGUMENT-TYPE
      error E_NOT_OK: error-code=1
  sender receiver interface EmmcErrorNotifier
    data EmmcErrorNotifierData: type=SEmmcErrorNotifier
  sender receiver interface DisplayCurrentState
    data DisplayCurrentStateData: type=SDisplayCurrentState
  sender receiver interface DisplaySetPower
    data DisplaySetPowerData: type=SDisplaySetPower
  client server interface TI_DID_App_Diag_Action
    operation DID_DiagAction: possible-error=TI_DID_App_Diag_Action/E_NOT_OK
      5 x arg, all with server-argument-impl-policy=USE-ARGUMENT-TYPE:
        OpStatus: type=teDiagOpStatus, direction=IN
        DIDNum: type=UInt16, direction=IN
        Data: type=UInt8, direction=INOUT
        pNrc: type=UInt8, direction=INOUT
        eOperation: type=teDIDOperation, direction=IN
    error E_NOT_OK: error-code=1
  client server interface TI_DiagEntrySts
    operation Diag_Entry_Status: possible-error=TI_DiagEntrySts/E_NOT_OK
      6 x arg, all with server-argument-impl-policy=USE-ARGUMENT-TYPE:
        SID: type=UInt8, direction=IN
        RequestData: type=UInt8, direction=OUT
        RequestDataSize: type=UInt16, direction=IN
        ReqType: type=UInt8, direction=IN
        SourceAddress: type=UInt16, direction=IN
        ErrorCode: type=Dcm_NegativeResponseCodeType, direction=OUT
    error E_NOT_OK: error-code=1
  client server interface TI_RID_App_Diag_Action
    operation RID_DiagAction: possible-error=TI_RID_App_Diag_Action/E_NOT_OK
      7 x arg, all with server-argument-impl-policy=USE-ARGUMENT-TYPE:
        OpStatus: type=teDiagOpStatus, direction=IN
        RIDNum: type=UInt16, direction=IN
        Out_RoutineInfo: type=UInt8, direction=INOUT
        Data: type=UInt8, direction=INOUT
        DataLength: type=UInt16, direction=OUT
        pNrc: type=UInt8, direction=INOUT
        eOperation: type=teRoutineOperation, direction=IN
    error E_NOT_OK: error-code=1
  sender receiver interface TI_DisplaySetPower
    data DisplaySetPowerData: type=SDisplaySetPower
  client server interface TI_ComMExt
    13 x operation:
      CAN_ActivateSilentCommunication: possible-error=TI_ComMExt/E_NOT_OK
        arg Channel: type=UInt8, direction=IN, server-argument-impl-policy=USE-ARGUMENT-TYPE
      CAN_CommControlActivateRx: possible-error=TI_ComMExt/E_NOT_OK
        arg Channel: type=UInt8, direction=IN, server-argument-impl-policy=USE-ARGUMENT-TYPE
      CAN_CommControlActivateTx: possible-error=TI_ComMExt/E_NOT_OK
        arg Channel: type=UInt8, direction=IN, server-argument-impl-policy=USE-ARGUMENT-TYPE
      CAN_CommControlDeActivateRx: possible-error=TI_ComMExt/E_NOT_OK
        arg Channel: type=UInt8, direction=IN, server-argument-impl-policy=USE-ARGUMENT-TYPE
      CAN_CommControlDeActivateTx: possible-error=TI_ComMExt/E_NOT_OK
        arg Channel: type=UInt8, direction=IN, server-argument-impl-policy=USE-ARGUMENT-TYPE
      CAN_CommControlSetDone
        arg PduInitRequest: type=Boolean, direction=IN, server-argument-impl-policy=USE-ARGUMENT-TYPE
      CAN_DeActivateSilentCommunication: possible-error=TI_ComMExt/E_NOT_OK
        arg Channel: type=UInt8, direction=IN, server-argument-impl-policy=USE-ARGUMENT-TYPE
      CAN_GetCurrentComMode: possible-error=TI_ComMExt/E_NOT_OK
        arg Channel: type=UInt8, direction=IN, server-argument-impl-policy=USE-ARGUMENT-TYPE
        arg ComMode: type=UInt8, direction=OUT, server-argument-impl-policy=USE-ARGUMENT-TYPE
      CAN_ReleaseCommunication: possible-error=TI_ComMExt/E_NOT_OK
        arg Channel: type=UInt8, direction=IN, server-argument-impl-policy=USE-ARGUMENT-TYPE
      CAN_RequestCommunication: possible-error=TI_ComMExt/E_NOT_OK
        arg Channel: type=UInt8, direction=IN, server-argument-impl-policy=USE-ARGUMENT-TYPE
      GetBusOffStatus: possible-error=TI_ComMExt/E_NOT_OK
        arg Channel: type=UInt8, direction=IN, server-argument-impl-policy=USE-ARGUMENT-TYPE
        arg BusOffStatus: type=Boolean, direction=OUT, server-argument-impl-policy=USE-ARGUMENT-TYPE
      Get_MCAN_ERR_PIN_Status: possible-error=TI_ComMExt/E_NOT_OK
        arg fl_pin_status_BOOL: type=Boolean, direction=OUT, server-argument-impl-policy=USE-ARGUMENT-TYPE
      Init
    error E_NOT_OK: error-code=1
  client server interface if_CS_ComAbsRx
    9 x operation:
      RxCan_GetSignalValue: possible-error=if_CS_ComAbsRx/E_NOT_OK
        arg SignalId: type=tRxSignalId, direction=IN, server-argument-impl-policy=USE-ARGUMENT-TYPE
        arg pSignalValue: type=UInt8, direction=OUT, server-argument-impl-policy=USE-ARGUMENT-TYPE
        arg pSignalStatus: type=tRxSignalStatus, direction=OUT, server-argument-impl-policy=USE-ARGUMENT-TYPE
      RxCan_GetSignalValueU8Arr: possible-error=if_CS_ComAbsRx/E_NOT_OK
        4 x arg, all with server-argument-impl-policy=USE-ARGUMENT-TYPE:
          SignalId: type=tRxSignalId, direction=IN
          pSignalValue: type=UInt8, direction=OUT
          pSignalStatus: type=tRxSignalStatus, direction=OUT
          pSignalLength: type=UInt32, direction=OUT
      RxCan_SetSignalInitValue: possible-error=if_CS_ComAbsRx/E_NOT_OK
        arg SignalId: type=tRxSignalId, direction=IN, server-argument-impl-policy=USE-ARGUMENT-TYPE
        arg pSignalValue: type=UInt8, direction=OUT, server-argument-impl-policy=USE-ARGUMENT-TYPE
      RxCan_SetSignalInitValueU8Arr: possible-error=if_CS_ComAbsRx/E_NOT_OK
        arg SignalId: type=tRxSignalId, direction=IN, server-argument-impl-policy=USE-ARGUMENT-TYPE
        arg pSignaValue: type=UInt8, direction=OUT, server-argument-impl-policy=USE-ARGUMENT-TYPE
        arg pSignalLength: type=UInt32, direction=OUT, server-argument-impl-policy=USE-ARGUMENT-TYPE
      RxCan_SignalClearJustRcvdStatus
        arg SignalId: type=tRxSignalId, direction=IN, server-argument-impl-policy=USE-ARGUMENT-TYPE
      RxCan_SignalGetJustRcvdStatus
        arg SignalId: type=tRxSignalId, direction=IN, server-argument-impl-policy=USE-ARGUMENT-TYPE
        arg pJustRcvdStatus: type=tRxSignalJustRcvdStatus, direction=INOUT, server-argument-impl-policy=USE-ARGUMENT-TYPE
      RxCan_SignalInvalidProcessingControl
        arg SignalId: type=tRxSignalId, direction=IN, server-argument-impl-policy=USE-ARGUMENT-TYPE
        arg Status: type=Boolean, direction=IN, server-argument-impl-policy=USE-ARGUMENT-TYPE
      RxCan_SignalMissingProcessingControl
        arg SignalId: type=tRxSignalId, direction=IN, server-argument-impl-policy=USE-ARGUMENT-TYPE
        arg Status: type=Boolean, direction=IN, server-argument-impl-policy=USE-ARGUMENT-TYPE
      RxCan_SignalNRProcessingControl
        arg SignalId: type=tRxSignalId, direction=IN, server-argument-impl-policy=USE-ARGUMENT-TYPE
        arg Status: type=Boolean, direction=IN, server-argument-impl-policy=USE-ARGUMENT-TYPE
    error E_NOT_OK: error-code=1
  client server interface if_CS_ComAbsTx
    5 x operation:
      TxCan_ClearCanSignalTxConfirmation
        arg SignalId: type=tTxSignalId, direction=IN, server-argument-impl-policy=USE-ARGUMENT-TYPE
      TxCan_GetCanSignalTxConfirmation
        arg SignalId: type=tTxSignalId, direction=IN, server-argument-impl-policy=USE-ARGUMENT-TYPE
        arg pStatus: type=tTxSigConfirmStatus, direction=OUT, server-argument-impl-policy=USE-ARGUMENT-TYPE
      TxCan_SetSignalFromRetentionBuffer: possible-error=if_CS_ComAbsTx/E_NOT_OK
        arg SignalId: type=tTxSignalId, direction=IN, server-argument-impl-policy=USE-ARGUMENT-TYPE
      TxCan_SetSignalValue: possible-error=if_CS_ComAbsTx/E_NOT_OK
        arg SignalId: type=tTxSignalId, direction=IN, server-argument-impl-policy=USE-ARGUMENT-TYPE
        arg pTxSignalData: type=UInt8, direction=INOUT, server-argument-impl-policy=USE-ARGUMENT-TYPE
      TxCan_SetSignalValueU8Arr: possible-error=if_CS_ComAbsTx/E_NOT_OK
        arg SignalId: type=tTxSignalId, direction=IN, server-argument-impl-policy=USE-ARGUMENT-TYPE
        arg pTxSignalData: type=UInt8, direction=INOUT, server-argument-impl-policy=USE-ARGUMENT-TYPE
        arg SignalLength: type=UInt32, direction=IN, server-argument-impl-policy=USE-ARGUMENT-TYPE
    error E_NOT_OK: error-code=1
  66 x sender receiver interface:
    if_SR_TxBattery_Voltage
      data Battery_Voltage: type=UInt8
    if_SR_TxDebug1_Byte0
      data Debug1_Byte0: type=UInt8
    if_SR_TxDebug1_Byte1
      data Debug1_Byte1: type=UInt8
    if_SR_TxDebug1_Byte2
      data Debug1_Byte2: type=UInt8
    if_SR_TxDebug1_Byte3
      data Debug1_Byte3: type=UInt8
    if_SR_TxDebug1_Byte4
      data Debug1_Byte4: type=UInt8
    if_SR_TxDebug1_Byte5
      data Debug1_Byte5: type=UInt8
    if_SR_TxDebug1_Byte6
      data Debug1_Byte6: type=UInt8
    if_SR_TxDebug1_Byte7
      data Debug1_Byte7: type=UInt8
    if_SR_TxDebug2_Byte0
      data Debug2_Byte0: type=UInt8
    if_SR_TxDebug2_Byte1
      data Debug2_Byte1: type=UInt8
    if_SR_TxDebug2_Byte2
      data Debug2_Byte2: type=UInt8
    if_SR_TxDebug2_Byte3
      data Debug2_Byte3: type=UInt8
    if_SR_TxDebug2_Byte4
      data Debug2_Byte4: type=UInt8
    if_SR_TxDebug2_Byte5
      data Debug2_Byte5: type=UInt8
    if_SR_TxDebug2_Byte6
      data Debug2_Byte6: type=UInt8
    if_SR_TxDebug2_Byte7
      data Debug2_Byte7: type=UInt8
    if_SR_TxDebug3_Byte0
      data Debug3_Byte0: type=UInt8
    if_SR_TxDebug3_Byte1
      data Debug3_Byte1: type=UInt8
    if_SR_TxDebug3_Byte2
      data Debug3_Byte2: type=UInt8
    if_SR_TxDebug3_Byte3
      data Debug3_Byte3: type=UInt8
    if_SR_TxDebug3_Byte4
      data Debug3_Byte4: type=UInt8
    if_SR_TxDebug3_Byte5
      data Debug3_Byte5: type=UInt8
    if_SR_TxDebug3_Byte6
      data Debug3_Byte6: type=UInt8
    if_SR_TxDebug3_Byte7
      data Debug3_Byte7: type=UInt8
    if_SR_TxDebug4_Byte0
      data Debug4_Byte0: type=UInt8
    if_SR_TxDebug4_Byte1
      data Debug4_Byte1: type=UInt8
    if_SR_TxDebug4_Byte2
      data Debug4_Byte2: type=UInt8
    if_SR_TxDebug4_Byte3
      data Debug4_Byte3: type=UInt8
    if_SR_TxDebug4_Byte4
      data Debug4_Byte4: type=UInt8
    if_SR_TxDebug4_Byte5
      data Debug4_Byte5: type=UInt8
    if_SR_TxDebug4_Byte6
      data Debug4_Byte6: type=UInt8
    if_SR_TxDebug4_Byte7
      data Debug4_Byte7: type=UInt8
    if_SR_TxDebug5_Byte0
      data Debug5_Byte0: type=UInt8
    if_SR_TxDebug5_Byte1
      data Debug5_Byte1: type=UInt8
    if_SR_TxDebug5_Byte2
      data Debug5_Byte2: type=UInt8
    if_SR_TxDebug5_Byte3
      data Debug5_Byte3: type=UInt8
    if_SR_TxDebug5_Byte4
      data Debug5_Byte4: type=UInt8
    if_SR_TxDebug5_Byte5
      data Debug5_Byte5: type=UInt8
    if_SR_TxDebug5_Byte6
      data Debug5_Byte6: type=UInt8
    if_SR_TxDebug5_Byte7
      data Debug5_Byte7: type=UInt8
    if_SR_TxFV_Tx
      data FV_Tx: type=UInt8
    if_SR_TxIllumination_PWM
      data Illumination_PWM: type=UInt8
    if_SR_TxMAC_Tx
      data MAC_Tx: type=UInt32
    if_SR_TxOdometer
      data Odometer: type=UInt32
    if_SR_TxSecureTxByte0
      data SecureTxByte0: type=UInt8
    if_SR_TxSecureTxByte1
      data SecureTxByte1: type=UInt8
    if_SR_TxSecureTxByte2
      data SecureTxByte2: type=UInt8
    if_SR_TxSecureTxByte3
      data SecureTxByte3: type=UInt8
    if_SR_TxVehicleSpeedIC
      data VehicleSpeedIC: type=UInt16
    if_SR_RxAirbag
      data Airbag: type=UInt8
    if_SR_RxAmbient_Light_level
      data Ambient_Light_level: type=UInt8
    if_SR_RxDayNightMode
      data DayNightMode: type=UInt8
    if_SR_RxEngineSpeed
      data EngineSpeed: type=UInt16
    if_SR_RxGear
      data Gear: type=UInt8
    if_SR_RxGearMode
      data GearMode: type=UInt8
    if_SR_RxGearRecommendation
      data GearRecommendation: type=UInt8
    if_SR_RxGearStatus
      data GearStatus: type=UInt8
    if_SR_RxIllumination_level
      data Illumination_level: type=UInt8
    if_SR_RxPowerMode
      data PowerMode: type=UInt8
    if_SR_RxTransportMode
      data TransportMode: type=UInt8
    if_SR_RxVehicleSpeedABS
      data VehicleSpeedABS: type=UInt16
    if_SR_RxWarning
      data Warning: type=UInt8
    TITelltaleBlinkStatusArray
      data TTBlinkStatusArray: type=TTBlinkArray
      data TTdummyDataForTypes: type=TTFlashMask
    TIGetTelltaleStatus
      data TelltaleFunctionalOpStatus: type=TT_OP_Type
    TITelltaleStatusOutput
      data TelltaleOpArray: type=TT_OP_Type
  client server interface TI_SafeInit
    operation Init
  13 x sender receiver interface:
    TI_UiETMEnterBulbTestMode
      data CurrentBulbTestStatus: type=BulbTestStatus
    TI_SR_HMIReadyStatus
      data HMI_ReadyStatus: type=HMIReadySts_Type
    TI_IgnBlankOutCheck
      data IgnBlankOutCheck: type=TFTIgnBlankSts_T
    TI_WSS_IgnitionSubstate
      data IgnitionSubstate: type=IgntionSubstateType
    TI_TelltaleIndexStatus
      data TTIndex: type=TT_ENUM_TYPE
      data TTStatus: type=TT_OP_STATES
    TIUpdateTelltaleStatus
      data CurrentTelltaleStatus: type=TT_OP_STATES
    TI_WSS_ClusterMode
      data WSSCurrentClusterMode: type=ClusterModes
    TI_WSS_ACCMode
      data WSSAccState: type=ModeStatus
    TI_WSS_BAMode
      data WSSBaState: type=ModeStatus
    TI_WSS_BAOFMode
      data WSSBaOfState: type=ModeStatus
    TI_WSS_IgnitionBuzState
      data IgnitioBuznstate: type=IgntionSubstateType
    TI_WSS_IGP_CANMode
      data WSSIGPCANState: type=ModeStatus
    TI_WSS_IGPMode
      data WSSIGPState: type=ModeStatus
  client server interface TI_WSS_SWCAppSleepStatus
    operation SWCSleepStatus
      arg AppModule: type=eAppMdl, direction=IN, server-argument-impl-policy=USE-ARGUMENT-TYPE
      arg SleepStatus: type=eSleepSt, direction=IN, server-argument-impl-policy=USE-ARGUMENT-TYPE
  client server interface TI_WSS_SWC_EarlyWakeUpHandle
    operation SWCEarlyWakeUpHandle
  sender receiver interface TI_WSS_Init_ClusterMode
    data WSSCurrentClusterInitMode: type=ClusterInitModes
  client server interface TI_WSS_SleepOperations
    operation CtrlWSS_CancelSleep: possible-error=TI_WSS_SleepOperations/E_NOT_OK
    operation CtrlWSS_ReadytoSleep: possible-error=TI_WSS_SleepOperations/E_NOT_OK
    operation CtrlWSS_RequestSleep: possible-error=TI_WSS_SleepOperations/E_NOT_OK
    error E_NOT_OK: error-code=1
  sender receiver interface TI_Sleep_Ready_Status
    data Sleep_Status: type=SleepType
  sender receiver interface TI_TFTDisplayOn
    data TFTDisplayOn: type=DisplayStatus
  sender receiver interface TI_TFTDisplayOnExTurn
    data TFTDisplayOnExTurn: type=DisplayStatus
  client server interface TI_Variant_Status
    operation GetVariant_Status
      arg Variant_Ind: type=UInt8, direction=IN, server-argument-impl-policy=USE-ARGUMENT-TYPE
      arg Variant_Status: type=UInt8, direction=OUT, server-argument-impl-policy=USE-ARGUMENT-TYPE
  9 x sender receiver interface:
    TI_WSS_VehAppMode
      data WSSCurrentVehicleState: type=VehicleActiveModes
    TI_FuelLid_Status
      data FuelLidStatus: sw-impl-policy=QUEUED, type=BOOL_TYPE
    TI_Hazard_Status
      data HazardStatus: sw-impl-policy=QUEUED, type=BOOL_TYPE
    if_SR_EcuAppM_phase1readcompleted_dummy
      data PhasedRead_Status_phase1readcompleted: type=Boolean
    if_SR_EcuAppM_phase2readcompleted_dummy
      data PhasedRead_Status_phase2readcompleted: type=Boolean
    TI_SR_HMI_Odo_Type
      data HMI_OdoType: type=HMI_Odo_Type
    TI_SR_HMIScreenMode
      data HMIScreenMode_Status: type=HMI_Screen_Mode
    TI_HeadLamp_Status
      data Head_Lamp_st: type=UInt8
    TI_DayNightStatus
      data illumDNStatus: type=UInt8
  client server interface TI_EcumExtInit
    operation Init
  23 x sender receiver interface:
    TI_SR_PWMOut_TC_Dbc
      data PWMOut_TC_Dbc: type=UInt8
    TI_SR_ShiftPositionDisplay
      data ShiftPositionDisplay: type=UInt8
    TI_TailLight_Status
      data Tail_Light_st: type=UInt8
    TI_SR_TurnHazard_TurnL_Status
      data LeftIndicatorSts: type=TurnStates
    TI_SR_TurnHazard_TurnR_Status
      data RightIndicatorSts: type=TurnStates
    TI_Illum_Transstep
      data Trans_Stepvlaue: type=UInt8
    TI_IlluminationDuty
      data DutyValue: type=UInt16
    TI_DayNightRequired
      data ilumDNRequired: type=UInt8
    TI_DimStepOutput
      data IllumStepValue: type=UInt8
    TI_RGBStepOutput
      data RGBStepValue: type=UInt16
    TI_RHDW_Dbc
      data RHDW_Dbc: type=UInt8
    TI_RHUP_Dbc
      data RHUP_Dbc: type=UInt8
    TI_RheoSw_Raw_Status
      data RawdataStatus: type=UInt8
    TI_RheoSwStatus
      data SwitchStatus: type=UInt8
    TI_RheostatDayStep
      data RheostatDayStep: type=UInt8
    TI_RheostatNightStep
      data RheostatNightStep: type=UInt8
    TI_RheostatONSStatus
      data RheostatONSStatus: type=UInt8
    TI_RheostatSwType
      data RheostatSwType: type=UInt8
    TI_SR_IllumRheostatONSTimer
      data Rheostat_OnSTime: type=UInt16
    TI_SR_Illum_StarterStatus
      data StarterStatus_Out: type=UInt8
    TI_SR_RheostatChange
      data RheoUpdateVal: type=UInt8
    TI_Etm_Illum_Sts
      data Illum_Status: type=UInt8
    TIEtm_Illumination_dummy
      data IllumStatus: type=UInt8
  client server interface TI_Ctrl_Warning_UpdateWarningStatus
    operation UpdateWarningStatus
      4 x arg, all with direction=IN, server-argument-impl-policy=USE-ARGUMENT-TYPE:
        WarningCurId: type=WarningId
        WarningCurStatus: type=WarningStatus
        WarningCurEvent: type=WarningEvent
        WarningPayload: type=UInt32
  sender receiver interface TI_Ctrl_Ready_to_sleep
    data Ready_to_Sleep: type=Boolean
  client server interface TI_PwmCurrent_Duty
    operation GetPwmCurrentDuty
      arg ChannelID: type=UInt8, direction=IN, server-argument-impl-policy=USE-ARGUMENT-TYPE
      arg Channel_Duty: type=UInt16, direction=OUT, server-argument-impl-policy=USE-ARGUMENT-TYPE
  sender receiver interface TI_SR_Dcm_AppStopNotification
    data AppId: type=IOCtrl_Type
  sender receiver interface TI_SR_Diag2F_Rheo
    data Diag_RheoStat: type=UInt8
  sender receiver interface TI_EcoRunPresenceFlag
    data EcoRunPresenceFlag: type=UInt8
  client server interface TI_MVC_Get_Variant_State_Dummy
    operation Get_Variant_Config_State
      arg VariantID: type=UInt8, direction=IN, server-argument-impl-policy=USE-ARGUMENT-TYPE
      arg VariantActiveSt: type=UInt8, direction=OUT, server-argument-impl-policy=USE-ARGUMENT-TYPE
  sender receiver interface TI_SR_IlumDayNightRequired
    data IlumDayNightRequired: type=UInt8
  sender receiver interface TI_SR_Day_Night_Status
    data Day_Night_Status: type=UInt8
  client server interface TI_Pwm_rate_status
    operation PWM_Rate_Status
      arg ChannelID: type=UInt8, direction=IN, server-argument-impl-policy=USE-ARGUMENT-TYPE
      arg Status: type=UInt16, direction=OUT, server-argument-impl-policy=USE-ARGUMENT-TYPE
  sender receiver interface TI_MVC_PowerTrain_State_Dummy
    data PowerTrain_Flag: type=UInt8
  client server interface TI_PwmWithTime
    operation GetPwmWithTime
      arg ChannelID: type=IoHwAb_PwmSignalIdType, direction=IN, server-argument-impl-policy=USE-ARGUMENT-TYPE
      arg TargetDuty: type=UInt16, direction=IN, server-argument-impl-policy=USE-ARGUMENT-TYPE
      arg TargetTime: type=UInt16, direction=IN, server-argument-impl-policy=USE-ARGUMENT-TYPE
  client server interface TI_PwmWithTimeExp
    operation GetPwmWithTimeExp
      arg ChannelID: type=IoHwAb_PwmSignalIdType, direction=IN, server-argument-impl-policy=USE-ARGUMENT-TYPE
      arg TargetDuty: type=UInt16, direction=IN, server-argument-impl-policy=USE-ARGUMENT-TYPE
      arg TargetTime: type=UInt16, direction=IN, server-argument-impl-policy=USE-ARGUMENT-TYPE
  sender receiver interface TI_StopPwmUpdate
    data channel_id: type=UInt8
  client server interface TI_PwmDirect
    operation GetPwmDirect
      arg ChannelID: type=IoHwAb_PwmSignalIdType, direction=IN, server-argument-impl-policy=USE-ARGUMENT-TYPE
      arg TargetDuty: type=UInt16, direction=IN, server-argument-impl-policy=USE-ARGUMENT-TYPE
  8 x sender receiver interface:
    TI_SR_UserID_Data
      data CurrentUserID: type=UserIdType
      data CustomizeReset: type=CustResetType
      data SettingResetResult: type=SettingResetResult_Type
    IlluminationData
      data IlluminationDataData: type=SIlluminationData
    TI_Ctrl_LL_Duty
      data ILL_Duty: type=UInt8
    TI_Ctrl_RGB_Dimming
      data RGB_Dimming: type=UInt8
    TI_Ctrl_Starter_Status
      data Starter_Status: type=Boolean
    TI_Pwm_LCD_BL_Dimming
      data BL_Dimming: type=UInt8
    TI_Ctrl_Day_Night_mode
      data Day_Night_mode_Ctrl: type=UInt8
    TI_CVS_EcoRunSystem_State_dummy
      data EcoRunSystem_Flag: type=UInt8
  11 x client server interface:
    TI_Ctrl_Warning_ActiveWarningStatus
      operation GetActiveWarningStatus
        arg CurrentWarning: type=WarningId, direction=IN, server-argument-impl-policy=USE-ARGUMENT-TYPE
        arg CurrentWarningStatus: type=ExtWarningData, direction=OUT, server-argument-impl-policy=USE-ARGUMENT-TYPE
    TI_Ctrl_Warning_UpdateExtdPayload
      operation UpdateExtdPayload
        arg WarningCurId: type=WarningId, direction=IN, server-argument-impl-policy=USE-ARGUMENT-TYPE
        arg WarningPayload: type=PayloadArr_u8_8, direction=IN, server-argument-impl-policy=USE-ARGUMENT-TYPE
    TI_Ctrl_Warning_LampStatus
      operation Get_Red_MasterLamp_Status
        arg LampStatus: type=UInt8, direction=OUT, server-argument-impl-policy=USE-ARGUMENT-TYPE
      operation Get_Yellow_MasterLamp_Status
        arg LampStatus: type=UInt8, direction=OUT, server-argument-impl-policy=USE-ARGUMENT-TYPE
    TI_Ctrl_Warning_UpdateDisplayedPayload
      operation SetWarningDisplayedPayload
        arg CurWarningId: type=WarningId, direction=IN, server-argument-impl-policy=USE-ARGUMENT-TYPE
        arg CurWarningDispPayload: type=PayloadArr_u8_8, direction=IN, server-argument-impl-policy=USE-ARGUMENT-TYPE
    TI_Ctrl_Warning_UpdateDisplayedStatus
      operation SetWarningDisplayedStatus
        arg CurWarningId: type=WarningId, direction=IN, server-argument-impl-policy=USE-ARGUMENT-TYPE
        arg CurWarningDispStatus: type=WarningDisplayedStatus, direction=IN, server-argument-impl-policy=USE-ARGUMENT-TYPE
    TI_Ctrl_WarningActiveStatus
      operation GetWarningActiveStatus
        arg CurrentWarning: type=WarningId, direction=IN, server-argument-impl-policy=USE-ARGUMENT-TYPE
        arg CurrentWarningStatus: type=WarningDataS, direction=OUT, server-argument-impl-policy=USE-ARGUMENT-TYPE
    TI_Ctrl_WarningDisplayedPayload
      operation GetWarningDisplayedPayload
        arg CurWarningId: type=WarningId, direction=IN, server-argument-impl-policy=USE-ARGUMENT-TYPE
        arg DisplayedPayload: type=PayloadArr_u8_8, direction=OUT, server-argument-impl-policy=USE-ARGUMENT-TYPE
    TI_Ctrl_WarningDisplayedStatus
      operation GetWarningDisplayedStatus
        arg CurWarningId: type=WarningId, direction=IN, server-argument-impl-policy=USE-ARGUMENT-TYPE
        arg DisplayedStatus: type=WarningDisplayedStatus, direction=OUT, server-argument-impl-policy=USE-ARGUMENT-TYPE
    TI_CS_Warning_Group_Update
      operation Warning_Group_update
    TI_CS_GroupWarningAck
      operation GroupWrnAck
    TI_CS_SW_NoOperationTimer
      operation SW_NoOperationTimer
        arg pEvent: type=EButtonId, direction=IN, server-argument-impl-policy=USE-ARGUMENT-TYPE
        arg pEventType: type=EButtonSts, direction=IN, server-argument-impl-policy=USE-ARGUMENT-TYPE
  15 x sender receiver interface:
    HudWarningDisplay
      data HudWarningDisplayData: type=SHudWarningDisplay
    TpmsWarningData
      data TpmsWarningDataData: type=STpmsWarningData
    TI_SR_WarningHighInterrupt_State
      data WarningHighInterrupt_State: type=UInt8
    TI_SR_WarningInterrupt_State
      data WarningInterrupt_State: type=UInt8
    WarningDisplay
      data WarningDisplayData: type=SWarningDisplay
    TIChimeRequest_dummy
      data Chime_Request: type=EChimeID
    TIChimeCheckstatus_Dummy
      data Chime_Status: type=EChimeStatus
    TI_SR_FactoryMode
      data FactoryMode: type=UInt8
    TI_SR_FactoryModeStatus
      data FactoryModeStatus: type=UInt8
    TI_SR_HudWake_HW
      data WakeType_Hw: type=Hud_Wake_Type
    TI_SR_HudWake_Int
      data WakeType_Int: type=Hud_Wake_Type
    HudWarningStatus
      data HudWarningStatusData: type=SHudWarningStatus
    TI_CS_NVM_Adapter_GetNVM_HUD_CoordinateFlag_Dummy
      data NvmData: type=UInt8
    TI_SR_TPMS_Payload
      data Tpms_Payload: type=Tpms_Arr_u8_5
    TI_SR_TargetSw_BtnEvent
      data TargetSw: type=Target_SW_Status
  client server interface TI_CS_ButtonAction
    operation GetButtonStatus
      arg Warning: type=WarningId, direction=IN, server-argument-impl-policy=USE-ARGUMENT-TYPE
      arg ButtonEvent: type=UInt16, direction=IN, server-argument-impl-policy=USE-ARGUMENT-TYPE
      arg CursorSt: type=UInt8, direction=IN, server-argument-impl-policy=USE-ARGUMENT-TYPE
  10 x sender receiver interface:
    Warning_Status
      data WarningStatusData: type=SWarningStatus
    FastGaugeInfo
      data FastGaugeInfoData: type=SFastGaugeInfo
    ShiftPosIndStatus
      data ShiftPosIndStatusData: type=SShiftPosIndStatus
    SlowGaugeInfo
      data SlowGaugeInfoData: type=SSlowGuageInfo
    TT_Status
      data TT_StatusData: type=STT_Status
    TI_ShiftIndicator
      data ShiftModeIndicator: type=ShiftPositionInd
    TI_ShiftPosition
      data ShiftPosition: type=ShiftPosition
    TI_SR_Shiftpos_Data
      data ShiftPos_Data: type=ShiftposData_Type
    TIIndicatorStatusUpdt
      data TIUpdateIndicatorStatus: type=UInt8
    TI_SafetyAdapter_Ign_Substate
      data SafetyAdapter_Ign_Substate: type=IgntionSubstateType
  client server interface if_CS_ComAbsSafeRx
    7 x operation:
      Mdl_SafetyAdapter_ReloadMissingTimer
        arg SignalId: type=tRxSafeSignalId, direction=IN, server-argument-impl-policy=USE-ARGUMENT-TYPE
      RxCanVarInit
      RxCan_GetSafeSignalValue: possible-error=if_CS_ComAbsSafeRx/E_NOT_OK
        arg SignalId: type=tRxSafeSignalId, direction=IN, server-argument-impl-policy=USE-ARGUMENT-TYPE
        arg pSignalValue: type=UInt8, direction=OUT, server-argument-impl-policy=USE-ARGUMENT-TYPE
        arg pSignalStatus: type=tRxSafeSignalStatus, direction=OUT, server-argument-impl-policy=USE-ARGUMENT-TYPE
      RxCan_SetSignalInitValue: possible-error=if_CS_ComAbsSafeRx/E_NOT_OK
        arg SignalId: type=tRxSafeSignalId, direction=IN, server-argument-impl-policy=USE-ARGUMENT-TYPE
        arg pSignalValue: type=UInt8, direction=OUT, server-argument-impl-policy=USE-ARGUMENT-TYPE
      RxCan_SignalInvalidProcessingControl
        arg SignalId: type=tRxSafeSignalId, direction=IN, server-argument-impl-policy=USE-ARGUMENT-TYPE
        arg Status: type=Boolean, direction=IN, server-argument-impl-policy=USE-ARGUMENT-TYPE
      RxCan_SignalMissingProcessingControl
        arg SignalId: type=tRxSafeSignalId, direction=IN, server-argument-impl-policy=USE-ARGUMENT-TYPE
        arg Status: type=Boolean, direction=IN, server-argument-impl-policy=USE-ARGUMENT-TYPE
      RxCan_SignalNRProcessingControl
        arg SignalId: type=tRxSafeSignalId, direction=IN, server-argument-impl-policy=USE-ARGUMENT-TYPE
        arg Status: type=Boolean, direction=IN, server-argument-impl-policy=USE-ARGUMENT-TYPE
    error E_NOT_OK: error-code=1
  sender receiver interface TI_SafetyAdapter_AppMode
    data SafetyAdapter_AppMode: type=VehicleActiveModes
  sender receiver interface TI_SafetyAdapter_ClusterMode
    data SafetyAdapter_CurrentClusterMode: type=UInt8
  client server interface TI_SafetyAdapter_Just_Rxed_Status
    operation RxCan_SignalClearJustRcvdStatus
      arg SignalId: type=tRxSafeSignalId, direction=IN, server-argument-impl-policy=USE-ARGUMENT-TYPE
    operation RxCan_SignalGetJustRcvdStatus
      arg SignalId: type=tRxSafeSignalId, direction=IN, server-argument-impl-policy=USE-ARGUMENT-TYPE
      arg pJustRcvdStatus: type=tRxSafeSignalJustRcvdStatus, direction=INOUT, server-argument-impl-policy=USE-ARGUMENT-TYPE
  59 x sender receiver interface:
    TI_SafetyAdapter_VoltageMode
      data SafetyAdapter_HVSD1: type=UInt8
      data SafetyAdapter_LVSD1: type=UInt8
    if_SR_RxAB
      data AB: type=UInt8
    if_SR_RxABS_MID
      data ABS_MID: type=UInt8
    if_SR_RxBHEXIST
      data BHEXIST: type=UInt8
    if_SR_RxBRK_MID
      data BRK_MID: type=UInt8
    if_SR_RxB_ABS
      data B_ABS: type=UInt8
    if_SR_RxB_ALSD
      data B_ALSD: type=UInt8
    if_SR_RxB_BRKW
      data B_BRKW: type=UInt8
    if_SR_RxB_BRKW2
      data B_BRKW2: type=UInt8
    if_SR_RxB_BRLV
      data B_BRLV: type=UInt8
    if_SR_RxB_BRLV2
      data B_BRLV2: type=UInt8
    if_SR_RxB_BUZZE2
      data B_BUZZE2: type=UInt8
    if_SR_RxB_BUZZER
      data B_BUZZER: type=UInt8
    if_SR_RxB_CPKB
      data B_CPKB: type=UInt8
    if_SR_RxB_DACIND
      data B_DACIND: type=UInt8
    if_SR_RxB_DAINDC
      data B_DAINDC: type=UInt8
    if_SR_RxB_DAINDP
      data B_DAINDP: type=UInt8
    if_SR_RxB_EBW
      data B_EBW: type=UInt8
    if_SR_RxB_EBW2
      data B_EBW2: type=UInt8
    if_SR_RxB_EPBMID
      data B_EPBMID: type=UInt8
    if_SR_RxB_EPBWL
      data B_EPBWL: type=UInt8
    if_SR_RxB_PKBLP
      data B_PKBLP: type=UInt8
    if_SR_RxDBKLAB
      data DBKLAB: type=UInt8
    if_SR_RxEBW_MID
      data EBW_MID: type=UInt8
    if_SR_RxECBEXIST
      data ECBEXIST: type=UInt8
    if_SR_RxMCBW
      data MCBW: type=UInt8
    if_SR_RxPBKLAB
      data PBKLAB: type=UInt8
    if_SR_RxPWIINFO
      data PWIINFO: type=UInt8
    if_SR_RxSCSACCEL
      data SCSACCEL: type=UInt8
    if_SR_RxSCSBZR
      data SCSBZR: type=UInt8
    if_SR_RxSLP_WL
      data SLP_WL: type=UInt8
    if_SR_RxTRCCONFL
      data TRCCONFL: type=UInt8
    if_SR_RxTRCCONFR
      data TRCCONFR: type=UInt8
    if_SR_RxTRCCONRL
      data TRCCONRL: type=UInt8
    if_SR_RxTRCCONRR
      data TRCCONRR: type=UInt8
    if_SR_RxTRCOFF
      data TRCOFF: type=UInt8
    if_SR_RxVSCEXIST
      data VSCEXIST: type=UInt8
    if_SR_RxVSCOFF
      data VSCOFF: type=UInt8
    if_CS_SndCtrlVolumeRequest_dummy
      data UpdateChimeVolume: type=UInt8
    TI_CS_NVM_Adapter_GetNVM_FlashCustBuzzerSPL_Dummy
      data Nvmdata: type=UInt8
    TI_SR_Tacho_Analog_out
      data Analog_Tacho: type=UInt16
    TI_SR_Diag_Display_speed_Value
      data Diag_Digital_Speed_Value: type=UInt16
    TI_SR_Tacho_Digital_out
      data Digital_Tacho: type=UInt16
    TI_SR_Meter_DisplayDistanceUnit
      data DisplayUnit: type=UInt8
    TI_SR_DispSpeedA
      data DispSpeedVal: type=UInt16
    TI_Display_speed_Value
      data Digital_Speed_Value: type=UInt16
    TI_SR_Tacho_Needle_Transparent
      data Needle_TR: type=UInt8
    TI_SR_SubDisplaySpeed_Value
      data SubDispSpeedVal: type=UInt16
    TI_SR_Tacho_Unit
      data Digital_TachoUnit: type=Boolean
    TI_SR_Tacho_RED_Start_RPM
      data RED_Start_RPM: type=UInt8
    TI_SR_Tacho_RPM_MAX
      data REVP_RPM_MAX: type=UInt8
    TI_SR_SubSpeedUnitValue
      data SubSpeedunit: type=UInt8
    TI_SR_CountryCode_Func
      data CountryCode_Func: type=CountryCode_FuncType
    TI_SPD_SP1_In_Status
      data SP1_In_Status: type=UInt16
    TI_SPD_Selection_Table
      data Speed_Selection_Table: type=UInt8
    TI_SPD_Target2_Status
      data Spd_Target2_Status: type=UInt16
    TI_SPD_Target_Status
      data Spd_Target_Status: type=UInt16
    TI_SPD_Trim2_Status
      data Spd_Trim2_Status: type=UInt16
    TI_SPD_Trim_Status
      data Spd_Trim_Status: type=UInt16
  client server interface TI_CS_LinearInterpolation
    4 x operation:
      Get_LinearInterpolateByte
        arg ptr_table: type=UInt8, direction=OUT, server-argument-impl-policy=USE-ARGUMENT-TYPE
        arg lookupvalue: type=UInt8, direction=IN, server-argument-impl-policy=USE-ARGUMENT-TYPE
        arg Ptr_Lin_Return: type=UInt8, direction=OUT, server-argument-impl-policy=USE-ARGUMENT-TYPE
      Get_LinearInterpolateSByte
        arg ptr_table: type=SInt8, direction=OUT, server-argument-impl-policy=USE-ARGUMENT-TYPE
        arg lookupvalue: type=SInt8, direction=IN, server-argument-impl-policy=USE-ARGUMENT-TYPE
        arg Ptr_Lin_Return: type=SInt8, direction=OUT, server-argument-impl-policy=USE-ARGUMENT-TYPE
      Get_LinearInterpolateSWord
        arg ptr_table: type=SInt16, direction=OUT, server-argument-impl-policy=USE-ARGUMENT-TYPE
        arg lookupvalue: type=SInt16, direction=IN, server-argument-impl-policy=USE-ARGUMENT-TYPE
        arg Ptr_Lin_Return: type=SInt16, direction=OUT, server-argument-impl-policy=USE-ARGUMENT-TYPE
      Get_LinearInterpolateWord
        arg ptr_table: type=UInt16, direction=OUT, server-argument-impl-policy=USE-ARGUMENT-TYPE
        arg lookupvalue: type=UInt16, direction=IN, server-argument-impl-policy=USE-ARGUMENT-TYPE
        arg Ptr_Lin_Return: type=UInt16, direction=OUT, server-argument-impl-policy=USE-ARGUMENT-TYPE
  sender receiver interface TI_SR_CaculatedTachoValue
    data CalTachoValue: type=UInt16
  sender receiver interface TI_SR_Tacho_Revp_Disp
    data REVP_DISP: type=Boolean
  sender receiver interface TI_SR_Tacho_Revp_RPM
    data REVP_RPM: type=UInt16
  client server interface TI_CS_NE1_Notify
    operation NE1_Recieve_Notify_Value
      arg NE1_SignalVal: type=UInt16, direction=IN, server-argument-impl-policy=USE-ARGUMENT-TYPE
  11 x sender receiver interface:
    MainHMIReadyStatus
      data MainHMIReadyStatusData: sw-impl-policy=QUEUED, type=SMainHMIReadyStatus
    SafeHMIReadyStatus
      data SafeHMIReadyStatusData: sw-impl-policy=QUEUED, type=SSafeHMIReadyStatus
    UpdateShortServiceResp
      data UpdateShortServiceRespData: sw-impl-policy=QUEUED, type=SUpdateShortServiceResp
    WarningDisplayAvailable
      data WarningDisplayAvailableData: type=SWarningDisplayAvailable
    FRTT_Status
      data FRTT_StatusData: type=SFRTT_Status
    RTT_Icon
      data RTT_IconData: type=SRTT_Icon
    RTT_Status
      data RTT_StatusData: type=SRTT_Status
    RTT_Toggle
      data RTT_ToggleData: type=SRTT_Toggle
    UpdateLongServiceReq
      data UpdateLongServiceReqData: sw-impl-policy=QUEUED, type=SUpdateLongServiceReq
    UpdateShortServiceReq
      data UpdateShortServiceReqData: sw-impl-policy=QUEUED, type=SUpdateShortServiceReq
    WarningExtDisplay
      data WarningExtDisplayData: type=SWarningExtDisplay
  13 x client server interface:
    TI_UpdateCdd_GenericDIDRequestHandler
      operation UpdateCdd_GenericDIDRequestHandler: possible-error=TI_UpdateCdd_GenericDIDRequestHandler/E_NOT_OK
        7 x arg, all with server-argument-impl-policy=USE-ARGUMENT-TYPE:
          OpStatus: type=UInt8, direction=IN
          DID_Action: type=UInt8, direction=IN
          DID: type=UInt16, direction=IN
          ReqLength: type=UInt32, direction=IN
          Buff: type=UInt8, direction=IN
          ResLength: type=UInt32, direction=OUT
          ErrorCode: type=UInt8, direction=OUT
      error E_NOT_OK: error-code=1
    TI_UpdateCdd_GenericDownloadRequestHandler
      operation UpdateCdd_GenericDownloadRequestHandler: possible-error=TI_UpdateCdd_GenericDownloadRequestHandler/E_NOT_OK
        6 x arg, all with server-argument-impl-policy=USE-ARGUMENT-TYPE:
          OpStatus: type=UInt8, direction=IN
          DataFormatIdentifier: type=UInt8, direction=IN
          MemoryAddress: type=UInt32, direction=IN
          MemorySize: type=UInt32, direction=IN
          BlockLength: type=UInt32, direction=OUT
          ErrorCode: type=UInt8, direction=OUT
      error E_NOT_OK: error-code=1
    TI_UpdateCdd_GenericRIDRequestHandler
      operation UpdateCdd_GenericRIDRequestHandler: possible-error=TI_UpdateCdd_GenericRIDRequestHandler/E_NOT_OK
        7 x arg, all with server-argument-impl-policy=USE-ARGUMENT-TYPE:
          OpStatus: type=UInt8, direction=IN
          RID_Action: type=UInt8, direction=IN
          RID: type=UInt16, direction=IN
          ReqLength: type=UInt32, direction=IN
          Buff: type=UInt8, direction=OUT
          ResLength: type=UInt32, direction=OUT
          ErrorCode: type=UInt8, direction=OUT
      error E_NOT_OK: error-code=1
    TI_UpdateCdd_GenericTransferDataHandler
      operation UpdateCdd_GenericTransferDataHandler: possible-error=TI_UpdateCdd_GenericTransferDataHandler/E_NOT_OK
        6 x arg, all with server-argument-impl-policy=USE-ARGUMENT-TYPE:
          OpStatus: type=UInt8, direction=IN
          MemoryIdentifier: type=UInt8, direction=IN
          MemoryAddress: type=UInt32, direction=IN
          MemorySize: type=UInt32, direction=IN
          MemoryData: type=UInt8, direction=OUT
          ErrorCode: type=UInt8, direction=OUT
      error E_NOT_OK: error-code=1
    TI_UpdateCdd_GenericTransferExitHandler
      operation UpdateCdd_GenericTransferExitHandler: possible-error=TI_UpdateCdd_GenericTransferExitHandler/E_NOT_OK
        6 x arg, all with server-argument-impl-policy=USE-ARGUMENT-TYPE:
          OpStatus: type=UInt8, direction=IN
          RequestfParameterRecord: type=UInt8, direction=IN
          RequestParameterRecordSize: type=UInt32, direction=IN
          ResponseParameterRecord: type=UInt8, direction=OUT
          ResponseParameterRecordSize: type=UInt32, direction=OUT
          ErrorCode: type=UInt8, direction=OUT
      error E_NOT_OK: error-code=1
    TI_RstM_GetResetCount
      operation RstM_GetResetCount: possible-error=TI_RstM_GetResetCount/E_NOT_OK
        arg FaultId: type=eFltM_FaultIdType, direction=IN, server-argument-impl-policy=USE-ARGUMENT-TYPE
        arg count: type=UInt8, direction=OUT, server-argument-impl-policy=USE-ARGUMENT-TYPE
      error E_NOT_OK: error-code=1
    TI_RstM_RequestSwReset
      operation RstM_RequestSwReset: possible-error=TI_RstM_RequestSwReset/E_NOT_OK
        arg FaultId: type=eFltM_FaultIdType, direction=IN, server-argument-impl-policy=USE-ARGUMENT-TYPE
        arg LogData: type=UInt8, direction=OUT, server-argument-impl-policy=USE-ARGUMENT-TYPE
        arg LogLength: type=UInt16, direction=IN, server-argument-impl-policy=USE-ARGUMENT-TYPE
      error E_NOT_OK: error-code=1
    TI_RstM_ClearResetCounter
      operation RstM_ClearResetCounter: possible-error=TI_RstM_ClearResetCounter/E_NOT_OK
        arg FaultId: type=RstM_FaultIdType, direction=IN, server-argument-impl-policy=USE-ARGUMENT-TYPE
      error E_NOT_OK: error-code=1
    TI_RstM_ClearResetHistory
      operation RstM_ClearResetHistory: possible-error=TI_RstM_ClearResetHistory/E_NOT_OK
      error E_NOT_OK: error-code=1
    TI_RstM_GetLastResetReason
      operation RstM_GetLastResetReason: possible-error=TI_RstM_GetLastResetReason/E_NOT_OK
        arg pFaultId: type=eFltM_FaultIdType, direction=OUT, server-argument-impl-policy=USE-ARGUMENT-TYPE
      error E_NOT_OK: error-code=1
    TI_RstM_GetResetHistory
      operation RstM_GetResetHistory: possible-error=TI_RstM_GetResetHistory/E_NOT_OK
        arg ResetHistory: type=UInt8, direction=OUT, server-argument-impl-policy=USE-ARGUMENT-TYPE
      error E_NOT_OK: error-code=1
    tiCS_TI_FltM_HandlePostReset
      operation FltM_HandlePostReset
    tiCS_TI_FltM_ReportFault
      operation FltM_ReportFault: possible-error=tiCS_TI_FltM_ReportFault/E_NOT_OK
        arg faultId: type=FltM_FaultIdType, direction=IN, server-argument-impl-policy=USE-ARGUMENT-TYPE
        arg Status: type=UInt8, direction=IN, server-argument-impl-policy=USE-ARGUMENT-TYPE
      error E_NOT_OK: error-code=1
  sender receiver interface if_SR_RxAlive_101
    data Alive_101: type=UInt8
  sender receiver interface if_SR_RxCRC_101
    data CRC_101: type=UInt8
  client server interface TI_FltM_HandlePostReset
    operation FltM_HandlePostReset
  client server interface TI_FltM_ReportFault
    operation FltM_ReportFault: possible-error=TI_FltM_ReportFault/E_NOT_OK
      4 x arg, all with server-argument-impl-policy=USE-ARGUMENT-TYPE:
        FaultId: type=eFltM_FaultIdType, direction=IN
        FaultStatus: type=eFltM_FaultStatusType, direction=IN
        LogData: type=UInt8, direction=OUT
        LogLength: type=UInt16, direction=IN
    error E_NOT_OK: error-code=1
  client server interface if_CS_DltExt_GetResetInfo
    operation GetResetInfo: possible-error=if_CS_DltExt_GetResetInfo/E_NOT_OK
      arg ResetHistory: type=UInt8, direction=OUT, server-argument-impl-policy=USE-ARGUMENT-TYPE
    error E_NOT_OK: error-code=1
  sender receiver interface TI_ppSR_ComCallout
    data ABS0x102_Status: type=Boolean
  client server interface TI_FaultInjectionHandler
    operation FaultInjectionHandler: possible-error=TI_FaultInjectionHandler/E_NOT_OK
      arg StartStopData: type=UInt8, direction=IN, server-argument-impl-policy=USE-ARGUMENT-TYPE
      arg TestListID: type=UInt8, direction=IN, server-argument-impl-policy=USE-ARGUMENT-TYPE
      arg Data: type=UInt8, direction=OUT, server-argument-impl-policy=USE-ARGUMENT-TYPE
    error E_NOT_OK: error-code=1
  sender receiver interface TI_IllumCtrl_Ip
    data IllumCtrl_Ip_Data: type=IllumCtrl_Ip
  sender receiver interface TI_IllumCtrl_Op
    data IllumCtrl_Op_Data: type=IllumCtrl_Op
  sender receiver interface DiagResponse_Q
    data DiagResponseData: sw-impl-policy=QUEUED, type=SDiagResponse
  client server interface TI_UpdateCdd_GenericRequestDownloadHandler
    operation UpdateCdd_GenericRequestDownloadHandler: possible-error=TI_UpdateCdd_GenericRequestDownloadHandler/E_NOT_OK
      6 x arg, all with server-argument-impl-policy=USE-ARGUMENT-TYPE:
        OpStatus: type=UInt8, direction=IN
        DataFormatIdentifier: type=UInt8, direction=IN
        MemoryAddress: type=UInt32, direction=IN
        MemorySize: type=UInt32, direction=IN
        BlockLength: type=UInt32, direction=OUT
        ErrorCode: type=UInt8, direction=OUT
    error E_NOT_OK: error-code=1
  client server interface TI_FITDID
    operation CDD_FitManager_RouteFITDID: possible-error=TI_FITDID/E_NOT_OK
      arg Data: type=UInt8, direction=OUT, server-argument-impl-policy=USE-ARGUMENT-TYPE
      arg OpStatus: type=UInt8, direction=IN, server-argument-impl-policy=USE-ARGUMENT-TYPE
      arg pNrc: type=UInt8, direction=OUT, server-argument-impl-policy=USE-ARGUMENT-TYPE
    error E_NOT_OK: error-code=1
  sender receiver interface if_SR_PhasedRead_Status_phase1readcompleted
    data PhasedRead_Status_phase1readcompleted: type=Boolean
  sender receiver interface if_SR_PhasedRead_Status_phase2readcompleted
    data PhasedRead_Status_phase2readcompleted: type=Boolean
  client server interface if_CS_ComAbsRxSafe
    9 x operation:
      RxCan_GetSignalValue: possible-error=if_CS_ComAbsRxSafe/E_NOT_OK
        arg SignalId: type=tSafeRxSignalId, direction=IN, server-argument-impl-policy=USE-ARGUMENT-TYPE
        arg pSignalValue: type=UInt8, direction=OUT, server-argument-impl-policy=USE-ARGUMENT-TYPE
        arg pSignalStatus: type=tSafeRxSignalStatus, direction=OUT, server-argument-impl-policy=USE-ARGUMENT-TYPE
      RxCan_GetSignalValueU8Arr: possible-error=if_CS_ComAbsRxSafe/E_NOT_OK
        4 x arg, all with server-argument-impl-policy=USE-ARGUMENT-TYPE:
          SignalId: type=tSafeRxSignalId, direction=IN
          pSignalValue: type=UInt8, direction=OUT
          pSignalStatus: type=tSafeRxSignalStatus, direction=OUT
          pSignalLength: type=UInt32, direction=OUT
      RxCan_SetSignalInitValue: possible-error=if_CS_ComAbsRxSafe/E_NOT_OK
        arg SignalId: type=tSafeRxSignalId, direction=IN, server-argument-impl-policy=USE-ARGUMENT-TYPE
        arg pSignalValue: type=UInt8, direction=OUT, server-argument-impl-policy=USE-ARGUMENT-TYPE
      RxCan_SetSignalInitValueU8Arr: possible-error=if_CS_ComAbsRxSafe/E_NOT_OK
        arg SignalId: type=tSafeRxSignalId, direction=IN, server-argument-impl-policy=USE-ARGUMENT-TYPE
        arg pSignaValue: type=UInt8, direction=OUT, server-argument-impl-policy=USE-ARGUMENT-TYPE
        arg pSignalLength: type=UInt32, direction=OUT, server-argument-impl-policy=USE-ARGUMENT-TYPE
      RxCan_SignalClearJustRcvdStatus
        arg SignalId: type=tSafeRxSignalId, direction=IN, server-argument-impl-policy=USE-ARGUMENT-TYPE
      RxCan_SignalGetJustRcvdStatus
        arg SignalId: type=tSafeRxSignalId, direction=IN, server-argument-impl-policy=USE-ARGUMENT-TYPE
        arg pJustRcvdStatus: type=tSafeRxSignalJustRcvdStatus, direction=INOUT, server-argument-impl-policy=USE-ARGUMENT-TYPE
      RxCan_SignalInvalidProcessingControl
        arg SignalId: type=tSafeRxSignalId, direction=IN, server-argument-impl-policy=USE-ARGUMENT-TYPE
        arg Status: type=Boolean, direction=IN, server-argument-impl-policy=USE-ARGUMENT-TYPE
      RxCan_SignalMissingProcessingControl
        arg SignalId: type=tSafeRxSignalId, direction=IN, server-argument-impl-policy=USE-ARGUMENT-TYPE
        arg Status: type=Boolean, direction=IN, server-argument-impl-policy=USE-ARGUMENT-TYPE
      RxCan_SignalNRProcessingControl
        arg SignalId: type=tSafeRxSignalId, direction=IN, server-argument-impl-policy=USE-ARGUMENT-TYPE
        arg Status: type=Boolean, direction=IN, server-argument-impl-policy=USE-ARGUMENT-TYPE
    error E_NOT_OK: error-code=1
  client server interface if_CS_ComAbsTxSafe
    5 x operation:
      TxCan_ClearCanSignalTxConfirmation
        arg SignalId: type=tSafeTxSignalId, direction=IN, server-argument-impl-policy=USE-ARGUMENT-TYPE
      TxCan_GetCanSignalTxConfirmation
        arg SignalId: type=tSafeTxSignalId, direction=IN, server-argument-impl-policy=USE-ARGUMENT-TYPE
        arg pStatus: type=tTxSigConfirmStatus, direction=OUT, server-argument-impl-policy=USE-ARGUMENT-TYPE
      TxCan_SetSignalFromRetentionBuffer: possible-error=if_CS_ComAbsTxSafe/E_NOT_OK
        arg SignalId: type=tSafeTxSignalId, direction=IN, server-argument-impl-policy=USE-ARGUMENT-TYPE
      TxCan_SetSignalValue: possible-error=if_CS_ComAbsTxSafe/E_NOT_OK
        arg SignalId: type=tSafeTxSignalId, direction=IN, server-argument-impl-policy=USE-ARGUMENT-TYPE
        arg pTxSignalData: type=UInt8, direction=INOUT, server-argument-impl-policy=USE-ARGUMENT-TYPE
      TxCan_SetSignalValueU8Arr: possible-error=if_CS_ComAbsTxSafe/E_NOT_OK
        arg SignalId: type=tSafeTxSignalId, direction=IN, server-argument-impl-policy=USE-ARGUMENT-TYPE
        arg pTxSignalData: type=UInt8, direction=INOUT, server-argument-impl-policy=USE-ARGUMENT-TYPE
        arg SignalLength: type=UInt32, direction=IN, server-argument-impl-policy=USE-ARGUMENT-TYPE
    error E_NOT_OK: error-code=1
  sender receiver interface if_SR_PhasedRead_Status_phase3readcompleted
    data PhasedRead_Status_phase3readcompleted: type=Boolean
  client server interface TI_UpdateCdd_GenericProgSessionRequest
    operation UpdateCdd_GenericProgSessionRequest: possible-error=TI_UpdateCdd_GenericProgSessionRequest/E_NOT_OK
      arg ErrorCode: type=UInt8, direction=OUT, server-argument-impl-policy=USE-ARGUMENT-TYPE
    error E_NOT_OK: error-code=1
  4 x sender receiver interface:
    DLTControlMessageRequest
      data DLTControlMessageRequestData: type=SDLTControlMessageRequest
    DLTMessageReadAck
      data DLTMessageReadAckData: type=SDLTMessageReadAck
    DLTControlMessageReponse
      data DLTControlMessageReponseData: type=SDLTControlMessageReponse
    DLTMessageReadRequest
      data DLTMessageReadRequestData: type=SDLTMessageReadRequest
  4 x client server interface:
    TI_FltM_FlsIntegrity_GetStatus
      operation FltM_FlsIntegrity_GetStatus
        arg Status: type=eFltM_FlsIntegrityStatusType, direction=OUT, server-argument-impl-policy=USE-ARGUMENT-TYPE
    TI_WSS_SWCNotifySleepStatus
      operation CtrlWSS_NotifyNetworkSleep: possible-error=TI_WSS_SWCNotifySleepStatus/E_NOT_OK
        arg NotifyStatus: type=UInt8, direction=OUT, server-argument-impl-policy=USE-ARGUMENT-TYPE
      error E_NOT_OK: error-code=1
    TI_EcuBatteryMData
      operation EcuBatteryM_GetChannelStatus: possible-error=TI_EcuBatteryMData/E_NOT_OK
        arg Channel: type=UInt8, direction=IN, server-argument-impl-policy=USE-ARGUMENT-TYPE
        arg Status: type=UInt8, direction=OUT, server-argument-impl-policy=USE-ARGUMENT-TYPE
      operation EcuBatteryM_GetDIOStatus: possible-error=TI_EcuBatteryMData/E_NOT_OK
        arg InputId: type=UInt8, direction=IN, server-argument-impl-policy=USE-ARGUMENT-TYPE
        arg Status: type=UInt8, direction=OUT, server-argument-impl-policy=USE-ARGUMENT-TYPE
      error E_NOT_OK: error-code=1
    TI_SigCddCrc
      operation Impl_sig_get_win_crc_data
        arg p_sw_info: type=SIG_WIN_INFO_T, direction=IN, server-argument-impl-policy=USE-ARGUMENT-TYPE
        arg p_sw_crc_rgb: type=SIG_WIN_CRC_RGB_T, direction=OUT, server-argument-impl-policy=USE-ARGUMENT-TYPE
  sender receiver interface TI_SigCddSts
    data win_violation_output: type=UInt8
  sender receiver interface TI_SigData
    data sig0_port: type=SIG_WIN_SETUP_T
package /Predefined_DEV/PortInterfaces
  43 x client server interface:
    NvMNotifyInitBlock: is-service=true
      operation InitBlock
    NvSWC_NvMNotifyInitBlock
      operation InitBlock
    NvMAdministration: is-service=true
      operation SetBlockProtection: possible-error=NvMAdministration/E_NOT_OK
        arg ProtectionEnabled: type=Boolean, direction=IN, server-argument-impl-policy=USE-ARGUMENT-TYPE
      error E_NOT_OK: error-code=1
    NvSWC_NvMAdministration
      operation SetBlockProtection: possible-error=NvSWC_NvMAdministration/E_NOT_OK
        arg ProtectionEnabled: type=Boolean, direction=IN, server-argument-impl-policy=USE-ARGUMENT-TYPE
      error E_NOT_OK: error-code=1
    NvMService: is-service=true
      operation GetErrorStatus: possible-error=NvMService/E_NOT_OK
        arg ErrorStatus: type=NvM_RequestResultType, direction=OUT, server-argument-impl-policy=USE-ARGUMENT-TYPE
      error E_NOT_OK: error-code=1
    NvMService_AC2: is-service=true
      operation GetErrorStatus: possible-error=NvMService_AC2/E_NOT_OK
        arg ErrorStatus: type=NvM_RequestResultType, direction=OUT, server-argument-impl-policy=USE-ARGUMENT-TYPE
      operation ReadBlock: possible-error=NvMService_AC2/E_NOT_OK
        arg DstPtr: type=dtRef_VOID, direction=IN, server-argument-impl-policy=USE-ARGUMENT-TYPE
      operation WriteBlock: possible-error=NvMService_AC2/E_NOT_OK
        arg SrcPtr: type=dtRef_const_VOID, direction=IN, server-argument-impl-policy=USE-ARGUMENT-TYPE
      error E_NOT_OK: error-code=1
    NvMService_AC2_Defs: is-service=true
      4 x operation, all with possible-error=NvMService_AC2_Defs/E_NOT_OK:
        GetErrorStatus
          arg ErrorStatus: type=NvM_RequestResultType, direction=OUT, server-argument-impl-policy=USE-ARGUMENT-TYPE
        ReadBlock
          arg DstPtr: type=dtRef_VOID, direction=IN, server-argument-impl-policy=USE-ARGUMENT-TYPE
        RestoreBlockDefaults
          arg DstPtr: type=dtRef_VOID, direction=IN, server-argument-impl-policy=USE-ARGUMENT-TYPE
        WriteBlock
          arg SrcPtr: type=dtRef_const_VOID, direction=IN, server-argument-impl-policy=USE-ARGUMENT-TYPE
      error E_NOT_OK: error-code=1
    NvMService_AC2_DS: is-service=true
      5 x operation, all with possible-error=NvMService_AC2_DS/E_NOT_OK:
        GetDataIndex
          arg DataIndex: type=UInt8, direction=OUT, server-argument-impl-policy=USE-ARGUMENT-TYPE
        GetErrorStatus
          arg ErrorStatus: type=NvM_RequestResultType, direction=OUT, server-argument-impl-policy=USE-ARGUMENT-TYPE
        ReadBlock
          arg DstPtr: type=dtRef_VOID, direction=IN, server-argument-impl-policy=USE-ARGUMENT-TYPE
        SetDataIndex
          arg DataIndex: type=UInt8, direction=IN, server-argument-impl-policy=USE-ARGUMENT-TYPE
        WriteBlock
          arg SrcPtr: type=dtRef_const_VOID, direction=IN, server-argument-impl-policy=USE-ARGUMENT-TYPE
      error E_NOT_OK: error-code=1
    NvMService_AC2_DS_Defs: is-service=true
      6 x operation, all with possible-error=NvMService_AC2_DS_Defs/E_NOT_OK:
        GetDataIndex
          arg DataIndex: type=UInt8, direction=OUT, server-argument-impl-policy=USE-ARGUMENT-TYPE
        GetErrorStatus
          arg ErrorStatus: type=NvM_RequestResultType, direction=OUT, server-argument-impl-policy=USE-ARGUMENT-TYPE
        ReadBlock
          arg DstPtr: type=dtRef_VOID, direction=IN, server-argument-impl-policy=USE-ARGUMENT-TYPE
        RestoreBlockDefaults
          arg DstPtr: type=dtRef_VOID, direction=IN, server-argument-impl-policy=USE-ARGUMENT-TYPE
        SetDataIndex
          arg DataIndex: type=UInt8, direction=IN, server-argument-impl-policy=USE-ARGUMENT-TYPE
        WriteBlock
          arg SrcPtr: type=dtRef_const_VOID, direction=IN, server-argument-impl-policy=USE-ARGUMENT-TYPE
      error E_NOT_OK: error-code=1
    NvMService_AC2_SRBS: is-service=true
      4 x operation, all with possible-error=NvMService_AC2_SRBS/E_NOT_OK:
        GetErrorStatus
          arg ErrorStatus: type=NvM_RequestResultType, direction=OUT, server-argument-impl-policy=USE-ARGUMENT-TYPE
        ReadBlock
          arg DstPtr: type=dtRef_VOID, direction=IN, server-argument-impl-policy=USE-ARGUMENT-TYPE
        SetRamBlockStatus
          arg RamBlockStatus: type=Boolean, direction=IN, server-argument-impl-policy=USE-ARGUMENT-TYPE
        WriteBlock
          arg SrcPtr: type=dtRef_const_VOID, direction=IN, server-argument-impl-policy=USE-ARGUMENT-TYPE
      error E_NOT_OK: error-code=1
    NvMService_AC2_SRBS_Defs: is-service=true
      5 x operation, all with possible-error=NvMService_AC2_SRBS_Defs/E_NOT_OK:
        GetErrorStatus
          arg ErrorStatus: type=NvM_RequestResultType, direction=OUT, server-argument-impl-policy=USE-ARGUMENT-TYPE
        ReadBlock
          arg DstPtr: type=dtRef_VOID, direction=IN, server-argument-impl-policy=USE-ARGUMENT-TYPE
        RestoreBlockDefaults
          arg DstPtr: type=dtRef_VOID, direction=IN, server-argument-impl-policy=USE-ARGUMENT-TYPE
        SetRamBlockStatus
          arg RamBlockStatus: type=Boolean, direction=IN, server-argument-impl-policy=USE-ARGUMENT-TYPE
        WriteBlock
          arg SrcPtr: type=dtRef_const_VOID, direction=IN, server-argument-impl-policy=USE-ARGUMENT-TYPE
      error E_NOT_OK: error-code=1
    NvMService_AC2_SRBS_DS: is-service=true
      6 x operation, all with possible-error=NvMService_AC2_SRBS_DS/E_NOT_OK:
        GetDataIndex
          arg DataIndex: type=UInt8, direction=OUT, server-argument-impl-policy=USE-ARGUMENT-TYPE
        GetErrorStatus
          arg ErrorStatus: type=NvM_RequestResultType, direction=OUT, server-argument-impl-policy=USE-ARGUMENT-TYPE
        ReadBlock
          arg DstPtr: type=dtRef_VOID, direction=IN, server-argument-impl-policy=USE-ARGUMENT-TYPE
        SetDataIndex
          arg DataIndex: type=UInt8, direction=IN, server-argument-impl-policy=USE-ARGUMENT-TYPE
        SetRamBlockStatus
          arg RamBlockStatus: type=Boolean, direction=IN, server-argument-impl-policy=USE-ARGUMENT-TYPE
        WriteBlock
          arg SrcPtr: type=dtRef_const_VOID, direction=IN, server-argument-impl-policy=USE-ARGUMENT-TYPE
      error E_NOT_OK: error-code=1
    NvMService_AC2_SRBS_DS_Defs: is-service=true
      7 x operation, all with possible-error=NvMService_AC2_SRBS_DS_Defs/E_NOT_OK:
        GetDataIndex
          arg DataIndex: type=UInt8, direction=OUT, server-argument-impl-policy=USE-ARGUMENT-TYPE
        GetErrorStatus
          arg ErrorStatus: type=NvM_RequestResultType, direction=OUT, server-argument-impl-policy=USE-ARGUMENT-TYPE
        ReadBlock
          arg DstPtr: type=dtRef_VOID, direction=IN, server-argument-impl-policy=USE-ARGUMENT-TYPE
        RestoreBlockDefaults
          arg DstPtr: type=dtRef_VOID, direction=IN, server-argument-impl-policy=USE-ARGUMENT-TYPE
        SetDataIndex
          arg DataIndex: type=UInt8, direction=IN, server-argument-impl-policy=USE-ARGUMENT-TYPE
        SetRamBlockStatus
          arg RamBlockStatus: type=Boolean, direction=IN, server-argument-impl-policy=USE-ARGUMENT-TYPE
        WriteBlock
          arg SrcPtr: type=dtRef_const_VOID, direction=IN, server-argument-impl-policy=USE-ARGUMENT-TYPE
      error E_NOT_OK: error-code=1
    NvMService_AC3: is-service=true
      5 x operation, all with possible-error=NvMService_AC3/E_NOT_OK:
        EraseBlock
        GetErrorStatus
          arg ErrorStatus: type=NvM_RequestResultType, direction=OUT, server-argument-impl-policy=USE-ARGUMENT-TYPE
        InvalidateNvBlock
        ReadBlock
          arg DstPtr: type=dtRef_VOID, direction=IN, server-argument-impl-policy=USE-ARGUMENT-TYPE
        WriteBlock
          arg SrcPtr: type=dtRef_const_VOID, direction=IN, server-argument-impl-policy=USE-ARGUMENT-TYPE
      error E_NOT_OK: error-code=1
    NvMService_AC3_Defs: is-service=true
      6 x operation, all with possible-error=NvMService_AC3_Defs/E_NOT_OK:
        EraseBlock
        GetErrorStatus
          arg ErrorStatus: type=NvM_RequestResultType, direction=OUT, server-argument-impl-policy=USE-ARGUMENT-TYPE
        InvalidateNvBlock
        ReadBlock
          arg DstPtr: type=dtRef_VOID, direction=IN, server-argument-impl-policy=USE-ARGUMENT-TYPE
        RestoreBlockDefaults
          arg DstPtr: type=dtRef_VOID, direction=IN, server-argument-impl-policy=USE-ARGUMENT-TYPE
        WriteBlock
          arg SrcPtr: type=dtRef_const_VOID, direction=IN, server-argument-impl-policy=USE-ARGUMENT-TYPE
      error E_NOT_OK: error-code=1
    NvMService_AC3_DS: is-service=true
      7 x operation, all with possible-error=NvMService_AC3_DS/E_NOT_OK:
        EraseBlock
        GetDataIndex
          arg DataIndex: type=UInt8, direction=OUT, server-argument-impl-policy=USE-ARGUMENT-TYPE
        GetErrorStatus
          arg ErrorStatus: type=NvM_RequestResultType, direction=OUT, server-argument-impl-policy=USE-ARGUMENT-TYPE
        InvalidateNvBlock
        ReadBlock
          arg DstPtr: type=dtRef_VOID, direction=IN, server-argument-impl-policy=USE-ARGUMENT-TYPE
        SetDataIndex
          arg DataIndex: type=UInt8, direction=IN, server-argument-impl-policy=USE-ARGUMENT-TYPE
        WriteBlock
          arg SrcPtr: type=dtRef_const_VOID, direction=IN, server-argument-impl-policy=USE-ARGUMENT-TYPE
      error E_NOT_OK: error-code=1
    NvMService_AC3_DS_Defs: is-service=true
      8 x operation, all with possible-error=NvMService_AC3_DS_Defs/E_NOT_OK:
        EraseBlock
        GetDataIndex
          arg DataIndex: type=UInt8, direction=OUT, server-argument-impl-policy=USE-ARGUMENT-TYPE
        GetErrorStatus
          arg ErrorStatus: type=NvM_RequestResultType, direction=OUT, server-argument-impl-policy=USE-ARGUMENT-TYPE
        InvalidateNvBlock
        ReadBlock
          arg DstPtr: type=dtRef_VOID, direction=IN, server-argument-impl-policy=USE-ARGUMENT-TYPE
        RestoreBlockDefaults
          arg DstPtr: type=dtRef_VOID, direction=IN, server-argument-impl-policy=USE-ARGUMENT-TYPE
        SetDataIndex
          arg DataIndex: type=UInt8, direction=IN, server-argument-impl-policy=USE-ARGUMENT-TYPE
        WriteBlock
          arg SrcPtr: type=dtRef_const_VOID, direction=IN, server-argument-impl-policy=USE-ARGUMENT-TYPE
      error E_NOT_OK: error-code=1
    NvMService_AC3_SRBS: is-service=true
      6 x operation, all with possible-error=NvMService_AC3_SRBS/E_NOT_OK:
        EraseBlock
        GetErrorStatus
          arg ErrorStatus: type=NvM_RequestResultType, direction=OUT, server-argument-impl-policy=USE-ARGUMENT-TYPE
        InvalidateNvBlock
        ReadBlock
          arg DstPtr: type=dtRef_VOID, direction=IN, server-argument-impl-policy=USE-ARGUMENT-TYPE
        SetRamBlockStatus
          arg RamBlockStatus: type=Boolean, direction=IN, server-argument-impl-policy=USE-ARGUMENT-TYPE
        WriteBlock
          arg SrcPtr: type=dtRef_const_VOID, direction=IN, server-argument-impl-policy=USE-ARGUMENT-TYPE
      error E_NOT_OK: error-code=1
    NvMService_AC3_SRBS_Defs: is-service=true
      7 x operation, all with possible-error=NvMService_AC3_SRBS_Defs/E_NOT_OK:
        EraseBlock
        GetErrorStatus
          arg ErrorStatus: type=NvM_RequestResultType, direction=OUT, server-argument-impl-policy=USE-ARGUMENT-TYPE
        InvalidateNvBlock
        ReadBlock
          arg DstPtr: type=dtRef_VOID, direction=IN, server-argument-impl-policy=USE-ARGUMENT-TYPE
        RestoreBlockDefaults
          arg DstPtr: type=dtRef_VOID, direction=IN, server-argument-impl-policy=USE-ARGUMENT-TYPE
        SetRamBlockStatus
          arg RamBlockStatus: type=Boolean, direction=IN, server-argument-impl-policy=USE-ARGUMENT-TYPE
        WriteBlock
          arg SrcPtr: type=dtRef_const_VOID, direction=IN, server-argument-impl-policy=USE-ARGUMENT-TYPE
      error E_NOT_OK: error-code=1
    NvMService_AC3_SRBS_DS: is-service=true
      8 x operation, all with possible-error=NvMService_AC3_SRBS_DS/E_NOT_OK:
        EraseBlock
        GetDataIndex
          arg DataIndex: type=UInt8, direction=OUT, server-argument-impl-policy=USE-ARGUMENT-TYPE
        GetErrorStatus
          arg ErrorStatus: type=NvM_RequestResultType, direction=OUT, server-argument-impl-policy=USE-ARGUMENT-TYPE
        InvalidateNvBlock
        ReadBlock
          arg DstPtr: type=dtRef_VOID, direction=IN, server-argument-impl-policy=USE-ARGUMENT-TYPE
        SetDataIndex
          arg DataIndex: type=UInt8, direction=IN, server-argument-impl-policy=USE-ARGUMENT-TYPE
        SetRamBlockStatus
          arg RamBlockStatus: type=Boolean, direction=IN, server-argument-impl-policy=USE-ARGUMENT-TYPE
        WriteBlock
          arg SrcPtr: type=dtRef_const_VOID, direction=IN, server-argument-impl-policy=USE-ARGUMENT-TYPE
      error E_NOT_OK: error-code=1
    NvMService_AC3_SRBS_DS_Defs: is-service=true
      9 x operation, all with possible-error=NvMService_AC3_SRBS_DS_Defs/E_NOT_OK:
        EraseBlock
        GetDataIndex
          arg DataIndex: type=UInt8, direction=OUT, server-argument-impl-policy=USE-ARGUMENT-TYPE
        GetErrorStatus
          arg ErrorStatus: type=NvM_RequestResultType, direction=OUT, server-argument-impl-policy=USE-ARGUMENT-TYPE
        InvalidateNvBlock
        ReadBlock
          arg DstPtr: type=dtRef_VOID, direction=IN, server-argument-impl-policy=USE-ARGUMENT-TYPE
        RestoreBlockDefaults
          arg DstPtr: type=dtRef_VOID, direction=IN, server-argument-impl-policy=USE-ARGUMENT-TYPE
        SetDataIndex
          arg DataIndex: type=UInt8, direction=IN, server-argument-impl-policy=USE-ARGUMENT-TYPE
        SetRamBlockStatus
          arg RamBlockStatus: type=Boolean, direction=IN, server-argument-impl-policy=USE-ARGUMENT-TYPE
        WriteBlock
          arg SrcPtr: type=dtRef_const_VOID, direction=IN, server-argument-impl-policy=USE-ARGUMENT-TYPE
      error E_NOT_OK: error-code=1
    NvMService_SRBS: is-service=true
      operation GetErrorStatus: possible-error=NvMService_SRBS/E_NOT_OK
        arg ErrorStatus: type=NvM_RequestResultType, direction=OUT, server-argument-impl-policy=USE-ARGUMENT-TYPE
      operation SetRamBlockStatus: possible-error=NvMService_SRBS/E_NOT_OK
        arg RamBlockStatus: type=Boolean, direction=IN, server-argument-impl-policy=USE-ARGUMENT-TYPE
      error E_NOT_OK: error-code=1
    NvSWC_NvMService
      operation GetErrorStatus: possible-error=NvSWC_NvMService/E_NOT_OK
        arg ErrorStatus: type=NvM_RequestResultType, direction=OUT, server-argument-impl-policy=USE-ARGUMENT-TYPE
      error E_NOT_OK: error-code=1
    NvSWC_NvMService_AC2
      operation GetErrorStatus: possible-error=NvSWC_NvMService_AC2/E_NOT_OK
        arg ErrorStatus: type=NvM_RequestResultType, direction=OUT, server-argument-impl-policy=USE-ARGUMENT-TYPE
      operation ReadBlock: possible-error=NvSWC_NvMService_AC2/E_NOT_OK
        arg DstPtr: type=dtRef_VOID, direction=IN, server-argument-impl-policy=USE-ARGUMENT-TYPE
      operation WriteBlock: possible-error=NvSWC_NvMService_AC2/E_NOT_OK
        arg SrcPtr: type=dtRef_const_VOID, direction=IN, server-argument-impl-policy=USE-ARGUMENT-TYPE
      error E_NOT_OK: error-code=1
    NvSWC_NvMService_AC2_Defs
      4 x operation, all with possible-error=NvSWC_NvMService_AC2_Defs/E_NOT_OK:
        GetErrorStatus
          arg ErrorStatus: type=NvM_RequestResultType, direction=OUT, server-argument-impl-policy=USE-ARGUMENT-TYPE
        ReadBlock
          arg DstPtr: type=dtRef_VOID, direction=IN, server-argument-impl-policy=USE-ARGUMENT-TYPE
        RestoreBlockDefaults
          arg DstPtr: type=dtRef_VOID, direction=IN, server-argument-impl-policy=USE-ARGUMENT-TYPE
        WriteBlock
          arg SrcPtr: type=dtRef_const_VOID, direction=IN, server-argument-impl-policy=USE-ARGUMENT-TYPE
      error E_NOT_OK: error-code=1
    NvSWC_NvMService_AC2_DS
      5 x operation, all with possible-error=NvSWC_NvMService_AC2_DS/E_NOT_OK:
        GetDataIndex
          arg DataIndex: type=UInt8, direction=OUT, server-argument-impl-policy=USE-ARGUMENT-TYPE
        GetErrorStatus
          arg ErrorStatus: type=NvM_RequestResultType, direction=OUT, server-argument-impl-policy=USE-ARGUMENT-TYPE
        ReadBlock
          arg DstPtr: type=dtRef_VOID, direction=IN, server-argument-impl-policy=USE-ARGUMENT-TYPE
        SetDataIndex
          arg DataIndex: type=UInt8, direction=IN, server-argument-impl-policy=USE-ARGUMENT-TYPE
        WriteBlock
          arg SrcPtr: type=dtRef_const_VOID, direction=IN, server-argument-impl-policy=USE-ARGUMENT-TYPE
      error E_NOT_OK: error-code=1
    NvSWC_NvMService_AC2_DS_Defs
      6 x operation, all with possible-error=NvSWC_NvMService_AC2_DS_Defs/E_NOT_OK:
        GetDataIndex
          arg DataIndex: type=UInt8, direction=OUT, server-argument-impl-policy=USE-ARGUMENT-TYPE
        GetErrorStatus
          arg ErrorStatus: type=NvM_RequestResultType, direction=OUT, server-argument-impl-policy=USE-ARGUMENT-TYPE
        ReadBlock
          arg DstPtr: type=dtRef_VOID, direction=IN, server-argument-impl-policy=USE-ARGUMENT-TYPE
        RestoreBlockDefaults
          arg DstPtr: type=dtRef_VOID, direction=IN, server-argument-impl-policy=USE-ARGUMENT-TYPE
        SetDataIndex
          arg DataIndex: type=UInt8, direction=IN, server-argument-impl-policy=USE-ARGUMENT-TYPE
        WriteBlock
          arg SrcPtr: type=dtRef_const_VOID, direction=IN, server-argument-impl-policy=USE-ARGUMENT-TYPE
      error E_NOT_OK: error-code=1
    NvSWC_NvMService_AC2_SRBS
      4 x operation, all with possible-error=NvSWC_NvMService_AC2_SRBS/E_NOT_OK:
        GetErrorStatus
          arg ErrorStatus: type=NvM_RequestResultType, direction=OUT, server-argument-impl-policy=USE-ARGUMENT-TYPE
        ReadBlock
          arg DstPtr: type=dtRef_VOID, direction=IN, server-argument-impl-policy=USE-ARGUMENT-TYPE
        SetRamBlockStatus
          arg RamBlockStatus: type=Boolean, direction=IN, server-argument-impl-policy=USE-ARGUMENT-TYPE
        WriteBlock
          arg SrcPtr: type=dtRef_const_VOID, direction=IN, server-argument-impl-policy=USE-ARGUMENT-TYPE
      error E_NOT_OK: error-code=1
    NvSWC_NvMService_AC2_SRBS_Defs
      5 x operation, all with possible-error=NvSWC_NvMService_AC2_SRBS_Defs/E_NOT_OK:
        GetErrorStatus
          arg ErrorStatus: type=NvM_RequestResultType, direction=OUT, server-argument-impl-policy=USE-ARGUMENT-TYPE
        ReadBlock
          arg DstPtr: type=dtRef_VOID, direction=IN, server-argument-impl-policy=USE-ARGUMENT-TYPE
        RestoreBlockDefaults
          arg DstPtr: type=dtRef_VOID, direction=IN, server-argument-impl-policy=USE-ARGUMENT-TYPE
        SetRamBlockStatus
          arg RamBlockStatus: type=Boolean, direction=IN, server-argument-impl-policy=USE-ARGUMENT-TYPE
        WriteBlock
          arg SrcPtr: type=dtRef_const_VOID, direction=IN, server-argument-impl-policy=USE-ARGUMENT-TYPE
      error E_NOT_OK: error-code=1
    NvSWC_NvMService_AC2_SRBS_DS
      6 x operation, all with possible-error=NvSWC_NvMService_AC2_SRBS_DS/E_NOT_OK:
        GetDataIndex
          arg DataIndex: type=UInt8, direction=OUT, server-argument-impl-policy=USE-ARGUMENT-TYPE
        GetErrorStatus
          arg ErrorStatus: type=NvM_RequestResultType, direction=OUT, server-argument-impl-policy=USE-ARGUMENT-TYPE
        ReadBlock
          arg DstPtr: type=dtRef_VOID, direction=IN, server-argument-impl-policy=USE-ARGUMENT-TYPE
        SetDataIndex
          arg DataIndex: type=UInt8, direction=IN, server-argument-impl-policy=USE-ARGUMENT-TYPE
        SetRamBlockStatus
          arg RamBlockStatus: type=Boolean, direction=IN, server-argument-impl-policy=USE-ARGUMENT-TYPE
        WriteBlock
          arg SrcPtr: type=dtRef_const_VOID, direction=IN, server-argument-impl-policy=USE-ARGUMENT-TYPE
      error E_NOT_OK: error-code=1
    NvSWC_NvMService_AC2_SRBS_DS_Defs
      7 x operation, all with possible-error=NvSWC_NvMService_AC2_SRBS_DS_Defs/E_NOT_OK:
        GetDataIndex
          arg DataIndex: type=UInt8, direction=OUT, server-argument-impl-policy=USE-ARGUMENT-TYPE
        GetErrorStatus
          arg ErrorStatus: type=NvM_RequestResultType, direction=OUT, server-argument-impl-policy=USE-ARGUMENT-TYPE
        ReadBlock
          arg DstPtr: type=dtRef_VOID, direction=IN, server-argument-impl-policy=USE-ARGUMENT-TYPE
        RestoreBlockDefaults
          arg DstPtr: type=dtRef_VOID, direction=IN, server-argument-impl-policy=USE-ARGUMENT-TYPE
        SetDataIndex
          arg DataIndex: type=UInt8, direction=IN, server-argument-impl-policy=USE-ARGUMENT-TYPE
        SetRamBlockStatus
          arg RamBlockStatus: type=Boolean, direction=IN, server-argument-impl-policy=USE-ARGUMENT-TYPE
        WriteBlock
          arg SrcPtr: type=dtRef_const_VOID, direction=IN, server-argument-impl-policy=USE-ARGUMENT-TYPE
      error E_NOT_OK: error-code=1
    NvSWC_NvMService_AC3
      5 x operation, all with possible-error=NvSWC_NvMService_AC3/E_NOT_OK:
        EraseBlock
        GetErrorStatus
          arg ErrorStatus: type=NvM_RequestResultType, direction=OUT, server-argument-impl-policy=USE-ARGUMENT-TYPE
        InvalidateNvBlock
        ReadBlock
          arg DstPtr: type=dtRef_VOID, direction=IN, server-argument-impl-policy=USE-ARGUMENT-TYPE
        WriteBlock
          arg SrcPtr: type=dtRef_const_VOID, direction=IN, server-argument-impl-policy=USE-ARGUMENT-TYPE
      error E_NOT_OK: error-code=1
    NvSWC_NvMService_AC3_Defs
      6 x operation, all with possible-error=NvSWC_NvMService_AC3_Defs/E_NOT_OK:
        EraseBlock
        GetErrorStatus
          arg ErrorStatus: type=NvM_RequestResultType, direction=OUT, server-argument-impl-policy=USE-ARGUMENT-TYPE
        InvalidateNvBlock
        ReadBlock
          arg DstPtr: type=dtRef_VOID, direction=IN, server-argument-impl-policy=USE-ARGUMENT-TYPE
        RestoreBlockDefaults
          arg DstPtr: type=dtRef_VOID, direction=IN, server-argument-impl-policy=USE-ARGUMENT-TYPE
        WriteBlock
          arg SrcPtr: type=dtRef_const_VOID, direction=IN, server-argument-impl-policy=USE-ARGUMENT-TYPE
      error E_NOT_OK: error-code=1
    NvSWC_NvMService_AC3_DS
      7 x operation, all with possible-error=NvSWC_NvMService_AC3_DS/E_NOT_OK:
        EraseBlock
        GetDataIndex
          arg DataIndex: type=UInt8, direction=OUT, server-argument-impl-policy=USE-ARGUMENT-TYPE
        GetErrorStatus
          arg ErrorStatus: type=NvM_RequestResultType, direction=OUT, server-argument-impl-policy=USE-ARGUMENT-TYPE
        InvalidateNvBlock
        ReadBlock
          arg DstPtr: type=dtRef_VOID, direction=IN, server-argument-impl-policy=USE-ARGUMENT-TYPE
        SetDataIndex
          arg DataIndex: type=UInt8, direction=IN, server-argument-impl-policy=USE-ARGUMENT-TYPE
        WriteBlock
          arg SrcPtr: type=dtRef_const_VOID, direction=IN, server-argument-impl-policy=USE-ARGUMENT-TYPE
      error E_NOT_OK: error-code=1
    NvSWC_NvMService_AC3_DS_Defs
      8 x operation, all with possible-error=NvSWC_NvMService_AC3_DS_Defs/E_NOT_OK:
        EraseBlock
        GetDataIndex
          arg DataIndex: type=UInt8, direction=OUT, server-argument-impl-policy=USE-ARGUMENT-TYPE
        GetErrorStatus
          arg ErrorStatus: type=NvM_RequestResultType, direction=OUT, server-argument-impl-policy=USE-ARGUMENT-TYPE
        InvalidateNvBlock
        ReadBlock
          arg DstPtr: type=dtRef_VOID, direction=IN, server-argument-impl-policy=USE-ARGUMENT-TYPE
        RestoreBlockDefaults
          arg DstPtr: type=dtRef_VOID, direction=IN, server-argument-impl-policy=USE-ARGUMENT-TYPE
        SetDataIndex
          arg DataIndex: type=UInt8, direction=IN, server-argument-impl-policy=USE-ARGUMENT-TYPE
        WriteBlock
          arg SrcPtr: type=dtRef_const_VOID, direction=IN, server-argument-impl-policy=USE-ARGUMENT-TYPE
      error E_NOT_OK: error-code=1
    NvSWC_NvMService_AC3_SRBS
      6 x operation, all with possible-error=NvSWC_NvMService_AC3_SRBS/E_NOT_OK:
        EraseBlock
        GetErrorStatus
          arg ErrorStatus: type=NvM_RequestResultType, direction=OUT, server-argument-impl-policy=USE-ARGUMENT-TYPE
        InvalidateNvBlock
        ReadBlock
          arg DstPtr: type=dtRef_VOID, direction=IN, server-argument-impl-policy=USE-ARGUMENT-TYPE
        SetRamBlockStatus
          arg RamBlockStatus: type=Boolean, direction=IN, server-argument-impl-policy=USE-ARGUMENT-TYPE
        WriteBlock
          arg SrcPtr: type=dtRef_const_VOID, direction=IN, server-argument-impl-policy=USE-ARGUMENT-TYPE
      error E_NOT_OK: error-code=1
    NvSWC_NvMService_AC3_SRBS_Defs
      7 x operation, all with possible-error=NvSWC_NvMService_AC3_SRBS_Defs/E_NOT_OK:
        EraseBlock
        GetErrorStatus
          arg ErrorStatus: type=NvM_RequestResultType, direction=OUT, server-argument-impl-policy=USE-ARGUMENT-TYPE
        InvalidateNvBlock
        ReadBlock
          arg DstPtr: type=dtRef_VOID, direction=IN, server-argument-impl-policy=USE-ARGUMENT-TYPE
        RestoreBlockDefaults
          arg DstPtr: type=dtRef_VOID, direction=IN, server-argument-impl-policy=USE-ARGUMENT-TYPE
        SetRamBlockStatus
          arg RamBlockStatus: type=Boolean, direction=IN, server-argument-impl-policy=USE-ARGUMENT-TYPE
        WriteBlock
          arg SrcPtr: type=dtRef_const_VOID, direction=IN, server-argument-impl-policy=USE-ARGUMENT-TYPE
      error E_NOT_OK: error-code=1
    NvSWC_NvMService_AC3_SRBS_DS
      8 x operation, all with possible-error=NvSWC_NvMService_AC3_SRBS_DS/E_NOT_OK:
        EraseBlock
        GetDataIndex
          arg DataIndex: type=UInt8, direction=OUT, server-argument-impl-policy=USE-ARGUMENT-TYPE
        GetErrorStatus
          arg ErrorStatus: type=NvM_RequestResultType, direction=OUT, server-argument-impl-policy=USE-ARGUMENT-TYPE
        InvalidateNvBlock
        ReadBlock
          arg DstPtr: type=dtRef_VOID, direction=IN, server-argument-impl-policy=USE-ARGUMENT-TYPE
        SetDataIndex
          arg DataIndex: type=UInt8, direction=IN, server-argument-impl-policy=USE-ARGUMENT-TYPE
        SetRamBlockStatus
          arg RamBlockStatus: type=Boolean, direction=IN, server-argument-impl-policy=USE-ARGUMENT-TYPE
        WriteBlock
          arg SrcPtr: type=dtRef_const_VOID, direction=IN, server-argument-impl-policy=USE-ARGUMENT-TYPE
      error E_NOT_OK: error-code=1
    NvSWC_NvMService_AC3_SRBS_DS_Defs
      9 x operation, all with possible-error=NvSWC_NvMService_AC3_SRBS_DS_Defs/E_NOT_OK:
        EraseBlock
        GetDataIndex
          arg DataIndex: type=UInt8, direction=OUT, server-argument-impl-policy=USE-ARGUMENT-TYPE
        GetErrorStatus
          arg ErrorStatus: type=NvM_RequestResultType, direction=OUT, server-argument-impl-policy=USE-ARGUMENT-TYPE
        InvalidateNvBlock
        ReadBlock
          arg DstPtr: type=dtRef_VOID, direction=IN, server-argument-impl-policy=USE-ARGUMENT-TYPE
        RestoreBlockDefaults
          arg DstPtr: type=dtRef_VOID, direction=IN, server-argument-impl-policy=USE-ARGUMENT-TYPE
        SetDataIndex
          arg DataIndex: type=UInt8, direction=IN, server-argument-impl-policy=USE-ARGUMENT-TYPE
        SetRamBlockStatus
          arg RamBlockStatus: type=Boolean, direction=IN, server-argument-impl-policy=USE-ARGUMENT-TYPE
        WriteBlock
          arg SrcPtr: type=dtRef_const_VOID, direction=IN, server-argument-impl-policy=USE-ARGUMENT-TYPE
      error E_NOT_OK: error-code=1
    NvSWC_NvMService_SRBS
      operation GetErrorStatus: possible-error=NvSWC_NvMService_SRBS/E_NOT_OK
        arg ErrorStatus: type=NvM_RequestResultType, direction=OUT, server-argument-impl-policy=USE-ARGUMENT-TYPE
      operation SetRamBlockStatus: possible-error=NvSWC_NvMService_SRBS/E_NOT_OK
        arg RamBlockStatus: type=Boolean, direction=IN, server-argument-impl-policy=USE-ARGUMENT-TYPE
      error E_NOT_OK: error-code=1
    NvMNotifyJobFinished: is-service=true
      operation JobFinished
        arg ServiceId: type=NvM_ServiceIdType, direction=IN, server-argument-impl-policy=USE-ARGUMENT-TYPE
        arg JobResult: type=NvM_RequestResultType, direction=IN, server-argument-impl-policy=USE-ARGUMENT-TYPE
    NvSWC_NvMNotifyJobFinished
      operation JobFinished
        arg ServiceId: type=NvM_ServiceIdType, direction=IN, server-argument-impl-policy=USE-ARGUMENT-TYPE
        arg JobResult: type=NvM_RequestResultType, direction=IN, server-argument-impl-policy=USE-ARGUMENT-TYPE
    CallbackDTCStatusChange: is-service=true, service-kind=DIAGNOSTIC-EVENT-MANAGER
      operation DTCStatusChanged: possible-error=CallbackDTCStatusChange/E_NOT_OK
        arg DTC: type=UInt32, direction=IN, server-argument-impl-policy=USE-ARGUMENT-TYPE
        arg DTCStatusOld: type=Dem_UdsStatusByteType, direction=IN, server-argument-impl-policy=USE-ARGUMENT-TYPE
        arg DTCStatusNew: type=Dem_UdsStatusByteType, direction=IN, server-argument-impl-policy=USE-ARGUMENT-TYPE
      error E_NOT_OK: error-code=1
package /ARRoot/If
  111 x nv data interface:
    SampleElement1
      nv-datas:
        data Value: type=Arr_u8_8
    SampleElement2
      nv-datas:
        data Value: type=Arr_u8_16
    BsConst_Audio_Element
      nv-datas:
        data Value: type=Arr_u8_128
    BsConst_Communication_Element
      nv-datas:
        data Value: type=Arr_u8_64
    BsConst_EngOffTimer_Element
      nv-datas:
        data Value: type=Arr_u8_32
    BsConst_FuelGauge_Element
      nv-datas:
        data Value: type=Arr_u8_128
    BsConst_Illumination_Element
      nv-datas:
        data Value: type=Arr_u8_128
    BsConst_OilGauge_Element
      nv-datas:
        data Value: type=Arr_u8_64
    BsConst_PowerGauge_Element
      nv-datas:
        data Value: type=Arr_u8_64
    BsConst_Power_Element
      nv-datas:
        data Value: type=Arr_u8_32
    BsConst_RealTimeClock_Element
      nv-datas:
        data Value: type=Arr_u8_48
    BsConst_ServiceReminder_Element
      nv-datas:
        data Value: type=Arr_u8_48
    BsConst_SpeedoGauge_Element
      nv-datas:
        data Value: type=Arr_u8_64
    BsConst_TachoGauge_Element
      nv-datas:
        data Value: type=Arr_u8_64
    BsConst_TempGauge_Element
      nv-datas:
        data Value: type=Arr_u8_64
    BsConst_TripComputer_Element
      nv-datas:
        data Value: type=Arr_u8_64
    BsConst_Warning_Element
      nv-datas:
        data Value: type=Arr_u8_64
    BsCys_Certicificate_Element
      nv-datas:
        data Value: type=Arr_u8_64
    BsDiag_Dtc_Element
      nv-datas:
        data Value: type=Arr_u8_2048
    BsDiag_ErrorRecord_Element
      nv-datas:
        data Value: type=Arr_u8_1024
    BsFuSa_Audio_Element
      nv-datas:
        data Value: type=Arr_u8_32
    BsFuSa_Communication_Element
      nv-datas:
        data Value: type=Arr_u8_16
    BsFuSa_Config_Element
      nv-datas:
        data Value: type=Arr_u8_16
    BsFuSa_Display_Element
      nv-datas:
        data Value: type=Arr_u8_64
    BsFuSa_Power_Element
      nv-datas:
        data Value: type=Arr_u8_48
    BsFuSa_Warning_Element
      nv-datas:
        data Value: type=Arr_u8_32
    BsFusa_Fota_Element
      nv-datas:
        data Value: type=Arr_u8_32
    BsReten_Audio_Element
      nv-datas:
        data Value: type=Arr_u8_100
    BsReten_Communication_Element
      nv-datas:
        data Value: type=Arr_u8_100
    BsReten_Display_Element
      nv-datas:
        data Value: type=Arr_u8_100
    BsReten_Gauges_Element
      nv-datas:
        data Value: type=Arr_u8_100
    BsReten_Illumination_Element
      nv-datas:
        data Value: type=Arr_u8_100
    BsReten_Odometer_Element
      nv-datas:
        data Value: type=Arr_u8_100
    BsReten_Personalization_Element
      nv-datas:
        data Value: type=Arr_u8_100
    BsReten_Power_Element
      nv-datas:
        data Value: type=Arr_u8_100
    BsReten_RealTimeClock_Element
      nv-datas:
        data Value: type=Arr_u8_100
    BsReten_Tripcomputer_Element
      nv-datas:
        data Value: type=Arr_u8_100
    BsReten_VisDlt_Element
      nv-datas:
        data Value: type=Arr_u8_256
    BsReten_Warning_Element
      nv-datas:
        data Value: type=Arr_u8_100
    BsRt_CusDlt_Element
      nv-datas:
        data Value: type=Arr_u8_128
    BsRt_FuelGauge_Element
      nv-datas:
        data Value: type=Arr_u8_32
    BsRt_Illumination_Element
      nv-datas:
        data Value: type=Arr_u8_100
    BsRt_Odometer_Element
      nv-datas:
        data Value: type=Arr_u8_128
    BsRt_OilGauge_Element
      nv-datas:
        data Value: type=Arr_u8_8
    BsRt_Personalization_Element
      nv-datas:
        data Value: type=Arr_u8_128
    BsRt_PowerGauge_Element
      nv-datas:
        data Value: type=Arr_u8_32
    BsRt_RealTimeClock_Element
      nv-datas:
        data Value: type=Arr_u8_48
    BsRt_SpeedoGauge_Element
      nv-datas:
        data Value: type=Arr_u8_8
    BsRt_TachoGauge_Element
      nv-datas:
        data Value: type=Arr_u8_16
    BsRt_TempGauge_Element
      nv-datas:
        data Value: type=Arr_u8_32
    BsRt_TripComputer_Element
      nv-datas:
        data Value: type=Arr_u8_64
    BsRt_Warning_Element
      nv-datas:
        data Value: type=Arr_u8_32
    BsShare_EcuPartNumber_Element
      nv-datas:
        data Value: type=Arr_u8_61
    BsShare_SwUpdFotaFinPrint_Element
      nv-datas:
        data Value: type=Arr_u8_32
    BsShare_SwUpdFotaMode_Element
      nv-datas:
        data Value: type=Arr_u8_16
    BsShare_SwUpdFotaStatus_Element
      nv-datas:
        data Value: type=Arr_u8_48
    BsShare_SwUpdFotadecrypt_Element
      nv-datas:
        data Value: type=Arr_u8_64
    BsShare_SwUpdReflash_Element
      nv-datas:
        data Value: type=Arr_u8_8
    BsShare_VehicleConfig_Element
      nv-datas:
        data Value: type=Arr_u8_256
    BsShare_VisMeet_Element
      nv-datas:
        data Value: type=Arr_u8_46
    RefCys_Certicificate1_Element
      nv-datas:
        data Value: type=Arr_u8_64
    RefCys_Certicificate_Element
      nv-datas:
        data Value: type=Arr_u8_64
    BsShare_VisMeet_EOLEntry_Element
      nv-datas:
        data Value: type=uint16
    BsShare_AssemblyManufacturingDate
      nv-datas:
        data Value: type=Arr_u8_3
    BsShare_AssemblyPlantNumber
      nv-datas:
        data Value: type=Arr_u8_3
    BsShare_HWModification
      nv-datas:
        data Value: type=uint16
    BsShare_PCBSerialNumber
      nv-datas:
        data Value: type=Arr_u8_9
    BsShare_ProductSerialNumber
      nv-datas:
        data Value: type=Arr_u8_10
    BsShare_SMTManufacturingDate
      nv-datas:
        data Value: type=Arr_u8_3
    BsShare_SMTPlantNumber
      nv-datas:
        data Value: type=Arr_u8_3
    BsShare_VisteonPCBPartNumber
      nv-datas:
        data Value: type=Arr_u8_17
    BsShare_VisteonPartNumber
      nv-datas:
        data Value: type=Arr_u8_17
    BsFuSa_FeatureData_Audio_Element
      nv-datas:
        data Value: type=Arr_u8_8
    BsFuSa_FeatureData_Communication_Element
      nv-datas:
        data Value: type=Arr_u8_9
    BsFuSa_FeatureData_Display_Element
      nv-datas:
        data Value: type=UInt16
    BsFuSa_FeatureData_Fota_Element
      nv-datas:
        data Value: type=UInt16
    BsFuSa_FeatureData_Power_Element
      nv-datas:
        data Value: type=Arr_u8_10
    BsFuSa_FeatureData_Warning_Element
      nv-datas:
        data Value: type=Arr_u8_3
    BsConst_BsConst_Illumination_ReservedByte
      nv-datas:
        data Value: type=Arr_u8_28
    BsConst_BsConst_Illumination_ReservedByte_SafeCopy1
      nv-datas:
        data Value: type=Arr_u8_28
    BsConst_BsConst_Illumination_ReservedByte_SafeCopy2
      nv-datas:
        data Value: type=Arr_u8_28
    BsConst_Compensation_Line_Shift_b
      nv-datas:
        data Value: type=uint32
    BsConst_Compensation_Line_Shift_b_SafeCopy1
      nv-datas:
        data Value: type=uint32
    BsConst_Compensation_Line_Shift_b_SafeCopy2
      nv-datas:
        data Value: type=uint32
    BsConst_Compensation_Line_Slope_m
      nv-datas:
        data Value: type=uint32
    BsConst_Compensation_Line_Slope_m_SafeCopy1
      nv-datas:
        data Value: type=uint32
    BsConst_Compensation_Line_Slope_m_SafeCopy2
      nv-datas:
        data Value: type=uint32
    BsConst_Derating_Backlight_Disable
      nv-datas:
        data Value: type=uint8
    BsConst_Derating_Backlight_Disable_SafeCopy1
      nv-datas:
        data Value: type=uint8
    BsConst_Derating_Backlight_Disable_SafeCopy2
      nv-datas:
        data Value: type=uint8
    BsConst_Display_Illum_Max_Level
      nv-datas:
        data Value: type=uint16
    BsConst_Display_Illum_Max_Level_SafeCopy1
      nv-datas:
        data Value: type=uint16
    BsConst_Display_Illum_Max_Level_SafeCopy2
      nv-datas:
        data Value: type=uint16
    BsConst_Lookup_Curve_HotSpot_Coef_X
      nv-datas:
        data Value: type=Arr_u16_7
    BsConst_Lookup_Curve_HotSpot_Coef_X_SafeCopy1
      nv-datas:
        data Value: type=Arr_u16_7
    BsConst_Lookup_Curve_HotSpot_Coef_X_SafeCopy2
      nv-datas:
        data Value: type=Arr_u16_7
    BsConst_Lookup_Curve_HotSpot_Coef_Y
      nv-datas:
        data Value: type=Arr_u16_7
    BsConst_Lookup_Curve_HotSpot_Coef_Y_SafeCopy1
      nv-datas:
        data Value: type=Arr_u16_7
    BsConst_Lookup_Curve_HotSpot_Coef_Y_SafeCopy2
      nv-datas:
        data Value: type=Arr_u16_7
    BsConst_PCB_Temperature_Sensor_Conv
      nv-datas:
        data Value: type=T_NV_Temperature_Conversion
    BsConst_PCB_Temperature_Sensor_Conv_SafeCopy1
      nv-datas:
        data Value: type=T_NV_Temperature_Conversion
    BsConst_PCB_Temperature_Sensor_Conv_SafeCopy2
      nv-datas:
        data Value: type=T_NV_Temperature_Conversion
    BsConst_PWM_boost_bypass_duty
      nv-datas:
        data Value: type=uint8
    BsConst_PWM_boost_bypass_duty_SafeCopy1
      nv-datas:
        data Value: type=uint8
    BsConst_PWM_boost_bypass_duty_SafeCopy2
      nv-datas:
        data Value: type=uint8
    BsConst_Temp_Threshold_Hysteresis_Derating
      nv-datas:
        data Value: type=uint8
    BsConst_Temp_Threshold_Hysteresis_Derating_SafeCopy1
      nv-datas:
        data Value: type=uint8
    BsConst_Temp_Threshold_Hysteresis_Derating_SafeCopy2
      nv-datas:
        data Value: type=uint8
    BsConst_Temperature_Sensor_Conv
      nv-datas:
        data Value: type=T_NV_Temperature_Conversion
    BsConst_Temperature_Sensor_Conv_SafeCopy1
      nv-datas:
        data Value: type=T_NV_Temperature_Conversion
    BsConst_Temperature_Sensor_Conv_SafeCopy2
      nv-datas:
        data Value: type=T_NV_Temperature_Conversion
package /AUTOSAR_SfdA/SfdA/ModeDeclarationGroups
  mode declaration group MDG_SfdAModes: category=ALPHABETIC_ORDER, initial-mode=UNINIT
    mode UNINIT
    mode INIT
  mode declaration group MDG_SfdARoles: category=EXPLICIT_ORDER, initial-mode=SFDC_NO_ROLE, on-transition-value=255
    7 x mode:
      SFDC_NO_ROLE: value=0
      SFD_ROLE_EPTI: value=1
      SFD_ROLE_BASIC: value=2
      SFD_ROLE_EXTENDED: value=3
      SFD_ROLE_SUPERUSER: value=4
      SFD_ROLE_PRODUCTION: value=5
      SFD_ROLE_OTA: value=6
package /AUTOSAR_SfdA/SfdA/PortInterfaces
  mode switch interface SfdA_CurMode: is-service=true
    mode group MG_SfdAMode: type=MDG_SfdAModes
  mode switch interface SfdA_CurRole: is-service=true
    mode group MG_SfdARole: type=MDG_SfdARoles
  sender receiver interface SfdA_RequestRole: is-service=true
    data Role: type=SfdA_RequestRoleType
package /PortInterfaces
  client server interface EcuM_StateRequest: is-service=true
    4 x operation, all with possible-error=EcuM_StateRequest/E_NOT_OK:
      ReleasePOSTRUN
        arg user: type=EcuM_UserType, direction=IN, server-argument-impl-policy=USE-ARGUMENT-TYPE
      ReleaseRUN
        arg user: type=EcuM_UserType, direction=IN, server-argument-impl-policy=USE-ARGUMENT-TYPE
      RequestPOSTRUN
        arg user: type=EcuM_UserType, direction=IN, server-argument-impl-policy=USE-ARGUMENT-TYPE
      RequestRUN
        arg user: type=EcuM_UserType, direction=IN, server-argument-impl-policy=USE-ARGUMENT-TYPE
    error E_NOT_OK: error-code=1
  client server interface if_ICTRL_Diag_GetVersionInfo
    operation getversionInfo
      arg arg: type=Std_VersionInfoType, direction=INOUT, server-argument-impl-policy=USE-ARGUMENT-TYPE
  146 x sender receiver interface:
    RequestPOSTRUN
      data Request: type=Ivd_RequestPostRun
    Airbag
      data Airbag: type=Airbag
    Alive_101
      data Alive_101: type=Alive_101
    Ambient_Light_level
      data Ambient_Light_level: type=Ambient_Light_level
    CRC_101
      data CRC_101: type=CRC_101
    DayNightMode
      data DayNightMode: type=DayNightMode
    Gear
      data Gear: type=Gear
    GearMode
      data GearMode: type=GearMode
    GearRecommendation
      data GearRecommendation: type=GearRecommendation
    GearStatus
      data GearStatus: type=GearStatus
    Illumination_level
      data Illumination_level: type=Illumination_level
    PowerMode
      data PowerMode: type=PowerMode
    TransportMode
      data TransportMode: type=TransportMode
    VehicleSpeedABS
      data VehicleSpeedABS: type=VehicleSpeedABS
    Warning
      data Warning: type=Warning
    Battery_Voltage
      data Battery_Voltage: type=Battery_Voltage
    CurrentStateIC
      data CurrentStateIC: type=CurrentStateIC
    Debug1_Byte0
      data Debug1_Byte0: type=Debug1_Byte0
    Debug1_Byte1
      data Debug1_Byte1: type=Debug1_Byte1
    Debug1_Byte2
      data Debug1_Byte2: type=Debug1_Byte2
    Debug1_Byte3
      data Debug1_Byte3: type=Debug1_Byte3
    Debug1_Byte4
      data Debug1_Byte4: type=Debug1_Byte4
    Debug1_Byte5
      data Debug1_Byte5: type=Debug1_Byte5
    Debug1_Byte6
      data Debug1_Byte6: type=Debug1_Byte6
    Debug1_Byte7
      data Debug1_Byte7: type=Debug1_Byte7
    Debug2_Byte0
      data Debug2_Byte0: type=Debug2_Byte0
    Debug2_Byte1
      data Debug2_Byte1: type=Debug2_Byte1
    Debug2_Byte2
      data Debug2_Byte2: type=Debug2_Byte2
    Debug2_Byte3
      data Debug2_Byte3: type=Debug2_Byte3
    Debug2_Byte4
      data Debug2_Byte4: type=Debug2_Byte4
    Debug2_Byte5
      data Debug2_Byte5: type=Debug2_Byte5
    Debug2_Byte6
      data Debug2_Byte6: type=Debug2_Byte6
    Debug2_Byte7
      data Debug2_Byte7: type=Debug2_Byte7
    Debug3_Byte0
      data Debug3_Byte0: type=Debug3_Byte0
    Debug3_Byte1
      data Debug3_Byte1: type=Debug3_Byte1
    Debug3_Byte2
      data Debug3_Byte2: type=Debug3_Byte2
    Debug3_Byte3
      data Debug3_Byte3: type=Debug3_Byte3
    Debug3_Byte4
      data Debug3_Byte4: type=Debug3_Byte4
    Debug3_Byte5
      data Debug3_Byte5: type=Debug3_Byte5
    Debug3_Byte6
      data Debug3_Byte6: type=Debug3_Byte6
    Debug3_Byte7
      data Debug3_Byte7: type=Debug3_Byte7
    Debug4_Byte0
      data Debug4_Byte0: type=Debug4_Byte0
    Debug4_Byte1
      data Debug4_Byte1: type=Debug4_Byte1
    Debug4_Byte2
      data Debug4_Byte2: type=Debug4_Byte2
    Debug4_Byte3
      data Debug4_Byte3: type=Debug4_Byte3
    Debug4_Byte4
      data Debug4_Byte4: type=Debug4_Byte4
    Debug4_Byte5
      data Debug4_Byte5: type=Debug4_Byte5
    Debug4_Byte6
      data Debug4_Byte6: type=Debug4_Byte6
    Debug4_Byte7
      data Debug4_Byte7: type=Debug4_Byte7
    Debug5_Byte0
      data Debug5_Byte0: type=Debug5_Byte0
    Debug5_Byte1
      data Debug5_Byte1: type=Debug5_Byte1
    Debug5_Byte2
      data Debug5_Byte2: type=Debug5_Byte2
    Debug5_Byte3
      data Debug5_Byte3: type=Debug5_Byte3
    Debug5_Byte4
      data Debug5_Byte4: type=Debug5_Byte4
    Debug5_Byte5
      data Debug5_Byte5: type=Debug5_Byte5
    Debug5_Byte6
      data Debug5_Byte6: type=Debug5_Byte6
    Debug5_Byte7
      data Debug5_Byte7: type=Debug5_Byte7
    Diag_Buffer_Tx_USDT
      data Diag_Buffer_Tx_USDT: type=Diag_Buffer_Tx_USDT
    Diag_Buffer_Tx_UUDT
      data Diag_Buffer_Tx_UUDT: type=Diag_Buffer_Tx_UUDT
    FV_Tx
      data FV_Tx: type=FV_Tx
    Illumination_PWM
      data Illumination_PWM: type=Illumination_PWM
    MAC_Tx
      data MAC_Tx: type=MAC_Tx
    Odometer
      data Odometer: type=Odometer
    PreviousStateIC
      data PreviousStateIC: type=PreviousStateIC
    SecureTxByte0
      data SecureTxByte0: type=SecureTxByte0
    SecureTxByte1
      data SecureTxByte1: type=SecureTxByte1
    SecureTxByte2
      data SecureTxByte2: type=SecureTxByte2
    SecureTxByte3
      data SecureTxByte3: type=SecureTxByte3
    UserData1_IC
      data UserData1_IC: type=UserData1_IC
    UserData2_IC
      data UserData2_IC: type=UserData2_IC
    UserData3_IC
      data UserData3_IC: type=UserData3_IC
    UserData4_IC
      data UserData4_IC: type=UserData4_IC
    UserData5_IC
      data UserData5_IC: type=UserData5_IC
    VehicleSpeedIC
      data VehicleSpeedIC: type=VehicleSpeedIC
    Airbag_1
      data Airbag: type=Airbag
    Airbag_2
      data Airbag: type=Airbag
    Airbag_3
      data Airbag: type=Airbag
    Airbag_4
      data Airbag: type=Airbag
    Airbag_5
      data Airbag: type=Airbag
    SG_ABS
      data RP_SR_TX_SG_ABS: type=SG_ABS
    SG_COM_HS
      data SG_COM_HS: type=SG_COM_HS
    SG_COM_HS_1
      data SG_COM_HS: type=SG_COM_HS
    Ambient_Light_level_1
      data Ambient_Light_level: type=Ambient_Light_level
    CurrentStateIC_1
      data CurrentStateIC: type=CurrentStateIC
    DayNightMode_1
      data DayNightMode: type=DayNightMode
    Gear_1
      data Gear: type=Gear
    GearMode_1
      data GearMode: type=GearMode
    GearRecommendation_1
      data GearRecommendation: type=GearRecommendation
    GearStatus_1
      data GearStatus: type=GearStatus
    Illumination_level_1
      data Illumination_level: type=Illumination_level
    PowerMode_1
      data PowerMode: type=PowerMode
    TransportMode_1
      data TransportMode: type=TransportMode
    Warning_1
      data Warning: type=Warning
    Debug1_Byte0_1
      data Debug1_Byte0: type=Debug1_Byte0
    Debug1_Byte1_1
      data Debug1_Byte1: type=Debug1_Byte1
    Debug1_Byte2_1
      data Debug1_Byte2: type=Debug1_Byte2
    Debug1_Byte3_1
      data Debug1_Byte3: type=Debug1_Byte3
    Debug1_Byte4_1
      data Debug1_Byte4: type=Debug1_Byte4
    Debug1_Byte5_1
      data Debug1_Byte5: type=Debug1_Byte5
    Debug1_Byte6_1
      data Debug1_Byte6: type=Debug1_Byte6
    Debug1_Byte7_1
      data Debug1_Byte7: type=Debug1_Byte7
    Debug2_Byte0_1
      data Debug2_Byte0: type=Debug2_Byte0
    Debug2_Byte1_1
      data Debug2_Byte1: type=Debug2_Byte1
    Debug2_Byte2_1
      data Debug2_Byte2: type=Debug2_Byte2
    Debug2_Byte3_1
      data Debug2_Byte3: type=Debug2_Byte3
    Debug2_Byte4_1
      data Debug2_Byte4: type=Debug2_Byte4
    Debug2_Byte5_1
      data Debug2_Byte5: type=Debug2_Byte5
    Debug2_Byte6_1
      data Debug2_Byte6: type=Debug2_Byte6
    Debug2_Byte7_1
      data Debug2_Byte7: type=Debug2_Byte7
    Debug3_Byte0_1
      data Debug3_Byte0: type=Debug3_Byte0
    Debug3_Byte1_1
      data Debug3_Byte1: type=Debug3_Byte1
    Debug3_Byte2_1
      data Debug3_Byte2: type=Debug3_Byte2
    Debug3_Byte3_1
      data Debug3_Byte3: type=Debug3_Byte3
    Debug3_Byte4_1
      data Debug3_Byte4: type=Debug3_Byte4
    Debug3_Byte5_1
      data Debug3_Byte5: type=Debug3_Byte5
    Debug3_Byte6_1
      data Debug3_Byte6: type=Debug3_Byte6
    Debug3_Byte7_1
      data Debug3_Byte7: type=Debug3_Byte7
    Debug4_Byte0_1
      data Debug4_Byte0: type=Debug4_Byte0
    Debug4_Byte1_1
      data Debug4_Byte1: type=Debug4_Byte1
    Debug4_Byte2_1
      data Debug4_Byte2: type=Debug4_Byte2
    Debug4_Byte3_1
      data Debug4_Byte3: type=Debug4_Byte3
    Debug4_Byte4_1
      data Debug4_Byte4: type=Debug4_Byte4
    Debug4_Byte5_1
      data Debug4_Byte5: type=Debug4_Byte5
    Debug4_Byte6_1
      data Debug4_Byte6: type=Debug4_Byte6
    Debug4_Byte7_1
      data Debug4_Byte7: type=Debug4_Byte7
    Debug5_Byte0_1
      data Debug5_Byte0: type=Debug5_Byte0
    Debug5_Byte1_1
      data Debug5_Byte1: type=Debug5_Byte1
    Debug5_Byte2_1
      data Debug5_Byte2: type=Debug5_Byte2
    Debug5_Byte3_1
      data Debug5_Byte3: type=Debug5_Byte3
    Debug5_Byte4_1
      data Debug5_Byte4: type=Debug5_Byte4
    Debug5_Byte5_1
      data Debug5_Byte5: type=Debug5_Byte5
    Debug5_Byte6_1
      data Debug5_Byte6: type=Debug5_Byte6
    Debug5_Byte7_1
      data Debug5_Byte7: type=Debug5_Byte7
    FV_Tx_1
      data FV_Tx: type=FV_Tx
    Illumination_PWM_1
      data Illumination_PWM: type=Illumination_PWM
    MAC_Tx_1
      data MAC_Tx: type=MAC_Tx
    Odometer_1
      data Odometer: type=Odometer
    SecureTxByte0_1
      data SecureTxByte0: type=SecureTxByte0
    SecureTxByte1_1
      data SecureTxByte1: type=SecureTxByte1
    SecureTxByte2_1
      data SecureTxByte2: type=SecureTxByte2
    SecureTxByte3_1
      data SecureTxByte3: type=SecureTxByte3
    VehicleSpeedIC_1
      data VehicleSpeedIC: type=VehicleSpeedIC
    EngineSpeed
      data EngineSpeed: type=EngineSpeed
    Turn_Indicator_Control
      data Turn_Indicator_Control: type=Turn_Indicator_Control
    EngineSpeed_1
      data EngineSpeed: type=EngineSpeed
    Turn_Indicator_Control_1
      data Turn_Indicator_Control: type=Turn_Indicator_Control
package /ZARXML_PORT_IF
  13 x sender receiver interface:
    HealthDumpGetHdr
      data HealthDumpGetHdrData: type=SHealthDumpGetHdr
    HealthDumpGetData
      data HealthDumpGetDataData: type=SHealthDumpGetData
    PowerSystemStateReqChange
      data PowerSystemStateReqChangeData: type=SPowerSystemStateReqChange
    IgnState
      data IgnStateData: type=SIgnState
    EnetRegReq
      data EnetRegReqData: type=SEnetRegReq
    HealthDomainHeartbeat
      data HealthDomainHeartbeatData: type=SHealthDomainHeartbeat
    HealthDomainFatalError
      data HealthDomainFatalErrorData: type=SHealthDomainFatalError
    HealthDumpHdrInfo
      data HealthDumpHdrInfoData: type=SHealthDumpHdrInfo
    PowerSystemState
      data PowerSystemStateData: type=SPowerSystemState
    PowerExtendShutdownTime
      data PowerExtendShutdownTimeData: type=SPowerExtendShutdownTime
    HealthEventRecord
      data HealthEventRecordData: type=SHealthEventRecord
    EnetRegResp
      data EnetRegRespData: type=SEnetRegResp
    DisplayCurrentState
      data DisplayCurrentStateData: type=SDisplayCurrentState
  client server interface UclInitShutdown
    operation Initialize: possible-error=UclInitShutdown/E_OK
    operation Shutdown: possible-error=UclInitShutdown/E_OK
    error E_OK: error-code=0
  client server interface UclCmplibCmd
    operation OnCommand: possible-error=UclCmplibCmd/E_OK
      arg Cmd: type=uint8, direction=IN, server-argument-impl-policy=USE-ARGUMENT-TYPE
    error E_OK: error-code=0
  client server interface UclSystemCallbacks
    operation ErrorNotification
      arg DLInst: type=uint8, direction=IN, server-argument-impl-policy=USE-ARGUMENT-TYPE
      arg ErrorCode: type=sint32, direction=IN, server-argument-impl-policy=USE-ARGUMENT-TYPE
    operation LinkStatusChanged
      arg DLInst: type=uint8, direction=IN, server-argument-impl-policy=USE-ARGUMENT-TYPE
      arg Status: type=sint32, direction=IN, server-argument-impl-policy=USE-ARGUMENT-TYPE
  sender receiver interface UclTxStatuses
package /AUTOSAR_EcuM/ModeDeclarationGroups
  mode declaration group EcuM_Mode: category=ALPHABETIC_ORDER, initial-mode=EcuM_Mode/STARTUP
    6 x mode:
      POST_RUN
      RUN
      SHUTDOWN
      SLEEP
      STARTUP
      WAKE_SLEEP
package /AUTOSAR_EcuM/PortInterfaces
  mode switch interface EcuM_CurrentMode: is-service=true
    mode group currentMode: type=ModeDeclarationGroups/EcuM_Mode
