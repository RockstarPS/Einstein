AUTOSAR XML (schema 00044)
package /ComponentTypes
  service sw component type Det
    behavior Det_InternalBehavior
      timing event TMT_Det_MainFunction: start-on-event=Det_MainFunction, period=0.01
      runnable Det_MainFunction
  swc implementation Det_Implementation: behavior=Det_InternalBehavior
