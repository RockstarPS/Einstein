AUTOSAR XML (schema 00044)
package /E40_Platform_System_SystemPackage
  composition sw component type E40_Platform_System_SoftwareArchitecture
