AUTOSAR XML (schema 00044)
standard types defined: uint8, uint16, uint32, sint32, boolean, UInt16, UInt32, Boolean, SInt32, UInt8, sint8, SInt8, sint16, SInt16, uint64, sint64, float32, float64
package /MICROSAR/EcuM_swc
  data type mapping set EcuMMode_DataTypeMappingSet: mode-request-type-map{implementation-data-type=EcuM_StateType, mode-group=EcuM_Mode}  # Data Mapping for the Mode Declaration Group EcuMMode.
package /MICROSAR/EcuM_swc/DataTypes
  6 x impl type, all with category=TYPE_REFERENCE:
    EcuM_UserType: compu {0=EcuMConf_EcuMFixedUserConfig_EcuMUserConfig_CTRL_App}, range raw 0..255, implementation-data-type=UInt8  # Unique value for each user
    EcuM_StateType: compu {80=ECUM_STATE_SLEEP, 128=ECUM_STATE_OFF, 144=ECUM_STATE_RESET}, range raw 0..144, implementation-data-type=UInt8
    EcuM_ModeType: compu {2=EcuMConf_EcuMResetMode_ECUM_RESET_IO, 0=EcuMConf_EcuMResetMode_ECUM_RESET_MCU, 3=EcuMConf_EcuMResetMode_ECUM_RESET_WAKEUP, 1=EcuMConf_EcuMResetMode_ECUM_RESET_WDG}, range raw 0..3, implementation-data-type=UInt8  # ECU State Manager states.
    EcuM_TimeType: range raw 0..4294967295, implementation-data-type=UInt32
    EcuM_ShutdownCauseType: compu {0=EcuMConf_EcuMShutdownCause_ECUM_CAUSE_UNKNOWN, 3=EcuMConf_EcuMShutdownCause_ECUM_CAUSE_DCM, 1=EcuMConf_EcuMShutdownCause_ECUM_CAUSE_ECU_STATE, 2=EcuMConf_EcuMShutdownCause_ECUM_CAUSE_WDGM}, range raw 0..3, implementation-data-type=UInt8  # This type describes the cause for a shutdown by the ECU State Manager. It can be extended by configuration.
    EcuM_BootTargetType: compu {0=ECUM_BOOT_TARGET_APP, 1=ECUM_BOOT_TARGET_OEM_BOOTLOADER, 2=ECUM_BOOT_TARGET_SYS_BOOTLOADER}, range raw 0..2, implementation-data-type=UInt8  # This type represents the boot targets the ECU Manager module can be configured with. The default boot target is ECUM_BOOT_TARGET_OEM_BOOTLOADER.
package /MICROSAR/ComM_swc
  data type mapping set ComMMode_DataTypeMappingSet: mode-request-type-map{implementation-data-type=ComM_ModeType, mode-group=ComMMode}  # Data Mapping for the Mode Declaration Group ComMMode.
package /MICROSAR/ComM_swc/DataTypes
  4 x impl type, all with category=TYPE_REFERENCE, implementation-data-type=UInt8:
    ComM_InhibitionStatusType: range raw 0..255
    ComM_ModeType: compu {0=COMM_NO_COMMUNICATION, 1=COMM_SILENT_COMMUNICATION, 2=COMM_FULL_COMMUNICATION}, range raw 0..3
    ComM_UserHandleType: range raw 0..255
    NetworkHandleType: range raw 0..255, type-emitter=ComM
package /MICROSAR/BswM_swc
  data type mapping set BswMMappingSet  # Contains Mapping for ModeDeclarations Groups which are provided by BswM.
    mode-request-type-maps:
      implementation-data-type=UInt8, mode-group=EcuM_Mode
      implementation-data-type=UInt8, mode-group=MDG_SfdAModes
      implementation-data-type=SfdA_RequestRoleType, mode-group=MDG_SfdARoles
      implementation-data-type=BswM_MDG_Sfd_NvmBlockStatus, mode-group=MDG_Sfd_NvmBlockStatus
package /MICROSAR/BswM_swc/DataTypes
  impl type BswM_MDG_Sfd_NvmBlockStatus: compu {1=SFD_BLOCKS_INITIALIZED, 0=SFD_BLOCKS_NOT_INITIALIZED}, range raw 0..255, implementation-data-type=UInt8  # Unique value for each user
package /E40_Platform_System_SystemPackage/Types
  30 x impl type:
    EDisplayType: category=VALUE, base-type=DataTypes/uint8, compu {0=e_Display10Inch, 1=e_DisplayMaxDevice}, range raw 0..1
    EDisplayPowerState: category=VALUE, base-type=DataTypes/uint8, compu {0=eDisplayIdle, 1=eDisplayPowerON, 2=eDisplayNormal, 3=eDisplayPowerOFF, 4=eDisplayFault_Handle, 5=eDisplayMaxPowerState}, range raw 0..5
    EDeviceStatus: category=VALUE, base-type=DataTypes/uint8, compu {0=eDeviceNotReady, 1=eDeviceInitialized, 2=eDeviceReady, 3=eDeviceBusy, 4=eDeviceFault, 5=eDeviceMaxState}, range raw 0..5
    ECmpCmd: category=VALUE, base-type=DataTypes/uint8, compu {0=eCmpCmd_Init, 1=eCmpCmd_DeInit, 2=eCmpCmd_Activate, 3=eCmpCmd_DeActivate}, range raw 0..3
    IoHwAb_DOutGroupIdType: category=VALUE, base-type=DataTypes/sint32, compu {0=eIO_DOutGroupIdCount}, range raw -2147483647..2147483647
    IoHwAb_ErrorType: category=VALUE, base-type=DataTypes/uint8, compu {2=E_NO_ERROR, 3=E_ERROR, 4=E_ADC_ERROR, 5=E_DOUT_ID_INVALID, 6=E_DIN_ID_INVALID, 7=E_ADC_ID_INVALID, 8=IOHWAB_E_ADC_ERROR, 9=IOHWAB_E_ADC_ID_INVALID, 10=IOHWAB_E_ERROR, 11=IOHWAB_E_DOUT_ID_INVALID, 12=IOHWAB_E_NO_ERROR, 13=IOHWAB_E_DIN_ID_INVALID}, range raw 2..13
    IoHwAb_DOutSignalIdType:
      category=VALUE
      base-type=DataTypes/uint8
      compu {0=eIO_DOUT_DO_5VSW2_3V3_EN, 1=eIO_DOUT_PARK_BRAKE_TT_OUT, 2=eIO_DOUT_DO_SYC1, 3=eIO_DOUT_SEAT_BELT_TT_MCUOUT, 4=eIO_DOUT_TURN_LEFT_TT_MCUOUT, 5=eIO_DOUT_DO_LCD_BL_PWR_EN, 6=eIO_DOUT_DO_3V3_DISP_SW_EN, 7=eIO_DOUT_AMP_SHTD, 8=eIO_DOUT_FUEL_RHEO_SUP_EN, 9=eIO_DOUT_DO_LCD_STBYB, 10=eIO_DOUT_SBATT2_EN, 11=eIO_DOUT_BRAKE_TT_MCUOUT, 12=eIO_DOUT_AIRBAG_TT_MCUOUT, 13=eIO_DOUT_TURN_RIGHT_TT_MCUOUT, 14=eIO_DOUT_DO_SMPS_5V_SW_EN, 15=eIO_DOUT_PCS_OFF_TT_MCUOUT, 16=eIO_DOUT_ABS_TT_MCUOUT, 17=eIO_DOUT_SLIP_TT_MCUOUT, 18=eIO_DOUT_VCS_OFF_TT_MCUOUT, 19=eIO_DOUT_ECB_EPB_TT_MCUOUT, 20=eIO_DOUT_Flasher_FL_RL_OUT, 21=eIO_DOUT_Flasher_DEN1, 22=eIO_DOUT_Flasher_DSEL1, 23=eIO_DOUT_Flasher_FR_RR_OUT, 24=eIO_DOUT_DO_LCD_RST, 25=eIO_DOUT_DO_SMPS_1V2_EN, 26=eIO_DO_MAX, 27=eIO_DOUT_DO_DISP_RESET, 28=eIO_DOUT_DO_DISP_STBY, 29=eIO_DOUT_DO_TFT_BL_EN, 30=eIO_DOUT_DO_PWM_DIMMING, 31=eIO_DOUT_DO_RTC_INTN, 32=eIO_DOUT_DO_SOC_PWR_LATCH, 33=eIO_DOUT_DO_1V2_EN, 34=eIO_DOUT_DO_EN_5V, 35=eIO_DOUT_DO_ENET_EN, 36=eIO_DOUT_DO_LIN_NSLP, 37=eIO_DOUT_DO_MCU_RESETSTAZ, 38=eIO_DOUT_DO_3V3_DISP, 39=eIO_DOUT_DO_MD_TOUCH_RST, 40=eIO_DOUT_DO_VPP_EN, 41=eIO_DOUT_DO_MD_GNSS_BOOT_EN, 42=eIO_DOUT_DO_MD_GNSS_RESETP, 43=eIO_DOUT_DO_MD_GNSS_PWR_EN, 44=eIO_DOUT_DO_BLU_OPAMP_PWR_EN, 45=eIO_DOUT_DO_BLU_DWALED_EN, 46=eIO_DOUT_DO_TCON_BYPASS_MODE, 47=eIO_DOUT_DO_TCON_BYPASS_SEL0, 48=eIO_DOUT_DO_TCON_BYPASS_SEL1, 49=eIO_DOUT_DO_SOC_FPDLINK3_PDB, 50=eIO_DOUT_DO_SOC_FPDLINK3_INTB, 51=eIO_DOUT_DO_SOC_FPDLINK3_BISTEN, 52=eIO_DOUT_DO_ENET_RSTB, 53=eIO_DOUT_DO_EN_BUCK_FALD, 54=eIO_DOUT_DO_MCU_AMUX_S1, 55=eIO_DOUT_DO_MCU_AMUX_S0, 56=eIO_DOUT_DO_TCON_SPI0_CS0, 57=eIO_DOUT_DO_SPI_CAN_CS, 58=eIO_DOUT_DESER_SPI1_DO, 59=eIO_DOUT_DO_SOC_TCON_GRBN, 60=eIO_DOUT_DO_TFT_CSB}
      range raw 0..60
    IoHwAb_DInSignalIdType:
      category=VALUE
      base-type=DataTypes/uint8
      compu {0=eIO_DIN_DI_AL_HAZARD, 1=eIO_DIN_DI_AH_IGNITION, 2=eIO_DIN_DI_SMPS_3V3_PG, 3=eIO_DIN_STOP_LAMP_MCU, 4=eIO_DIN_DI_AL_BRAKE_LEVEL, 5=eIO_DIN_DI_AL_OIL_W, 6=eIO_DIN_DI_AL_DRV_SEAT_BUCKLE, 7=eIO_DIN_DI_AL_WASHER_LEVEL_SW, 8=eIO_DIN_ODO_TripKnobInput, 9=eIO_DIN_DI_AL_VACUUM, 10=eIO_DIN_DI_LCD_BL_PWR_FAULT, 11=eIO_DIN_DI_AL_FUEL_LID_EFI_ECU, 12=eIO_DIN_DI_TT_SHIFT_ERR, 13=eIO_DIN_MAX, 14=eIO_DIN_DI_PMIC_INTN, 15=eIO_DIN_DI_MCU_PORZ, 16=eIO_DIN_DI_SBATT2_ERR, 17=eIO_DIN_DI_FALD_PG, 18=eIO_DIN_DI_MD_TOUCH_INTN, 19=eIO_DIN_DI_BL_FAULT, 20=eIO_DIN_DI_SOC_FPDLINK3_LOCK, 21=eIO_DIN_DI_SOC_FPDLINK3_PASS, 22=eIO_DIN_DI_ENET_MII_INT, 23=eIO_DIN_DI_IGN_MON, 24=eIO_DIN_DI_CABLE_DETECT, 25=eIO_DIN_DI_TCON_IND_OUT, 26=eIO_DIN_DI_SPI_CAN_TCON_SDI, 27=eIO_DIN_DI_MCU_FALD_CONN_CHK, 28=eIO_DIN_DI_LDO_1V2_FAULTN, 29=eIO_DIN_DI_TFT_ER_DET}
      range raw 0..29
    IoHwAb_DInGroupIdType: category=VALUE, base-type=DataTypes/sint32, compu {0=eIO_DInGroupIdCount}, range raw -2147483647..2147483647
    IoHwAb_PwmSignalIdType: category=VALUE, base-type=DataTypes/uint8, compu {0=eIO_PWM_MCU_BUZZER_AMPLCTRL, 1=eIO_PWM_HIGH_BEAM_TT_MCUOUT, 2=eIO_PWM_FUEL_TEMP_GAUG_TEXT_PWM_OUT, 3=eIO_PWM_PWM_OUT_ILL2, 4=eIO_PWM_PWM_OUT_ILL1, 5=eIO_PWM_BG_Dimming_PWM, 6=eIO_PWM_PWM_GREEN_TT_DIMMING, 7=eIO_PWM_CXPI_CLK, 8=eIO_PWM_PWM_LCD_BL_DIMMING, 9=eIO_PWM_MAX}, range raw 0..9
    IoHwAb_AdcSignalIdType:
      category=VALUE
      base-type=DataTypes/uint8
      compu {16=eIO_ADC_ADC_FUEL_5V_MON, 17=eIO_ADC_ADC_FUEL_MAIN, 2=eIO_ADC_IGN_AD, 3=eIO_ADC_FUEL_SEND_SUB_MICRO_AD, 4=eIO_ADC_AI_BATTERY, 5=eIO_ADC_AI_LCD_NTC, 6=eIO_ADC_AI_TEMP_RTC, 7=eIO_ADC_Flasher_Diag_sense_1, 8=eIO_ADC_STR_SW2_ADIN, 9=eIO_ADC_STR_SW1_ADIN, 10=eIO_ADC_RHEO_SW_IN_ADIN, 11=eIO_ADC_ADC_RHEO_5V_MON_ADIN, 12=eIO_ADC_Flasher_Diag_sense_2, 13=eIO_ADC_AdcChannel_Vdb, 14=eIO_ADC_AdcChannel_Vtemp, 15=eIO_ADC_MAX, 0=eIO_ADC_AI_SAMPLE_1, 1=eIO_ADC_AI_SAMPLE_2}
      range raw 0..17
    eIOPulseInputId: category=VALUE, base-type=DataTypes/sint32, compu {0=eIOPulseInputIdCount}, range raw -2147483647..2147483647
    EGammaCorrectionStatus: category=VALUE, base-type=DataTypes/uint8, compu {0=eDisplayCdd_GammaCorrection_None, 1=eDisplayCdd_GammaCorrection_OnGoing, 2=eDisplayCdd_GammaCorrection_Success, 3=eDisplayCdd_GammaCorrection_Failure}, range raw 0..3
    EDisplayCddStatus: category=VALUE, base-type=DataTypes/uint8, compu {0=eDisplayNotReady, 1=eDisplayReady, 2=eDisplayBusy, 3=eDisplayFaultHandle, 4=eDisplayMaxStatus}, range raw 0..4
    Nvm_U8ArrType_3: category=ARRAY
      element ArrayElement: category=VALUE, array-size=3, array-size-semantics=FIXED-SIZE, base-type=DataTypes/uint8
    NvM_BlockIdType: category=VALUE, base-type=DataTypes/uint16, range raw 0..65535
    NvM_RequestResultType: category=VALUE, base-type=DataTypes/uint8, range raw 0..255
    HTimer:
      category=VALUE
      base-type=DataTypes/uint8
      compu {0=eWarningMask_Timerhandle, 1=eOWC_Timerhandle, 2=eNWD_Timerhandle, 3=eWarningBulbCheckMask_Timerhandle, 4=eInitWarning_TimerHandle, 5=eInitChimeTimerHandle, 6=eProgrammingTimerHandle, 7=eStubCounter_TimerHanlde, 8=eModeMgrDisplayPowerDownUp, 9=eModeMgrDisplayFaultAction, 10=eModeMgrDomanResetAction, 11=eModeMgrPowerFaultAction, 12=eEtm4SecTimer, 13=eEtm1200msecTimer, 14=eEtm3SecTimer, 15=eCallbackTimerOdoMdl, 16=eThrottleTimerOdoMdl, 17=eChangeupCallbackTimerodoMdl, 18=eTimerVehicleState, 19=eTimerVariantConfig, 20=WARNING_DISPLAY_TIMER_ID, 21=WARNING_HOLD_TIMER_ID, 22=WARNING_CYCLE_TIMER_ID, 23=WARNING_DISPLAYHOLD_TIMER_ID, 24=WARNING_ACK_TIMER_ID, 25=eTimerHandle_Sleep, 26=eInStartCount_TimerHandle, 27=eVehicleModeCount_TimerHandle, 28=e10secTimer, 29=e3secTimer, 30=e30secTimer, 31=e2_6secTimer, 32=eDcmApp5secTimer, 33=eDcmApp1secTimer, 34=eLidopen_OFFTimer, 35=eLidopen_ONTimer, 36=POPUP_DISPLAY_TIMER_ID, 37=POPUP_GRP_TAB_TIMER_ID, 38=eDrvRec5_6Timer, 39=eDrvRec3_6Timer, 40=eIDS_1SecTimer, 41=eIDS3_1SecTimer, 42=eIDS_3SecTimer, 43=ePerDispSet100msTimer, 44=eDrvRec1_2secTimer, 45=eDrvRec0_8secTimer, 46=eHMI_Initial_Blank_timer_ID, 47=eHMI_Fade_in_delay_timer_ID, 48=eKM6secTimer, 49=eKM5_8secTimer, 50=eKM0_6secTimer, 51=eKM0_2secTimer, 52=eIgnCANMode_3SecTimer, 53=eDem2_6secTimer, 54=eDem5secTimer, 55=e2FRheo5secTimer, 56=e2FSTSW5secTimer, 57=eLSTM3_Timer, 58=eLSTM4_Timer, 59=eDem_AFS_5sec_Timer, 60=WARNING_MSGTIMEOUT_1SEC_TIMER_ID, 61=eDCMApp_30Sec_Timer, 62=WRN_ACK_REDISPLAY_TIMER_ID, 63=eMenuScrollStart1sTimer, 64=eType4_6secTimer, 65=eDcmApp_0_35secTimer, 66=eDcmApp_0_35_1secTimer, 67=eRemoteCarFindCtrlStateTimer, 68=eBrake_Red_100msecTimer, 69=eStreeingSw_ReleaseTimer, 70=POPUP_SETTING_TIMER_ID, 71=eMenu100msTimer, 72=eBuzzerMiddleEast_6secs, 73=eBuzzerMiddleEast_6secs_2, 74=eMaxNumof16BitTimers, 75=eSleepMaxTimer, 76=eRentACarTimer, 77=eDoorWarn_Timer, 78=eTimerHandleGdtCdd, 79=eSample32BitTimer, 80=eTimerMax}
      range raw 0..80
    SPulseInputConfigParam: category=STRUCTURE
      16 x element, all with category=TYPE_REFERENCE:
        MissingRecoveryTimeoutInMicroSec: implementation-data-type=UInt32
        ValidPeriodMinInMicroSec: implementation-data-type=UInt32
        ValidPeriodMaxInMicroSec: implementation-data-type=UInt32
        HystLimitForPeriodMinInMicroSec: implementation-data-type=UInt32
        HystRcvryForPeriodMinInMicroSec: implementation-data-type=UInt32
        HystLimitForPeriodMaxInMicroSec: implementation-data-type=UInt32
        HystRcvryForPeriodMaxInMicroSec: implementation-data-type=UInt32
        ValidDutyMinInPercentage: implementation-data-type=UInt16
        ValidDutyMaxInPercentage: implementation-data-type=UInt16
        HystLimitForDutyMinInPercentage: implementation-data-type=UInt16
        HystRcvryForDutyMinInPercentage: implementation-data-type=UInt16
        HystLimitForDutyMaxInPercentage: implementation-data-type=UInt16
        HystRcvryForDutyMaxInPercentage: implementation-data-type=UInt16
        InValidTimeoutInMilliSec: implementation-data-type=UInt16
        InValidRecoveryTimeoutInMilliSec: implementation-data-type=UInt16
        MissingTimeoutInMilliSec: implementation-data-type=UInt16
    SSpeedCalcParam: category=STRUCTURE
      element Pulses_Per_Revolution: implementation-data-type=UInt32
      element Revolutions_Per_Unit: implementation-data-type=UInt32
      element Tuning_Factor: implementation-data-type=UInt32
    Arr_u8_8: category=ARRAY
      element ArrayElement: category=VALUE, array-size=8, array-size-semantics=FIXED-SIZE, base-type=DataTypes/uint8
    Arr_u8_16: category=ARRAY
      element ArrayElement: category=VALUE, array-size=16, array-size-semantics=FIXED-SIZE, base-type=DataTypes/uint8
    Arr_u8_128: category=ARRAY
      element ArrayElement: category=VALUE, array-size=128, array-size-semantics=FIXED-SIZE, base-type=DataTypes/uint8
    Arr_u8_64: category=ARRAY
      element ArrayElement: category=VALUE, array-size=64, array-size-semantics=FIXED-SIZE, base-type=DataTypes/uint8
    Arr_u8_32: category=ARRAY
      element ArrayElement: category=VALUE, array-size=32, array-size-semantics=FIXED-SIZE, base-type=DataTypes/uint8
    Arr_u8_48: category=ARRAY
      element ArrayElement: category=VALUE, array-size=48, array-size-semantics=FIXED-SIZE, base-type=DataTypes/uint8
    Arr_u8_2048: category=ARRAY
      element ArrayElement: category=VALUE, array-size=2048, array-size-semantics=FIXED-SIZE, base-type=DataTypes/uint8
    Arr_u8_1024: category=ARRAY
      element ArrayElement: category=VALUE, array-size=1024, array-size-semantics=FIXED-SIZE, base-type=DataTypes/uint8
    Arr_u8_100: category=ARRAY
      element ArrayElement: category=VALUE, array-size=100, array-size-semantics=FIXED-SIZE, base-type=DataTypes/uint8
    Arr_u8_256: category=ARRAY
      element ArrayElement: category=VALUE, array-size=256, array-size-semantics=FIXED-SIZE, base-type=DataTypes/uint8
  29 x impl type:
    ESystemState: category=VALUE, base-type=DataTypes/uint8, compu {0=ESystemState_Off, 1=ESystemState_Startup, 2=ESystemState_Up, 3=ESystemState_FullRun, 4=ESystemState_PrepareShutdown, 5=ESystemState_Minimal, 6=ESystemState_Meet, 7=ESystemState_Shutdown, 8=ESystemState_Last}, range raw 0..8
    EDomainId: category=VALUE, base-type=DataTypes/uint8, compu {0=EDomainId_VP, 1=EDomainId_Cluster, 2=EDomainId_IVI, 3=EDomainId_Last}, range raw 0..3
    SPowerSystemStateReqChange: category=STRUCTURE
      element state: implementation-data-type=Types/ESystemState
      element domainId: implementation-data-type=Types/EDomainId
    EDmnChangeReqStatus_t: category=VALUE, base-type=DataTypes/uint8, compu {0=EDmnChangeReqStatus_NoReq, 1=EDmnChangeReqStatus_WaitAwakeTime, 2=EDmnChangeReqStatus_WaitShutdonwTime, 3=EDmnChangeReqStatus_PrevReqPending, 4=EDmnChangeReqStatus_ReqSucceed, 5=EDmnChangeReqStatus_ReqFail, 6=EDmnChangeReqStatus_ReqTimedOut, 7=EDmnChangeReqStatus_DmnNotReady}, range raw 0..7
    EUclLinkState_t: category=VALUE, base-type=DataTypes/uint8, compu {0=EUclLinkState_Not_Rcvd, 1=EUclLinkState_Down, 2=EUclLinkState_Up, 3=EUclLinkState_Last}, range raw 0..3
    EDmnHealthState_t: category=VALUE, base-type=DataTypes/uint8, compu {0=EDmnHealth_Active, 1=EDmnHealth_UCL_Fatal_Error, 2=EDmnHealth_HB_Miss, 3=EDmnHealth_Fatal_Error, 4=EDmnHealth_Rcvd_Inv_SeqCnt, 5=EDmnHealth_First_HB_Rcv_Time_Expired, 6=EDmnHealth_First_LinkUp_Time_Expired, 7=EDmnHealth_Shutdown_Time_Expired, 8=EDmnHealth_Last}, range raw 0..8
    EDmnOverallState_t: category=VALUE, base-type=DataTypes/uint8, compu {0=DMN_NOT_READY, 1=DMN_READY}, range raw 0..1
    data_u8_32: category=ARRAY
      element ArrayElement: category=VALUE, array-size=32, array-size-semantics=FIXED-SIZE, base-type=DataTypes/uint8
    SPowerSystemState: category=STRUCTURE
      element domainId: implementation-data-type=Types/EDomainId
      element state: implementation-data-type=Types/ESystemState
    data_u8_8: category=ARRAY
      element ArrayElement: category=VALUE, array-size=8, array-size-semantics=FIXED-SIZE, base-type=DataTypes/uint8
    EDidType: category=VALUE, base-type=DataTypes/uint8, compu {0=EDidType_Read, 1=EDidType_Write, 2=EDidType_Last}, range raw 0..2
    data_u8_256: category=ARRAY
      element ArrayElement: category=VALUE, array-size=256, array-size-semantics=FIXED-SIZE, base-type=DataTypes/uint8
    EIOCtrlOptType: category=VALUE, base-type=DataTypes/uint8, compu {0=EIOCtrlOptType_returnControlToECU, 1=EIOCtrlOptType_resetToDefault, 2=EIOCtrlOptType_freezeCurrentState, 3=EIOCtrlOptType_shortTermAdjustment, 4=EIOCtrlOptType_Last}, range raw 0..4
    ERoutineType: category=VALUE, base-type=DataTypes/uint8, compu {0=ERoutineType_Start, 1=ERoutineType_Stop, 2=ERoutineType_QueryResults, 3=ERoutineType_Last}, range raw 0..3
    EIgnitionStatus: category=VALUE, base-type=DataTypes/uint8, compu {0=EIgnitionStatus_Off, 1=EIgnitionStatus_Acc, 2=EIgnitionStatus_Start, 3=EIgnitionStatus_Run, 4=EIgnitionStatus_Last}, range raw 0..4
    SIgnState: category=STRUCTURE
      element state: implementation-data-type=Types/EIgnitionStatus
    SDiagDIDRequest: category=STRUCTURE
      4 x element, all with category=TYPE_REFERENCE:
        did: implementation-data-type=UInt16
        didType: implementation-data-type=EDidType
        dataLen: implementation-data-type=UInt16
        data: implementation-data-type=data_u8_256
    SDiagIOCtrlRequest: category=STRUCTURE
      4 x element, all with category=TYPE_REFERENCE:
        did: implementation-data-type=UInt16
        optionCtrl: implementation-data-type=EIOCtrlOptType
        dataLen: implementation-data-type=UInt16
        data: implementation-data-type=data_u8_256
    SDiagRoutineRequest: category=STRUCTURE
      4 x element, all with category=TYPE_REFERENCE:
        routineId: implementation-data-type=UInt16
        routineType: implementation-data-type=ERoutineType
        dataLen: implementation-data-type=UInt16
        data: implementation-data-type=data_u8_256
    SHealthDomainFatalError: category=STRUCTURE
      element domainId: implementation-data-type=Types/EDomainId
      element compIdx: implementation-data-type=UInt32
    SHealthDomainHeartbeat: category=STRUCTURE
      element domainId: implementation-data-type=Types/EDomainId
      element seqCnt: implementation-data-type=UInt32
    SHealthDumpData: category=STRUCTURE
      element chunkSize: implementation-data-type=UInt32
      element data: implementation-data-type=Types/data_u8_32
    SHealthDumpHdrInfo: category=STRUCTURE
      element fileSize: implementation-data-type=UInt32
    SPowerExtendShutdownTime: category=STRUCTURE
      element domainId: implementation-data-type=Types/EDomainId
      element timeoutMs: implementation-data-type=UInt32
    SPowerKeepSystemAwake: category=STRUCTURE
      element domainId: implementation-data-type=Types/EDomainId
      element timeoutMs: implementation-data-type=UInt32
    SDmnStatus: category=STRUCTURE
      6 x element, all with category=TYPE_REFERENCE:
        dmnId: implementation-data-type=Types/EDomainId
        linkStatus: implementation-data-type=EUclLinkState_t
        uclErrCode: implementation-data-type=SInt32
        dmnHealthState: implementation-data-type=EDmnHealthState_t
        state: implementation-data-type=Types/ESystemState
        dmnStatus: implementation-data-type=EDmnOverallState_t
    SHealthDumpGetData: category=STRUCTURE
      element reserved: implementation-data-type=UInt8
    SHealthDumpGetHdr: category=STRUCTURE
      element encrypt: implementation-data-type=UInt8
    SHealthEventRecord: category=STRUCTURE
      element recordType: implementation-data-type=UInt8
      element recordLen: implementation-data-type=UInt8
      element recordData: implementation-data-type=Types/data_u8_8
  18 x impl type:
    Dlt_MessageLogLevelType: category=VALUE, base-type=DataTypes/uint8, compu {0=DLT_LOG_OFF, 1=DLT_LOG_FATAL, 2=DLT_LOG_ERROR, 3=DLT_LOG_WARN, 4=DLT_LOG_INFO, 5=DLT_LOG_DEBUG, 6=DLT_LOG_VERBOSE}, range raw 0..6
    Dlt_SessionIDType: category=VALUE, base-type=DataTypes/uint32, range raw 0..4294967295
    Dlt_MessageArgumentCount: category=VALUE, base-type=DataTypes/uint16, range raw 0..65535
    Dlt_MessageOptionsType: category=VALUE, base-type=DataTypes/uint8, range raw 0..255
    Dlt_MessageLogInfoType: category=STRUCTURE
      5 x element, all with category=TYPE_REFERENCE:
        argCount: implementation-data-type=Dlt_MessageArgumentCount
        logLevel: implementation-data-type=Dlt_MessageLogLevelType
        options: implementation-data-type=Dlt_MessageOptionsType
        contextId: implementation-data-type=Dlt_ContextIDType
        appId: implementation-data-type=Dlt_ApplicationIDType
    Dlt_MessageTraceType: category=VALUE, base-type=DataTypes/uint8, compu {1=DLT_TRACE_VARIABLE, 2=DLT_TRACE_FUNCTION_IN, 3=DLT_TRACE_FUNCTION_OUT, 4=DLT_TRACE_STATE, 5=DLT_TRACE_VFB}, range raw 1..5
    Dlt_MessageTraceInfoType: category=STRUCTURE
      4 x element, all with category=TYPE_REFERENCE:
        traceInfo: implementation-data-type=Dlt_MessageTraceType
        options: implementation-data-type=Dlt_MessageOptionsType
        context: implementation-data-type=Dlt_ContextIDType
        appId: implementation-data-type=Dlt_ApplicationIDType
    Dlt_AssignmentOperation: category=VALUE, base-type=DataTypes/uint8, compu {1=DLT_ASSIGN_ADD, 2=DLT_ASSIGN_REMOVE}, range raw 1..2
    data_uint8_8: category=ARRAY
      element ArrayElement: category=VALUE, array-size=8, array-size-semantics=FIXED-SIZE, base-type=DataTypes/uint8
    EcuMExt_ResetType: category=VALUE, base-type=DataTypes/uint8, range raw 0..255
    Dlt_ContextIdInfoType: category=STRUCTURE
      5 x element, all with category=TYPE_REFERENCE:
        contextId: implementation-data-type=Dlt_ContextIDType
        logLevel: implementation-data-type=Dlt_MessageLogLevelType
        traceStatus: implementation-data-type=UInt8
        lenContextDescription: implementation-data-type=UInt16
        contextDesc: implementation-data-type=UInt8
    Dlt_ApplicationIdInfoType: category=STRUCTURE
      5 x element, all with category=TYPE_REFERENCE:
        appId: implementation-data-type=Dlt_ApplicationIDType
        contextIdCount: implementation-data-type=UInt16
        contextInfoList: implementation-data-type=Dlt_ContextIdInfoType
        appDescLen: implementation-data-type=UInt16
        appDesc: implementation-data-type=UInt8
    Dlt_LogInfoType: category=STRUCTURE
      element appIdCount: implementation-data-type=UInt16
      element appIdInfo: implementation-data-type=Dlt_ApplicationIdInfoType
    tDlt_BH_MessageFormat: category=STRUCTURE
      6 x element, all with category=TYPE_REFERENCE:
        HeaderType: implementation-data-type=UInt32
        MessageCount: implementation-data-type=UInt8
        MessageLen: implementation-data-type=UInt16
        MessageInfo: implementation-data-type=UInt8
        no_of_arguments: implementation-data-type=UInt8
        LogMessage_Timestamp: implementation-data-type=UInt32
    tDlt_MessageFormat: category=STRUCTURE
      element BaseHeader: implementation-data-type=tDlt_BH_MessageFormat
      element PayLoad: implementation-data-type=data_uint8_8
    uint8_Ref: category=VALUE, base-type=DataTypes/uint8, range raw 0..255
    Rtc_TimeType: category=STRUCTURE
      7 x element, all with category=TYPE_REFERENCE:
        year: implementation-data-type=UInt16
        month: implementation-data-type=UInt8
        week: implementation-data-type=UInt8
        day: implementation-data-type=UInt8
        hour: implementation-data-type=UInt8
        minute: implementation-data-type=UInt8
        second: implementation-data-type=UInt8
    Rtc_AlarmType: category=STRUCTURE
      element day: implementation-data-type=UInt8
      element minute: implementation-data-type=UInt8
      element hour: implementation-data-type=UInt8
  8 x impl type:
    EChimeID: category=VALUE, base-type=DataTypes/uint8, compu {0=NO_CHIME_ID, 1=MAX_CHIME_ID}, range raw 0..1
    EChimeStatus: category=VALUE, base-type=DataTypes/uint16, range raw 0..65535
    ELastToneStatus: category=VALUE, base-type=DataTypes/boolean, range raw 0..1
    ESndToneInterruptableType: category=VALUE, base-type=DataTypes/uint8, compu {0=eSndToneInterruptableType_NotInterruptible, 1=eSndToneInterruptableType_Interruptible}, range raw 0..1
    EChimeType: category=VALUE, base-type=DataTypes/uint8, compu {0=eChimeEvent, 15=eChimeContinuous}, range raw 0..15
    ESndInterruptType: category=VALUE, base-type=DataTypes/uint8, compu {0=eSndCdd_InterruptType_None, 1=eSndCdd_InterruptType_TypeA, 2=eSndCdd_InterruptType_TypeB, 3=eSndCdd_InterruptType_TypeDA, 4=eSndCdd_InterruptType_TypeDB, 5=eSndCdd_InterruptType_Immidiate, 6=eSndCdd_InterruptType_Tone, 7=eSndCdd_InterruptType_SoundUnit, 8=eSndCdd_InterruptType_TypeC, 9=eSndCdd_InterruptType_TypeD}, range raw 0..9
    SSndCddChimeData: category=STRUCTURE
      element ChannelId: implementation-data-type=UInt8
      element ChimeType: implementation-data-type=EChimeType
      element DynamicDeadTime: implementation-data-type=UInt16
    EcuM_UserType: category=VALUE, base-type=DataTypes/uint8, range raw 0..255
  18 x impl type:
    teDiagOpStatus: category=VALUE, base-type=DataTypes/uint8, compu {0=DIAG_INITIAL, 1=DIAG_PENDING, 2=DIAG_CANCEL, 3=DIAG_FORCE_RCRRP_OK, 64=DIAG_FORCE_RCRRP_NOT_OK}, range raw 0..64
    teDIDOperation: category=VALUE, base-type=DataTypes/uint8, compu {0=eRead, 1=eWrite, 2=eSTA, 3=eRCTECU, 4=eCheckConditions, 5=eRST2DEFAULT, 6=eFCS, 7=eLengthCheck}, range raw 0..7
    EDcmExtAction: category=VALUE, base-type=DataTypes/uint8, compu {0=eDcmExtAction_Read, 1=eDcmExtAction_Write, 2=eDcmExtAction_IOCtrl, 3=eDcmExtAction_RetCtrlEcu, 4=eDcmExtAction_RoutineStart, 5=eDcmExtAction_RoutineStop, 6=eDcmExtAction__RoutineResult, 7=eDcmExtAction_CheckConditions, 8=eDcmExtAction_Reset}, range raw 0..8
    teRoutineOperation: category=VALUE, base-type=DataTypes/uint8, compu {0=eRoutineStart, 1=eRoutineStop, 2=eRoutineResult}, range raw 0..2
    EMeetModeStatus: category=VALUE, base-type=DataTypes/uint8, compu {0=eManufModeActive, 1=eManufModeInActive}, range raw 0..1
    Dcm_OpStatusType: category=VALUE, base-type=DataTypes/uint8, range raw 0..255
    Dcm_NegativeResponseCodeType: category=VALUE, base-type=DataTypes/uint8, range raw 0..255
    Dcm_DspDidIdentifierTableType: category=VALUE, base-type=DataTypes/uint16, range raw 0..65535
    Dcm_MsgLenType: category=VALUE, base-type=DataTypes/uint32, range raw 0..4294967295
    Dcm_DspRidIdentifierTableType: category=VALUE, base-type=DataTypes/uint16, range raw 0..65535
    Dem_EventIdType: category=VALUE, base-type=DataTypes/uint16, range raw 0..65535
    Dem_DTCFormatType: category=VALUE, base-type=DataTypes/uint8, range raw 0..255
    Dem_DebouncingStateType: category=VALUE, base-type=DataTypes/uint8, range raw 0..255
    Dem_UdsStatusByteType: category=VALUE, base-type=DataTypes/uint8, range raw 0..255
    Dem_DTCOriginType: category=VALUE, base-type=DataTypes/uint8, range raw 0..255
    Dem_OperationCycleStateType: category=VALUE, base-type=DataTypes/uint8, range raw 0..255
    Dem_EventStatusType: category=VALUE, base-type=DataTypes/uint8, range raw 0..255
    SEmmcErrorNotifier: category=STRUCTURE
      element errorCode: implementation-data-type=UInt32
  10 x impl type:
    Arr_u8_46: category=ARRAY
      element ArrayElement: category=VALUE, array-size=46, array-size-semantics=FIXED-SIZE, base-type=DataTypes/uint8
    EDisplayStatus: category=VALUE, base-type=DataTypes/uint8, compu {0=EDisplayState_Off, 1=EDisplayState_On, 2=EDisplayState_Error, 3=EDisplayState_Disconnected, 4=EDisplayState_Last}, range raw 0..4
    EDisplayPower: category=VALUE, base-type=DataTypes/uint8, compu {0=EDisplayPower_Off, 1=EDisplayPower_On, 2=EDisplayPower_Last}, range raw 0..2
    SDisplayCurrentState: category=STRUCTURE
      element displayId: implementation-data-type=UInt32
      element state: implementation-data-type=Types/EDisplayStatus
    SDisplaySetPower: category=STRUCTURE
      element displayId: implementation-data-type=UInt32
      element state: implementation-data-type=EDisplayPower
    Arr_u8_3: category=ARRAY
      element ArrayElement: category=VALUE, array-size=3, array-size-semantics=FIXED-SIZE, base-type=DataTypes/uint8
    Arr_u8_61: category=ARRAY
      element ArrayElement: category=VALUE, array-size=61, array-size-semantics=FIXED-SIZE, base-type=DataTypes/uint8
    Arr_u8_9: category=ARRAY
      element ArrayElement: category=VALUE, array-size=9, array-size-semantics=FIXED-SIZE, base-type=DataTypes/uint8
    Arr_u8_10: category=ARRAY
      element ArrayElement: category=VALUE, array-size=10, array-size-semantics=FIXED-SIZE, base-type=DataTypes/uint8
    Arr_u8_17: category=ARRAY
      element ArrayElement: category=VALUE, array-size=17, array-size-semantics=FIXED-SIZE, base-type=DataTypes/uint8
  72 x impl type:
    tRxSignalId: category=VALUE, base-type=DataTypes/uint8, compu {0=eDayNightModeIn, 1=eIllumination_levelIn, 2=eAmbient_Light_levelIn, 3=ePowerModeIn, 4=eTransportModeIn, 5=eGearModeIn, 6=eGearRecommendationIn, 7=eGearIn, 8=eWarningIn, 9=eGearStatusIn, 10=eEngineSpeedIn, 11=eTurn_Indicator_ControlIn, 12=eEndOfRxSignal}, range raw 0..12
    tRxSignalStatus: category=VALUE, base-type=DataTypes/uint8, compu {0=eSIGNAL_OK, 1=eSIGNAL_MISSING, 2=eSIGNAL_NEVER_RECEIVED, 4=eSIGNAL_INVALID}, range raw 0..4
    tRxSignalJustRcvdStatus: category=VALUE, base-type=DataTypes/uint8, compu {0=eJust_Received, 1=eNot_Just_Received}, range raw 0..1
    tTxSignalId:
      category=VALUE
      base-type=DataTypes/uint8
      compu {0=eSecureTxByte0Out, 1=eSecureTxByte1Out, 2=eSecureTxByte2Out, 3=eSecureTxByte3Out, 4=eMAC_TxOut, 5=eFV_TxOut, 6=eOdometerOut, 7=eVehicleSpeedICOut, 8=eIllumination_PWMOut, 9=eDebug1_Byte0Out, 10=eDebug1_Byte1Out, 11=eDebug1_Byte2Out, 12=eDebug1_Byte3Out, 13=eDebug1_Byte4Out, 14=eDebug1_Byte5Out, 15=eDebug1_Byte6Out, 16=eDebug1_Byte7Out, 17=eDebug2_Byte0Out, 18=eDebug2_Byte1Out, 19=eDebug2_Byte2Out, 20=eDebug2_Byte3Out, 21=eDebug2_Byte4Out, 22=eDebug2_Byte5Out, 23=eDebug2_Byte6Out, 24=eDebug2_Byte7Out, 25=eDebug3_Byte0Out, 26=eDebug3_Byte1Out, 27=eDebug3_Byte2Out, 28=eDebug3_Byte3Out, 29=eDebug3_Byte4Out, 30=eDebug3_Byte5Out, 31=eDebug3_Byte6Out, 32=eDebug3_Byte7Out, 33=eDebug4_Byte0Out, 34=eDebug4_Byte1Out, 35=eDebug4_Byte2Out, 36=eDebug4_Byte3Out, 37=eDebug4_Byte4Out, 38=eDebug4_Byte5Out, 39=eDebug4_Byte6Out, 40=eDebug4_Byte7Out, 41=eDebug5_Byte0Out, 42=eDebug5_Byte1Out, 43=eDebug5_Byte2Out, 44=eDebug5_Byte3Out, 45=eDebug5_Byte4Out, 46=eDebug5_Byte5Out, 47=eDebug5_Byte6Out, 48=eDebug5_Byte7Out, 49=eEndOfTxSignal}
      range raw 0..49
    tTxSigConfirmStatus: category=VALUE, base-type=DataTypes/uint8, compu {0=eTxSigConfirmStatus_Cleared, 1=eTxSigConfirmStatus_Set, 2=eTxSigConfirmStatus_NotSupported}, range raw 0..2
    TTBlinkArray: category=ARRAY
      element ArrayElement: category=VALUE, array-size=16, array-size-semantics=FIXED-SIZE, base-type=DataTypes/uint8
    TTFlashMask: category=VALUE, base-type=DataTypes/uint8, compu {0=NOT_IN_SYNCH, 1=FLASH_180DEG_PHASE_SYNCH, 2=FLASH_360DEG_PHASE_SYNCH, 4=FLASH_OFF_PERIOD_MASK}, range raw 0..4
    TT_OP_Type: category=ARRAY
      element ArrayElement: category=VALUE, array-size=92, array-size-semantics=FIXED-SIZE, base-type=DataTypes/uint8
    BulbTestStatus: category=VALUE, base-type=DataTypes/uint16, compu {0=BulbStatusNotActive, 45020=BulbStatusActive}, range raw 0..45020
    HMIReadySts_Type: category=VALUE, base-type=DataTypes/uint8, compu {0=eHMI_NOT_READY, 1=eHMI_READY}, range raw 0..1
    TFTIgnBlankSts_T: category=VALUE, base-type=DataTypes/uint8, compu {0=TFTExitBlankOut, 1=TFTInBlankOut}, range raw 0..1
    IgntionSubstateType: category=VALUE, base-type=DataTypes/uint8, compu {0=IgnOff, 1=IgnOn}, range raw 0..1
    TT_ENUM_TYPE:
      category=VALUE
      base-type=DataTypes/uint8
      compu {0=TT_ABS_INDEX, 1=TT_AIRBAG_INDEX, 2=TT_BRAKE_RED_INDEX, 3=TT_BRAKE_HOLD_INDEX, 4=TT_BRAKE_YELLOW_INDEX, 5=TT_PARKING_BRAKE_INDEX, 6=TT_TRACTION_CTRL_INDEX, 7=TT_VCS_OFF_INDEX, 8=TT_ABS_INDEX_US, 9=TT_BRAKE_RED_INDEX_US, 10=TT_PARKING_BRAKE_INDEX_US, 11=TT_SAF_RES4_INDEX, 12=TT_SAF_RES5_INDEX, 13=TT_SAF_RES6_INDEX, 14=TT_SAF_RES7_INDEX, 15=TT_SAF_RES8_INDEX, 16=TT_ADAS_INDEX, 17=TT_AUTO_HIGH_BEAM_INDEX, 18=TT_BRAKE_HOLD_STANDBY_INDEX, 19=TT_FUEL_INDEX, 20=TT_FFOG_INDEX, 21=TT_HEAD_INDEX, 22=TT_HIGH_BEAM_INDEX, 23=TT_PCS_OFF_INDEX, 24=TT_READY_INDEX, 25=TT_RFOG_INDEX, 26=TT_SEAT_BELT_INDEX, 27=TT_TAIL_LIGHT_INDEX, 28=TT_TURN_HAZARD_RIGHT_INDEX, 29=TT_TURN_HAZARD_LEFT_INDEX, 30=TT_EWT_INDEX, 31=TT_AAHB_LO_GREEN, 32=TT_AAHB_SHADED_GREEN, 33=TT_AAHB_HI_GREEN, 34=TT_AAHB_HI_WHITE, 35=TT_ITS_INFRA, 36=TT_ITS_VEHICLE, 37=TT_ITS_COMBINATION, 38=TT_SSS_GREEN, 39=TT_SSS_AMBER, 40=TT_LCA_LEFT_WHITE, 41=TT_LCA_LEFT_GRAY, 42=TT_LCA_LEFT_GREEN, 43=TT_LCA_RIGHT_WHITE, 44=TT_LCA_RIGHT_GRAY, 45=TT_LCA_RIGHT_GREEN, 46=TT_LTA_GREEN, 47=TT_LTA_WHITE, 48=TT_LTA_AMBER, 49=TT_CCT_GREEN, 50=TT_CCT_WHITE, 51=TT_CCT_AMBER, 52=TT_RCCT_GREEN, 53=TT_RCCT_WHITE, 54=TT_RCCT_AMBER, 55=TT_ACCDT_WHITE_LV4, 56=TT_ACCDT_WHITE_LV3, 57=TT_ACCDT_WHITE_LV2, 58=TT_ACCDT_WHITE_LV1, 59=TT_ACCDT_GREEN_LV4, 60=TT_ACCDT_GREEN_LV3, 61=TT_ACCDT_GREEN_LV2, 62=TT_ACCDT_GREEN_LV1, 63=TT_SL_GREEN, 64=TT_SL_WHITE, 65=TT_SL_AMBER, 66=TT_AUTO_LSD_AMBER, 67=TT_DRIVEMODE_SPORT, 68=TT_DRIVEMODE_ECO, 69=TT_DRIVEMODE_CUSTOM, 70=TT_DRIVEMODE_RANGE, 71=TT_DRIVEMODE_REARCOMFORT, 72=TT_DRIVEMODE_SNOW, 73=TT_DRIVEMODE_TRACK, 74=TT_LDA_RED, 75=TT_LDA_AMBER, 76=TT_LDA_WHITE, 77=TT_LDA_OFF_AMBER, 78=TT_LDA_OFF_WHITE, 79=TT_ECOLAMP, 80=TT_PS_GREEN, 81=TT_PKBOPER_TXT, 82=TT_PKBOPER_IMG, 83=TT_TPMS_INDEX, 84=TT_EBPWIND_RED_US, 85=TT_EBPWIND_RED, 86=TT_FMSR_AMBER, 87=TT_FMFR_AMBER, 88=TT_MULWL_GREEN, 89=TT_HCS_ACCESS_GREEN, 90=TT_HCS_LIFT_GREEN, 91=TT_HCS_LIFT_AMBER, 92=TT_TOTAL_NUM_OF_TELLTALES}
      range raw 0..92
    TT_OP_STATES:
      category=VALUE
      base-type=DataTypes/uint8
      compu {0=TT_TURN_OFF, 1=TT_TURN_ON, 2=TT_FLASH_QUARTER_HZ, 3=TT_FLASH_HALF_HZ, 4=TT_FLASH_CSNR_HALF_HZ, 5=TT_FLASH_0_83_HZ, 6=TT_FLASH_1HZ, 7=TT_FLASH_1_33_HZ, 8=TT_FLASH_1_66_HZ, 9=TT_FLASH_2HZ, 10=TT_FLASH_2_5_HZ, 11=TT_FLASH_2_66_HZ, 12=TT_FLASH_TRNHZ_Normal, 13=TT_FLASH_TRNHZ_Fast, 14=TT_FLASH_TRNHZ_FHL, 15=TT_FLASH_3HZ, 16=TT_FLASH_4HZ, 17=TT_FLASH_5HZ, 18=TT_FLASH_SYNC_QUARTER_HZ, 19=TT_FLASH_SYNC_HALF_HZ, 20=TT_FLASH_SYNC_CSNR_HALF_HZ, 21=TT_FLASH_SYNC_0_83_HZ, 22=TT_FLASH_SYNC_1HZ, 23=TT_FLASH_SYNC_1_33_HZ, 24=TT_FLASH_SYNC_1_66_HZ, 25=TT_FLASH_SYNC_2HZ, 26=TT_FLASH_SYNC_2_5_HZ, 27=TT_FLASH_SYNC_2_66_HZ, 28=TT_FLASH_TRNHZ_SYNC_Normal, 29=TT_FLASH_TRNHZ_SYNC_Fast, 30=TT_FLASH_TRNHZ_SYNC_FHL, 31=TT_FLASH_SYNC_4HZ, 32=TT_FLASH_SYNC_5HZ, 255=TT_CONFIGURED_OFF}
      range raw 0..255
    ClusterModes: category=VALUE, base-type=DataTypes/uint8, compu {0=CLUSTER_INACTIVE, 1=CLUSTER_ACTIVE}, range raw 0..1
    ModeStatus: category=VALUE, base-type=DataTypes/uint8, compu {0=STATUS_OFF, 1=STATUS_ON}, range raw 0..1
    eAppMdl: category=VALUE, base-type=DataTypes/uint8, compu {0=eSWCApp_SmartKey_Bzr, 1=eSWCApp_Warn_MFLID, 2=eSWCApp_Head_TT, 3=eSWCApp_Tail_TT, 4=eSWCApp_Fuel, 5=eSWCApp_Illum, 6=eSWCApp_Buzzer, 7=eSWCApp_NVM, 8=eTFTDisplayOnExceptTurn, 9=eTurnL_Status, 10=eTurnR_Status, 11=eSWCApp_End}, range raw 0..11
    eSleepSt: category=VALUE, base-type=DataTypes/uint8, compu {0=eSleep_Inactive, 1=eISleep_Active}, range raw 0..1
    ClusterInitModes: category=VALUE, base-type=DataTypes/uint8, compu {0=CLUSTER_INIT, 1=CLUSTER_RUN, 2=CLUSTER_RUN_READALL}, range raw 0..2
    SleepType: category=VALUE, base-type=DataTypes/uint8, compu {0=SLEEEP_READY, 1=SLEEP_NOT_READY}, range raw 0..1
    DisplayStatus: category=VALUE, base-type=DataTypes/uint8, compu {0=TFTDisplayOFF, 1=TFTDisplayON}, range raw 0..1
    VehicleActiveModes: category=VALUE, base-type=DataTypes/uint8, compu {0=NETWORK_SLEEP, 1=NETWORK_NORMAL, 2=NETWORK_STANDALONE}, range raw 0..2
    BOOL_TYPE: category=VALUE, base-type=DataTypes/uint8, compu {0=DBG_TRUE, 1=DBG_FALSE}, range raw 0..1
    HMI_Odo_Type: category=VALUE, base-type=DataTypes/uint8, compu {0=eODO_TYPE_OFF, 1=eODO_TYPE_BLANK, 2=eODO_TYPE_ODO, 3=eODO_TYPE_TRIPA, 4=eODO_TYPE_TRIPB, 5=eODO_TYPE_OILMIL_DISTANCE, 6=eODO_TYPE_FUEL_OW_ADV_NOTICE, 7=eODO_TYPE_FUEL_OVER_WRITE, 8=eODO_TYPE_POWER_STATUS_ACC, 9=eODO_TYPE_POWER_STATUS_ON, 10=eODO_TYPE_OILMIL_DISTANCE_INT}, range raw 0..10
    HMI_Screen_Mode: category=VALUE, base-type=DataTypes/uint8, compu {0=eSCREENMODE_OFF, 1=eSCREENMODE_BLANK, 2=eSCREENMODE_NORMAL, 3=eSCREENMODE_DISPLAY_ADJ, 4=eSCREENMODE_WELCOME, 5=eSCREENMODE_IGNOFF_CHR, 6=eSCREENMODE_OPENING, 7=eSCREENMODE_ENDING, 8=eSCREENMODE_ENDING_IGNOFF_CHR, 9=eSCREENMODE_RESERVED}, range raw 0..9
    TurnStates: category=VALUE, base-type=DataTypes/uint8, compu {0=TurnOff, 1=TurnOn, 2=TurnBlink}, range raw 0..2
    WarningId:
      category=VALUE
      base-type=DataTypes/uint16
      compu {0=WRN_NORM_BRLV_02, 1=WRN_NORM_ECB_02, 2=WRN_NORM_BRK_02, 3=WRN_NORM_BRKHLD_10, 4=WRN_NORM_BRKHLD_12, 5=WRN_NORM_BRKHLD_16, 6=WRN_NORM_ABS_02, 7=WRN_NORM_AUTHIG_02, 8=WRN_NORM_ADAHIG_02, 9=WRN_NORM_BRKHLD_02, 10=WRN_NORM_BRKHLD_03, 11..14=WRN_NORM_BRKHLD_05..WRN_NORM_BRKHLD_08, 15=WRN_NORM_BRKHLD_11, 16=WRN_NORM_BRKHLD_13, 17=WRN_NORM_BRKHLD_14, 18=WRN_NORM_BRKHLD_15, 19=WRN_NORM_BRKHLD_17, 20=WRN_NORM_AIRBAG_03, 21=WRN_NORM_AUTHIG_04, 22=WRN_NORM_ADAHIG_04, 23=WRN_NORM_ADASTT_05, 24=WRN_NORM_ADASTT_07, 25=WRN_NORM_ADASTT_09, 26=WRN_NORM_ADASTT_10, 27=WRN_NORM_ADASTT_11, 28=WRN_NORM_TFUEL_01, 29=WRN_NORM_PSC1_02, 30..36=WRN_NORM_PSC1_04..WRN_NORM_PSC1_10, 37=WRN_NORM_PSC1_12, 38=WRN_NORM_PSC1_13, 39=WRN_NORM_EPB_03, 40=WRN_NORM_EPB_04, 41=WRN_NORM_EPB_05, 42=WRN_NORM_EPB_08, 43..51=WRN_NORM_EPB_10..WRN_NORM_EPB_18, 52=WRN_NORM_TRCOFF_02, 53=WRN_NORM_WASLEV_02, 54=WRN_NORM_BVOOPE_02, 55=WRN_NORM_THESEN_02, 56=WRN_NORM_THESEN_03, 57..60=WRN_CUSTMIZE_DIGKEY_04..WRN_CUSTMIZE_DIGKEY_07, 61=WRN_NORM_MLGT_01, 62=WRN_NORM_TPWSR_01, 63=WRN_NORM_TPWSR_02, 64=WRN_NORM_TPWSR_03, 65..76=WRN_NORM_SMASTA_02..WRN_NORM_SMASTA_13, 77..81=WRN_NORM_SMASTA_17..WRN_NORM_SMASTA_21, 82..85=WRN_NORM_SMASTA_23..WRN_NORM_SMASTA_26, 86..92=WRN_NORM_SMASTA_28..WRN_NORM_SMASTA_34, 93..98=WRN_NORM_SMASTA_36..WRN_NORM_SMASTA_41, 99=WRN_NORM_LEDHEA_01, 100=WRN_NORM_HEALEV_02, 101=WRN_NORM_HEALEV_03, 102=WRN_NORM_GRISHU_02, 103=WRN_NORM_AVAS_02, 104=WRN_NORM_ALOA_03, 105=WRN_NORM_PCS2_03, 106=WRN_NORM_PCS2_11, 107=WRN_NORM_TRWIP_01, 108..111=WRN_NORM_RSEREM_02..WRN_NORM_RSEREM_05, 112=WRN_NORM_4WDSYS_03, 113=WRN_NORM_4WDSYS_04, 114=WRN_NORM_4WDSYS_06, 115=WRN_NORM_CVTOIL_02, 116=WRN_NORM_CVTOIL_03, 117=WRN_NORM_ATMAL_02, 118=WRN_NORM_SFTPOS_02, 119=WRN_NORM_SFTPOS_03, 120=WRN_NORM_SFTPOS_04, 121=WRN_NORM_MCBW_02, 122=WRN_NORM_TPWS_01, 123=WRN_NORM_TPWS_02, 124..127=WRN_NORM_OILMIL_02..WRN_NORM_OILMIL_05, 128=WRN_NORM_BRLV0_02, 129=WRN_NORM_OILPRE_01, 130=WRN_NORM_BRK0_02, 131=WRN_NORM_BRK0_03, 132..137=WRN_NORM_EPS_02..WRN_NORM_EPS_07, 138=WRN_NORM_EPS_09, 139=WRN_NORM_EPS_10, 140=WRN_NORM_EPS_11, 141=WRN_NORM_FUECAP_02, 142=WRN_NORM_CHEENG_02, 143=WRN_NORM_CHEENG_03, 144=WRN_NORM_CHEENG_04, 145=WRN_NORM_CHEENG_07, 146=WRN_NORM_ROLAWA_01, 147=WRN_NORM_ROLAWA_02, 148=WRN_NORM_ROLAWA_03, 149..155=WRN_NORM_GPF_05..WRN_NORM_GPF_11, 156=WRN_NORM_OILLEV_02, 157=WRN_NORM_COOTEM_03, 158=WRN_NORM_ONACCN_03, 159=WRN_NORM_BATLOW_02, 160=WRN_NORM_CHAMAL_02, 161=WRN_NORM_CHAMAL_03, 162=WRN_NORM_POWMAN_02, 163=WRN_NORM_SOCLOW_02, 164=WRN_NORM_SOCLOW_03, 165..168=WRN_NORM_BATINS_02..WRN_NORM_BATINS_05, 169=WRN_NORM_ONACCP_02, 170=WRN_NORM_ALMN_02, 171=WRN_NORM_HEAECU_02, 172=WRN_NORM_BOS_02, 173=WRN_NORM_BOS_03, 174..182=WRN_NORM_EVMOD_02..WRN_NORM_EVMOD_10, 183=WRN_NORM_DSC_02, 184=WRN_NORM_DSC_03, 185=WRN_NORM_DSC_04, 186..196=WRN_NORM_ROLAWA1_01..WRN_NORM_ROLAWA1_11, 197..200=WRN_NORM_MAICER_09..WRN_NORM_MAICER_12, 201=WRN_NORM_PKSB_09, 202=WRN_NORM_PKSB_10, 203=WRN_NORM_PKSB_11, 204=WRN_NORM_PKSB_13, 205=WRN_NORM_PKSB_14, 206=WRN_NORM_ISA_02, 207=WRN_NORM_ISA_04, 208=WRN_NORM_TCBM_01, 209=WRN_NORM_TCBM_02, 210=WRN_NORM_ADAFRO_02, 211=WRN_NORM_PDA_03, 212=WRN_NORM_RTAN_03, 213=WRN_NORM_SEA_02, 214=WRN_NORM_T120_01, 215=WRN_POWER_EIGCON_02, 216=WRN_POWER_EIGCON_04, 217..220=WRN_PROSRV_PROSRV_02..WRN_PROSRV_PROSRV_05, 221..226=WRN_PROSRV_PROSRV_08..WRN_PROSRV_PROSRV_13, 227=WRN_PROSRV_PROSRV_22, 228=WRN_PROSRV_PROSRV_23, 229=WRN_NORM_BATCOO_02, 230=WRN_NORM_BATCOO_03, 231=WRN_NORM_LDA_02, 232=WRN_NORM_LDA_03, 233=WRN_NORM_LDA_06, 234=WRN_NORM_LDA_07, 235=WRN_NORM_LTA_02, 236=WRN_NORM_LTA_03, 237=WRN_NORM_LTA_07, 238..241=WRN_NORM_LCA_02..WRN_NORM_LCA_05, 242=WRN_NORM_LCA_15, 243=WRN_NORM_LCA_16, 244=WRN_NORM_LCA_17, 245=WRN_NORM_LCA_20, 246=WRN_NORM_RSA_01, 247=WRN_NORM_RSA_04, 248=WRN_NORM_RSA_05, 249=WRN_NORM_CHADYN_01, 250=WRN_NORM_CHADYN_02, 251=WRN_NORM_TOWWAR_02, 252=WRN_NORM_TOWWAR_03, 253=WRN_NORM_TOWWAR_05, 254=WRN_NORM_DMC_02, 255=WRN_NORM_DMC_03, 256=WRN_NORM_DMC_05, 257=WRN_NORM_DMC_06, 258..261=WRN_NORM_DMC_12..WRN_NORM_DMC_15, 262=WRN_NORM_DMC_17, 263=WRN_NORM_DMC_18, 264=WRN_NORM_ICYRA_01, 265=WRN_NORM_SEA_NCYC_02, 266=WRN_NORM_DRIPOW_02, 267=WRN_NORM_DRIPOW_03, 268=WRN_NORM_DRIPOW_04, 269=WRN_NORM_CCS_02, 270=WRN_NORM_CCS_03, 271..281=WRN_NORM_ACC_02..WRN_NORM_ACC_12, 282=WRN_NORM_ACC_18, 283=WRN_NORM_ACC_19, 284=WRN_NORM_ACC_21, 285..291=WRN_NORM_DESA_02..WRN_NORM_DESA_08, 292=WRN_NORM_PEXI_02, 293..299=WRN_NORM_RESADJ_09..WRN_NORM_RESADJ_15, 300=WRN_NORM_TSMODE_02, 301=WRN_NORM_UNIOVE_02, 302=WRN_NORM_UNIOVE_04, 303=WARN_ADAS_SDG_01, 304=WRN_ADAS_PDA_01, 305=WRN_ADAS_PDA_02, 306=WRN_NORM_TDOOR_01, 307=WRN_NORM_TDOOR_02, 308=WRN_NORM_TDOOR_03, 309=WRN_NORM_ACCHOL_02, 310=WRN_NORM_ACCHOL_03, 311=WRN_NORM_ACCHOL_05, 312..318=WRN_NORM_MAICER_09_RESADJ_09..WRN_NORM_MAICER_09_RESADJ_15, 319..325=WRN_NORM_MAICER_11_RESADJ_09..WRN_NORM_MAICER_11_RESADJ_15, 326=WRN_NORM_CVRS_04, 327=WRN_NORM_CVRS_05, 328..334=WRN_NORM_SMASTA_42..WRN_NORM_SMASTA_48, 335=WRN_MFLID_MFLID_01, 336=WRN_NORM_MFLID_02, 337=WRN_NORM_MFLID_03, 338=WRN_NORM_TMNT_15, 339=WRN_NORM_TMNT_16, 340=WRN_ADAS_LCA1, 341=WRN_ADAS_LCA2, 342=WRN_DOOR_UNLMOD_02, 343=WARN_ADAS_PDA1, 344..350=WRN_ADAS_URSM_01..WRN_ADAS_URSM_07, 351..367=WRN_NORM_SYSMAL_HVIND1..WRN_NORM_SYSMAL_HVIND17, 368=WRN_NORM_FHL_04, 369=WRN_NORM_SMASTA_52, 370=WRN_NORM_SMASTA_53, 371..377=WRN_NORM_GPF_MEV01_02..WRN_NORM_GPF_MEV01_08, 378=WRN_NORM_VCOPE_02, 379=WRN_NORM_VCOPE_03, 380=WRN_ADAS_LCA_01, 381=WRN_ADAS_LCA_03, 382=WRN_ADAS_LCA_04, 383..389=WRN_NORM_FCMDI_01..WRN_NORM_FCMDI_07, 390=WRN_NORM_TSMODE_VM01_02, 391..395=WRN_ADAS_ACC_01..WRN_ADAS_ACC_05, 396..431=WRN_ADAS_ACC_22..WRN_ADAS_ACC_57, 432..439=WRN_NORM_ACC_VM01_GSY07_02..WRN_NORM_ACC_VM01_GSY07_09, 440..443=WRN_NORM_ACC_VM01_EFE02_02..WRN_NORM_ACC_VM01_EFE02_05, 444..447=WRN_NORM_ACC_VM01_EFE01_02..WRN_NORM_ACC_VM01_EFE01_05, 448..455=WRN_NORM_ACC_VM01_GME12_02..WRN_NORM_ACC_VM01_GME12_09, 456=WRN_NORM_FCTA_01, 457=WARN_NORM_GRISHU_02, 458=WRN_NORM_CHEENG_06, 459=WRN_NORM_SFTPOSL_02, 460=WRN_NORM_SFTPOSL_03, 461=WRN_NORM_SFTPOSL_04, 462=WRN_NORM_TPMS_02, 463=WRN_NORM_TPMS_03, 464=WRN_NORM_STOSTA_02, 465=WRN_NORM_RSRDI_02, 466=WRN_NORM_PSSDI_02, 467=WRN_NORM_UNOVE_02, 468=WRN_NORM_UNOVE_04, 469=WRN_CUSTMIZE_PERSET_02, 470=WRN_CUSTMIZE_PERSET_03, 471=WRN_CUSTMIZE_PERSET_04, 472..490=WRN_CUSTMIZE_PERSET_06..WRN_CUSTMIZE_PERSET_24, 491=WRN_NORM_SEA_VM01_02, 492=WRN_NORM_SEA_VM02_02, 493..496=WRN_NORM_PSSDI_03..WRN_NORM_PSSDI_06, 497=WRN_NORM_CLESON_02, 498=WRN_CUTMIZE_DIGKEY_01, 499=WRN_NORM_RSRDI_03, 500=WRN_ADAS_LCA_02, 501..510=WRN_NORM_TPMS_VM02_REQ02..WRN_NORM_TPMS_VM02_REQ11, 511=WRN_NORM_TPMS_VM02_GWM08_REQ02, 512=WRN_NORM_TPMS_VM02_GWM08_REQ01, 513=WRN_NORM_PSSDI_07, 514=WRN_NORM_EXWUOC_04, 515=WRN_NORM_EXWUOC_06, 516=WRN_NORM_EXWUOC_10, 517=WRN_NORM_EXWUOC_16, 518=WRN_NORM_EXWUOC_17, 519=WRN_NORM_EXWUOC_18, 520=WRN_NORM_PBD_02, 521=WRN_NORM_FCTA_02, 522=WRN_NORM_TMN_02, 523=WRN_NORM_TMN_03, 524=WRN_NORM_PEDPRO_03, 525=WRN_NORM_PEDPRO_04, 526=WRN_NORM_LEAUNF_02, 527=WRN_NORM_LEAUNF_04, 528..537=WRN_NORM_HCS_02..WRN_NORM_HCS_11, 538=WRN_NORM_SCB_02, 539=WRN_NORM_ITS_02, 540=WRN_NORM_ITS_06, 541=WRN_NORM_ITS_MEV01_02, 542=WRN_NORM_ITS_MEV01_04, 543=WRN_NORM_ITS_MEV01_05, 544=WRN_NORM_ITS_MEV01_06, 545=WRN_NORM_MAPACC_02, 546=WRN_NORM_OAA_03, 547=WRN_NORM_OAA_04, 548=WRN_NORM_LCA_21, 549..554=WRN_NORM_LCA_26..WRN_NORM_LCA_31, 555=WRN_NORM_NLOCK_02, 556=WRN_NORM_ATFWRN_02, 557=WRN_NORM_LTA_04, 558=WRN_NORM_LTA_05, 559=WRN_NORM_LTA_06, 560..564=WRN_NORM_LTA_08..WRN_NORM_LTA_12, 565=WRN_NORM_PCL_02, 566..573=WRN_ADAS_LCA_05..WRN_ADAS_LCA_12, 574=WRN_NORM_LDA_04, 575=WRN_NORM_LDA_05, 576=WRN_ADAS_OAA_01, 577=WRN_NORM_TPMS_VM02_GWM08_REQ06, 578=WRN_NORM_TPMS_VM02_GWM08_REQ07, 579=WRN_ADAS_ACC_G7, 580=WRN_ADAS_ACC_G11_01, 581=WRN_ADAS_ACC_G11_02, 582=WRN_ADAS_ACC_G11_03, 583=WRN_ADAS_ACC_G20, 584=WRN_ADAS_ACC_G22, 585=WRN_ADAS_ACC_G23, 586=HUD_WRN_NORM_PCS1_05, 587=HUD_WRN_NORM_PCS1_06, 588=HUD_WRN_ADAS_ACC_G20, 589=HUD_WRN_ADAS_ACC_G7, 590=HUD_WRN_ADAS_ACC_G23, 591=HUD_WRN_ADAS_ACC_G22, 592=HUD_WRN_ADAS_LCA_02, 593=HUD_WRN_NORM_DA_02, 594=HUD_WRN_NORM_SCB_02, 595=HUD_WRN_NORM_ITS_MEV01_04, 596=HUD_WRN_NORM_ITS_MEV01_02, 597=HUD_WRN_NORM_ITS_02, 598=HUD_WRN_NORM_BOS_02, 599=HUD_WRN_NORM_DSC_02, 600=HUD_WRN_NORM_PMAR_03, 601=HUD_WRN_ADAS_OAA_01, 602=HUD_WRN_NORM_ACC_19, 603=HUD_WRN_NORM_LCA_29, 604..611=HUD_WRN_ADAS_LCA_05..HUD_WRN_ADAS_LCA_12, 612=HUD_WRN_NORM_RTAN_02, 613=HUD_WRN_NORM_LDA_02, 614=HUD_WRN_ADAS_LCA_03, 615=HUD_WRN_ADAS_LCA_04, 616=HUD_WRN_NORM_ACC_21, 617=HUD_WRN_ADAS_ACC_G11_01, 618=HUD_WRN_ADAS_ACC_G11_02, 619=HUD_WRN_ADAS_ACC_G11_03, 620=HUD_WRN_NORM_DSC_04, 621..629=WRN_NORM_GROUP1..WRN_NORM_GROUP9, 630=TotalNumOfWarnings}
      range raw 0..630
    WarningStatus: category=VALUE, base-type=DataTypes/uint8, compu {0=UI_WARNING_STATUS_OFF, 1=UI_WARNING_STATUS_ON, 2=UI_WARNING_STATUS_UNKNOWN}, range raw 0..2
    WarningEvent: category=VALUE, base-type=DataTypes/uint8, compu {0=UI_WARNING_EVENT_NONE, 1=UI_WARNING_EVENT_RETRIGGER, 2=UI_WARNING_EVENT_FORCED}, range raw 0..2
    IOCtrl_Type: category=VALUE, base-type=DataTypes/uint8, compu {1=eSPEEDO, 2=eTACHO, 4=eHVSYS_INDICATOR, 8=eSPEAKER, 16=eTELLTALE, 32=eBUTTONEVENT, 64=eMIDDISPALY}, range raw 1..64
    UserIdType: category=VALUE, base-type=DataTypes/uint8, compu {1=USER1, 2=USER2, 3=USER3, 4=GUEST}, range raw 1..4
    CustResetType: category=VALUE, base-type=DataTypes/uint8, compu {0=NO_REQUEST, 1=USER1, 2=USER2, 3=USER3, 4=GUEST}, range raw 0..4
    SettingResetResult_Type: category=VALUE, base-type=DataTypes/uint8, compu {0=INPROGRESS, 1=SUCCESS, 2=FAIL}, range raw 0..2
    PayloadArr_u8_8: category=ARRAY
      element ArrayElement: category=VALUE, array-size=8, array-size-semantics=FIXED-SIZE, base-type=DataTypes/uint8
    ExtWarningData: category=STRUCTURE
      element ExtWarningCurrentStatus: implementation-data-type=WarningStatus
      element ExtWarningCurrentEvent: implementation-data-type=WarningEvent
      element ExtWarningCurrentPayload: implementation-data-type=PayloadArr_u8_8
    WarningDisplayedStatus: category=VALUE, base-type=DataTypes/uint8, compu {0=WRNG_NOTIFIED_NONE, 1=WRNG_NOTIFIED_ACKNOWLEDGED, 2=WRNG_NOTIFIED_TIMEOUT, 4=WRNG_NOTIFIED_HIDDEN, 8=WRNG_NOTIFIED_SHOW, 16=WRNG_NOTIFIED_ACTIVE, 32=WRNG_NOTIFIED_INACTIVE}, range raw 0..32
    EButtonId: category=VALUE, base-type=DataTypes/uint8, compu {0=EButtonId_None, 1=EButtonId_Ok, 2=EButtonId_Up, 3=EButtonId_Down, 4=EButtonId_Back, 5=EButtonId_Menu, 6=EButtonId_Phone, 7=EButtonId_Hud, 8=EButtonId_Last}, range raw 0..8
    EButtonSts: category=VALUE, base-type=DataTypes/uint8, compu {0=EButtonSts_Off, 1=EButtonSts_On, 2=EButtonSts_Short, 3=EButtonSts_Long, 4=EButtonSts_Repeat, 5=EButtonSts_Last}, range raw 0..5
    data_u32_5: category=ARRAY
      element ArrayElement: category=VALUE, array-size=5, array-size-semantics=FIXED-SIZE, base-type=DataTypes/uint32
    STpmsWarningData: category=STRUCTURE
      element tpmsWarndata: implementation-data-type=data_u32_5
    data_u8_4: category=ARRAY
      element ArrayElement: category=VALUE, array-size=4, array-size-semantics=FIXED-SIZE, base-type=DataTypes/uint8
    Hud_Wake_Type: category=VALUE, base-type=DataTypes/uint8, compu {0=HUD_WK_LO, 1=HUD_WK_HI}, range raw 0..1
    data_u8_10: category=ARRAY
      element ArrayElement: category=VALUE, array-size=10, array-size-semantics=FIXED-SIZE, base-type=DataTypes/uint8
    Tpms_Arr_u8_5: category=ARRAY
      element ArrayElement: category=VALUE, array-size=5, array-size-semantics=FIXED-SIZE, base-type=DataTypes/uint8
    Target_SW_Status: category=VALUE, base-type=DataTypes/uint8, compu {0=NO_TARGET, 1=TG_LEFT, 2=TG_UP, 3=TG_DOWN, 4=TG_RIGHT, 5=TG_ENTER, 6=TG_BACK, 7=TG_MAX}, range raw 0..7
    EGaugeUnit: category=VALUE, base-type=DataTypes/uint8, compu {0=EGaugeUnit_Mph, 1=EGaugeUnit_Kmph, 2=EGaugeUnit_Centigrade, 3=EGaugeUnit_Farenheit, 4=EGaugeUnit_Psi, 5=EGaugeUnit_Pa, 6=EGaugeUnit_Bar, 7=EGaugeUnit_Kmpl, 8=EGaugeUnit_Mpg, 9=EGaugeUnit_Ltr, 10=EGaugeUnit_Gal, 11=EGaugeUnit_Km, 12=EGaugeUnit_Mile, 13=EGaugeUnit_Last}, range raw 0..13
    data_u8_12: category=ARRAY
      element ArrayElement: category=VALUE, array-size=12, array-size-semantics=FIXED-SIZE, base-type=DataTypes/uint8
    STT_Status: category=STRUCTURE
      element mask: implementation-data-type=data_u8_15
    ShiftPositionInd: category=VALUE, base-type=DataTypes/uint8, compu {1=Shift_PosInd_Ind_S, 2=Shift_PosInd_Ind_M, 3=Shift_PosInd_Ind_D}, range raw 1..3
    ShiftPosition: category=VALUE, base-type=DataTypes/uint8, compu {16=Shift_PosInd_P, 32=Shift_PosInd_R, 48=Shift_PosInd_N, 64=Shift_PosInd_D, 80=Shift_PosInd_B, 96=Shift_PosInd_SD}, range raw 16..96
    tRxSafeSignalId:
      category=VALUE
      base-type=DataTypes/uint8
      compu {0=eSCSBZRIn, 1=eSCSACCELIn, 2=ePBKLABIn, 3=eDBKLABIn, 4=eABIn, 5=eB_PKBLPIn, 6=eB_EPBWLIn, 7=eB_EPBMIDIn, 8=eB_CPKBIn, 9=eVSCOFFIn, 10=eVSCEXISTIn, 11=eTRCOFFIn, 12=eSLP_WLIn, 13=eMCBWIn, 14=eECBEXISTIn, 15=eEBW_MIDIn, 16=eBRK_MIDIn, 17=eBHEXISTIn, 18=eB_EBWIn, 19=eB_DAINDPIn, 20=eB_DAINDCIn, 21=eB_DACINDIn, 22=eB_BUZZERIn, 23=eB_BRLVIn, 24=eB_BRKWIn, 25=eB_ALSDIn, 26=eB_ABSIn, 27=eABS_MIDIn, 28=ePWIINFOIn, 29=eTRCCONRRIn, 30=eTRCCONRLIn, 31=eTRCCONFRIn, 32=eTRCCONFLIn, 33=eB_EBW2In, 34=eB_BUZZE2In, 35=eB_BRLV2In, 36=eB_BRKW2In, 37=eEndOfRxSafeSignal}
      range raw 0..37
    tRxSafeSignalStatus: category=VALUE, base-type=DataTypes/uint8, compu {0=eSIGNAL_OK, 1=eSIGNAL_MISSING, 2=eSIGNAL_NEVER_RECEIVED, 4=eSIGNAL_INVALID}, range raw 0..4
    tRxSafeSignalJustRcvdStatus: category=VALUE, base-type=DataTypes/uint8, compu {0=eJust_Received, 1=eNot_Just_Received}, range raw 0..1
    CountryCode_FuncType: category=VALUE, base-type=DataTypes/uint8, compu {0=eFUNC_CANADA, 1=eFUNC_NORTH_AMERICA, 2=eFUNC_MEXICO, 3=eFUNC_GENERAL_EXPORT, 4=eFUNC_UK, 5=eFUNC_EUROPE, 6=eFUNC_SOUTH_AFRICA, 7=eFUNC_MIDDLE_EAST_ASIA, 8=eFUNC_JAPAN, 9=eFUNC_INDIA, 10=eFUNC_KOREA, 11=eFUNC_TAIWAN, 12=eFUNC_CHINA, 13=eFUNC_HONG_KONG, 14=eFUNC_AUSTRALIA}, range raw 0..14
    WarningDataS: category=STRUCTURE
      element WarningCurrentStatus: implementation-data-type=WarningStatus
      element WarningCurrentEvent: implementation-data-type=WarningEvent
      element WarningCurrentPayload: implementation-data-type=UInt32
    SIlluminationData: category=STRUCTURE
      4 x element, all with category=TYPE_REFERENCE, implementation-data-type=UInt8:
        data
        dayStep
        nightStep
        daynightStatus
    SHudWarningDisplay: category=STRUCTURE
      element show: implementation-data-type=UInt8
      element warningId: implementation-data-type=UInt16
      element dynData: implementation-data-type=Types/data_u8_8
    SWarningDisplay: category=STRUCTURE
      element show: implementation-data-type=UInt8
      element warningId: implementation-data-type=UInt16
      element dynData: implementation-data-type=Types/data_u8_8
    SHudWarningStatus: category=STRUCTURE
      element visible: implementation-data-type=UInt8
      element warningId: implementation-data-type=UInt16
      element dynData: implementation-data-type=data_u8_10
    SKeyVal1: category=STRUCTURE
      element key: implementation-data-type=UInt8
      element value: implementation-data-type=UInt8
    SWarningStatus: category=STRUCTURE
      element visible: implementation-data-type=UInt8
      element warningId: implementation-data-type=UInt16
      element dynData: implementation-data-type=data_u8_10
    SGaugeInfo: category=STRUCTURE
      5 x element, all with category=TYPE_REFERENCE:
        id: implementation-data-type=UInt8
        position: implementation-data-type=UInt16
        digitalData: implementation-data-type=SInt32
        unit: implementation-data-type=EGaugeUnit
        dynData: implementation-data-type=UInt16
    SFastGuageInfo: category=STRUCTURE
      element gaugeInfo_4: implementation-data-type=SGaugeInfo
    SShiftInd: category=STRUCTURE
      6 x element, all with category=TYPE_REFERENCE, implementation-data-type=UInt8:
        Shift_Ind_Pos
        Shift_Ind_BlinkReq
        Shift_Ind_DisplayDecState
        Shift_Ind_Down
        Shift_Ind_Screen_ShiftType
        Shift_Ind_Up
    SShiftPosIndStatus: category=STRUCTURE
      element status: implementation-data-type=SShiftInd
    ShiftposData_Type: category=STRUCTURE
      5 x element, all with category=TYPE_REFERENCE:
        Shift_Up_Ind: implementation-data-type=UInt8
        DisplayDecState: implementation-data-type=UInt8
        Shift_Ind_Pos: implementation-data-type=UInt16
        Shift_Down_Ind: implementation-data-type=UInt8
        Screen_ShiftType: implementation-data-type=UInt8
    data_u8_15: category=ARRAY
      element ArrayElement: category=VALUE, array-size=15, array-size-semantics=FIXED-SIZE, base-type=DataTypes/uint8
    Dlt_ApplicationIDType: category=ARRAY
      element ArrayElement: category=VALUE, array-size=4, array-size-semantics=FIXED-SIZE, base-type=DataTypes/uint8
    Dlt_ContextIDType: category=ARRAY
      element ArrayElement: category=VALUE, array-size=4, array-size-semantics=FIXED-SIZE, base-type=DataTypes/uint8
    SGaugeInfo_u32dyn: category=STRUCTURE
      5 x element, all with category=TYPE_REFERENCE:
        id: implementation-data-type=UInt8
        position: implementation-data-type=UInt16
        digitalData: implementation-data-type=UInt32
        unit: implementation-data-type=EGaugeUnit
        dynData: implementation-data-type=UInt16
    SFastGaugeInfo: category=STRUCTURE
      element gaugeInfo: implementation-data-type=SGaugeInfo_u32dyn_2
    SSlowGaugeInfo: category=STRUCTURE
      element gaugeInfo: implementation-data-type=SGaugeInfo_2
  17 x impl type:
    data_u8_64: category=ARRAY
      element ArrayElement: category=VALUE, array-size=64, array-size-semantics=FIXED-SIZE, base-type=DataTypes/uint8
    data_u8_2: category=ARRAY
      element ArrayElement: category=VALUE, array-size=2, array-size-semantics=FIXED-SIZE, base-type=DataTypes/uint8
    SRTT_Status: category=STRUCTURE
      element mask: implementation-data-type=data_u8_2
    SRTT_Icon: category=STRUCTURE
      element icon: implementation-data-type=data_u8_2
    data_u8_512: category=ARRAY
      element ArrayElement: category=VALUE, array-size=512, array-size-semantics=FIXED-SIZE, base-type=DataTypes/uint8
    RstM_FaultIdType:
      category=VALUE
      base-type=DataTypes/uint8
      compu {0=RSTM_DET_ERROR, 1=RSTM_WDGM_ALIVE_FAIL, 2=RSTM_WDG_TIMEOUT_LOG, 3=RSTM_FOTA, 4=RSTM_DIAG, 5=RSTM_RAM_TST_ERROR, 6=RSTM_CAN_LOOP_TEST_ERROR, 7=RSTM_FLS_TST_ERROR, 8=RSTM_EARLY_WAKEUP, 9=RSTM_CORE_SYS_TST_ERROR, 10=RSTM_PMIC_CRC_FAIL, 11=RSTM_NVM_FAILURE, 12=RSTM_GIP_HEALTH_FAIL, 13=RSTM_ESM_DM_RTI, 14=RSTM_ESM_HSM_RTI, 15=RSTM_ESM_ECC_FAIL, 16=RSTM_ESM_DCC_FAIL, 17=RSTM_ESM_OCOC_FAIL, 18=RSTM_OS_PROTECTION_HOOK, 19=RSTM_OS_ERROR_HOOK}
      range raw 0..19
    RstM_ResetType: category=VALUE, base-type=DataTypes/uint8, compu {0=NONE, 1=PMIC_RESET, 2=MCU_RESET}, range raw 0..2
    RstM_ResetHistoryType: category=STRUCTURE
      element ResetTime: implementation-data-type=UInt32
      element FaultId: implementation-data-type=RstM_FaultIdType
      element ResetType: implementation-data-type=RstM_ResetType
    SMainHMIReadyStatus: category=STRUCTURE
      element status: implementation-data-type=UInt8
    SSafeHMIReadyStatus: category=STRUCTURE
      element status: implementation-data-type=UInt8
    SUpdateShortServiceResp: category=STRUCTURE
      7 x element, all with category=TYPE_REFERENCE:
        msgId: implementation-data-type=UInt16
        msgSize: implementation-data-type=UInt16
        sid: implementation-data-type=UInt8
        length: implementation-data-type=UInt16
        responseCode: implementation-data-type=UInt8
        NRC: implementation-data-type=UInt8
        data: implementation-data-type=data_u8_64
    SWarningDisplayAvailable: category=STRUCTURE
      element status: implementation-data-type=UInt8
    SRTT_Toggle: category=STRUCTURE
      element positions: implementation-data-type=UInt8
      element display: implementation-data-type=UInt8
    SUpdateLongServiceReq: category=STRUCTURE
      7 x element, all with category=TYPE_REFERENCE:
        msgId: implementation-data-type=UInt16
        msgSize: implementation-data-type=UInt16
        memoryType: implementation-data-type=UInt8
        memoryCmd: implementation-data-type=UInt8
        sid: implementation-data-type=UInt8
        length: implementation-data-type=UInt32
        data: implementation-data-type=data_u8_2048
    SUpdateShortServiceReq: category=STRUCTURE
      7 x element, all with category=TYPE_REFERENCE:
        msgId: implementation-data-type=UInt16
        msgSize: implementation-data-type=UInt16
        memoryType: implementation-data-type=UInt8
        memoryCmd: implementation-data-type=UInt8
        sid: implementation-data-type=UInt8
        length: implementation-data-type=UInt32
        data: implementation-data-type=data_u8_64
    SWarningExtDisplay: category=STRUCTURE
      element show: implementation-data-type=UInt8
      element warningId: implementation-data-type=UInt16
      element dynData: implementation-data-type=Types/data_u8_8
    RstM_ResetLogType: category=STRUCTURE
      5 x element, all with category=TYPE_REFERENCE:
        ModuleId: implementation-data-type=UInt16
        InstanceId: implementation-data-type=UInt8
        ApiId: implementation-data-type=UInt8
        FaultId: implementation-data-type=RstM_FaultIdType
        ErrorId: implementation-data-type=UInt8
  5 x impl type:
    Arr_u8_28: category=ARRAY
      element ArrayElement: category=VALUE, array-size=28, array-size-semantics=FIXED-SIZE, base-type=DataTypes/uint8
    Arr_u16_7: category=ARRAY
      element ArrayElement: category=VALUE, array-size=7, array-size-semantics=FIXED-SIZE, base-type=DataTypes/uint16
    T_NV_Temperature_Conversion: category=ARRAY
      element ArrayElement: category=VALUE, array-size=2, array-size-semantics=FIXED-SIZE, base-type=DataTypes/uint32
    FltM_FaultIdType: category=VALUE, base-type=DataTypes/uint16, range raw 0..65535
    SFRTT_Status: category=STRUCTURE
      element mask: implementation-data-type=data_u8_2
  9 x impl type:
    eFltM_FaultIdType:
      category=VALUE
      base-type=DataTypes/uint16
      compu {65281=FLTM_E_OS_ACCESS, 65282=FLTM_E_OS_CALLLEVEL, 65283=FLTM_E_OS_ID, 65284=FLTM_E_OS_LIMIT, 65285=FLTM_E_OS_NOFUNC, 65286=FLTM_E_OS_RESOURCE, 65287=FLTM_E_OS_STATE, 65288=FLTM_E_OS_VALUE, 65289=FLTM_E_OS_SERVICEID, 65290=FLTM_E_OS_ILLEGAL_ADDRESS, 65291=FLTM_E_OS_MISSINGEND, 65292=FLTM_E_OS_DISABLEDINT, 65293=FLTM_E_OS_STACKFAULT, 65294=FLTM_E_OS_PROTECTION_MEMORY, 65295=FLTM_E_OS_PROTECTION_TIME, 65296=FLTM_E_OS_PROTECTION_ARRIVAL, 65297=FLTM_E_OS_PROTECTION_LOCKED, 65298=FLTM_E_OS_PROTECTION_EXCEPTION, 65299=FLTM_E_OS_INTERFERENCE_DEADLOCK, 65300=FLTM_E_OS_NESTING_DEADLOCK, 65301=FLTM_E_OS_SPINLOCK, 65302=FLTM_E_OS_CORE, 65303=FLTM_E_OS_PARAM_POINTER, 65304=FLTM_E_OS_SHUTDOWN, 65305=FLTM_E_OS_SYS_API_ERROR, 65520=FLTM_E_OS_SYS_ASSERTION, 65521=FLTM_E_OS_SYS_DISABLED, 65522=FLTM_E_OS_SYS_NO_BARRIER_PARTICIPANT, 65523=FLTM_E_OS_SYS_UNIMPLEMENTED_FUNCTIONALITY, 65524=FLTM_E_OS_SYS_NO_NTFSTACK, 65525=FLTM_E_OS_SYS_OVERFLOW, 65526=FLTM_E_OS_SYS_KILL_KERNEL_OBJ, 65527=FLTM_E_OS_SYS_NO_RESTARTTASK, 65528=FLTM_E_OS_SYS_CALL_NOT_ALLOWED, 65529=FLTM_E_OS_SYS_FUNCTION_UNAVAILABLE, 65530=FLTM_E_OS_SYS_PROTECTION_SYSCALL, 65531=FLTM_E_OS_SYS_PROTECTION_IRQ, 65532=FLTM_E_OS_SYS_OVERLOAD, 65533=FLTM_E_OS_SYS_CROSS_CORE_REQUESTED, 64001=E_ARM_NMI_EVENT, 64002=E_ARM_HARD_FAULT, 64003=E_ARM_MEMMANAGE_FAULT, 64004=E_ARM_BUS_FAULT, 64005=E_ARM_USAGE_FAULT, 64006=E_ARM_DEBUG_MONITOR, 64007=E_ARM_PENDING_SV, 64241=E_ARM_UNDEFINED_INSTRUCTION, 64242=E_ARM_Supervisor_Call, 64243=E_ARM_PREFETCH_ABORT, 64244=E_ARM_DATA_ABORT, 64245=E_ARM_SUPERVISOR, 64246=E_ARM_UNDEFINED, 64247=E_ARM_SVC, 64248=E_ARM_PREFETCH_ABORT_R5, 64249=E_ARM_PREFETCH_ABOR_R5, 64257=NVM_E_HARDWARE, 64258=NVM_E_INTEGRITY_FAILED, 64259=E_NVM_REQ_FAILED, 64260=E_NVM_WRONG_BLOCK_ID, 64261=E_NVM_VERIFY_FAILED, 64262=E_NVM_LOSS_OF_REDUNDANCY, 64263=E_NVM_WRITE_FAILED, 64264=E_NVM_READ_FAILED, 64512=RESET_UNDEFINED, 64513=POWER_ON_RESET, 64514=MCU_PORz, 64515=SW_MAIN_PORz, 64516=MCU_RESETz, 64517=SW_MCU_WARMRSTz, 64518=MAIN_RESETz_REQ, 64519=SW_MAIN_WARMRSTz, 64520=VTM_THERMAL_RESET, 64521=ESM_ERRORz, 64522=SMS_COLD_OUT_RST_n, 64523=SMS_WARM_OUT_RST_n, 64524=DM_WDT_RST_n, 63745=DET_ERROR, 63746=WDGM_ALIVE_FAIL, 63747=FOTA_RESET, 63748=DIAG_RESET, 63749=RAM_TST_ERROR, 63750=CAN_LOOP_TEST_ERROR, 63751=FLS_TST_ERROR, 63752=EARLY_WAKEUP, 63753=CORE_SYS_TST_ERROR, 63754=WAKEUP_SEQ_TIMELIMIT_FAULT, 63755=TFT_RECOVERYTIMELIMIT_FAULT, 63756=NVM_WRITE_FAIL, 63757=ADC_TEST, 63758=WDM_TIMER_FAIL, 63759=CM_TEST_FAIL, 63760=DMA_TEST_FAIL, 63761=PPU_TEST_FAIL, 63762=POWER_SUPPLY_FAULT, 63763=ECC_FAULT, 63764=DCC_FAIL, 63765=OCOC_FAIL, 63766=GIP_HEALTH_FAIL, 63767=HSM_WDG_FAIL, 63768=POK_FAULT, 63769=DM_WDG_FAIL, 63770=FIREWALL_ACCESS_FAIL, 63771=FALSH_INTEGRITY_FAIL, 63772=TOG_FAULT, 63773=VTM_FAULT, 63774=DM_SAFETY_CHECK_PWR_FAIL, 63775=DM_SAFETY_CHECK_RES_FAIL, 63776=TIFS_SAFETY_CHECK_FWL_FAIL, 63777=SCI_CLIENT_PM_CLOCK_FAIL, 63778=SCI_CLIENT_PM_RESET_FAIL, 63779=SCI_CLIENT_PM_LPM_FAIL, 63780=SCI_CLIENT_RM_IRQ_FAIL, 63781=SCI_CLIENT_RM_FWL_FAIL, 63782=SCI_CLIENT_RM_UDMA_FAIL, 63783=SCI_CLIENT_RM_PSIL_FAIL, 63784=DM_BOOT_STAGE1_FAIL, 63785=DM_BOOT_STAGE2_FAIL, 63786=DM_DDR_FAIL, 63787=DM_eMMC_FAIL, 63788=DM_QSPI_FAIL, 63789=DM_STACK_FAIL, 63790=DM_OS_ERROR, 63791=DM_SCI_SERVER_FAIL, 63792=JTAG_PWD_FEED_FAIL, 63793=BM_SB_FAIL, 63794=FBL_SB_FAIL, 63795=APP_SB_FAIL, 63796=CRC_SB_FAIL, 63797=HSM_OS_ERROR, 63798=HSM_MAC_FAIL, 63799=HSM_CIPHER_FAIL, 63800=HSM_KEY_FAIL, 63801=HSM_SEED_FAIL, 63802=HSM_FWL_FAIL, 63803=EXT_WDG_RESET, 63804=EXT_WDG_COMM_ERROR, 63805=PMIC_SLEEP_RESET, 63806=ECC_FAULT_SED, 63807=FLASH_INTEGRITY_FAIL, 63233=UNEXPECTED_ERROR, 63234=DISPLAY_ERROR, 63235=TEMP_ERROR, 63236=VOLTAGE_ERROR, 63237=SAFETY_ERROR, 63238=SECURITY_ERROR, 63239=CPU_UTUILISATION_ERROR, 63240=NETWORK_ERROR, 63241=PERIPHERAL_ERROR, 63242=BACKLIGHT_ERROR, 63243=POWERUP_SOWN_ERROR, 63244=TIMEOUT_EVENT_MISSING_ERRORS, 63245=IPCL_VERSION_MISMATCH, 63246=HEALTH_MON_ERROR, 63247=UCL_FATAL_ERROR, 63248=UCL_ERROR_STATUS, 63249=SOTA_OTA_FOTA_ERROR, 63250=ODOMETER_ERROR, 62977=FORCED_BLANK, 62978=POWER_UP_STATE, 62979=POWER_DOWN_STATE, 62980=ILLUMINATION_VALUE, 62981=NVM_STATUS, 62982=FEATURE_SLEEP_STATUS, 62983=NETWORK_STATUS, 62984=WAKEUP_REASON, 62985=HMISTATUS, 62986=MAGIC_FLAGSTATUS, 63808=FLTM_E_DMNMGR_GIP_FIRSTHB_MISS, 63809=FLTM_E_PMIC_ABIST_FAIL, 63810=FLTM_E_PMIC_FAILINT_ERROR, 63811=FLTM_E_PMIC_RSTINT_ERROR, 63812=FLTM_E_SW_HANG, 63813=FLTM_E_BUCK1_OVUV, 63814=FLTM_E_BUCK2_OVUV, 63815=FLTM_E_BUCK3_OVUV, 63816=FLTM_E_BUCK4_OVUV, 63817=FLTM_E_LDO1_OVUV, 63818=FLTM_E_LDO2_OVUV, 63819=FLTM_E_LDO3_OVUV, 63820=FLTM_E_VVCA_OVUV, 63821=FLTM_E_VMON1_OVUV, 63822=FLTM_E_NVM_INTEGRITY_ERROR, 63823=ECC_1BIT_ERROR, 63824=ECC_2BIT_ERROR, 63825=FLTM_PMIC_MAXRSTCOUNT_REACHED, 65535=FLTM_E_UNKNOWN, 63826=FLTM_E_DMNMGR_GIP_HB_MISS, 63827=FLTM_E_DMNMGR_GIP_LINKUP_FAILED, 63828=FLTM_E_DMNMGR_GIP_HEALTH_FATAL_ERROR}
      range raw 62977..65535
    eFltM_FaultStatusType: category=VALUE, base-type=DataTypes/uint8, compu {0=FLTM_NONE, 1=FLTM_INACTIVE, 2=FLTM_ACTIVE, 3=FLTM_CHANGED}, range raw 0..3
    Dlt_LogChannelNameType: category=ARRAY
      element ArrayElement: category=VALUE, array-size=4, array-size-semantics=FIXED-SIZE, base-type=DataTypes/uint8
    SSlowGuageInfo: category=STRUCTURE
      element gaugeInfo: implementation-data-type=SGaugeInfo
    IllumCtrl_Ip: category=STRUCTURE
      8 x element, all with category=TYPE_REFERENCE:
        Illumination_Mode: implementation-data-type=UInt8
        battery_status: implementation-data-type=UInt8
        Illumination_Sts: implementation-data-type=UInt8
        power_mode: implementation-data-type=UInt8
        step_value: implementation-data-type=UInt8
        step_direction: implementation-data-type=UInt8
        switch_type: implementation-data-type=UInt8
        Derating_Value: implementation-data-type=UInt16
    SDiagResponse: category=STRUCTURE
      element responseCode: implementation-data-type=UInt8
      element dataLen: implementation-data-type=UInt16
      element data: implementation-data-type=data_u8_256
    SGaugeInfo_u32dyn_3: category=STRUCTURE
      element SGaugeInfo_u32dyn_3: implementation-data-type=SGaugeInfo_u32dyn
    IllumCtrl_Op: category=STRUCTURE
      8 x element, all with category=TYPE_REFERENCE, implementation-data-type=UInt16:
        Brightness_Out
        Bulb_PWM_Out
        Illumination_Duty_Out
        RGB_Dimming_Out
        LED_PWM_Out
        Dial_Out
        Display_Out
        Telltale_Out
    SGaugeInfo_u32dyn_2: category=ARRAY
      element ArrayElement: array-size=2, array-size-semantics=FIXED-SIZE, implementation-data-type=SGaugeInfo_u32dyn
  8 x impl type:
    tSafeRxSignalId: category=VALUE, base-type=DataTypes/uint8, compu {0=eVehicleSpeedABSIn, 1=eAirbagIn, 2=eAlive_101In, 3=eCRC_101In, 4=eEndOfSafeRxSignal}, range raw 0..4
    tSafeRxSignalStatus: category=VALUE, base-type=DataTypes/uint8, compu {0=eSIGNAL_OK, 1=eSIGNAL_MISSING, 2=eSIGNAL_NEVER_RECEIVED, 3=eSIGNAL_INVALID, 4=eSIGNAL_INVALID_CRC, 5=eSIGNAL_INVALID_ALIVE_COUNTER, 6=eSIGNAL_REPEATED}, range raw 0..6
    tSafeRxSignalJustRcvdStatus: category=VALUE, base-type=DataTypes/uint8, compu {0=eJust_Received, 1=eNot_Just_Received}, range raw 0..1
    tSafeTxSignalId: category=VALUE, base-type=DataTypes/uint8, compu {0=eBattery_VoltageOut, 1=eAlive_200Out, 2=eCRC_200Out, 3=eEndofSafeTxSignals}, range raw 0..3
    SDLTControlMessageRequest: category=STRUCTURE
      element status: implementation-data-type=UInt8
    SDLTMessageReadAck: category=STRUCTURE
      element status: implementation-data-type=UInt8
    SDLTControlMessageReponse: category=STRUCTURE
      element status: implementation-data-type=UInt8
    SDLTMessageReadRequest: category=STRUCTURE
      element status: implementation-data-type=UInt8
  5 x impl type:
    eFltM_FlsIntegrityStatusType: category=VALUE, base-type=DataTypes/uint8, compu {0=FLTM_FLSINTEGRITY_NOT_STARTED, 1=FLTM_FLSINTEGRITY_INPROGRESS, 2=FLTM_FLSINTEGRITY_COMPLETED_PASS, 3=FLTM_FLSINTEGRITY_COMPLETED_FAIL}, range raw 0..3
    SIG_WIN_CRC_RGB_T: category=STRUCTURE
      element crc: implementation-data-type=UInt32
    SIG_WIN_SETUP_T: category=STRUCTURE
      6 x element, all with category=TYPE_REFERENCE:
        control: implementation-data-type=UInt32
        winsx: implementation-data-type=UInt16
        winsy: implementation-data-type=UInt16
        winex: implementation-data-type=UInt16
        winey: implementation-data-type=UInt16
        ref_crc: implementation-data-type=UInt32
    SIG_WIN_INFO_T: category=STRUCTURE
      element sig_unit: implementation-data-type=UInt8
      element window: implementation-data-type=UInt8
    data_u8_2048: category=ARRAY
      element ArrayElement: category=VALUE, array-size=2048, array-size-semantics=FIXED-SIZE, base-type=DataTypes/uint8
package /E40_Platform_System_SystemPackage/Types/DataConstrs
  range UInt16_DataConstraint: raw 0..65535
  range UInt32_DataConstraint: raw 0..4294967295
  range Boolean_DataConstraint: raw 0..1
  range SInt32_DataConstraint: raw -2147483648..2147483647
  range UInt8_DataConstraint: raw 0..255
  range Dlt_LogChannelNameType_DataConstraint: raw 0..255
  range Dlt_ApplicationIDType_DataConstraint: raw 0..255
  range Dlt_ContextIDType_DataConstraint: raw 0..255
  range SInt8_DataConstraint: raw -128..127
  range SInt16_DataConstraint: raw -32768..32767
package /Predefined_DEV/ImplementationDataTypes
  impl type NvM_RequestResultType: compu {0=NVM_REQ_OK, 1=NVM_REQ_NOT_OK, 2=NVM_REQ_PENDING, 3=NVM_REQ_INTEGRITY_FAILED, 4=NVM_REQ_BLOCK_SKIPPED, 5=NVM_REQ_NV_INVALIDATED, 6=NVM_REQ_CANCELED, 7=NVM_REQ_REDUNDANCY_FAILED, 8=NVM_REQ_RESTORED_FROM_ROM}, implementation-data-type=uint8
  impl type NvM_ServiceIdType: compu {6=NVM_READ_BLOCK, 7=NVM_WRITE_BLOCK, 8=NVM_RESTORE_BLOCK_DEFAULTS, 9=NVM_ERASE_BLOCK, 11=NVM_INVALIDATE_NV_BLOCK, 12=NVM_READ_ALL}, implementation-data-type=uint8
  impl type Dem_UdsStatusByteType: compu {mask 1: 1=DEM_UDS_STATUS_TF, mask 2: 2=DEM_UDS_STATUS_TFTOC, mask 4: 4=DEM_UDS_STATUS_PDTC, mask 8: 8=DEM_UDS_STATUS_CDTC, mask 16: 16=DEM_UDS_STATUS_TNCSLC, mask 32: 32=DEM_UDS_STATUS_TFSLC, mask 64: 64=DEM_UDS_STATUS_TNCTOC, mask 128: 128=DEM_UDS_STATUS_WIR}, range raw 0..255, implementation-data-type=UInt8
package /ZARXML_DATA_TYPES
  impl type EDomainId: compu {0=EDomainId_VP, 1=EDomainId_Cluster, 2=EDomainId_IVI, 3=EDomainId_Last}, implementation-data-type=uint8
  impl type ESystemState: compu {0=ESystemState_Off, 1=ESystemState_Startup, 2=ESystemState_Up, 3=ESystemState_FullRun, 4=ESystemState_PrepareShutdown, 5=ESystemState_Minimal, 6=ESystemState_Shutdown, 7=ESystemState_Meet, 8=ESystemState_Last}, implementation-data-type=uint8
  impl type EIgnitionStatus: compu {0=EIgnitionStatus_Off, 1=EIgnitionStatus_Acc, 2=EIgnitionStatus_Start, 3=EIgnitionStatus_Run, 4=EIgnitionStatus_Last}, implementation-data-type=uint8
  impl type EnetReqCmd_t: compu {1=EnetReqType_Reset, 2=EnetReqType_linkStatus, 3=EnetReqType_SqiVal, 4=EnetReqType_WorstSqiVal, 5=EnetReqType_BestSqiVal, 6=EnetReqType_FaultStatus, 7=EnetReqType_CableStatus, 8=EnetReqType_masterSlaveStatus, 9=EnetReqType_Last}, implementation-data-type=uint8
  impl type EnetReqMode_t: compu {0=EnetReqMode_Read, 1=EnetReqMode_Write, 2=EnetReqMode_Last}, implementation-data-type=uint8
  impl type data_u8_8: category=ARRAY
    element Element: array-size=8, array-size-semantics=FIXED-SIZE, implementation-data-type=uint8
  impl type data_u8_32: category=ARRAY
    element Element: array-size=32, array-size-semantics=FIXED-SIZE, implementation-data-type=uint8
  14 x impl type:
    EDisplayStatus: compu {0=EDisplayState_Off, 1=EDisplayState_On, 2=EDisplayState_Error, 3=EDisplayState_Disconnected, 4=EDisplayState_Last}, implementation-data-type=uint8
    SHealthDumpGetHdr: category=STRUCTURE
      element encrypt: implementation-data-type=uint8
    SHealthDumpGetData: category=STRUCTURE
      element reserved: implementation-data-type=uint8
    SPowerSystemStateReqChange: category=STRUCTURE
      element domainId: implementation-data-type=ZARXML_DATA_TYPES/EDomainId
      element state: implementation-data-type=ZARXML_DATA_TYPES/ESystemState
    SIgnState: category=STRUCTURE
      element state: implementation-data-type=ZARXML_DATA_TYPES/EIgnitionStatus
    SEnetRegReq: category=STRUCTURE
      4 x element, all with category=TYPE_REFERENCE:
        cmd: implementation-data-type=EnetReqCmd_t
        mode: implementation-data-type=EnetReqMode_t
        dataLen: implementation-data-type=uint8
        data: implementation-data-type=ZARXML_DATA_TYPES/data_u8_8
    SHealthDomainHeartbeat: category=STRUCTURE
      element domainId: implementation-data-type=uint8
      element seqCnt: implementation-data-type=uint32
    SHealthDomainFatalError: category=STRUCTURE
      element domainId: implementation-data-type=uint8
      element compldx: implementation-data-type=uint32
    SHealthDumpHdrInfo: category=STRUCTURE
      element fileSize: implementation-data-type=uint32
    SPowerSystemState: category=STRUCTURE
      element domainId: implementation-data-type=ZARXML_DATA_TYPES/EDomainId
      element state: implementation-data-type=ZARXML_DATA_TYPES/ESystemState
    SPowerExtendShutdownTime: category=STRUCTURE
      element domainId: implementation-data-type=ZARXML_DATA_TYPES/EDomainId
      element timeoutMs: implementation-data-type=uint32
    SHealthEventRecord: category=STRUCTURE
      element recordType: implementation-data-type=uint8
      element recordLen: implementation-data-type=uint8
      element recordData: implementation-data-type=ZARXML_DATA_TYPES/data_u8_8
    SEnetRegResp: category=STRUCTURE
      element cmd: implementation-data-type=EnetReqCmd_t
      element respLen: implementation-data-type=uint8
      element response: implementation-data-type=ZARXML_DATA_TYPES/data_u8_32
    SDisplayCurrentState: category=STRUCTURE
      element displayId: implementation-data-type=uint32
      element state: implementation-data-type=ZARXML_DATA_TYPES/EDisplayStatus
package /ARRoot/Types
  65 x impl type, all with category=STRUCTURE, sw-calibration-access=READ-ONLY:
    NV_Data_NvMSampleBlock1
      element SampleElement1: implementation-data-type=Arr_u8_8
    NV_Data_SampleBlock2
      element SampleElement2: implementation-data-type=Arr_u8_16
    NV_Data_BsConst_Audio
      element BsConst_Audio_Element: implementation-data-type=Arr_u8_128
    NV_Data_BsConst_Communication
      element BsConst_Communication_Element: implementation-data-type=Arr_u8_64
    NV_Data_BsConst_EngOffTimer
      element BsConst_EngOffTimer_Element: implementation-data-type=Arr_u8_32
    NV_Data_BsConst_FuelGauge
      element BsConst_FuelGauge_Element: implementation-data-type=Arr_u8_128
    NV_Data_BsConst_Illumination
      11 x element, all with category=TYPE_REFERENCE:
        BsConst_Compensation_Line_Slope_m: implementation-data-type=uint32
        BsConst_Compensation_Line_Shift_b: implementation-data-type=uint32
        BsConst_Lookup_Curve_HotSpot_Coef_X: implementation-data-type=Arr_u16_7
        BsConst_Lookup_Curve_HotSpot_Coef_Y: implementation-data-type=Arr_u16_7
        BsConst_Temp_Threshold_Hysteresis_Derating: implementation-data-type=uint8
        BsConst_Derating_Backlight_Disable: implementation-data-type=uint8
        BsConst_Temperature_Sensor_Conv: implementation-data-type=T_NV_Temperature_Conversion
        BsConst_PCB_Temperature_Sensor_Conv: implementation-data-type=T_NV_Temperature_Conversion
        BsConst_Display_Illum_Max_Level: implementation-data-type=uint16
        BsConst_PWM_boost_bypass_duty: implementation-data-type=uint8
        BsConst_BsConst_Illumination_ReservedByte: implementation-data-type=Arr_u8_28
    NV_Data_BsConst_OilGauge
      element BsConst_OilGauge_Element: implementation-data-type=Arr_u8_64
    NV_Data_BsConst_Power
      element BsConst_Power_Element: implementation-data-type=Arr_u8_32
    NV_Data_BsConst_PowerGauge
      element BsConst_PowerGauge_Element: implementation-data-type=Arr_u8_64
    NV_Data_BsConst_RealTimeClock
      element BsConst_RealTimeClock_Element: implementation-data-type=Arr_u8_48
    NV_Data_BsConst_ServiceReminder
      element BsConst_ServiceReminder_Element: implementation-data-type=Arr_u8_48
    NV_Data_BsConst_SpeedoGauge
      element BsConst_SpeedoGauge_Element: implementation-data-type=Arr_u8_64
    NV_Data_BsConst_TachoGauge
      element BsConst_TachoGauge_Element: implementation-data-type=Arr_u8_64
    NV_Data_BsConst_TempGauge
      element BsConst_TempGauge_Element: implementation-data-type=Arr_u8_64
    NV_Data_BsConst_TripComputer
      element BsConst_TripComputer_Element: implementation-data-type=Arr_u8_64
    NV_Data_BsConst_Warning
      element BsConst_Warning_Element: implementation-data-type=Arr_u8_64
    NV_Data_BsCys_Certicificate
      element BsCys_Certicificate_Element: implementation-data-type=Arr_u8_64
    NV_Data_BsDiag_Dtc
      element BsDiag_Dtc_Element: implementation-data-type=Arr_u8_2048
    NV_Data_BsDiag_ErrorRecord
      element BsDiag_ErrorRecord_Element: implementation-data-type=Arr_u8_1024
    NV_Data_BsFuSa_Audio
      element BsFuSa_Audio_Element: implementation-data-type=Arr_u8_32
    NV_Data_BsFuSa_Communication
      element BsFuSa_Communication_Element: implementation-data-type=Arr_u8_16
    NV_Data_BsFuSa_Config
      element BsFuSa_Config_Element: implementation-data-type=Arr_u8_16
    NV_Data_BsFuSa_Display
      element BsFuSa_Display_Element: implementation-data-type=Arr_u8_64
    NV_Data_BsFuSa_Power
      element BsFuSa_Power_Element: implementation-data-type=Arr_u8_48
    NV_Data_BsFuSa_Warning
      element BsFuSa_Warning_Element: implementation-data-type=Arr_u8_32
    NV_Data_BsFusa_Fota
      element BsFusa_Fota_Element: implementation-data-type=Arr_u8_32
    NV_Data_BsReten_Audio
      element BsReten_Audio_Element: implementation-data-type=Arr_u8_100
    NV_Data_BsReten_Communication
      element BsReten_Communication_Element: implementation-data-type=Arr_u8_100
    NV_Data_BsReten_Display
      element BsReten_Display_Element: implementation-data-type=Arr_u8_100
    NV_Data_BsReten_Gauges
      element BsReten_Gauges_Element: implementation-data-type=Arr_u8_100
    NV_Data_BsReten_Illumination
      element BsReten_Illumination_Element: implementation-data-type=Arr_u8_100
    NV_Data_BsReten_Odometer
      element BsReten_Odometer_Element: implementation-data-type=Arr_u8_100
    NV_Data_BsReten_Personalization
      element BsReten_Personalization_Element: implementation-data-type=Arr_u8_100
    NV_Data_BsReten_Power
      element BsReten_Power_Element: implementation-data-type=Arr_u8_100
    NV_Data_BsReten_RealTimeClock
      element BsReten_RealTimeClock_Element: implementation-data-type=Arr_u8_100
    NV_Data_BsReten_Tripcomputer
      element BsReten_Tripcomputer_Element: implementation-data-type=Arr_u8_100
    NV_Data_BsReten_VisDlt
      element BsReten_VisDlt_Element: implementation-data-type=Arr_u8_256
    NV_Data_BsReten_Warning
      element BsReten_Warning_Element: implementation-data-type=Arr_u8_100
    NV_Data_BsRt_CusDlt
      element BsRt_CusDlt_Element: implementation-data-type=Arr_u8_128
    NV_Data_BsRt_FuelGauge
      element BsRt_FuelGauge_Element: implementation-data-type=Arr_u8_32
    NV_Data_BsRt_Illumination
      element BsRt_Illumination_Element: implementation-data-type=Arr_u8_100
    NV_Data_BsRt_Odometer
      element BsRt_Odometer_Element: implementation-data-type=Arr_u8_128
    NV_Data_BsRt_OilGauge
      element BsRt_OilGauge_Element: implementation-data-type=Arr_u8_8
    NV_Data_BsRt_Personalization
      element BsRt_Personalization_Element: implementation-data-type=Arr_u8_128
    NV_Data_BsRt_PowerGauge
      element BsRt_PowerGauge_Element: implementation-data-type=Arr_u8_32
    NV_Data_BsRt_RealTimeClock
      element BsRt_RealTimeClock_Element: implementation-data-type=Arr_u8_48
    NV_Data_BsRt_SpeedoGauge
      element BsRt_SpeedoGauge_Element: implementation-data-type=Arr_u8_8
    NV_Data_BsRt_TachoGauge
      element BsRt_TachoGauge_Element: implementation-data-type=Arr_u8_16
    NV_Data_BsRt_TempGauge
      element BsRt_TempGauge_Element: implementation-data-type=Arr_u8_32
    NV_Data_BsRt_TripComputer
      element BsRt_TripComputer_Element: implementation-data-type=Arr_u8_64
    NV_Data_BsRt_Warning
      element BsRt_Warning_Element: implementation-data-type=Arr_u8_32
    NV_Data_BsShare_EcuPartNumber
      10 x element, all with category=TYPE_REFERENCE:
        BsShare_EcuPartNumber_Element: implementation-data-type=Arr_u8_61
        BsShare_VisteonPartNumber: implementation-data-type=Arr_u8_17
        BsShare_VisteonPCBPartNumber: implementation-data-type=Arr_u8_17
        BsShare_ProductSerialNumber: implementation-data-type=Arr_u8_10
        BsShare_PCBSerialNumber: implementation-data-type=Arr_u8_9
        BsShare_SMTManufacturingDate: implementation-data-type=Arr_u8_3
        BsShare_AssemblyManufacturingDate: implementation-data-type=Arr_u8_3
        BsShare_SMTPlantNumber: implementation-data-type=Arr_u8_3
        BsShare_AssemblyPlantNumber: implementation-data-type=Arr_u8_3
        BsShare_HWModification: implementation-data-type=uint16
    NV_Data_BsShare_SwUpdFotaFinPrint
      element BsShare_SwUpdFotaFinPrint_Element: implementation-data-type=Arr_u8_32
    NV_Data_BsShare_SwUpdFotaMode
      element BsShare_SwUpdFotaMode_Element: implementation-data-type=Arr_u8_16
    NV_Data_BsShare_SwUpdFotaStatus
      element BsShare_SwUpdFotaStatus_Element: implementation-data-type=Arr_u8_48
    NV_Data_BsShare_SwUpdFotadecrypt
      element BsShare_SwUpdFotadecrypt_Element: implementation-data-type=Arr_u8_64
    NV_Data_BsShare_SwUpdReflash
      element BsShare_SwUpdReflash_Element: implementation-data-type=Arr_u8_8
    NV_Data_BsShare_VehicleConfig
      element BsShare_VehicleConfig_Element: implementation-data-type=Arr_u8_256
    NV_Data_BsShare_VisMeet
      element BsShare_VisMeet_Element: implementation-data-type=Arr_u8_46
      element BsShare_VisMeet_EOLEntry_Element: implementation-data-type=uint16
    NV_Data_RefCys_Certicificate
      element RefCys_Certicificate_Element: implementation-data-type=Arr_u8_64
    NV_Data_RefCys_Certicificate1
      element RefCys_Certicificate1_Element: implementation-data-type=Arr_u8_64
    NV_Data_BsFuSa_FeatureData
      6 x element, all with category=TYPE_REFERENCE:
        BsFuSa_FeatureData_Warning_Element: implementation-data-type=Arr_u8_3
        BsFuSa_FeatureData_Power_Element: implementation-data-type=Arr_u8_10
        BsFuSa_FeatureData_Display_Element: implementation-data-type=UInt16
        BsFuSa_FeatureData_Audio_Element: implementation-data-type=Arr_u8_8
        BsFuSa_FeatureData_Communication_Element: implementation-data-type=Arr_u8_9
        BsFuSa_FeatureData_Fota_Element: implementation-data-type=UInt16
    NV_Data_BsConst_Illumination_Copy1
      11 x element, all with category=TYPE_REFERENCE:
        BsConst_Compensation_Line_Slope_m_SafeCopy1: implementation-data-type=uint32
        BsConst_Compensation_Line_Shift_b_SafeCopy1: implementation-data-type=uint32
        BsConst_Lookup_Curve_HotSpot_Coef_X_SafeCopy1: implementation-data-type=Arr_u16_7
        BsConst_Lookup_Curve_HotSpot_Coef_Y_SafeCopy1: implementation-data-type=Arr_u16_7
        BsConst_Temp_Threshold_Hysteresis_Derating_SafeCopy1: implementation-data-type=uint8
        BsConst_Derating_Backlight_Disable_SafeCopy1: implementation-data-type=uint8
        BsConst_Temperature_Sensor_Conv_SafeCopy1: implementation-data-type=T_NV_Temperature_Conversion
        BsConst_PCB_Temperature_Sensor_Conv_SafeCopy1: implementation-data-type=T_NV_Temperature_Conversion
        BsConst_Display_Illum_Max_Level_SafeCopy1: implementation-data-type=uint16
        BsConst_PWM_boost_bypass_duty_SafeCopy1: implementation-data-type=uint8
        BsConst_BsConst_Illumination_ReservedByte_SafeCopy1: implementation-data-type=Arr_u8_28
    NV_Data_BsConst_Illumination_Copy2
      11 x element, all with category=TYPE_REFERENCE:
        BsConst_Compensation_Line_Slope_m_SafeCopy2: implementation-data-type=uint32
        BsConst_Compensation_Line_Shift_b_SafeCopy2: implementation-data-type=uint32
        BsConst_Lookup_Curve_HotSpot_Coef_X_SafeCopy2: implementation-data-type=Arr_u16_7
        BsConst_Lookup_Curve_HotSpot_Coef_Y_SafeCopy2: implementation-data-type=Arr_u16_7
        BsConst_Temp_Threshold_Hysteresis_Derating_SafeCopy2: implementation-data-type=uint8
        BsConst_Derating_Backlight_Disable_SafeCopy2: implementation-data-type=uint8
        BsConst_Temperature_Sensor_Conv_SafeCopy2: implementation-data-type=T_NV_Temperature_Conversion
        BsConst_PCB_Temperature_Sensor_Conv_SafeCopy2: implementation-data-type=T_NV_Temperature_Conversion
        BsConst_Display_Illum_Max_Level_SafeCopy2: implementation-data-type=uint16
        BsConst_PWM_boost_bypass_duty_SafeCopy2: implementation-data-type=uint8
        BsConst_BsConst_Illumination_ReservedByte_SafeCopy2: implementation-data-type=Arr_u8_28
package /DataTypes
  82 x impl type:
    Ivd_RequestPostRun: compu {0=IVD_REQUESTPOSTRUN_REQUESTED, 1=IVD_REQUESTPOSTRUN_RELEASED}, range raw 0..1, implementation-data-type=UInt8, type-emitter=RTE
    SGaugeInfo_2: category=ARRAY, sw-calibration-access=READ-ONLY, type-emitter=RTE
      element Element: array-size=2, array-size-semantics=FIXED-SIZE, implementation-data-type=SGaugeInfo
    SGaugeInfo_u32dyn_3: category=ARRAY, sw-calibration-access=READ-ONLY, type-emitter=RTE
      element Element: array-size=3, array-size-semantics=FIXED-SIZE, implementation-data-type=SGaugeInfo_u32dyn
    Airbag: category=VALUE, base-type=DataType/uint8, compu {0=Cx0_Off, 1=Cx1_On, 2=Cx2_Blink, 3=Cx3_Reserved}, range raw 0..3
    Alive_101: category=VALUE, base-type=DataType/uint8, range raw 0..15
    Ambient_Light_level: category=VALUE, base-type=DataType/uint8, range raw 0..100
    CRC_101: category=VALUE, base-type=DataType/uint8, range raw 0..255
    DayNightMode: category=VALUE, base-type=DataType/boolean, compu {0=Cx0_Day, 1=Cx1_Night}
    Gear: category=VALUE, base-type=DataType/uint8, range raw 0..15
    GearMode: category=VALUE, base-type=DataType/boolean, compu {0=Cx0_Manual, 1=Cx1_Auto}
    GearRecommendation: category=VALUE, base-type=DataType/uint8, compu {0=Cx0_No_Indication (No Indication), 1=Cx1_GearUp, 2=Cx2_GearDown, 3=Cx3_GearUpBlink, 4=Cx4_GearDownBlinkl, 5=Cx5_Reserved, 6=Cx6_Reserved, 7=Cx7_Reserved}, range raw 0..7
    GearStatus: category=VALUE, base-type=DataType/uint8, compu {0=Cx00_On, 1=Cx01_Blink}
    Illumination_level: category=VALUE, base-type=DataType/uint8, range raw 0..255
    PowerMode: category=VALUE, base-type=DataType/uint8, compu {0=Cx0_Off, 1=Cx1_Awake, 2=Cx2_Accessory, 3=Cx3_Ignition_On (Ignition On), 4=Cx4_Run_Engine_or_Motor_on_ (Run(Engine_or_Motor_on))}, range raw 0..15
    TransportMode: category=VALUE, base-type=DataType/boolean, compu {0=Cx0_Transport_Link_Off (Transport Link Off), 1=Cx1_Transport_Link_Active (Transport Link Active)}
    VehicleSpeedABS: category=VALUE, base-type=DataType/uint16
    Warning: category=VALUE, base-type=DataType/uint8, range raw 0..255
    Battery_Voltage: category=VALUE, base-type=DataType/uint8
    CurrentStateIC: category=VALUE, base-type=DataType/boolean, range raw -1..0
    Debug1_Byte{0..7}: category=VALUE, base-type=DataType/uint8, range raw 0..255
    Debug2_Byte{0..7}: category=VALUE, base-type=DataType/uint8, range raw 0..255
    Debug3_Byte{0..7}: category=VALUE, base-type=DataType/uint8, range raw 0..255
    Debug4_Byte{0..7}: category=VALUE, base-type=DataType/uint8, range raw 0..255
    Debug5_Byte{0..7}: category=VALUE, base-type=DataType/uint8, range raw 0..255
    Diag_Buffer_Tx_USDT: category=ARRAY
      element Element: array-size=8, array-size-semantics=FIXED-SIZE, implementation-data-type=UInt8
    Diag_Buffer_Tx_UUDT: category=ARRAY
      element Element: array-size=8, array-size-semantics=FIXED-SIZE, implementation-data-type=UInt8
    FV_Tx: category=VALUE, base-type=DataType/uint8, range raw 0..15
    Illumination_PWM: category=VALUE, base-type=DataType/uint8, range raw 0..100
    MAC_Tx: category=VALUE, base-type=DataType/uint32, range raw 0..268435455
    Odometer: category=VALUE, base-type=DataType/uint32, range raw 0..1609343
    PreviousStateIC: category=VALUE, base-type=DataType/sint8, range raw -4..3
    SecureTxByte{0..3}: category=VALUE, base-type=DataType/uint8, range raw 0..255
    UserData{1..5}_IC: category=VALUE, base-type=DataType/uint8, range raw 0..255
    VehicleSpeedIC: category=VALUE, base-type=DataType/uint16
    SG_ABS: category=STRUCTURE
      4 x element, all with category=TYPE_REFERENCE:
        Airbag: range raw 0..3, implementation-data-type=Airbag
        Alive_101: range raw 0..15, implementation-data-type=Alive_101
        CRC_101: range raw 0..255, implementation-data-type=CRC_101
        VehicleSpeedABS: implementation-data-type=VehicleSpeedABS
    SG_COM_HS: category=STRUCTURE
      element Alive_200: range raw 0..15, implementation-data-type=Alive_200
      element Battery_Voltage: implementation-data-type=Battery_Voltage
      element CRC_200: range raw 0..255, implementation-data-type=CRC_200
    Alive_200: category=VALUE, base-type=DataType/uint8
    CRC_200: category=VALUE, base-type=DataType/uint8
    EngineSpeed: category=VALUE, base-type=DataType/uint16
    Turn_Indicator_Control: category=VALUE, base-type=DataType/uint8, range raw 0..3
package /AUTOSAR_Std/ImplementationDataTypes
  impl type Std_VersionInfoType: category=STRUCTURE, sw-calibration-access=READ-ONLY, type-emitter=HEADER_FILE  # This type shall be used to request the version of a BSW module using the "ModuleName"_GetVersionInfo() function.
    5 x element, all with category=TYPE_REFERENCE:
      vendorID: implementation-data-type=UInt16
      moduleID: implementation-data-type=UInt16
      sw_major_version: implementation-data-type=UInt8
      sw_minor_version: implementation-data-type=UInt8
      sw_patch_version: implementation-data-type=UInt8
package /Vw_Fpk_System_SystemPackage/Types/DataConstrs
  range UInt8_DataConstraint: raw 0..255
package /AUTOSAR_SfdA/SfdA/ImplementationDataTypes
  impl type SfdA_RequestRoleType: compu {0=SFDC_NO_ROLE, 1=SFD_ROLE_EPTI, 2=SFD_ROLE_BASIC, 3=SFD_ROLE_EXTENDED, 4=SFD_ROLE_SUPERUSER, 5=SFD_ROLE_PRODUCTION, 6=SFD_ROLE_OTA}, implementation-data-type=UInt8
package /DataType
  base type uint8_8_iso_8859_1: category=FIXED_LENGTH, base-type-size=64, base-type-encoding=ISO-8859-1
package /DataType/Constraint
  range DC_Diag_Buffer_Tx_USDT: raw 0..18446744073709551615
  range DC_Diag_Buffer_Tx_UUDT: raw 0..18446744073709551615
package /DataType/Semantics
  compu method CM_Ambient_Light_level: identical
  compu method CM_Battery_Voltage: phys=raw*0.25 for raw 0..255; unit V
  compu method CM_CurrentStateIC: identical
  compu method CM_Debug1_Byte{0..7}: identical
  compu method CM_Debug2_Byte{0..7}: identical
  compu method CM_Debug3_Byte{0..7}: identical
  compu method CM_Debug4_Byte{0..7}: identical
  compu method CM_Debug5_Byte{0..7}: identical
  compu method CM_Diag_Buffer_Tx_USDT: identical
  compu method CM_Diag_Buffer_Tx_UUDT: identical
  compu method CM_FV_Tx: identical
  compu method CM_Gear: identical
  compu method CM_Illumination_level: identical
  compu method CM_Illumination_PWM: identical
  compu method CM_MAC_Tx: identical
  compu method CM_Odometer: identical
  compu method CM_PreviousStateIC: identical
  compu method CM_SecureTxByte{0..3}: identical
  compu method CM_UserData{1..5}_IC: identical
  compu method CM_VehicleSpeedABS: phys=raw*0.0625 for raw 0..4800; unit kmph
  compu method CM_VehicleSpeedIC: phys=raw*0.0625 for raw 0..4800; unit kmph
  compu method CM_Warning: identical
  compu method CM_Alive_101: identical
  compu method CM_CRC_101: identical
  compu method CM_Alive_200: identical
  compu method CM_CRC_200: identical
  compu method CM_EngineSpeed: phys=raw*0.78125 for raw 0..65535
  compu method CM_Turn_Indicator_Control: identical
package /DataType/Unit
  5 x unit, all with factor-si-to-unit=1, offset-si-to-unit=0:
    U_km: display-name=km
    U_kmph: display-name=kmph
    U_No_Unit: display-name=No Unit
    U_p: display-name=%
    U_V: display-name=V
