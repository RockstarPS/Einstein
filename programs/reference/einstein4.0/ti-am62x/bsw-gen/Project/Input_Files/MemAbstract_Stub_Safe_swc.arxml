AUTOSAR XML (schema 4-3-0)
standard types defined: UInt16, UInt32, UInt8, uint16, uint32, uint8
package /ARRoot/If
  11 x nv data interface:
    BsConst_BsConst_Illumination_ReservedByte
      nv-datas:
        data Value: type=Arr_u8_28
    BsConst_Compensation_Line_Shift_b
      nv-datas:
        data Value: type=UInt32
    BsConst_Compensation_Line_Slope_m
      nv-datas:
        data Value: type=UInt32
    BsConst_Derating_Backlight_Disable
      nv-datas:
        data Value: type=UInt8
    BsConst_Display_Illum_Max_Level
      nv-datas:
        data Value: type=UInt16
    BsConst_Lookup_Curve_HotSpot_Coef_X
      nv-datas:
        data Value: type=Arr_u16_7
    BsConst_Lookup_Curve_HotSpot_Coef_Y
      nv-datas:
        data Value: type=Arr_u16_7
    BsConst_PCB_Temperature_Sensor_Conv
      nv-datas:
        data Value: type=T_NV_Temperature_Conversion
    BsConst_PWM_boost_bypass_duty
      nv-datas:
        data Value: type=UInt8
    BsConst_Temp_Threshold_Hysteresis_Derating
      nv-datas:
        data Value: type=UInt8
    BsConst_Temperature_Sensor_Conv
      nv-datas:
        data Value: type=T_NV_Temperature_Conversion
package /ComponentTypes
  application sw component type MemAbstract_Stub_Safe
    11 x provide/require port:
      BsConst_BsConst_Illumination_ReservedByte: nv-provide-com-spec=BsConst_BsConst_Illumination_ReservedByte/Value, nv-require-com-spec=BsConst_BsConst_Illumination_ReservedByte/Value, provided-required-interface=BsConst_BsConst_Illumination_ReservedByte
      BsConst_Compensation_Line_Shift_b: nv-provide-com-spec=BsConst_Compensation_Line_Shift_b/Value, nv-require-com-spec=BsConst_Compensation_Line_Shift_b/Value, provided-required-interface=BsConst_Compensation_Line_Shift_b
      BsConst_Compensation_Line_Slope_m: nv-provide-com-spec=BsConst_Compensation_Line_Slope_m/Value, nv-require-com-spec=BsConst_Compensation_Line_Slope_m/Value, provided-required-interface=BsConst_Compensation_Line_Slope_m
      BsConst_Derating_Backlight_Disable: nv-provide-com-spec=BsConst_Derating_Backlight_Disable/Value, nv-require-com-spec=BsConst_Derating_Backlight_Disable/Value, provided-required-interface=BsConst_Derating_Backlight_Disable
      BsConst_Display_Illum_Max_Level_Safe: nv-provide-com-spec=BsConst_Display_Illum_Max_Level/Value, nv-require-com-spec=BsConst_Display_Illum_Max_Level/Value, provided-required-interface=BsConst_Display_Illum_Max_Level
      BsConst_Lookup_Curve_HotSpot_Coef_X: nv-provide-com-spec=BsConst_Lookup_Curve_HotSpot_Coef_X/Value, nv-require-com-spec=BsConst_Lookup_Curve_HotSpot_Coef_X/Value, provided-required-interface=BsConst_Lookup_Curve_HotSpot_Coef_X
      BsConst_Lookup_Curve_HotSpot_Coef_Y: nv-provide-com-spec=BsConst_Lookup_Curve_HotSpot_Coef_Y/Value, nv-require-com-spec=BsConst_Lookup_Curve_HotSpot_Coef_Y/Value, provided-required-interface=BsConst_Lookup_Curve_HotSpot_Coef_Y
      BsConst_PCB_Temperature_Sensor_Conv: nv-provide-com-spec=BsConst_PCB_Temperature_Sensor_Conv/Value, nv-require-com-spec=BsConst_PCB_Temperature_Sensor_Conv/Value, provided-required-interface=BsConst_PCB_Temperature_Sensor_Conv
      BsConst_PWM_boost_bypass_duty: nv-provide-com-spec=BsConst_PWM_boost_bypass_duty/Value, nv-require-com-spec=BsConst_PWM_boost_bypass_duty/Value, provided-required-interface=BsConst_PWM_boost_bypass_duty
      BsConst_Temp_Threshold_Hysteresis_Derating: nv-provide-com-spec=BsConst_Temp_Threshold_Hysteresis_Derating/Value, nv-require-com-spec=BsConst_Temp_Threshold_Hysteresis_Derating/Value, provided-required-interface=BsConst_Temp_Threshold_Hysteresis_Derating
      BsConst_Temperature_Sensor_Conv: nv-provide-com-spec=BsConst_Temperature_Sensor_Conv/Value, nv-require-com-spec=BsConst_Temperature_Sensor_Conv/Value, provided-required-interface=BsConst_Temperature_Sensor_Conv
    behavior MemAbstract_Stub_Safe_InternalBehavior
      timing event TMT_MemAbstract_Stub_Safe: start-on-event=MemAbstract_Stub_Safe, period=0.01
      runnable MemAbstract_Stub_Safe
        data-receive-point-by-arguments:
          11 x access:
            REC_BsConst_BsConst_Illumination_ReservedByte_Value: accessed-variable=BsConst_BsConst_Illumination_ReservedByte.Value
            REC_BsConst_Compensation_Line_Shift_b_Value: accessed-variable=BsConst_Compensation_Line_Shift_b.Value
            REC_BsConst_Compensation_Line_Slope_m_Value: accessed-variable=BsConst_Compensation_Line_Slope_m.Value
            REC_BsConst_Derating_Backlight_Disable_Value: accessed-variable=BsConst_Derating_Backlight_Disable.Value
            REC_BsConst_Display_Illum_Max_Level_Safe_Value: accessed-variable=BsConst_Display_Illum_Max_Level_Safe.Value
            REC_BsConst_Lookup_Curve_HotSpot_Coef_X_Value: accessed-variable=BsConst_Lookup_Curve_HotSpot_Coef_X.Value
            REC_BsConst_Lookup_Curve_HotSpot_Coef_Y_Value: accessed-variable=BsConst_Lookup_Curve_HotSpot_Coef_Y.Value
            REC_BsConst_PCB_Temperature_Sensor_Conv_Value: accessed-variable=BsConst_PCB_Temperature_Sensor_Conv.Value
            REC_BsConst_PWM_boost_bypass_duty_Value: accessed-variable=BsConst_PWM_boost_bypass_duty.Value
            REC_BsConst_Temp_Threshold_Hysteresis_Derating_Value: accessed-variable=BsConst_Temp_Threshold_Hysteresis_Derating.Value
            REC_BsConst_Temperature_Sensor_Conv_Value: accessed-variable=BsConst_Temperature_Sensor_Conv.Value
        data-send-points:
          11 x access:
            SEND_BsConst_BsConst_Illumination_ReservedByte_Value: accessed-variable=BsConst_BsConst_Illumination_ReservedByte.Value
            SEND_BsConst_Compensation_Line_Shift_b_Value: accessed-variable=BsConst_Compensation_Line_Shift_b.Value
            SEND_BsConst_Compensation_Line_Slope_m_Value: accessed-variable=BsConst_Compensation_Line_Slope_m.Value
            SEND_BsConst_Derating_Backlight_Disable_Value: accessed-variable=BsConst_Derating_Backlight_Disable.Value
            SEND_BsConst_Display_Illum_Max_Level_Safe_Value: accessed-variable=BsConst_Display_Illum_Max_Level_Safe.Value
            SEND_BsConst_Lookup_Curve_HotSpot_Coef_X_Value: accessed-variable=BsConst_Lookup_Curve_HotSpot_Coef_X.Value
            SEND_BsConst_Lookup_Curve_HotSpot_Coef_Y_Value: accessed-variable=BsConst_Lookup_Curve_HotSpot_Coef_Y.Value
            SEND_BsConst_PCB_Temperature_Sensor_Conv_Value: accessed-variable=BsConst_PCB_Temperature_Sensor_Conv.Value
            SEND_BsConst_PWM_boost_bypass_duty_Value: accessed-variable=BsConst_PWM_boost_bypass_duty.Value
            SEND_BsConst_Temp_Threshold_Hysteresis_Derating_Value: accessed-variable=BsConst_Temp_Threshold_Hysteresis_Derating.Value
            SEND_BsConst_Temperature_Sensor_Conv_Value: accessed-variable=BsConst_Temperature_Sensor_Conv.Value
  swc implementation MemAbstract_Stub_Safe_Implementation: behavior=MemAbstract_Stub_Safe_InternalBehavior
    code-descriptors:
      code Default: artifact-descriptors=autosar-engineering-object={short-label=Default, category=SWSRC}
package /E40_Platform_System_SystemPackage/Types
  impl type Arr_u16_7: category=ARRAY
    element ArrayElement: category=VALUE, array-size=7, array-size-semantics=FIXED-SIZE, base-type=uint16
  impl type Arr_u8_28: category=ARRAY
    element ArrayElement: category=VALUE, array-size=28, array-size-semantics=FIXED-SIZE, base-type=uint8
  impl type T_NV_Temperature_Conversion: category=ARRAY
    element ArrayElement: category=VALUE, array-size=2, array-size-semantics=FIXED-SIZE, base-type=uint32
package /E40_Platform_System_SystemPackage/Types/DataConstrs
  range UInt16_DataConstraint: raw 0..65535
  range UInt32_DataConstraint: raw 0..4294967295
  range UInt8_DataConstraint: raw 0..255
