[part 10 of 10: packages /E40_Platform_System_SystemPackage/Types to /E40_Platform_System_SystemPackage/Types/DataConstrs]
AUTOSAR XML (schema 4-2-1)
package /E40_Platform_System_SystemPackage/Types  (continued)
  18 x sender receiver interface:
    TI_Illum_Transstep: invalidation-policy{data-element=Trans_Stepvlaue, handle-invalid=DONT-INVALIDATE}
      data Trans_Stepvlaue: implementation-data-type=DataTypes/UInt8, type=DataTypes/UInt8
    TI_IlluminationDuty: invalidation-policy{data-element=DutyValue, handle-invalid=DONT-INVALIDATE}
      data DutyValue: implementation-data-type=UInt16, type=UInt16
    TI_DayNightRequired: invalidation-policy{data-element=ilumDNRequired, handle-invalid=DONT-INVALIDATE}
      data ilumDNRequired: implementation-data-type=DataTypes/UInt8, type=DataTypes/UInt8
    TI_DimStepOutput: invalidation-policy{data-element=IllumStepValue, handle-invalid=DONT-INVALIDATE}
      data IllumStepValue: implementation-data-type=DataTypes/UInt8, type=DataTypes/UInt8
    TI_RGBStepOutput: invalidation-policy{data-element=RGBStepValue, handle-invalid=DONT-INVALIDATE}
      data RGBStepValue: implementation-data-type=UInt16, type=UInt16
    TI_RHDW_Dbc: invalidation-policy{data-element=RHDW_Dbc, handle-invalid=DONT-INVALIDATE}
      data RHDW_Dbc: implementation-data-type=DataTypes/UInt8, type=DataTypes/UInt8
    TI_RHUP_Dbc: invalidation-policy{data-element=RHUP_Dbc, handle-invalid=DONT-INVALIDATE}
      data RHUP_Dbc: implementation-data-type=DataTypes/UInt8, type=DataTypes/UInt8
    TI_RheoSw_Raw_Status: invalidation-policy{data-element=RawdataStatus, handle-invalid=DONT-INVALIDATE}
      data RawdataStatus: implementation-data-type=DataTypes/UInt8, type=DataTypes/UInt8
    TI_RheoSwStatus: invalidation-policy{data-element=SwitchStatus, handle-invalid=DONT-INVALIDATE}
      data SwitchStatus: implementation-data-type=DataTypes/UInt8, type=DataTypes/UInt8
    TI_RheostatDayStep: invalidation-policy{data-element=RheostatDayStep, handle-invalid=DONT-INVALIDATE}
      data RheostatDayStep: implementation-data-type=DataTypes/UInt8, type=DataTypes/UInt8
    TI_RheostatNightStep: invalidation-policy{data-element=RheostatNightStep, handle-invalid=DONT-INVALIDATE}
      data RheostatNightStep: implementation-data-type=DataTypes/UInt8, type=DataTypes/UInt8
    TI_RheostatONSStatus: invalidation-policy{data-element=RheostatONSStatus, handle-invalid=DONT-INVALIDATE}
      data RheostatONSStatus: implementation-data-type=DataTypes/UInt8, type=DataTypes/UInt8
    TI_RheostatSwType: invalidation-policy{data-element=RheostatSwType, handle-invalid=DONT-INVALIDATE}
      data RheostatSwType: implementation-data-type=DataTypes/UInt8, type=DataTypes/UInt8
    TI_SR_IllumRheostatONSTimer: invalidation-policy{data-element=Rheostat_OnSTime, handle-invalid=DONT-INVALIDATE}
      data Rheostat_OnSTime: implementation-data-type=UInt16, type=UInt16
    TI_SR_Illum_StarterStatus: invalidation-policy{data-element=StarterStatus_Out, handle-invalid=DONT-INVALIDATE}
      data StarterStatus_Out: implementation-data-type=DataTypes/UInt8, type=DataTypes/UInt8
    TI_SR_RheostatChange: invalidation-policy{data-element=RheoUpdateVal, handle-invalid=DONT-INVALIDATE}
      data RheoUpdateVal: implementation-data-type=DataTypes/UInt8, type=DataTypes/UInt8
    TI_Etm_Illum_Sts: invalidation-policy{data-element=Illum_Status, handle-invalid=DONT-INVALIDATE}
      data Illum_Status: implementation-data-type=DataTypes/UInt8, type=DataTypes/UInt8
    TIEtm_Illumination_dummy: invalidation-policy{data-element=IllumStatus, handle-invalid=DONT-INVALIDATE}
      data IllumStatus: implementation-data-type=DataTypes/UInt8, type=DataTypes/UInt8
  impl type WarningId:
    category=VALUE
    base-type=uint16
    compu {0=WRN_NORM_BRLV_02, 1=WRN_NORM_ECB_02, 2=WRN_NORM_BRK_02, 3=WRN_NORM_BRKHLD_10, 4=WRN_NORM_BRKHLD_12, 5=WRN_NORM_BRKHLD_16, 6=WRN_NORM_ABS_02, 7=WRN_NORM_AUTHIG_02, 8=WRN_NORM_ADAHIG_02, 9=WRN_NORM_BRKHLD_02, 10=WRN_NORM_BRKHLD_03, 11..14=WRN_NORM_BRKHLD_05..WRN_NORM_BRKHLD_08, 15=WRN_NORM_BRKHLD_11, 16=WRN_NORM_BRKHLD_13, 17=WRN_NORM_BRKHLD_14, 18=WRN_NORM_BRKHLD_15, 19=WRN_NORM_BRKHLD_17, 20=WRN_NORM_AIRBAG_03, 21=WRN_NORM_AUTHIG_04, 22=WRN_NORM_ADAHIG_04, 23=WRN_NORM_ADASTT_05, 24=WRN_NORM_ADASTT_07, 25=WRN_NORM_ADASTT_09, 26=WRN_NORM_ADASTT_10, 27=WRN_NORM_ADASTT_11, 28=WRN_NORM_TFUEL_01, 29=WRN_NORM_PSC1_02, 30..36=WRN_NORM_PSC1_04..WRN_NORM_PSC1_10, 37=WRN_NORM_PSC1_12, 38=WRN_NORM_PSC1_13, 39=WRN_NORM_EPB_03, 40=WRN_NORM_EPB_04, 41=WRN_NORM_EPB_05, 42=WRN_NORM_EPB_08, 43..51=WRN_NORM_EPB_10..WRN_NORM_EPB_18, 52=WRN_NORM_TRCOFF_02, 53=WRN_NORM_WASLEV_02, 54=WRN_NORM_BVOOPE_02, 55=WRN_NORM_THESEN_02, 56=WRN_NORM_THESEN_03, 57..60=WRN_CUSTMIZE_DIGKEY_04..WRN_CUSTMIZE_DIGKEY_07, 61=WRN_NORM_MLGT_01, 62=WRN_NORM_TPWSR_01, 63=WRN_NORM_TPWSR_02, 64=WRN_NORM_TPWSR_03, 65..76=WRN_NORM_SMASTA_02..WRN_NORM_SMASTA_13, 77..81=WRN_NORM_SMASTA_17..WRN_NORM_SMASTA_21, 82..85=WRN_NORM_SMASTA_23..WRN_NORM_SMASTA_26, 86..92=WRN_NORM_SMASTA_28..WRN_NORM_SMASTA_34, 93..98=WRN_NORM_SMASTA_36..WRN_NORM_SMASTA_41, 99=WRN_NORM_LEDHEA_01, 100=WRN_NORM_HEALEV_02, 101=WRN_NORM_HEALEV_03, 102=WRN_NORM_GRISHU_02, 103=WRN_NORM_AVAS_02, 104=WRN_NORM_ALOA_03, 105=WRN_NORM_PCS2_03, 106=WRN_NORM_PCS2_11, 107=WRN_NORM_TRWIP_01, 108..111=WRN_NORM_RSEREM_02..WRN_NORM_RSEREM_05, 112=WRN_NORM_4WDSYS_03, 113=WRN_NORM_4WDSYS_04, 114=WRN_NORM_4WDSYS_06, 115=WRN_NORM_CVTOIL_02, 116=WRN_NORM_CVTOIL_03, 117=WRN_NORM_ATMAL_02, 118=WRN_NORM_SFTPOS_02, 119=WRN_NORM_SFTPOS_03, 120=WRN_NORM_SFTPOS_04, 121=WRN_NORM_MCBW_02, 122=WRN_NORM_TPWS_01, 123=WRN_NORM_TPWS_02, 124..127=WRN_NORM_OILMIL_02..WRN_NORM_OILMIL_05, 128=WRN_NORM_BRLV0_02, 129=WRN_NORM_OILPRE_01, 130=WRN_NORM_BRK0_02, 131=WRN_NORM_BRK0_03, 132..137=WRN_NORM_EPS_02..WRN_NORM_EPS_07, 138=WRN_NORM_EPS_09, 139=WRN_NORM_EPS_10, 140=WRN_NORM_EPS_11, 141=WRN_NORM_FUECAP_02, 142=WRN_NORM_CHEENG_02, 143=WRN_NORM_CHEENG_03, 144=WRN_NORM_CHEENG_04, 145=WRN_NORM_CHEENG_07, 146=WRN_NORM_ROLAWA_01, 147=WRN_NORM_ROLAWA_02, 148=WRN_NORM_ROLAWA_03, 149..155=WRN_NORM_GPF_05..WRN_NORM_GPF_11, 156=WRN_NORM_OILLEV_02, 157=WRN_NORM_COOTEM_03, 158=WRN_NORM_ONACCN_03, 159=WRN_NORM_BATLOW_02, 160=WRN_NORM_CHAMAL_02, 161=WRN_NORM_CHAMAL_03, 162=WRN_NORM_POWMAN_02, 163=WRN_NORM_SOCLOW_02, 164=WRN_NORM_SOCLOW_03, 165..168=WRN_NORM_BATINS_02..WRN_NORM_BATINS_05, 169=WRN_NORM_ONACCP_02, 170=WRN_NORM_ALMN_02, 171=WRN_NORM_HEAECU_02, 172=WRN_NORM_BOS_02, 173=WRN_NORM_BOS_03, 174..182=WRN_NORM_EVMOD_02..WRN_NORM_EVMOD_10, 183=WRN_NORM_DSC_02, 184=WRN_NORM_DSC_03, 185=WRN_NORM_DSC_04, 186..196=WRN_NORM_ROLAWA1_01..WRN_NORM_ROLAWA1_11, 197..200=WRN_NORM_MAICER_09..WRN_NORM_MAICER_12, 201=WRN_NORM_PKSB_09, 202=WRN_NORM_PKSB_10, 203=WRN_NORM_PKSB_11, 204=WRN_NORM_PKSB_13, 205=WRN_NORM_PKSB_14, 206=WRN_NORM_ISA_02, 207=WRN_NORM_ISA_04, 208=WRN_NORM_TCBM_01, 209=WRN_NORM_TCBM_02, 210=WRN_NORM_ADAFRO_02, 211=WRN_NORM_PDA_03, 212=WRN_NORM_RTAN_03, 213=WRN_NORM_SEA_02, 214=WRN_NORM_T120_01, 215=WRN_POWER_EIGCON_02, 216=WRN_POWER_EIGCON_04, 217..220=WRN_PROSRV_PROSRV_02..WRN_PROSRV_PROSRV_05, 221..226=WRN_PROSRV_PROSRV_08..WRN_PROSRV_PROSRV_13, 227=WRN_PROSRV_PROSRV_22, 228=WRN_PROSRV_PROSRV_23, 229=WRN_NORM_BATCOO_02, 230=WRN_NORM_BATCOO_03, 231=WRN_NORM_LDA_02, 232=WRN_NORM_LDA_03, 233=WRN_NORM_LDA_06, 234=WRN_NORM_LDA_07, 235=WRN_NORM_LTA_02, 236=WRN_NORM_LTA_03, 237=WRN_NORM_LTA_07, 238..241=WRN_NORM_LCA_02..WRN_NORM_LCA_05, 242=WRN_NORM_LCA_15, 243=WRN_NORM_LCA_16, 244=WRN_NORM_LCA_17, 245=WRN_NORM_LCA_20, 246=WRN_NORM_RSA_01, 247=WRN_NORM_RSA_04, 248=WRN_NORM_RSA_05, 249=WRN_NORM_CHADYN_01, 250=WRN_NORM_CHADYN_02, 251=WRN_NORM_TOWWAR_02, 252=WRN_NORM_TOWWAR_03, 253=WRN_NORM_TOWWAR_05, 254=WRN_NORM_DMC_02, 255=WRN_NORM_DMC_03, 256=WRN_NORM_DMC_05, 257=WRN_NORM_DMC_06, 258..261=WRN_NORM_DMC_12..WRN_NORM_DMC_15, 262=WRN_NORM_DMC_17, 263=WRN_NORM_DMC_18, 264=WRN_NORM_ICYRA_01, 265=WRN_NORM_SEA_NCYC_02, 266=WRN_NORM_DRIPOW_02, 267=WRN_NORM_DRIPOW_03, 268=WRN_NORM_DRIPOW_04, 269=WRN_NORM_CCS_02, 270=WRN_NORM_CCS_03, 271..281=WRN_NORM_ACC_02..WRN_NORM_ACC_12, 282=WRN_NORM_ACC_18, 283=WRN_NORM_ACC_19, 284=WRN_NORM_ACC_21, 285..291=WRN_NORM_DESA_02..WRN_NORM_DESA_08, 292=WRN_NORM_PEXI_02, 293..299=WRN_NORM_RESADJ_09..WRN_NORM_RESADJ_15, 300=WRN_NORM_TSMODE_02, 301=WRN_NORM_UNIOVE_02, 302=WRN_NORM_UNIOVE_04, 303=WARN_ADAS_SDG_01, 304=WRN_ADAS_PDA_01, 305=WRN_ADAS_PDA_02, 306=WRN_NORM_TDOOR_01, 307=WRN_NORM_TDOOR_02, 308=WRN_NORM_TDOOR_03, 309=WRN_NORM_ACCHOL_02, 310=WRN_NORM_ACCHOL_03, 311=WRN_NORM_ACCHOL_05, 312..318=WRN_NORM_MAICER_09_RESADJ_09..WRN_NORM_MAICER_09_RESADJ_15, 319..325=WRN_NORM_MAICER_11_RESADJ_09..WRN_NORM_MAICER_11_RESADJ_15, 326=WRN_NORM_CVRS_04, 327=WRN_NORM_CVRS_05, 328..334=WRN_NORM_SMASTA_42..WRN_NORM_SMASTA_48, 335=WRN_MFLID_MFLID_01, 336=WRN_NORM_MFLID_02, 337=WRN_NORM_MFLID_03, 338=WRN_NORM_TMNT_15, 339=WRN_NORM_TMNT_16, 340=WRN_ADAS_LCA1, 341=WRN_ADAS_LCA2, 342=WRN_DOOR_UNLMOD_02, 343=WARN_ADAS_PDA1, 344..350=WRN_ADAS_URSM_01..WRN_ADAS_URSM_07, 351..367=WRN_NORM_SYSMAL_HVIND1..WRN_NORM_SYSMAL_HVIND17, 368=WRN_NORM_FHL_04, 369=WRN_NORM_SMASTA_52, 370=WRN_NORM_SMASTA_53, 371..377=WRN_NORM_GPF_MEV01_02..WRN_NORM_GPF_MEV01_08, 378=WRN_NORM_VCOPE_02, 379=WRN_NORM_VCOPE_03, 380=WRN_ADAS_LCA_01, 381=WRN_ADAS_LCA_03, 382=WRN_ADAS_LCA_04, 383..389=WRN_NORM_FCMDI_01..WRN_NORM_FCMDI_07, 390=WRN_NORM_TSMODE_VM01_02, 391..395=WRN_ADAS_ACC_01..WRN_ADAS_ACC_05, 396..431=WRN_ADAS_ACC_22..WRN_ADAS_ACC_57, 432..439=WRN_NORM_ACC_VM01_GSY07_02..WRN_NORM_ACC_VM01_GSY07_09, 440..443=WRN_NORM_ACC_VM01_EFE02_02..WRN_NORM_ACC_VM01_EFE02_05, 444..447=WRN_NORM_ACC_VM01_EFE01_02..WRN_NORM_ACC_VM01_EFE01_05, 448..455=WRN_NORM_ACC_VM01_GME12_02..WRN_NORM_ACC_VM01_GME12_09, 456=WRN_NORM_FCTA_01, 457=WARN_NORM_GRISHU_02, 458=WRN_NORM_CHEENG_06, 459=WRN_NORM_SFTPOSL_02, 460=WRN_NORM_SFTPOSL_03, 461=WRN_NORM_SFTPOSL_04, 462=WRN_NORM_TPMS_02, 463=WRN_NORM_TPMS_03, 464=WRN_NORM_STOSTA_02, 465=WRN_NORM_RSRDI_02, 466=WRN_NORM_PSSDI_02, 467=WRN_NORM_UNOVE_02, 468=WRN_NORM_UNOVE_04, 469=WRN_CUSTMIZE_PERSET_02, 470=WRN_CUSTMIZE_PERSET_03, 471=WRN_CUSTMIZE_PERSET_04, 472..490=WRN_CUSTMIZE_PERSET_06..WRN_CUSTMIZE_PERSET_24, 491=WRN_NORM_SEA_VM01_02, 492=WRN_NORM_SEA_VM02_02, 493..496=WRN_NORM_PSSDI_03..WRN_NORM_PSSDI_06, 497=WRN_NORM_CLESON_02, 498=WRN_CUTMIZE_DIGKEY_01, 499=WRN_NORM_RSRDI_03, 500=WRN_ADAS_LCA_02, 501..510=WRN_NORM_TPMS_VM02_REQ02..WRN_NORM_TPMS_VM02_REQ11, 511=WRN_NORM_TPMS_VM02_GWM08_REQ02, 512=WRN_NORM_TPMS_VM02_GWM08_REQ01, 513=WRN_NORM_PSSDI_07, 514=WRN_NORM_EXWUOC_04, 515=WRN_NORM_EXWUOC_06, 516=WRN_NORM_EXWUOC_10, 517=WRN_NORM_EXWUOC_16, 518=WRN_NORM_EXWUOC_17, 519=WRN_NORM_EXWUOC_18, 520=WRN_NORM_PBD_02, 521=WRN_NORM_FCTA_02, 522=WRN_NORM_TMN_02, 523=WRN_NORM_TMN_03, 524=WRN_NORM_PEDPRO_03, 525=WRN_NORM_PEDPRO_04, 526=WRN_NORM_LEAUNF_02, 527=WRN_NORM_LEAUNF_04, 528..537=WRN_NORM_HCS_02..WRN_NORM_HCS_11, 538=WRN_NORM_SCB_02, 539=WRN_NORM_ITS_02, 540=WRN_NORM_ITS_06, 541=WRN_NORM_ITS_MEV01_02, 542=WRN_NORM_ITS_MEV01_04, 543=WRN_NORM_ITS_MEV01_05, 544=WRN_NORM_ITS_MEV01_06, 545=WRN_NORM_MAPACC_02, 546=WRN_NORM_OAA_03, 547=WRN_NORM_OAA_04, 548=WRN_NORM_LCA_21, 549..554=WRN_NORM_LCA_26..WRN_NORM_LCA_31, 555=WRN_NORM_NLOCK_02, 556=WRN_NORM_ATFWRN_02, 557=WRN_NORM_LTA_04, 558=WRN_NORM_LTA_05, 559=WRN_NORM_LTA_06, 560..564=WRN_NORM_LTA_08..WRN_NORM_LTA_12, 565=WRN_NORM_PCL_02, 566..573=WRN_ADAS_LCA_05..WRN_ADAS_LCA_12, 574=WRN_NORM_LDA_04, 575=WRN_NORM_LDA_05, 576=WRN_ADAS_OAA_01, 577=WRN_NORM_TPMS_VM02_GWM08_REQ06, 578=WRN_NORM_TPMS_VM02_GWM08_REQ07, 579=WRN_ADAS_ACC_G7, 580=WRN_ADAS_ACC_G11_01, 581=WRN_ADAS_ACC_G11_02, 582=WRN_ADAS_ACC_G11_03, 583=WRN_ADAS_ACC_G20, 584=WRN_ADAS_ACC_G22, 585=WRN_ADAS_ACC_G23, 586=HUD_WRN_NORM_PCS1_05, 587=HUD_WRN_NORM_PCS1_06, 588=HUD_WRN_ADAS_ACC_G20, 589=HUD_WRN_ADAS_ACC_G7, 590=HUD_WRN_ADAS_ACC_G23, 591=HUD_WRN_ADAS_ACC_G22, 592=HUD_WRN_ADAS_LCA_02, 593=HUD_WRN_NORM_DA_02, 594=HUD_WRN_NORM_SCB_02, 595=HUD_WRN_NORM_ITS_MEV01_04, 596=HUD_WRN_NORM_ITS_MEV01_02, 597=HUD_WRN_NORM_ITS_02, 598=HUD_WRN_NORM_BOS_02, 599=HUD_WRN_NORM_DSC_02, 600=HUD_WRN_NORM_PMAR_03, 601=HUD_WRN_ADAS_OAA_01, 602=HUD_WRN_NORM_ACC_19, 603=HUD_WRN_NORM_LCA_29, 604..611=HUD_WRN_ADAS_LCA_05..HUD_WRN_ADAS_LCA_12, 612=HUD_WRN_NORM_RTAN_02, 613=HUD_WRN_NORM_LDA_02, 614=HUD_WRN_ADAS_LCA_03, 615=HUD_WRN_ADAS_LCA_04, 616=HUD_WRN_NORM_ACC_21, 617=HUD_WRN_ADAS_ACC_G11_01, 618=HUD_WRN_ADAS_ACC_G11_02, 619=HUD_WRN_ADAS_ACC_G11_03, 620=HUD_WRN_NORM_DSC_04, 621..629=WRN_NORM_GROUP1..WRN_NORM_GROUP9, 630=TotalNumOfWarnings}
    range raw 0..630
  impl type WarningStatus: category=VALUE, base-type=uint8, compu {0=UI_WARNING_STATUS_OFF, 1=UI_WARNING_STATUS_ON, 2=UI_WARNING_STATUS_UNKNOWN}, range raw 0..2
  impl type WarningEvent: category=VALUE, base-type=uint8, compu {0=UI_WARNING_EVENT_NONE, 1=UI_WARNING_EVENT_RETRIGGER, 2=UI_WARNING_EVENT_FORCED}, range raw 0..2
  client server interface TI_Ctrl_Warning_UpdateWarningStatus
    operation UpdateWarningStatus
      4 x arg, all with direction=IN:
        WarningCurId: implementation-data-type=WarningId, type=WarningId
        WarningCurStatus: implementation-data-type=WarningStatus, type=WarningStatus
        WarningCurEvent: implementation-data-type=WarningEvent, type=WarningEvent
        WarningPayload: implementation-data-type=UInt32, type=UInt32
  19 x impl type, all with category=ARRAY:
    Arr_u8_128
      element ArrayElement: category=VALUE, array-size=128, array-size-semantics=FIXED-SIZE, base-type=uint8
    Arr_u8_28
      element ArrayElement: category=VALUE, array-size=28, array-size-semantics=FIXED-SIZE, base-type=uint8
    Arr_u8_64
      element ArrayElement: category=VALUE, array-size=64, array-size-semantics=FIXED-SIZE, base-type=uint8
    Arr_u8_32
      element ArrayElement: category=VALUE, array-size=32, array-size-semantics=FIXED-SIZE, base-type=uint8
    Arr_u16_7
      element ArrayElement: category=VALUE, array-size=7, array-size-semantics=FIXED-SIZE, base-type=uint16
    T_NV_Temperature_Conversion
      element ArrayElement: category=VALUE, array-size=2, array-size-semantics=FIXED-SIZE, base-type=uint32
    Arr_u8_48
      element ArrayElement: category=VALUE, array-size=48, array-size-semantics=FIXED-SIZE, base-type=uint8
    Arr_u8_2048
      element ArrayElement: category=VALUE, array-size=2048, array-size-semantics=FIXED-SIZE, base-type=uint8
    Arr_u8_1024
      element ArrayElement: category=VALUE, array-size=1024, array-size-semantics=FIXED-SIZE, base-type=uint8
    Arr_u8_100
      element ArrayElement: category=VALUE, array-size=100, array-size-semantics=FIXED-SIZE, base-type=uint8
    Arr_u8_256
      element ArrayElement: category=VALUE, array-size=256, array-size-semantics=FIXED-SIZE, base-type=uint8
    Arr_u8_8
      element ArrayElement: category=VALUE, array-size=8, array-size-semantics=FIXED-SIZE, base-type=uint8
    Arr_u8_16
      element ArrayElement: category=VALUE, array-size=16, array-size-semantics=FIXED-SIZE, base-type=uint8
    Arr_u8_3
      element ArrayElement: category=VALUE, array-size=3, array-size-semantics=FIXED-SIZE, base-type=uint8
    Arr_u8_61
      element ArrayElement: category=VALUE, array-size=61, array-size-semantics=FIXED-SIZE, base-type=uint8
    Arr_u8_9
      element ArrayElement: category=VALUE, array-size=9, array-size-semantics=FIXED-SIZE, base-type=uint8
    Arr_u8_10
      element ArrayElement: category=VALUE, array-size=10, array-size-semantics=FIXED-SIZE, base-type=uint8
    Arr_u8_46
      element ArrayElement: category=VALUE, array-size=46, array-size-semantics=FIXED-SIZE, base-type=uint8
    Arr_u8_17
      element ArrayElement: category=VALUE, array-size=17, array-size-semantics=FIXED-SIZE, base-type=uint8
  client server interface if_CS_MemAbsGet
    95 x operation, all with possible-error=if_CS_MemAbsGet/E_NOT_OK:
      Get_BsConst_Audio_Element
        arg Ptr: implementation-data-type=Arr_u8_128, type=Arr_u8_128, direction=OUT
      Get_BsConst_BsConst_Illumination_ReservedByte
        arg Ptr: implementation-data-type=Arr_u8_28, type=Arr_u8_28, direction=OUT
      Get_BsConst_BsConst_Illumination_ReservedByte_SafeCopy1
        arg Ptr: implementation-data-type=Arr_u8_28, type=Arr_u8_28, direction=OUT
      Get_BsConst_BsConst_Illumination_ReservedByte_SafeCopy2
        arg Ptr: implementation-data-type=Arr_u8_28, type=Arr_u8_28, direction=OUT
      Get_BsConst_Communication_Element
        arg Ptr: implementation-data-type=Arr_u8_64, type=Arr_u8_64, direction=OUT
      Get_BsConst_Compensation_Line_Shift_b
        arg Ptr: implementation-data-type=UInt32, type=UInt32, direction=OUT
      Get_BsConst_Compensation_Line_Shift_b_SafeCopy1
        arg Ptr: implementation-data-type=UInt32, type=UInt32, direction=OUT
      Get_BsConst_Compensation_Line_Shift_b_SafeCopy2
        arg Ptr: implementation-data-type=UInt32, type=UInt32, direction=OUT
      Get_BsConst_Compensation_Line_Slope_m
        arg Ptr: implementation-data-type=UInt32, type=UInt32, direction=OUT
      Get_BsConst_Compensation_Line_Slope_m_SafeCopy1
        arg Ptr: implementation-data-type=UInt32, type=UInt32, direction=OUT
      Get_BsConst_Compensation_Line_Slope_m_SafeCopy2
        arg Ptr: implementation-data-type=UInt32, type=UInt32, direction=OUT
      Get_BsConst_Derating_Backlight_Disable
        arg Ptr: implementation-data-type=DataTypes/UInt8, type=DataTypes/UInt8, direction=OUT
      Get_BsConst_Derating_Backlight_Disable_SafeCopy1
        arg Ptr: implementation-data-type=DataTypes/UInt8, type=DataTypes/UInt8, direction=OUT
      Get_BsConst_Derating_Backlight_Disable_SafeCopy2
        arg Ptr: implementation-data-type=DataTypes/UInt8, type=DataTypes/UInt8, direction=OUT
      Get_BsConst_Display_Illum_Max_Level
        arg Ptr: implementation-data-type=UInt16, type=UInt16, direction=OUT
      Get_BsConst_Display_Illum_Max_Level_SafeCopy1
        arg Ptr: implementation-data-type=UInt16, type=UInt16, direction=OUT
      Get_BsConst_Display_Illum_Max_Level_SafeCopy2
        arg Ptr: implementation-data-type=UInt16, type=UInt16, direction=OUT
      Get_BsConst_EngOffTimer_Element
        arg Ptr: implementation-data-type=Arr_u8_32, type=Arr_u8_32, direction=OUT
      Get_BsConst_FuelGauge_Element
        arg Ptr: implementation-data-type=Arr_u8_128, type=Arr_u8_128, direction=OUT
      Get_BsConst_Lookup_Curve_HotSpot_Coef_X
        arg Ptr: implementation-data-type=Arr_u16_7, type=Arr_u16_7, direction=OUT
      Get_BsConst_Lookup_Curve_HotSpot_Coef_X_SafeCopy1
        arg Ptr: implementation-data-type=Arr_u16_7, type=Arr_u16_7, direction=OUT
      Get_BsConst_Lookup_Curve_HotSpot_Coef_X_SafeCopy2
        arg Ptr: implementation-data-type=Arr_u16_7, type=Arr_u16_7, direction=OUT
      Get_BsConst_Lookup_Curve_HotSpot_Coef_Y
        arg Ptr: implementation-data-type=Arr_u16_7, type=Arr_u16_7, direction=OUT
      Get_BsConst_Lookup_Curve_HotSpot_Coef_Y_SafeCopy1
        arg Ptr: implementation-data-type=Arr_u16_7, type=Arr_u16_7, direction=OUT
      Get_BsConst_Lookup_Curve_HotSpot_Coef_Y_SafeCopy2
        arg Ptr: implementation-data-type=Arr_u16_7, type=Arr_u16_7, direction=OUT
      Get_BsConst_OilGauge_Element
        arg Ptr: implementation-data-type=Arr_u8_64, type=Arr_u8_64, direction=OUT
      Get_BsConst_PCB_Temperature_Sensor_Conv
        arg Ptr: implementation-data-type=T_NV_Temperature_Conversion, type=T_NV_Temperature_Conversion, direction=OUT
      Get_BsConst_PCB_Temperature_Sensor_Conv_SafeCopy1
        arg Ptr: implementation-data-type=T_NV_Temperature_Conversion, type=T_NV_Temperature_Conversion, direction=OUT
      Get_BsConst_PCB_Temperature_Sensor_Conv_SafeCopy2
        arg Ptr: implementation-data-type=T_NV_Temperature_Conversion, type=T_NV_Temperature_Conversion, direction=OUT
      Get_BsConst_PWM_boost_bypass_duty
        arg Ptr: implementation-data-type=DataTypes/UInt8, type=DataTypes/UInt8, direction=OUT
      Get_BsConst_PWM_boost_bypass_duty_SafeCopy1
        arg Ptr: implementation-data-type=DataTypes/UInt8, type=DataTypes/UInt8, direction=OUT
      Get_BsConst_PWM_boost_bypass_duty_SafeCopy2
        arg Ptr: implementation-data-type=DataTypes/UInt8, type=DataTypes/UInt8, direction=OUT
      Get_BsConst_PowerGauge_Element
        arg Ptr: implementation-data-type=Arr_u8_64, type=Arr_u8_64, direction=OUT
      Get_BsConst_Power_Element
        arg Ptr: implementation-data-type=Arr_u8_32, type=Arr_u8_32, direction=OUT
      Get_BsConst_RealTimeClock_Element
        arg Ptr: implementation-data-type=Arr_u8_48, type=Arr_u8_48, direction=OUT
      Get_BsConst_ServiceReminder_Element
        arg Ptr: implementation-data-type=Arr_u8_48, type=Arr_u8_48, direction=OUT
      Get_BsConst_SpeedoGauge_Element
        arg Ptr: implementation-data-type=Arr_u8_64, type=Arr_u8_64, direction=OUT
      Get_BsConst_TachoGauge_Element
        arg Ptr: implementation-data-type=Arr_u8_64, type=Arr_u8_64, direction=OUT
      Get_BsConst_TempGauge_Element
        arg Ptr: implementation-data-type=Arr_u8_64, type=Arr_u8_64, direction=OUT
      Get_BsConst_Temp_Threshold_Hysteresis_Derating
        arg Ptr: implementation-data-type=DataTypes/UInt8, type=DataTypes/UInt8, direction=OUT
      Get_BsConst_Temp_Threshold_Hysteresis_Derating_SafeCopy1
        arg Ptr: implementation-data-type=DataTypes/UInt8, type=DataTypes/UInt8, direction=OUT
      Get_BsConst_Temp_Threshold_Hysteresis_Derating_SafeCopy2
        arg Ptr: implementation-data-type=DataTypes/UInt8, type=DataTypes/UInt8, direction=OUT
      Get_BsConst_Temperature_Sensor_Conv
        arg Ptr: implementation-data-type=T_NV_Temperature_Conversion, type=T_NV_Temperature_Conversion, direction=OUT
      Get_BsConst_Temperature_Sensor_Conv_SafeCopy1
        arg Ptr: implementation-data-type=T_NV_Temperature_Conversion, type=T_NV_Temperature_Conversion, direction=OUT
      Get_BsConst_Temperature_Sensor_Conv_SafeCopy2
        arg Ptr: implementation-data-type=T_NV_Temperature_Conversion, type=T_NV_Temperature_Conversion, direction=OUT
      Get_BsConst_TripComputer_Element
        arg Ptr: implementation-data-type=Arr_u8_64, type=Arr_u8_64, direction=OUT
      Get_BsConst_Warning_Element
        arg Ptr: implementation-data-type=Arr_u8_64, type=Arr_u8_64, direction=OUT
      Get_BsCys_Certicificate_Element
        arg Ptr: implementation-data-type=Arr_u8_64, type=Arr_u8_64, direction=OUT
      Get_BsDiag_Dtc_Element
        arg Ptr: implementation-data-type=Arr_u8_2048, type=Arr_u8_2048, direction=OUT
      Get_BsDiag_ErrorRecord_Element
        arg Ptr: implementation-data-type=Arr_u8_1024, type=Arr_u8_1024, direction=OUT
      Get_BsReten_Audio_Element
        arg Ptr: implementation-data-type=Arr_u8_100, type=Arr_u8_100, direction=OUT
      Get_BsReten_Communication_Element
        arg Ptr: implementation-data-type=Arr_u8_100, type=Arr_u8_100, direction=OUT
      Get_BsReten_Display_Element
        arg Ptr: implementation-data-type=Arr_u8_100, type=Arr_u8_100, direction=OUT
      Get_BsReten_Gauges_Element
        arg Ptr: implementation-data-type=Arr_u8_100, type=Arr_u8_100, direction=OUT
      Get_BsReten_Illumination_Element
        arg Ptr: implementation-data-type=Arr_u8_100, type=Arr_u8_100, direction=OUT
      Get_BsReten_Odometer_Element
        arg Ptr: implementation-data-type=Arr_u8_100, type=Arr_u8_100, direction=OUT
      Get_BsReten_Personalization_Element
        arg Ptr: implementation-data-type=Arr_u8_100, type=Arr_u8_100, direction=OUT
      Get_BsReten_Power_Element
        arg Ptr: implementation-data-type=Arr_u8_100, type=Arr_u8_100, direction=OUT
      Get_BsReten_RealTimeClock_Element
        arg Ptr: implementation-data-type=Arr_u8_100, type=Arr_u8_100, direction=OUT
      Get_BsReten_Tripcomputer_Element
        arg Ptr: implementation-data-type=Arr_u8_100, type=Arr_u8_100, direction=OUT
      Get_BsReten_VisDlt_Element
        arg Ptr: implementation-data-type=Arr_u8_256, type=Arr_u8_256, direction=OUT
      Get_BsReten_Warning_Element
        arg Ptr: implementation-data-type=Arr_u8_100, type=Arr_u8_100, direction=OUT
      Get_BsRt_CusDlt_Element
        arg Ptr: implementation-data-type=Arr_u8_128, type=Arr_u8_128, direction=OUT
      Get_BsRt_FuelGauge_Element
        arg Ptr: implementation-data-type=Arr_u8_32, type=Arr_u8_32, direction=OUT
      Get_BsRt_Illumination_Element
        arg Ptr: implementation-data-type=Arr_u8_100, type=Arr_u8_100, direction=OUT
      Get_BsRt_Odometer_Element
        arg Ptr: implementation-data-type=Arr_u8_128, type=Arr_u8_128, direction=OUT
      Get_BsRt_OilGauge_Element
        arg Ptr: implementation-data-type=Arr_u8_8, type=Arr_u8_8, direction=OUT
      Get_BsRt_Personalization_Element
        arg Ptr: implementation-data-type=Arr_u8_128, type=Arr_u8_128, direction=OUT
      Get_BsRt_PowerGauge_Element
        arg Ptr: implementation-data-type=Arr_u8_32, type=Arr_u8_32, direction=OUT
      Get_BsRt_RealTimeClock_Element
        arg Ptr: implementation-data-type=Arr_u8_48, type=Arr_u8_48, direction=OUT
      Get_BsRt_SpeedoGauge_Element
        arg Ptr: implementation-data-type=Arr_u8_8, type=Arr_u8_8, direction=OUT
      Get_BsRt_TachoGauge_Element
        arg Ptr: implementation-data-type=Arr_u8_16, type=Arr_u8_16, direction=OUT
      Get_BsRt_TempGauge_Element
        arg Ptr: implementation-data-type=Arr_u8_32, type=Arr_u8_32, direction=OUT
      Get_BsRt_TripComputer_Element
        arg Ptr: implementation-data-type=Arr_u8_64, type=Arr_u8_64, direction=OUT
      Get_BsRt_Warning_Element
        arg Ptr: implementation-data-type=Arr_u8_32, type=Arr_u8_32, direction=OUT
      Get_BsShare_AssemblyManufacturingDate
        arg Ptr: implementation-data-type=Arr_u8_3, type=Arr_u8_3, direction=OUT
      Get_BsShare_AssemblyPlantNumber
        arg Ptr: implementation-data-type=Arr_u8_3, type=Arr_u8_3, direction=OUT
      Get_BsShare_EcuPartNumber_Element
        arg Ptr: implementation-data-type=Arr_u8_61, type=Arr_u8_61, direction=OUT
      Get_BsShare_HWModification
        arg Ptr: implementation-data-type=UInt16, type=UInt16, direction=OUT
      Get_BsShare_PCBSerialNumber
        arg Ptr: implementation-data-type=Arr_u8_9, type=Arr_u8_9, direction=OUT
      Get_BsShare_ProductSerialNumber
        arg Ptr: implementation-data-type=Arr_u8_10, type=Arr_u8_10, direction=OUT
      Get_BsShare_SMTManufacturingDate
        arg Ptr: implementation-data-type=Arr_u8_3, type=Arr_u8_3, direction=OUT
      Get_BsShare_SMTPlantNumber
        arg Ptr: implementation-data-type=Arr_u8_3, type=Arr_u8_3, direction=OUT
      Get_BsShare_SwUpdFotaFinPrint_Element
        arg Ptr: implementation-data-type=Arr_u8_32, type=Arr_u8_32, direction=OUT
      Get_BsShare_SwUpdFotaMode_Element
        arg Ptr: implementation-data-type=Arr_u8_16, type=Arr_u8_16, direction=OUT
      Get_BsShare_SwUpdFotaStatus_Element
        arg Ptr: implementation-data-type=Arr_u8_48, type=Arr_u8_48, direction=OUT
      Get_BsShare_SwUpdFotadecrypt_Element
        arg Ptr: implementation-data-type=Arr_u8_64, type=Arr_u8_64, direction=OUT
      Get_BsShare_SwUpdReflash_Element
        arg Ptr: implementation-data-type=Arr_u8_8, type=Arr_u8_8, direction=OUT
      Get_BsShare_VehicleConfig_Element
        arg Ptr: implementation-data-type=Arr_u8_256, type=Arr_u8_256, direction=OUT
      Get_BsShare_VisMeet_EOLEntry_Element
        arg Ptr: implementation-data-type=UInt16, type=UInt16, direction=OUT
      Get_BsShare_VisMeet_Element
        arg Ptr: implementation-data-type=Arr_u8_46, type=Arr_u8_46, direction=OUT
      Get_BsShare_VisteonPCBPartNumber
        arg Ptr: implementation-data-type=Arr_u8_17, type=Arr_u8_17, direction=OUT
      Get_BsShare_VisteonPartNumber
        arg Ptr: implementation-data-type=Arr_u8_17, type=Arr_u8_17, direction=OUT
      Get_RefCys_Certicificate1_Element
        arg Ptr: implementation-data-type=Arr_u8_64, type=Arr_u8_64, direction=OUT
      Get_RefCys_Certicificate_Element
        arg Ptr: implementation-data-type=Arr_u8_64, type=Arr_u8_64, direction=OUT
    error E_NOT_OK: error-code=1
  client server interface if_CS_MemAbsSet
    95 x operation:
      Set_BsConst_Audio_Element
        arg BsConst_Audio_Element: implementation-data-type=Arr_u8_128, type=Arr_u8_128, direction=IN
      Set_BsConst_BsConst_Illumination_ReservedByte
        arg BsConst_BsConst_Illumination_ReservedByte: implementation-data-type=Arr_u8_28, type=Arr_u8_28, direction=IN
      Set_BsConst_BsConst_Illumination_ReservedByte_SafeCopy1
        arg BsConst_BsConst_Illumination_ReservedByte_SafeCopy1: implementation-data-type=Arr_u8_28, type=Arr_u8_28, direction=IN
      Set_BsConst_BsConst_Illumination_ReservedByte_SafeCopy2
        arg BsConst_BsConst_Illumination_ReservedByte_SafeCopy2: implementation-data-type=Arr_u8_28, type=Arr_u8_28, direction=IN
      Set_BsConst_Communication_Element
        arg BsConst_Communication_Element: implementation-data-type=Arr_u8_64, type=Arr_u8_64, direction=IN
      Set_BsConst_Compensation_Line_Shift_b
        arg BsConst_Compensation_Line_Shift_b: implementation-data-type=UInt32, type=UInt32, direction=IN
      Set_BsConst_Compensation_Line_Shift_b_SafeCopy1
        arg BsConst_Compensation_Line_Shift_b_SafeCopy1: implementation-data-type=UInt32, type=UInt32, direction=IN
      Set_BsConst_Compensation_Line_Shift_b_SafeCopy2
        arg BsConst_Compensation_Line_Shift_b_SafeCopy2: implementation-data-type=UInt32, type=UInt32, direction=IN
      Set_BsConst_Compensation_Line_Slope_m
        arg BsConst_Compensation_Line_Slope_m: implementation-data-type=UInt32, type=UInt32, direction=IN
      Set_BsConst_Compensation_Line_Slope_m_SafeCopy1
        arg BsConst_Compensation_Line_Slope_m_SafeCopy1: implementation-data-type=UInt32, type=UInt32, direction=IN
      Set_BsConst_Compensation_Line_Slope_m_SafeCopy2
        arg BsConst_Compensation_Line_Slope_m_SafeCopy2: implementation-data-type=UInt32, type=UInt32, direction=IN
      Set_BsConst_Derating_Backlight_Disable
        arg BsConst_Derating_Backlight_Disable: implementation-data-type=DataTypes/UInt8, type=DataTypes/UInt8, direction=IN
      Set_BsConst_Derating_Backlight_Disable_SafeCopy1
        arg BsConst_Derating_Backlight_Disable_SafeCopy1: implementation-data-type=DataTypes/UInt8, type=DataTypes/UInt8, direction=IN
      Set_BsConst_Derating_Backlight_Disable_SafeCopy2
        arg BsConst_Derating_Backlight_Disable_SafeCopy2: implementation-data-type=DataTypes/UInt8, type=DataTypes/UInt8, direction=IN
      Set_BsConst_Display_Illum_Max_Level
        arg BsConst_Display_Illum_Max_Level: implementation-data-type=UInt16, type=UInt16, direction=IN
      Set_BsConst_Display_Illum_Max_Level_SafeCopy1
        arg BsConst_Display_Illum_Max_Level_SafeCopy1: implementation-data-type=UInt16, type=UInt16, direction=IN
      Set_BsConst_Display_Illum_Max_Level_SafeCopy2
        arg BsConst_Display_Illum_Max_Level_SafeCopy2: implementation-data-type=UInt16, type=UInt16, direction=IN
      Set_BsConst_EngOffTimer_Element
        arg BsConst_EngOffTimer_Element: implementation-data-type=Arr_u8_32, type=Arr_u8_32, direction=IN
      Set_BsConst_FuelGauge_Element
        arg BsConst_FuelGauge_Element: implementation-data-type=Arr_u8_128, type=Arr_u8_128, direction=IN
      Set_BsConst_Lookup_Curve_HotSpot_Coef_X
        arg BsConst_Lookup_Curve_HotSpot_Coef_X: implementation-data-type=Arr_u16_7, type=Arr_u16_7, direction=IN
      Set_BsConst_Lookup_Curve_HotSpot_Coef_X_SafeCopy1
        arg BsConst_Lookup_Curve_HotSpot_Coef_X_SafeCopy1: implementation-data-type=Arr_u16_7, type=Arr_u16_7, direction=IN
      Set_BsConst_Lookup_Curve_HotSpot_Coef_X_SafeCopy2
        arg BsConst_Lookup_Curve_HotSpot_Coef_X_SafeCopy2: implementation-data-type=Arr_u16_7, type=Arr_u16_7, direction=IN
      Set_BsConst_Lookup_Curve_HotSpot_Coef_Y
        arg BsConst_Lookup_Curve_HotSpot_Coef_Y: implementation-data-type=Arr_u16_7, type=Arr_u16_7, direction=IN
      Set_BsConst_Lookup_Curve_HotSpot_Coef_Y_SafeCopy1
        arg BsConst_Lookup_Curve_HotSpot_Coef_Y_SafeCopy1: implementation-data-type=Arr_u16_7, type=Arr_u16_7, direction=IN
      Set_BsConst_Lookup_Curve_HotSpot_Coef_Y_SafeCopy2
        arg BsConst_Lookup_Curve_HotSpot_Coef_Y_SafeCopy2: implementation-data-type=Arr_u16_7, type=Arr_u16_7, direction=IN
      Set_BsConst_OilGauge_Element
        arg BsConst_OilGauge_Element: implementation-data-type=Arr_u8_64, type=Arr_u8_64, direction=IN
      Set_BsConst_PCB_Temperature_Sensor_Conv
        arg BsConst_PCB_Temperature_Sensor_Conv: implementation-data-type=T_NV_Temperature_Conversion, type=T_NV_Temperature_Conversion, direction=IN
      Set_BsConst_PCB_Temperature_Sensor_Conv_SafeCopy1
        arg BsConst_PCB_Temperature_Sensor_Conv_SafeCopy1: implementation-data-type=T_NV_Temperature_Conversion, type=T_NV_Temperature_Conversion, direction=IN
      Set_BsConst_PCB_Temperature_Sensor_Conv_SafeCopy2
        arg BsConst_PCB_Temperature_Sensor_Conv_SafeCopy2: implementation-data-type=T_NV_Temperature_Conversion, type=T_NV_Temperature_Conversion, direction=IN
      Set_BsConst_PWM_boost_bypass_duty
        arg BsConst_PWM_boost_bypass_duty: implementation-data-type=DataTypes/UInt8, type=DataTypes/UInt8, direction=IN
      Set_BsConst_PWM_boost_bypass_duty_SafeCopy1
        arg BsConst_PWM_boost_bypass_duty_SafeCopy1: implementation-data-type=DataTypes/UInt8, type=DataTypes/UInt8, direction=IN
      Set_BsConst_PWM_boost_bypass_duty_SafeCopy2
        arg BsConst_PWM_boost_bypass_duty_SafeCopy2: implementation-data-type=DataTypes/UInt8, type=DataTypes/UInt8, direction=IN
      Set_BsConst_PowerGauge_Element
        arg BsConst_PowerGauge_Element: implementation-data-type=Arr_u8_64, type=Arr_u8_64, direction=IN
      Set_BsConst_Power_Element
        arg BsConst_Power_Element: implementation-data-type=Arr_u8_32, type=Arr_u8_32, direction=IN
      Set_BsConst_RealTimeClock_Element
        arg BsConst_RealTimeClock_Element: implementation-data-type=Arr_u8_48, type=Arr_u8_48, direction=IN
      Set_BsConst_ServiceReminder_Element
        arg BsConst_ServiceReminder_Element: implementation-data-type=Arr_u8_48, type=Arr_u8_48, direction=IN
      Set_BsConst_SpeedoGauge_Element
        arg BsConst_SpeedoGauge_Element: implementation-data-type=Arr_u8_64, type=Arr_u8_64, direction=IN
      Set_BsConst_TachoGauge_Element
        arg BsConst_TachoGauge_Element: implementation-data-type=Arr_u8_64, type=Arr_u8_64, direction=IN
      Set_BsConst_TempGauge_Element
        arg BsConst_TempGauge_Element: implementation-data-type=Arr_u8_64, type=Arr_u8_64, direction=IN
      Set_BsConst_Temp_Threshold_Hysteresis_Derating
        arg BsConst_Temp_Threshold_Hysteresis_Derating: implementation-data-type=DataTypes/UInt8, type=DataTypes/UInt8, direction=IN
      Set_BsConst_Temp_Threshold_Hysteresis_Derating_SafeCopy1
        arg BsConst_Temp_Threshold_Hysteresis_Derating_SafeCopy1: implementation-data-type=DataTypes/UInt8, type=DataTypes/UInt8, direction=IN
      Set_BsConst_Temp_Threshold_Hysteresis_Derating_SafeCopy2
        arg BsConst_Temp_Threshold_Hysteresis_Derating_SafeCopy2: implementation-data-type=DataTypes/UInt8, type=DataTypes/UInt8, direction=IN
      Set_BsConst_Temperature_Sensor_Conv
        arg BsConst_Temperature_Sensor_Conv: implementation-data-type=T_NV_Temperature_Conversion, type=T_NV_Temperature_Conversion, direction=IN
      Set_BsConst_Temperature_Sensor_Conv_SafeCopy1
        arg BsConst_Temperature_Sensor_Conv_SafeCopy1: implementation-data-type=T_NV_Temperature_Conversion, type=T_NV_Temperature_Conversion, direction=IN
      Set_BsConst_Temperature_Sensor_Conv_SafeCopy2
        arg BsConst_Temperature_Sensor_Conv_SafeCopy2: implementation-data-type=T_NV_Temperature_Conversion, type=T_NV_Temperature_Conversion, direction=IN
      Set_BsConst_TripComputer_Element
        arg BsConst_TripComputer_Element: implementation-data-type=Arr_u8_64, type=Arr_u8_64, direction=IN
      Set_BsConst_Warning_Element
        arg BsConst_Warning_Element: implementation-data-type=Arr_u8_64, type=Arr_u8_64, direction=IN
      Set_BsCys_Certicificate_Element
        arg BsCys_Certicificate_Element: implementation-data-type=Arr_u8_64, type=Arr_u8_64, direction=IN
      Set_BsDiag_Dtc_Element
        arg BsDiag_Dtc_Element: implementation-data-type=Arr_u8_2048, type=Arr_u8_2048, direction=IN
      Set_BsDiag_ErrorRecord_Element
        arg BsDiag_ErrorRecord_Element: implementation-data-type=Arr_u8_1024, type=Arr_u8_1024, direction=IN
      Set_BsReten_Audio_Element
        arg BsReten_Audio_Element: implementation-data-type=Arr_u8_100, type=Arr_u8_100, direction=IN
      Set_BsReten_Communication_Element
        arg BsReten_Communication_Element: implementation-data-type=Arr_u8_100, type=Arr_u8_100, direction=IN
      Set_BsReten_Display_Element
        arg BsReten_Display_Element: implementation-data-type=Arr_u8_100, type=Arr_u8_100, direction=IN
      Set_BsReten_Gauges_Element
        arg BsReten_Gauges_Element: implementation-data-type=Arr_u8_100, type=Arr_u8_100, direction=IN
      Set_BsReten_Illumination_Element
        arg BsReten_Illumination_Element: implementation-data-type=Arr_u8_100, type=Arr_u8_100, direction=IN
      Set_BsReten_Odometer_Element
        arg BsReten_Odometer_Element: implementation-data-type=Arr_u8_100, type=Arr_u8_100, direction=IN
      Set_BsReten_Personalization_Element
        arg BsReten_Personalization_Element: implementation-data-type=Arr_u8_100, type=Arr_u8_100, direction=IN
      Set_BsReten_Power_Element
        arg BsReten_Power_Element: implementation-data-type=Arr_u8_100, type=Arr_u8_100, direction=IN
      Set_BsReten_RealTimeClock_Element
        arg BsReten_RealTimeClock_Element: implementation-data-type=Arr_u8_100, type=Arr_u8_100, direction=IN
      Set_BsReten_Tripcomputer_Element
        arg BsReten_Tripcomputer_Element: implementation-data-type=Arr_u8_100, type=Arr_u8_100, direction=IN
      Set_BsReten_VisDlt_Element
        arg BsReten_VisDlt_Element: implementation-data-type=Arr_u8_256, type=Arr_u8_256, direction=IN
      Set_BsReten_Warning_Element
        arg BsReten_Warning_Element: implementation-data-type=Arr_u8_100, type=Arr_u8_100, direction=IN
      Set_BsRt_CusDlt_Element
        arg BsRt_CusDlt_Element: implementation-data-type=Arr_u8_128, type=Arr_u8_128, direction=IN
      Set_BsRt_FuelGauge_Element
        arg BsRt_FuelGauge_Element: implementation-data-type=Arr_u8_32, type=Arr_u8_32, direction=IN
      Set_BsRt_Illumination_Element
        arg BsRt_Illumination_Element: implementation-data-type=Arr_u8_100, type=Arr_u8_100, direction=IN
      Set_BsRt_Odometer_Element
        arg BsRt_Odometer_Element: implementation-data-type=Arr_u8_128, type=Arr_u8_128, direction=IN
      Set_BsRt_OilGauge_Element
        arg BsRt_OilGauge_Element: implementation-data-type=Arr_u8_8, type=Arr_u8_8, direction=IN
      Set_BsRt_Personalization_Element
        arg BsRt_Personalization_Element: implementation-data-type=Arr_u8_128, type=Arr_u8_128, direction=IN
      Set_BsRt_PowerGauge_Element
        arg BsRt_PowerGauge_Element: implementation-data-type=Arr_u8_32, type=Arr_u8_32, direction=IN
      Set_BsRt_RealTimeClock_Element
        arg BsRt_RealTimeClock_Element: implementation-data-type=Arr_u8_48, type=Arr_u8_48, direction=IN
      Set_BsRt_SpeedoGauge_Element
        arg BsRt_SpeedoGauge_Element: implementation-data-type=Arr_u8_8, type=Arr_u8_8, direction=IN
      Set_BsRt_TachoGauge_Element
        arg BsRt_TachoGauge_Element: implementation-data-type=Arr_u8_16, type=Arr_u8_16, direction=IN
      Set_BsRt_TempGauge_Element
        arg BsRt_TempGauge_Element: implementation-data-type=Arr_u8_32, type=Arr_u8_32, direction=IN
      Set_BsRt_TripComputer_Element
        arg BsRt_TripComputer_Element: implementation-data-type=Arr_u8_64, type=Arr_u8_64, direction=IN
      Set_BsRt_Warning_Element
        arg BsRt_Warning_Element: implementation-data-type=Arr_u8_32, type=Arr_u8_32, direction=IN
      Set_BsShare_AssemblyManufacturingDate
        arg BsShare_AssemblyManufacturingDate: implementation-data-type=Arr_u8_3, type=Arr_u8_3, direction=IN
      Set_BsShare_AssemblyPlantNumber
        arg BsShare_AssemblyPlantNumber: implementation-data-type=Arr_u8_3, type=Arr_u8_3, direction=IN
      Set_BsShare_EcuPartNumber_Element
        arg BsShare_EcuPartNumber_Element: implementation-data-type=Arr_u8_61, type=Arr_u8_61, direction=IN
      Set_BsShare_HWModification
        arg BsShare_HWModification: implementation-data-type=UInt16, type=UInt16, direction=IN
      Set_BsShare_PCBSerialNumber
        arg BsShare_PCBSerialNumber: implementation-data-type=Arr_u8_9, type=Arr_u8_9, direction=IN
      Set_BsShare_ProductSerialNumber
        arg BsShare_ProductSerialNumber: implementation-data-type=Arr_u8_10, type=Arr_u8_10, direction=IN
      Set_BsShare_SMTManufacturingDate
        arg BsShare_SMTManufacturingDate: implementation-data-type=Arr_u8_3, type=Arr_u8_3, direction=IN
      Set_BsShare_SMTPlantNumber
        arg BsShare_SMTPlantNumber: implementation-data-type=Arr_u8_3, type=Arr_u8_3, direction=IN
      Set_BsShare_SwUpdFotaFinPrint_Element
        arg BsShare_SwUpdFotaFinPrint_Element: implementation-data-type=Arr_u8_32, type=Arr_u8_32, direction=IN
      Set_BsShare_SwUpdFotaMode_Element
        arg BsShare_SwUpdFotaMode_Element: implementation-data-type=Arr_u8_16, type=Arr_u8_16, direction=IN
      Set_BsShare_SwUpdFotaStatus_Element
        arg BsShare_SwUpdFotaStatus_Element: implementation-data-type=Arr_u8_48, type=Arr_u8_48, direction=IN
      Set_BsShare_SwUpdFotadecrypt_Element
        arg BsShare_SwUpdFotadecrypt_Element: implementation-data-type=Arr_u8_64, type=Arr_u8_64, direction=IN
      Set_BsShare_SwUpdReflash_Element
        arg BsShare_SwUpdReflash_Element: implementation-data-type=Arr_u8_8, type=Arr_u8_8, direction=IN
      Set_BsShare_VehicleConfig_Element
        arg BsShare_VehicleConfig_Element: implementation-data-type=Arr_u8_256, type=Arr_u8_256, direction=IN
      Set_BsShare_VisMeet_EOLEntry_Element
        arg BsShare_VisMeet_EOLEntry_Element: implementation-data-type=UInt16, type=UInt16, direction=IN
      Set_BsShare_VisMeet_Element
        arg BsShare_VisMeet_Element: implementation-data-type=Arr_u8_46, type=Arr_u8_46, direction=IN
      Set_BsShare_VisteonPCBPartNumber
        arg BsShare_VisteonPCBPartNumber: implementation-data-type=Arr_u8_17, type=Arr_u8_17, direction=IN
      Set_BsShare_VisteonPartNumber
        arg BsShare_VisteonPartNumber: implementation-data-type=Arr_u8_17, type=Arr_u8_17, direction=IN
      Set_RefCys_Certicificate1_Element
        arg RefCys_Certicificate1_Element: implementation-data-type=Arr_u8_64, type=Arr_u8_64, direction=IN
      Set_RefCys_Certicificate_Element
        arg RefCys_Certicificate_Element: implementation-data-type=Arr_u8_64, type=Arr_u8_64, direction=IN
  sender receiver interface TI_Ctrl_Ready_to_sleep: invalidation-policy{data-element=Ready_to_Sleep, handle-invalid=DONT-INVALIDATE}
    data Ready_to_Sleep: implementation-data-type=Boolean, type=Boolean
  client server interface TI_PwmCurrent_Duty
    operation GetPwmCurrentDuty
      arg ChannelID: implementation-data-type=DataTypes/UInt8, type=DataTypes/UInt8, direction=IN
      arg Channel_Duty: implementation-data-type=UInt16, type=UInt16, direction=OUT
  impl type IOCtrl_Type: category=VALUE, base-type=uint8, compu {1=eSPEEDO, 2=eTACHO, 4=eHVSYS_INDICATOR, 8=eSPEAKER, 16=eTELLTALE, 32=eBUTTONEVENT, 64=eMIDDISPALY}, range raw 1..64
  sender receiver interface TI_SR_Dcm_AppStopNotification: invalidation-policy{data-element=AppId, handle-invalid=DONT-INVALIDATE}
    data AppId: implementation-data-type=IOCtrl_Type, type=IOCtrl_Type
  sender receiver interface TI_SR_Diag2F_Rheo: invalidation-policy{data-element=Diag_RheoStat, handle-invalid=DONT-INVALIDATE}
    data Diag_RheoStat: implementation-data-type=DataTypes/UInt8, type=DataTypes/UInt8
  sender receiver interface TI_EcoRunPresenceFlag: invalidation-policy{data-element=EcoRunPresenceFlag, handle-invalid=DONT-INVALIDATE}
    data EcoRunPresenceFlag: implementation-data-type=DataTypes/UInt8, type=DataTypes/UInt8
  client server interface TI_MVC_Get_Variant_State_Dummy
    operation Get_Variant_Config_State
      arg VariantID: implementation-data-type=DataTypes/UInt8, type=DataTypes/UInt8, direction=IN
      arg VariantActiveSt: implementation-data-type=DataTypes/UInt8, type=DataTypes/UInt8, direction=OUT
  sender receiver interface TI_SR_IlumDayNightRequired: invalidation-policy{data-element=IlumDayNightRequired, handle-invalid=DONT-INVALIDATE}
    data IlumDayNightRequired: implementation-data-type=DataTypes/UInt8, type=DataTypes/UInt8
  sender receiver interface TI_SR_Day_Night_Status: invalidation-policy{data-element=Day_Night_Status, handle-invalid=DONT-INVALIDATE}
    data Day_Night_Status: implementation-data-type=DataTypes/UInt8, type=DataTypes/UInt8
  client server interface TI_Pwm_rate_status
    operation PWM_Rate_Status
      arg ChannelID: implementation-data-type=DataTypes/UInt8, type=DataTypes/UInt8, direction=IN
      arg Status: implementation-data-type=UInt16, type=UInt16, direction=OUT
  sender receiver interface TI_MVC_PowerTrain_State_Dummy: invalidation-policy{data-element=PowerTrain_Flag, handle-invalid=DONT-INVALIDATE}
    data PowerTrain_Flag: implementation-data-type=DataTypes/UInt8, type=DataTypes/UInt8
  client server interface TI_PwmWithTime
    operation GetPwmWithTime
      arg ChannelID: implementation-data-type=IoHwAb_PwmSignalIdType, type=IoHwAb_PwmSignalIdType, direction=IN
      arg TargetDuty: implementation-data-type=UInt16, type=UInt16, direction=IN
      arg TargetTime: implementation-data-type=UInt16, type=UInt16, direction=IN
  client server interface TI_PwmWithTimeExp
    operation GetPwmWithTimeExp
      arg ChannelID: implementation-data-type=IoHwAb_PwmSignalIdType, type=IoHwAb_PwmSignalIdType, direction=IN
      arg TargetDuty: implementation-data-type=UInt16, type=UInt16, direction=IN
      arg TargetTime: implementation-data-type=UInt16, type=UInt16, direction=IN
  sender receiver interface TI_StopPwmUpdate: invalidation-policy{data-element=channel_id, handle-invalid=DONT-INVALIDATE}
    data channel_id: implementation-data-type=DataTypes/UInt8, type=DataTypes/UInt8
  client server interface TI_PwmDirect
    operation GetPwmDirect
      arg ChannelID: implementation-data-type=IoHwAb_PwmSignalIdType, type=IoHwAb_PwmSignalIdType, direction=IN
      arg TargetDuty: implementation-data-type=UInt16, type=UInt16, direction=IN
  impl type UserIdType: category=VALUE, base-type=uint8, compu {1=USER1, 2=USER2, 3=USER3, 4=GUEST}, range raw 1..4
  impl type CustResetType: category=VALUE, base-type=uint8, compu {0=NO_REQUEST, 1=USER1, 2=USER2, 3=USER3, 4=GUEST}, range raw 0..4
  impl type SettingResetResult_Type: category=VALUE, base-type=uint8, compu {0=INPROGRESS, 1=SUCCESS, 2=FAIL}, range raw 0..2
  sender receiver interface TI_SR_UserID_Data
    data CurrentUserID: implementation-data-type=UserIdType, type=UserIdType
    data CustomizeReset: implementation-data-type=CustResetType, type=CustResetType
    data SettingResetResult: implementation-data-type=SettingResetResult_Type, type=SettingResetResult_Type
    invalidation-policys:
      data-element=CurrentUserID, handle-invalid=DONT-INVALIDATE
      data-element=CustomizeReset, handle-invalid=DONT-INVALIDATE
      data-element=SettingResetResult, handle-invalid=DONT-INVALIDATE
  impl type SIlluminationData: category=STRUCTURE
    4 x element, all with category=TYPE_REFERENCE, implementation-data-type=DataTypes/UInt8:
      data
      dayStep
      nightStep
      daynightStatus
  7 x sender receiver interface:
    IlluminationData: invalidation-policy{data-element=IlluminationDataData, handle-invalid=DONT-INVALIDATE}
      data IlluminationDataData: implementation-data-type=SIlluminationData, type=SIlluminationData
    TI_Ctrl_LL_Duty: invalidation-policy{data-element=ILL_Duty, handle-invalid=DONT-INVALIDATE}
      data ILL_Duty: implementation-data-type=DataTypes/UInt8, type=DataTypes/UInt8
    TI_Ctrl_RGB_Dimming: invalidation-policy{data-element=RGB_Dimming, handle-invalid=DONT-INVALIDATE}
      data RGB_Dimming: implementation-data-type=DataTypes/UInt8, type=DataTypes/UInt8
    TI_Ctrl_Starter_Status: invalidation-policy{data-element=Starter_Status, handle-invalid=DONT-INVALIDATE}
      data Starter_Status: implementation-data-type=Boolean, type=Boolean
    TI_Pwm_LCD_BL_Dimming: invalidation-policy{data-element=BL_Dimming, handle-invalid=DONT-INVALIDATE}
      data BL_Dimming: implementation-data-type=DataTypes/UInt8, type=DataTypes/UInt8
    TI_Ctrl_Day_Night_mode: invalidation-policy{data-element=Day_Night_mode_Ctrl, handle-invalid=DONT-INVALIDATE}
      data Day_Night_mode_Ctrl: implementation-data-type=DataTypes/UInt8, type=DataTypes/UInt8
    TI_CVS_EcoRunSystem_State_dummy: invalidation-policy{data-element=EcoRunSystem_Flag, handle-invalid=DONT-INVALIDATE}
      data EcoRunSystem_Flag: implementation-data-type=DataTypes/UInt8, type=DataTypes/UInt8
  client server interface if_CS_MemAbsGetDefault
    95 x operation, all with possible-error=if_CS_MemAbsGetDefault/E_NOT_OK:
      Get_Default_BsConst_Audio_Element
        arg Ptr: implementation-data-type=Arr_u8_128, type=Arr_u8_128, direction=OUT
      Get_Default_BsConst_BsConst_Illumination_ReservedByte
        arg Ptr: implementation-data-type=Arr_u8_28, type=Arr_u8_28, direction=OUT
      Get_Default_BsConst_BsConst_Illumination_ReservedByte_SafeCopy1
        arg Ptr: implementation-data-type=Arr_u8_28, type=Arr_u8_28, direction=OUT
      Get_Default_BsConst_BsConst_Illumination_ReservedByte_SafeCopy2
        arg Ptr: implementation-data-type=Arr_u8_28, type=Arr_u8_28, direction=OUT
      Get_Default_BsConst_Communication_Element
        arg Ptr: implementation-data-type=Arr_u8_64, type=Arr_u8_64, direction=OUT
      Get_Default_BsConst_Compensation_Line_Shift_b
        arg Ptr: implementation-data-type=UInt32, type=UInt32, direction=OUT
      Get_Default_BsConst_Compensation_Line_Shift_b_SafeCopy1
        arg Ptr: implementation-data-type=UInt32, type=UInt32, direction=OUT
      Get_Default_BsConst_Compensation_Line_Shift_b_SafeCopy2
        arg Ptr: implementation-data-type=UInt32, type=UInt32, direction=OUT
      Get_Default_BsConst_Compensation_Line_Slope_m
        arg Ptr: implementation-data-type=UInt32, type=UInt32, direction=OUT
      Get_Default_BsConst_Compensation_Line_Slope_m_SafeCopy1
        arg Ptr: implementation-data-type=UInt32, type=UInt32, direction=OUT
      Get_Default_BsConst_Compensation_Line_Slope_m_SafeCopy2
        arg Ptr: implementation-data-type=UInt32, type=UInt32, direction=OUT
      Get_Default_BsConst_Derating_Backlight_Disable
        arg Ptr: implementation-data-type=DataTypes/UInt8, type=DataTypes/UInt8, direction=OUT
      Get_Default_BsConst_Derating_Backlight_Disable_SafeCopy1
        arg Ptr: implementation-data-type=DataTypes/UInt8, type=DataTypes/UInt8, direction=OUT
      Get_Default_BsConst_Derating_Backlight_Disable_SafeCopy2
        arg Ptr: implementation-data-type=DataTypes/UInt8, type=DataTypes/UInt8, direction=OUT
      Get_Default_BsConst_Display_Illum_Max_Level
        arg Ptr: implementation-data-type=UInt16, type=UInt16, direction=OUT
      Get_Default_BsConst_Display_Illum_Max_Level_SafeCopy1
        arg Ptr: implementation-data-type=UInt16, type=UInt16, direction=OUT
      Get_Default_BsConst_Display_Illum_Max_Level_SafeCopy2
        arg Ptr: implementation-data-type=UInt16, type=UInt16, direction=OUT
      Get_Default_BsConst_EngOffTimer_Element
        arg Ptr: implementation-data-type=Arr_u8_32, type=Arr_u8_32, direction=OUT
      Get_Default_BsConst_FuelGauge_Element
        arg Ptr: implementation-data-type=Arr_u8_128, type=Arr_u8_128, direction=OUT
      Get_Default_BsConst_Lookup_Curve_HotSpot_Coef_X
        arg Ptr: implementation-data-type=Arr_u16_7, type=Arr_u16_7, direction=OUT
      Get_Default_BsConst_Lookup_Curve_HotSpot_Coef_X_SafeCopy1
        arg Ptr: implementation-data-type=Arr_u16_7, type=Arr_u16_7, direction=OUT
      Get_Default_BsConst_Lookup_Curve_HotSpot_Coef_X_SafeCopy2
        arg Ptr: implementation-data-type=Arr_u16_7, type=Arr_u16_7, direction=OUT
      Get_Default_BsConst_Lookup_Curve_HotSpot_Coef_Y
        arg Ptr: implementation-data-type=Arr_u16_7, type=Arr_u16_7, direction=OUT
      Get_Default_BsConst_Lookup_Curve_HotSpot_Coef_Y_SafeCopy1
        arg Ptr: implementation-data-type=Arr_u16_7, type=Arr_u16_7, direction=OUT
      Get_Default_BsConst_Lookup_Curve_HotSpot_Coef_Y_SafeCopy2
        arg Ptr: implementation-data-type=Arr_u16_7, type=Arr_u16_7, direction=OUT
      Get_Default_BsConst_OilGauge_Element
        arg Ptr: implementation-data-type=Arr_u8_64, type=Arr_u8_64, direction=OUT
      Get_Default_BsConst_PCB_Temperature_Sensor_Conv
        arg Ptr: implementation-data-type=T_NV_Temperature_Conversion, type=T_NV_Temperature_Conversion, direction=OUT
      Get_Default_BsConst_PCB_Temperature_Sensor_Conv_SafeCopy1
        arg Ptr: implementation-data-type=T_NV_Temperature_Conversion, type=T_NV_Temperature_Conversion, direction=OUT
      Get_Default_BsConst_PCB_Temperature_Sensor_Conv_SafeCopy2
        arg Ptr: implementation-data-type=T_NV_Temperature_Conversion, type=T_NV_Temperature_Conversion, direction=OUT
      Get_Default_BsConst_PWM_boost_bypass_duty
        arg Ptr: implementation-data-type=DataTypes/UInt8, type=DataTypes/UInt8, direction=OUT
      Get_Default_BsConst_PWM_boost_bypass_duty_SafeCopy1
        arg Ptr: implementation-data-type=DataTypes/UInt8, type=DataTypes/UInt8, direction=OUT
      Get_Default_BsConst_PWM_boost_bypass_duty_SafeCopy2
        arg Ptr: implementation-data-type=DataTypes/UInt8, type=DataTypes/UInt8, direction=OUT
      Get_Default_BsConst_PowerGauge_Element
        arg Ptr: implementation-data-type=Arr_u8_64, type=Arr_u8_64, direction=OUT
      Get_Default_BsConst_Power_Element
        arg Ptr: implementation-data-type=Arr_u8_32, type=Arr_u8_32, direction=OUT
      Get_Default_BsConst_RealTimeClock_Element
        arg Ptr: implementation-data-type=Arr_u8_48, type=Arr_u8_48, direction=OUT
      Get_Default_BsConst_ServiceReminder_Element
        arg Ptr: implementation-data-type=Arr_u8_48, type=Arr_u8_48, direction=OUT
      Get_Default_BsConst_SpeedoGauge_Element
        arg Ptr: implementation-data-type=Arr_u8_64, type=Arr_u8_64, direction=OUT
      Get_Default_BsConst_TachoGauge_Element
        arg Ptr: implementation-data-type=Arr_u8_64, type=Arr_u8_64, direction=OUT
      Get_Default_BsConst_TempGauge_Element
        arg Ptr: implementation-data-type=Arr_u8_64, type=Arr_u8_64, direction=OUT
      Get_Default_BsConst_Temp_Threshold_Hysteresis_Derating
        arg Ptr: implementation-data-type=DataTypes/UInt8, type=DataTypes/UInt8, direction=OUT
      Get_Default_BsConst_Temp_Threshold_Hysteresis_Derating_SafeCopy1
        arg Ptr: implementation-data-type=DataTypes/UInt8, type=DataTypes/UInt8, direction=OUT
      Get_Default_BsConst_Temp_Threshold_Hysteresis_Derating_SafeCopy2
        arg Ptr: implementation-data-type=DataTypes/UInt8, type=DataTypes/UInt8, direction=OUT
      Get_Default_BsConst_Temperature_Sensor_Conv
        arg Ptr: implementation-data-type=T_NV_Temperature_Conversion, type=T_NV_Temperature_Conversion, direction=OUT
      Get_Default_BsConst_Temperature_Sensor_Conv_SafeCopy1
        arg Ptr: implementation-data-type=T_NV_Temperature_Conversion, type=T_NV_Temperature_Conversion, direction=OUT
      Get_Default_BsConst_Temperature_Sensor_Conv_SafeCopy2
        arg Ptr: implementation-data-type=T_NV_Temperature_Conversion, type=T_NV_Temperature_Conversion, direction=OUT
      Get_Default_BsConst_TripComputer_Element
        arg Ptr: implementation-data-type=Arr_u8_64, type=Arr_u8_64, direction=OUT
      Get_Default_BsConst_Warning_Element
        arg Ptr: implementation-data-type=Arr_u8_64, type=Arr_u8_64, direction=OUT
      Get_Default_BsCys_Certicificate_Element
        arg Ptr: implementation-data-type=Arr_u8_64, type=Arr_u8_64, direction=OUT
      Get_Default_BsDiag_Dtc_Element
        arg Ptr: implementation-data-type=Arr_u8_2048, type=Arr_u8_2048, direction=OUT
      Get_Default_BsDiag_ErrorRecord_Element
        arg Ptr: implementation-data-type=Arr_u8_1024, type=Arr_u8_1024, direction=OUT
      Get_Default_BsReten_Audio_Element
        arg Ptr: implementation-data-type=Arr_u8_100, type=Arr_u8_100, direction=OUT
      Get_Default_BsReten_Communication_Element
        arg Ptr: implementation-data-type=Arr_u8_100, type=Arr_u8_100, direction=OUT
      Get_Default_BsReten_Display_Element
        arg Ptr: implementation-data-type=Arr_u8_100, type=Arr_u8_100, direction=OUT
      Get_Default_BsReten_Gauges_Element
        arg Ptr: implementation-data-type=Arr_u8_100, type=Arr_u8_100, direction=OUT
      Get_Default_BsReten_Illumination_Element
        arg Ptr: implementation-data-type=Arr_u8_100, type=Arr_u8_100, direction=OUT
      Get_Default_BsReten_Odometer_Element
        arg Ptr: implementation-data-type=Arr_u8_100, type=Arr_u8_100, direction=OUT
      Get_Default_BsReten_Personalization_Element
        arg Ptr: implementation-data-type=Arr_u8_100, type=Arr_u8_100, direction=OUT
      Get_Default_BsReten_Power_Element
        arg Ptr: implementation-data-type=Arr_u8_100, type=Arr_u8_100, direction=OUT
      Get_Default_BsReten_RealTimeClock_Element
        arg Ptr: implementation-data-type=Arr_u8_100, type=Arr_u8_100, direction=OUT
      Get_Default_BsReten_Tripcomputer_Element
        arg Ptr: implementation-data-type=Arr_u8_100, type=Arr_u8_100, direction=OUT
      Get_Default_BsReten_VisDlt_Element
        arg Ptr: implementation-data-type=Arr_u8_256, type=Arr_u8_256, direction=OUT
      Get_Default_BsReten_Warning_Element
        arg Ptr: implementation-data-type=Arr_u8_100, type=Arr_u8_100, direction=OUT
      Get_Default_BsRt_CusDlt_Element
        arg Ptr: implementation-data-type=Arr_u8_128, type=Arr_u8_128, direction=OUT
      Get_Default_BsRt_FuelGauge_Element
        arg Ptr: implementation-data-type=Arr_u8_32, type=Arr_u8_32, direction=OUT
      Get_Default_BsRt_Illumination_Element
        arg Ptr: implementation-data-type=Arr_u8_100, type=Arr_u8_100, direction=OUT
      Get_Default_BsRt_Odometer_Element
        arg Ptr: implementation-data-type=Arr_u8_128, type=Arr_u8_128, direction=OUT
      Get_Default_BsRt_OilGauge_Element
        arg Ptr: implementation-data-type=Arr_u8_8, type=Arr_u8_8, direction=OUT
      Get_Default_BsRt_Personalization_Element
        arg Ptr: implementation-data-type=Arr_u8_128, type=Arr_u8_128, direction=OUT
      Get_Default_BsRt_PowerGauge_Element
        arg Ptr: implementation-data-type=Arr_u8_32, type=Arr_u8_32, direction=OUT
      Get_Default_BsRt_RealTimeClock_Element
        arg Ptr: implementation-data-type=Arr_u8_48, type=Arr_u8_48, direction=OUT
      Get_Default_BsRt_SpeedoGauge_Element
        arg Ptr: implementation-data-type=Arr_u8_8, type=Arr_u8_8, direction=OUT
      Get_Default_BsRt_TachoGauge_Element
        arg Ptr: implementation-data-type=Arr_u8_16, type=Arr_u8_16, direction=OUT
      Get_Default_BsRt_TempGauge_Element
        arg Ptr: implementation-data-type=Arr_u8_32, type=Arr_u8_32, direction=OUT
      Get_Default_BsRt_TripComputer_Element
        arg Ptr: implementation-data-type=Arr_u8_64, type=Arr_u8_64, direction=OUT
      Get_Default_BsRt_Warning_Element
        arg Ptr: implementation-data-type=Arr_u8_32, type=Arr_u8_32, direction=OUT
      Get_Default_BsShare_AssemblyManufacturingDate
        arg Ptr: implementation-data-type=Arr_u8_3, type=Arr_u8_3, direction=OUT
      Get_Default_BsShare_AssemblyPlantNumber
        arg Ptr: implementation-data-type=Arr_u8_3, type=Arr_u8_3, direction=OUT
      Get_Default_BsShare_EcuPartNumber_Element
        arg Ptr: implementation-data-type=Arr_u8_61, type=Arr_u8_61, direction=OUT
      Get_Default_BsShare_HWModification
        arg Ptr: implementation-data-type=UInt16, type=UInt16, direction=OUT
      Get_Default_BsShare_PCBSerialNumber
        arg Ptr: implementation-data-type=Arr_u8_9, type=Arr_u8_9, direction=OUT
      Get_Default_BsShare_ProductSerialNumber
        arg Ptr: implementation-data-type=Arr_u8_10, type=Arr_u8_10, direction=OUT
      Get_Default_BsShare_SMTManufacturingDate
        arg Ptr: implementation-data-type=Arr_u8_3, type=Arr_u8_3, direction=OUT
      Get_Default_BsShare_SMTPlantNumber
        arg Ptr: implementation-data-type=Arr_u8_3, type=Arr_u8_3, direction=OUT
      Get_Default_BsShare_SwUpdFotaFinPrint_Element
        arg Ptr: implementation-data-type=Arr_u8_32, type=Arr_u8_32, direction=OUT
      Get_Default_BsShare_SwUpdFotaMode_Element
        arg Ptr: implementation-data-type=Arr_u8_16, type=Arr_u8_16, direction=OUT
      Get_Default_BsShare_SwUpdFotaStatus_Element
        arg Ptr: implementation-data-type=Arr_u8_48, type=Arr_u8_48, direction=OUT
      Get_Default_BsShare_SwUpdFotadecrypt_Element
        arg Ptr: implementation-data-type=Arr_u8_64, type=Arr_u8_64, direction=OUT
      Get_Default_BsShare_SwUpdReflash_Element
        arg Ptr: implementation-data-type=Arr_u8_8, type=Arr_u8_8, direction=OUT
      Get_Default_BsShare_VehicleConfig_Element
        arg Ptr: implementation-data-type=Arr_u8_256, type=Arr_u8_256, direction=OUT
      Get_Default_BsShare_VisMeet_EOLEntry_Element
        arg Ptr: implementation-data-type=UInt16, type=UInt16, direction=OUT
      Get_Default_BsShare_VisMeet_Element
        arg Ptr: implementation-data-type=Arr_u8_46, type=Arr_u8_46, direction=OUT
      Get_Default_BsShare_VisteonPCBPartNumber
        arg Ptr: implementation-data-type=Arr_u8_17, type=Arr_u8_17, direction=OUT
      Get_Default_BsShare_VisteonPartNumber
        arg Ptr: implementation-data-type=Arr_u8_17, type=Arr_u8_17, direction=OUT
      Get_Default_RefCys_Certicificate1_Element
        arg Ptr: implementation-data-type=Arr_u8_64, type=Arr_u8_64, direction=OUT
      Get_Default_RefCys_Certicificate_Element
        arg Ptr: implementation-data-type=Arr_u8_64, type=Arr_u8_64, direction=OUT
    error E_NOT_OK: error-code=1
  sender receiver interface if_SR_JobStatus
    95 x data, all with implementation-data-type=DataTypes/UInt8, type=DataTypes/UInt8:
      JobStatus_BsConst_Audio_Element
      JobStatus_BsConst_BsConst_Illumination_ReservedByte
      JobStatus_BsConst_BsConst_Illumination_ReservedByte_SafeCopy1
      JobStatus_BsConst_BsConst_Illumination_ReservedByte_SafeCopy2
      JobStatus_BsConst_Communication_Element
      JobStatus_BsConst_Compensation_Line_Shift_b
      JobStatus_BsConst_Compensation_Line_Shift_b_SafeCopy1
      JobStatus_BsConst_Compensation_Line_Shift_b_SafeCopy2
      JobStatus_BsConst_Compensation_Line_Slope_m
      JobStatus_BsConst_Compensation_Line_Slope_m_SafeCopy1
      JobStatus_BsConst_Compensation_Line_Slope_m_SafeCopy2
      JobStatus_BsConst_Derating_Backlight_Disable
      JobStatus_BsConst_Derating_Backlight_Disable_SafeCopy1
      JobStatus_BsConst_Derating_Backlight_Disable_SafeCopy2
      JobStatus_BsConst_Display_Illum_Max_Level
      JobStatus_BsConst_Display_Illum_Max_Level_SafeCopy1
      JobStatus_BsConst_Display_Illum_Max_Level_SafeCopy2
      JobStatus_BsConst_EngOffTimer_Element
      JobStatus_BsConst_FuelGauge_Element
      JobStatus_BsConst_Lookup_Curve_HotSpot_Coef_X
      JobStatus_BsConst_Lookup_Curve_HotSpot_Coef_X_SafeCopy1
      JobStatus_BsConst_Lookup_Curve_HotSpot_Coef_X_SafeCopy2
      JobStatus_BsConst_Lookup_Curve_HotSpot_Coef_Y
      JobStatus_BsConst_Lookup_Curve_HotSpot_Coef_Y_SafeCopy1
      JobStatus_BsConst_Lookup_Curve_HotSpot_Coef_Y_SafeCopy2
      JobStatus_BsConst_OilGauge_Element
      JobStatus_BsConst_PCB_Temperature_Sensor_Conv
      JobStatus_BsConst_PCB_Temperature_Sensor_Conv_SafeCopy1
      JobStatus_BsConst_PCB_Temperature_Sensor_Conv_SafeCopy2
      JobStatus_BsConst_PWM_boost_bypass_duty
      JobStatus_BsConst_PWM_boost_bypass_duty_SafeCopy1
      JobStatus_BsConst_PWM_boost_bypass_duty_SafeCopy2
      JobStatus_BsConst_PowerGauge_Element
      JobStatus_BsConst_Power_Element
      JobStatus_BsConst_RealTimeClock_Element
      JobStatus_BsConst_ServiceReminder_Element
      JobStatus_BsConst_SpeedoGauge_Element
      JobStatus_BsConst_TachoGauge_Element
      JobStatus_BsConst_TempGauge_Element
      JobStatus_BsConst_Temp_Threshold_Hysteresis_Derating
      JobStatus_BsConst_Temp_Threshold_Hysteresis_Derating_SafeCopy1
      JobStatus_BsConst_Temp_Threshold_Hysteresis_Derating_SafeCopy2
      JobStatus_BsConst_Temperature_Sensor_Conv
      JobStatus_BsConst_Temperature_Sensor_Conv_SafeCopy1
      JobStatus_BsConst_Temperature_Sensor_Conv_SafeCopy2
      JobStatus_BsConst_TripComputer_Element
      JobStatus_BsConst_Warning_Element
      JobStatus_BsCys_Certicificate_Element
      JobStatus_BsDiag_Dtc_Element
      JobStatus_BsDiag_ErrorRecord_Element
      JobStatus_BsReten_Audio_Element
      JobStatus_BsReten_Communication_Element
      JobStatus_BsReten_Display_Element
      JobStatus_BsReten_Gauges_Element
      JobStatus_BsReten_Illumination_Element
      JobStatus_BsReten_Odometer_Element
      JobStatus_BsReten_Personalization_Element
      JobStatus_BsReten_Power_Element
      JobStatus_BsReten_RealTimeClock_Element
      JobStatus_BsReten_Tripcomputer_Element
      JobStatus_BsReten_VisDlt_Element
      JobStatus_BsReten_Warning_Element
      JobStatus_BsRt_CusDlt_Element
      JobStatus_BsRt_FuelGauge_Element
      JobStatus_BsRt_Illumination_Element
      JobStatus_BsRt_Odometer_Element
      JobStatus_BsRt_OilGauge_Element
      JobStatus_BsRt_Personalization_Element
      JobStatus_BsRt_PowerGauge_Element
      JobStatus_BsRt_RealTimeClock_Element
      JobStatus_BsRt_SpeedoGauge_Element
      JobStatus_BsRt_TachoGauge_Element
      JobStatus_BsRt_TempGauge_Element
      JobStatus_BsRt_TripComputer_Element
      JobStatus_BsRt_Warning_Element
      JobStatus_BsShare_AssemblyManufacturingDate
      JobStatus_BsShare_AssemblyPlantNumber
      JobStatus_BsShare_EcuPartNumber_Element
      JobStatus_BsShare_HWModification
      JobStatus_BsShare_PCBSerialNumber
      JobStatus_BsShare_ProductSerialNumber
      JobStatus_BsShare_SMTManufacturingDate
      JobStatus_BsShare_SMTPlantNumber
      JobStatus_BsShare_SwUpdFotaFinPrint_Element
      JobStatus_BsShare_SwUpdFotaMode_Element
      JobStatus_BsShare_SwUpdFotaStatus_Element
      JobStatus_BsShare_SwUpdFotadecrypt_Element
      JobStatus_BsShare_SwUpdReflash_Element
      JobStatus_BsShare_VehicleConfig_Element
      JobStatus_BsShare_VisMeet_EOLEntry_Element
      JobStatus_BsShare_VisMeet_Element
      JobStatus_BsShare_VisteonPCBPartNumber
      JobStatus_BsShare_VisteonPartNumber
      JobStatus_RefCys_Certicificate1_Element
      JobStatus_RefCys_Certicificate_Element
    invalidation-policys:
      data-element=JobStatus_BsConst_Audio_Element, handle-invalid=DONT-INVALIDATE
      data-element=JobStatus_BsConst_BsConst_Illumination_ReservedByte, handle-invalid=DONT-INVALIDATE
      data-element=JobStatus_BsConst_BsConst_Illumination_ReservedByte_SafeCopy1, handle-invalid=DONT-INVALIDATE
      data-element=JobStatus_BsConst_BsConst_Illumination_ReservedByte_SafeCopy2, handle-invalid=DONT-INVALIDATE
      data-element=JobStatus_BsConst_Communication_Element, handle-invalid=DONT-INVALIDATE
      data-element=JobStatus_BsConst_Compensation_Line_Shift_b, handle-invalid=DONT-INVALIDATE
      data-element=JobStatus_BsConst_Compensation_Line_Shift_b_SafeCopy1, handle-invalid=DONT-INVALIDATE
      data-element=JobStatus_BsConst_Compensation_Line_Shift_b_SafeCopy2, handle-invalid=DONT-INVALIDATE
      data-element=JobStatus_BsConst_Compensation_Line_Slope_m, handle-invalid=DONT-INVALIDATE
      data-element=JobStatus_BsConst_Compensation_Line_Slope_m_SafeCopy1, handle-invalid=DONT-INVALIDATE
      data-element=JobStatus_BsConst_Compensation_Line_Slope_m_SafeCopy2, handle-invalid=DONT-INVALIDATE
      data-element=JobStatus_BsConst_Derating_Backlight_Disable, handle-invalid=DONT-INVALIDATE
      data-element=JobStatus_BsConst_Derating_Backlight_Disable_SafeCopy1, handle-invalid=DONT-INVALIDATE
      data-element=JobStatus_BsConst_Derating_Backlight_Disable_SafeCopy2, handle-invalid=DONT-INVALIDATE
      data-element=JobStatus_BsConst_Display_Illum_Max_Level, handle-invalid=DONT-INVALIDATE
      data-element=JobStatus_BsConst_Display_Illum_Max_Level_SafeCopy1, handle-invalid=DONT-INVALIDATE
      data-element=JobStatus_BsConst_Display_Illum_Max_Level_SafeCopy2, handle-invalid=DONT-INVALIDATE
      data-element=JobStatus_BsConst_EngOffTimer_Element, handle-invalid=DONT-INVALIDATE
      data-element=JobStatus_BsConst_FuelGauge_Element, handle-invalid=DONT-INVALIDATE
      data-element=JobStatus_BsConst_Lookup_Curve_HotSpot_Coef_X, handle-invalid=DONT-INVALIDATE
      data-element=JobStatus_BsConst_Lookup_Curve_HotSpot_Coef_X_SafeCopy1, handle-invalid=DONT-INVALIDATE
      data-element=JobStatus_BsConst_Lookup_Curve_HotSpot_Coef_X_SafeCopy2, handle-invalid=DONT-INVALIDATE
      data-element=JobStatus_BsConst_Lookup_Curve_HotSpot_Coef_Y, handle-invalid=DONT-INVALIDATE
      data-element=JobStatus_BsConst_Lookup_Curve_HotSpot_Coef_Y_SafeCopy1, handle-invalid=DONT-INVALIDATE
      data-element=JobStatus_BsConst_Lookup_Curve_HotSpot_Coef_Y_SafeCopy2, handle-invalid=DONT-INVALIDATE
      data-element=JobStatus_BsConst_OilGauge_Element, handle-invalid=DONT-INVALIDATE
      data-element=JobStatus_BsConst_PCB_Temperature_Sensor_Conv, handle-invalid=DONT-INVALIDATE
      data-element=JobStatus_BsConst_PCB_Temperature_Sensor_Conv_SafeCopy1, handle-invalid=DONT-INVALIDATE
      data-element=JobStatus_BsConst_PCB_Temperature_Sensor_Conv_SafeCopy2, handle-invalid=DONT-INVALIDATE
      data-element=JobStatus_BsConst_PWM_boost_bypass_duty, handle-invalid=DONT-INVALIDATE
      data-element=JobStatus_BsConst_PWM_boost_bypass_duty_SafeCopy1, handle-invalid=DONT-INVALIDATE
      data-element=JobStatus_BsConst_PWM_boost_bypass_duty_SafeCopy2, handle-invalid=DONT-INVALIDATE
      data-element=JobStatus_BsConst_PowerGauge_Element, handle-invalid=DONT-INVALIDATE
      data-element=JobStatus_BsConst_Power_Element, handle-invalid=DONT-INVALIDATE
      data-element=JobStatus_BsConst_RealTimeClock_Element, handle-invalid=DONT-INVALIDATE
      data-element=JobStatus_BsConst_ServiceReminder_Element, handle-invalid=DONT-INVALIDATE
      data-element=JobStatus_BsConst_SpeedoGauge_Element, handle-invalid=DONT-INVALIDATE
      data-element=JobStatus_BsConst_TachoGauge_Element, handle-invalid=DONT-INVALIDATE
      data-element=JobStatus_BsConst_TempGauge_Element, handle-invalid=DONT-INVALIDATE
      data-element=JobStatus_BsConst_Temp_Threshold_Hysteresis_Derating, handle-invalid=DONT-INVALIDATE
      data-element=JobStatus_BsConst_Temp_Threshold_Hysteresis_Derating_SafeCopy1, handle-invalid=DONT-INVALIDATE
      data-element=JobStatus_BsConst_Temp_Threshold_Hysteresis_Derating_SafeCopy2, handle-invalid=DONT-INVALIDATE
      data-element=JobStatus_BsConst_Temperature_Sensor_Conv, handle-invalid=DONT-INVALIDATE
      data-element=JobStatus_BsConst_Temperature_Sensor_Conv_SafeCopy1, handle-invalid=DONT-INVALIDATE
      data-element=JobStatus_BsConst_Temperature_Sensor_Conv_SafeCopy2, handle-invalid=DONT-INVALIDATE
      data-element=JobStatus_BsConst_TripComputer_Element, handle-invalid=DONT-INVALIDATE
      data-element=JobStatus_BsConst_Warning_Element, handle-invalid=DONT-INVALIDATE
      data-element=JobStatus_BsCys_Certicificate_Element, handle-invalid=DONT-INVALIDATE
      data-element=JobStatus_BsDiag_Dtc_Element, handle-invalid=DONT-INVALIDATE
      data-element=JobStatus_BsDiag_ErrorRecord_Element, handle-invalid=DONT-INVALIDATE
      data-element=JobStatus_BsReten_Audio_Element, handle-invalid=DONT-INVALIDATE
      data-element=JobStatus_BsReten_Communication_Element, handle-invalid=DONT-INVALIDATE
      data-element=JobStatus_BsReten_Display_Element, handle-invalid=DONT-INVALIDATE
      data-element=JobStatus_BsReten_Gauges_Element, handle-invalid=DONT-INVALIDATE
      data-element=JobStatus_BsReten_Illumination_Element, handle-invalid=DONT-INVALIDATE
      data-element=JobStatus_BsReten_Odometer_Element, handle-invalid=DONT-INVALIDATE
      data-element=JobStatus_BsReten_Personalization_Element, handle-invalid=DONT-INVALIDATE
      data-element=JobStatus_BsReten_Power_Element, handle-invalid=DONT-INVALIDATE
      data-element=JobStatus_BsReten_RealTimeClock_Element, handle-invalid=DONT-INVALIDATE
      data-element=JobStatus_BsReten_Tripcomputer_Element, handle-invalid=DONT-INVALIDATE
      data-element=JobStatus_BsReten_VisDlt_Element, handle-invalid=DONT-INVALIDATE
      data-element=JobStatus_BsReten_Warning_Element, handle-invalid=DONT-INVALIDATE
      data-element=JobStatus_BsRt_CusDlt_Element, handle-invalid=DONT-INVALIDATE
      data-element=JobStatus_BsRt_FuelGauge_Element, handle-invalid=DONT-INVALIDATE
      data-element=JobStatus_BsRt_Illumination_Element, handle-invalid=DONT-INVALIDATE
      data-element=JobStatus_BsRt_Odometer_Element, handle-invalid=DONT-INVALIDATE
      data-element=JobStatus_BsRt_OilGauge_Element, handle-invalid=DONT-INVALIDATE
      data-element=JobStatus_BsRt_Personalization_Element, handle-invalid=DONT-INVALIDATE
      data-element=JobStatus_BsRt_PowerGauge_Element, handle-invalid=DONT-INVALIDATE
      data-element=JobStatus_BsRt_RealTimeClock_Element, handle-invalid=DONT-INVALIDATE
      data-element=JobStatus_BsRt_SpeedoGauge_Element, handle-invalid=DONT-INVALIDATE
      data-element=JobStatus_BsRt_TachoGauge_Element, handle-invalid=DONT-INVALIDATE
      data-element=JobStatus_BsRt_TempGauge_Element, handle-invalid=DONT-INVALIDATE
      data-element=JobStatus_BsRt_TripComputer_Element, handle-invalid=DONT-INVALIDATE
      data-element=JobStatus_BsRt_Warning_Element, handle-invalid=DONT-INVALIDATE
      data-element=JobStatus_BsShare_AssemblyManufacturingDate, handle-invalid=DONT-INVALIDATE
      data-element=JobStatus_BsShare_AssemblyPlantNumber, handle-invalid=DONT-INVALIDATE
      data-element=JobStatus_BsShare_EcuPartNumber_Element, handle-invalid=DONT-INVALIDATE
      data-element=JobStatus_BsShare_HWModification, handle-invalid=DONT-INVALIDATE
      data-element=JobStatus_BsShare_PCBSerialNumber, handle-invalid=DONT-INVALIDATE
      data-element=JobStatus_BsShare_ProductSerialNumber, handle-invalid=DONT-INVALIDATE
      data-element=JobStatus_BsShare_SMTManufacturingDate, handle-invalid=DONT-INVALIDATE
      data-element=JobStatus_BsShare_SMTPlantNumber, handle-invalid=DONT-INVALIDATE
      data-element=JobStatus_BsShare_SwUpdFotaFinPrint_Element, handle-invalid=DONT-INVALIDATE
      data-element=JobStatus_BsShare_SwUpdFotaMode_Element, handle-invalid=DONT-INVALIDATE
      data-element=JobStatus_BsShare_SwUpdFotaStatus_Element, handle-invalid=DONT-INVALIDATE
      data-element=JobStatus_BsShare_SwUpdFotadecrypt_Element, handle-invalid=DONT-INVALIDATE
      data-element=JobStatus_BsShare_SwUpdReflash_Element, handle-invalid=DONT-INVALIDATE
      data-element=JobStatus_BsShare_VehicleConfig_Element, handle-invalid=DONT-INVALIDATE
      data-element=JobStatus_BsShare_VisMeet_EOLEntry_Element, handle-invalid=DONT-INVALIDATE
      data-element=JobStatus_BsShare_VisMeet_Element, handle-invalid=DONT-INVALIDATE
      data-element=JobStatus_BsShare_VisteonPCBPartNumber, handle-invalid=DONT-INVALIDATE
      data-element=JobStatus_BsShare_VisteonPartNumber, handle-invalid=DONT-INVALIDATE
      data-element=JobStatus_RefCys_Certicificate1_Element, handle-invalid=DONT-INVALIDATE
      data-element=JobStatus_RefCys_Certicificate_Element, handle-invalid=DONT-INVALIDATE
  impl type PayloadArr_u8_8: category=ARRAY
    element ArrayElement: category=VALUE, array-size=8, array-size-semantics=FIXED-SIZE, base-type=uint8
  impl type ExtWarningData: category=STRUCTURE
    element ExtWarningCurrentStatus: implementation-data-type=WarningStatus
    element ExtWarningCurrentEvent: implementation-data-type=WarningEvent
    element ExtWarningCurrentPayload: implementation-data-type=PayloadArr_u8_8
  4 x client server interface:
    TI_Ctrl_Warning_ActiveWarningStatus
      operation GetActiveWarningStatus
        arg CurrentWarning: implementation-data-type=WarningId, type=WarningId, direction=IN
        arg CurrentWarningStatus: implementation-data-type=ExtWarningData, type=ExtWarningData, direction=OUT
    TI_Ctrl_Warning_UpdateExtdPayload
      operation UpdateExtdPayload
        arg WarningCurId: implementation-data-type=WarningId, type=WarningId, direction=IN
        arg WarningPayload: implementation-data-type=PayloadArr_u8_8, type=PayloadArr_u8_8, direction=IN
    TI_Ctrl_Warning_LampStatus
      operation Get_Red_MasterLamp_Status
        arg LampStatus: implementation-data-type=DataTypes/UInt8, type=DataTypes/UInt8, direction=OUT
      operation Get_Yellow_MasterLamp_Status
        arg LampStatus: implementation-data-type=DataTypes/UInt8, type=DataTypes/UInt8, direction=OUT
    TI_Ctrl_Warning_UpdateDisplayedPayload
      operation SetWarningDisplayedPayload
        arg CurWarningId: implementation-data-type=WarningId, type=WarningId, direction=IN
        arg CurWarningDispPayload: implementation-data-type=PayloadArr_u8_8, type=PayloadArr_u8_8, direction=IN
  impl type WarningDisplayedStatus: category=VALUE, base-type=uint8, compu {0=WRNG_NOTIFIED_NONE, 1=WRNG_NOTIFIED_ACKNOWLEDGED, 2=WRNG_NOTIFIED_TIMEOUT, 4=WRNG_NOTIFIED_HIDDEN, 8=WRNG_NOTIFIED_SHOW, 16=WRNG_NOTIFIED_ACTIVE, 32=WRNG_NOTIFIED_INACTIVE}, range raw 0..32
  client server interface TI_Ctrl_Warning_UpdateDisplayedStatus
    operation SetWarningDisplayedStatus
      arg CurWarningId: implementation-data-type=WarningId, type=WarningId, direction=IN
      arg CurWarningDispStatus: implementation-data-type=WarningDisplayedStatus, type=WarningDisplayedStatus, direction=IN
  impl type WarningDataS: category=STRUCTURE
    element WarningCurrentStatus: implementation-data-type=WarningStatus
    element WarningCurrentEvent: implementation-data-type=WarningEvent
    element WarningCurrentPayload: implementation-data-type=UInt32
  5 x client server interface:
    TI_Ctrl_WarningActiveStatus
      operation GetWarningActiveStatus
        arg CurrentWarning: implementation-data-type=WarningId, type=WarningId, direction=IN
        arg CurrentWarningStatus: implementation-data-type=WarningDataS, type=WarningDataS, direction=OUT
    TI_Ctrl_WarningDisplayedPayload
      operation GetWarningDisplayedPayload
        arg CurWarningId: implementation-data-type=WarningId, type=WarningId, direction=IN
        arg DisplayedPayload: implementation-data-type=PayloadArr_u8_8, type=PayloadArr_u8_8, direction=OUT
    TI_Ctrl_WarningDisplayedStatus
      operation GetWarningDisplayedStatus
        arg CurWarningId: implementation-data-type=WarningId, type=WarningId, direction=IN
        arg DisplayedStatus: implementation-data-type=WarningDisplayedStatus, type=WarningDisplayedStatus, direction=OUT
    TI_CS_Warning_Group_Update
      operation Warning_Group_update
    TI_CS_GroupWarningAck
      operation GroupWrnAck
  impl type EButtonId: category=VALUE, base-type=uint8, compu {0=EButtonId_None, 1=EButtonId_Ok, 2=EButtonId_Up, 3=EButtonId_Down, 4=EButtonId_Back, 5=EButtonId_Menu, 6=EButtonId_Phone, 7=EButtonId_Hud, 8=EButtonId_Last}, range raw 0..8
  impl type EButtonSts: category=VALUE, base-type=uint8, compu {0=EButtonSts_Off, 1=EButtonSts_On, 2=EButtonSts_Short, 3=EButtonSts_Long, 4=EButtonSts_Repeat, 5=EButtonSts_Last}, range raw 0..5
  client server interface TI_CS_SW_NoOperationTimer
    operation SW_NoOperationTimer
      arg pEvent: implementation-data-type=EButtonId, type=EButtonId, direction=IN
      arg pEventType: implementation-data-type=EButtonSts, type=EButtonSts, direction=IN
  impl type data_u8_8: category=ARRAY
    element ArrayElement: category=VALUE, array-size=8, array-size-semantics=FIXED-SIZE, base-type=uint8
  impl type SHudWarningDisplay: category=STRUCTURE
    element show: implementation-data-type=DataTypes/UInt8
    element warningId: implementation-data-type=UInt16
    element dynData: implementation-data-type=data_u8_8
  sender receiver interface HudWarningDisplay: invalidation-policy{data-element=HudWarningDisplayData, handle-invalid=DONT-INVALIDATE}
    data HudWarningDisplayData: implementation-data-type=SHudWarningDisplay, type=SHudWarningDisplay
  impl type data_u32_5: category=ARRAY
    element ArrayElement: category=VALUE, array-size=5, array-size-semantics=FIXED-SIZE, base-type=uint32
  impl type STpmsWarningData: category=STRUCTURE
    element tpmsWarndata: implementation-data-type=data_u32_5
  sender receiver interface TpmsWarningData: invalidation-policy{data-element=TpmsWarningDataData, handle-invalid=DONT-INVALIDATE}
    data TpmsWarningDataData: implementation-data-type=STpmsWarningData, type=STpmsWarningData
  sender receiver interface TI_SR_WarningHighInterrupt_State: invalidation-policy{data-element=WarningHighInterrupt_State, handle-invalid=DONT-INVALIDATE}
    data WarningHighInterrupt_State: implementation-data-type=DataTypes/UInt8, type=DataTypes/UInt8
  sender receiver interface TI_SR_WarningInterrupt_State: invalidation-policy{data-element=WarningInterrupt_State, handle-invalid=DONT-INVALIDATE}
    data WarningInterrupt_State: implementation-data-type=DataTypes/UInt8, type=DataTypes/UInt8
  impl type SWarningDisplay: category=STRUCTURE
    element show: implementation-data-type=DataTypes/UInt8
    element warningId: implementation-data-type=UInt16
    element dynData: implementation-data-type=data_u8_8
  sender receiver interface WarningDisplay: invalidation-policy{data-element=WarningDisplayData, handle-invalid=DONT-INVALIDATE}
    data WarningDisplayData: implementation-data-type=SWarningDisplay, type=SWarningDisplay
  impl type EChimeID: category=VALUE, base-type=uint8, compu {0=NO_CHIME_ID, 1=MAX_CHIME_ID}, range raw 0..1
  sender receiver interface TIChimeRequest_dummy: invalidation-policy{data-element=Chime_Request, handle-invalid=DONT-INVALIDATE}
    data Chime_Request: implementation-data-type=EChimeID, type=EChimeID
  impl type EChimeStatus: category=VALUE, base-type=uint16, range raw 0..65535
  sender receiver interface TIChimeCheckstatus_Dummy: invalidation-policy{data-element=Chime_Status, handle-invalid=DONT-INVALIDATE}
    data Chime_Status: implementation-data-type=EChimeStatus, type=EChimeStatus
  sender receiver interface TI_SR_FactoryMode: invalidation-policy{data-element=FactoryMode, handle-invalid=DONT-INVALIDATE}
    data FactoryMode: implementation-data-type=DataTypes/UInt8, type=DataTypes/UInt8
  sender receiver interface TI_SR_FactoryModeStatus: invalidation-policy{data-element=FactoryModeStatus, handle-invalid=DONT-INVALIDATE}
    data FactoryModeStatus: implementation-data-type=DataTypes/UInt8, type=DataTypes/UInt8
  impl type Hud_Wake_Type: category=VALUE, base-type=uint8, compu {0=HUD_WK_LO, 1=HUD_WK_HI}, range raw 0..1
  sender receiver interface TI_SR_HudWake_HW: invalidation-policy{data-element=WakeType_Hw, handle-invalid=DONT-INVALIDATE}
    data WakeType_Hw: implementation-data-type=Hud_Wake_Type, type=Hud_Wake_Type
  sender receiver interface TI_SR_HudWake_Int: invalidation-policy{data-element=WakeType_Int, handle-invalid=DONT-INVALIDATE}
    data WakeType_Int: implementation-data-type=Hud_Wake_Type, type=Hud_Wake_Type
  impl type data_u8_10: category=ARRAY
    element ArrayElement: category=VALUE, array-size=10, array-size-semantics=FIXED-SIZE, base-type=uint8
  impl type SHudWarningStatus: category=STRUCTURE
    element visible: implementation-data-type=DataTypes/UInt8
    element warningId: implementation-data-type=UInt16
    element dynData: implementation-data-type=data_u8_10
  sender receiver interface HudWarningStatus: invalidation-policy{data-element=HudWarningStatusData, handle-invalid=DONT-INVALIDATE}
    data HudWarningStatusData: implementation-data-type=SHudWarningStatus, type=SHudWarningStatus
  sender receiver interface TI_CS_NVM_Adapter_GetNVM_HUD_CoordinateFlag_Dummy: invalidation-policy{data-element=NvmData, handle-invalid=DONT-INVALIDATE}
    data NvmData: implementation-data-type=DataTypes/UInt8, type=DataTypes/UInt8
  impl type Tpms_Arr_u8_5: category=ARRAY
    element ArrayElement: category=VALUE, array-size=5, array-size-semantics=FIXED-SIZE, base-type=uint8
  sender receiver interface TI_SR_TPMS_Payload: invalidation-policy{data-element=Tpms_Payload, handle-invalid=DONT-INVALIDATE}
    data Tpms_Payload: implementation-data-type=Tpms_Arr_u8_5, type=Tpms_Arr_u8_5
  impl type Target_SW_Status: category=VALUE, base-type=uint8, compu {0=NO_TARGET, 1=TG_LEFT, 2=TG_UP, 3=TG_DOWN, 4=TG_RIGHT, 5=TG_ENTER, 6=TG_BACK, 7=TG_MAX}, range raw 0..7
  sender receiver interface TI_SR_TargetSw_BtnEvent: invalidation-policy{data-element=TargetSw, handle-invalid=DONT-INVALIDATE}
    data TargetSw: implementation-data-type=Target_SW_Status, type=Target_SW_Status
  client server interface TI_CS_ButtonAction
    operation GetButtonStatus
      arg Warning: implementation-data-type=WarningId, type=WarningId, direction=IN
      arg ButtonEvent: implementation-data-type=UInt16, type=UInt16, direction=IN
      arg CursorSt: implementation-data-type=DataTypes/UInt8, type=DataTypes/UInt8, direction=IN
  impl type SWarningStatus: category=STRUCTURE
    element visible: implementation-data-type=DataTypes/UInt8
    element warningId: implementation-data-type=UInt16
    element dynData: implementation-data-type=data_u8_10
  sender receiver interface Warning_Status: invalidation-policy{data-element=WarningStatusData, handle-invalid=DONT-INVALIDATE}
    data WarningStatusData: implementation-data-type=SWarningStatus, type=SWarningStatus
  impl type EDisplayStatus: category=VALUE, base-type=uint8, compu {0=EDisplayState_Off, 1=EDisplayState_On, 2=EDisplayState_Error, 3=EDisplayState_Disconnected, 4=EDisplayState_Last}, range raw 0..4
  impl type SDisplayCurrentState: category=STRUCTURE
    element displayId: implementation-data-type=UInt32
    element state: implementation-data-type=EDisplayStatus
  sender receiver interface DisplayCurrentState: invalidation-policy{data-element=DisplayCurrentStateData, handle-invalid=DONT-INVALIDATE}
    data DisplayCurrentStateData: implementation-data-type=SDisplayCurrentState, type=SDisplayCurrentState
  impl type SEmmcErrorNotifier: category=STRUCTURE
    element errorCode: implementation-data-type=UInt32
  sender receiver interface EmmcErrorNotifier: invalidation-policy{data-element=EmmcErrorNotifierData, handle-invalid=DONT-INVALIDATE}
    data EmmcErrorNotifierData: implementation-data-type=SEmmcErrorNotifier, type=SEmmcErrorNotifier
  impl type EDomainId: category=VALUE, base-type=uint8, compu {0=EDomainId_VP, 1=EDomainId_Cluster, 2=EDomainId_IVI, 3=EDomainId_Last}, range raw 0..3
  impl type SHealthDomainFatalError: category=STRUCTURE
    element domainId: implementation-data-type=EDomainId
    element compIdx: implementation-data-type=UInt32
  sender receiver interface HealthDomainFatalError_Q: invalidation-policy{data-element=HealthDomainFatalErrorData, handle-invalid=DONT-INVALIDATE}
    data HealthDomainFatalErrorData: implementation-data-type=SHealthDomainFatalError, sw-impl-policy=QUEUED, type=SHealthDomainFatalError
  impl type SHealthDomainHeartbeat: category=STRUCTURE
    element domainId: implementation-data-type=EDomainId
    element seqCnt: implementation-data-type=UInt32
  sender receiver interface HealthDomainHeartbeat_Q: invalidation-policy{data-element=HealthDomainHeartbeatData, handle-invalid=DONT-INVALIDATE}
    data HealthDomainHeartbeatData: implementation-data-type=SHealthDomainHeartbeat, sw-impl-policy=QUEUED, type=SHealthDomainHeartbeat
  impl type data_u8_32: category=ARRAY
    element ArrayElement: category=VALUE, array-size=32, array-size-semantics=FIXED-SIZE, base-type=uint8
  impl type SHealthDumpData: category=STRUCTURE
    element chunkSize: implementation-data-type=UInt32
    element data: implementation-data-type=data_u8_32
  sender receiver interface HealthDumpData_Q: invalidation-policy{data-element=HealthDumpDataData, handle-invalid=DONT-INVALIDATE}
    data HealthDumpDataData: implementation-data-type=SHealthDumpData, sw-impl-policy=QUEUED, type=SHealthDumpData
  impl type SHealthDumpHdrInfo: category=STRUCTURE
    element fileSize: implementation-data-type=UInt32
  sender receiver interface HealthDumpHdrInfo_Q: invalidation-policy{data-element=HealthDumpHdrInfoData, handle-invalid=DONT-INVALIDATE}
    data HealthDumpHdrInfoData: implementation-data-type=SHealthDumpHdrInfo, sw-impl-policy=QUEUED, type=SHealthDumpHdrInfo
  impl type SHealthEventRecord: category=STRUCTURE
    element recordType: implementation-data-type=DataTypes/UInt8
    element recordLen: implementation-data-type=DataTypes/UInt8
    element recordData: implementation-data-type=data_u8_8
  sender receiver interface HealthEventRecord_Q: invalidation-policy{data-element=HealthEventRecordData, handle-invalid=DONT-INVALIDATE}
    data HealthEventRecordData: implementation-data-type=SHealthEventRecord, sw-impl-policy=QUEUED, type=SHealthEventRecord
  impl type SPowerExtendShutdownTime: category=STRUCTURE
    element domainId: implementation-data-type=EDomainId
    element timeoutMs: implementation-data-type=UInt32
  sender receiver interface PowerExtendShutdownTime_Q: invalidation-policy{data-element=PowerExtendShutdownTimeData, handle-invalid=DONT-INVALIDATE}
    data PowerExtendShutdownTimeData: implementation-data-type=SPowerExtendShutdownTime, sw-impl-policy=QUEUED, type=SPowerExtendShutdownTime
  impl type SPowerKeepSystemAwake: category=STRUCTURE
    element domainId: implementation-data-type=EDomainId
    element timeoutMs: implementation-data-type=UInt32
  sender receiver interface PowerKeepSystemAwake_Q: invalidation-policy{data-element=PowerKeepSystemAwakeData, handle-invalid=DONT-INVALIDATE}
    data PowerKeepSystemAwakeData: implementation-data-type=SPowerKeepSystemAwake, sw-impl-policy=QUEUED, type=SPowerKeepSystemAwake
  impl type ESystemState: category=VALUE, base-type=uint8, compu {0=ESystemState_Off, 1=ESystemState_Startup, 2=ESystemState_Up, 3=ESystemState_FullRun, 4=ESystemState_PrepareShutdown, 5=ESystemState_Minimal, 6=ESystemState_Shutdown, 7=ESystemState_Last}, range raw 0..7
  impl type SPowerSystemState: category=STRUCTURE
    element domainId: implementation-data-type=EDomainId
    element state: implementation-data-type=ESystemState
  sender receiver interface PowerSystemState: invalidation-policy{data-element=PowerSystemStateData, handle-invalid=DONT-INVALIDATE}
    data PowerSystemStateData: implementation-data-type=SPowerSystemState, type=SPowerSystemState
  impl type SSafeHMIReadyStatus: category=STRUCTURE
    element status: implementation-data-type=DataTypes/UInt8
  sender receiver interface SafeHMIReadyStatus: invalidation-policy{data-element=SafeHMIReadyStatusData, handle-invalid=DONT-INVALIDATE}
    data SafeHMIReadyStatusData: implementation-data-type=SSafeHMIReadyStatus, sw-impl-policy=QUEUED, type=SSafeHMIReadyStatus
  impl type data_u8_64: category=ARRAY
    element ArrayElement: category=VALUE, array-size=64, array-size-semantics=FIXED-SIZE, base-type=uint8
  impl type SUpdateShortServiceResp: category=STRUCTURE
    7 x element, all with category=TYPE_REFERENCE:
      msgId: implementation-data-type=UInt16
      msgSize: implementation-data-type=UInt16
      sid: implementation-data-type=DataTypes/UInt8
      length: implementation-data-type=UInt16
      responseCode: implementation-data-type=DataTypes/UInt8
      NRC: implementation-data-type=DataTypes/UInt8
      data: implementation-data-type=data_u8_64
  sender receiver interface UpdateShortServiceResp: invalidation-policy{data-element=UpdateShortServiceRespData, handle-invalid=DONT-INVALIDATE}
    data UpdateShortServiceRespData: implementation-data-type=SUpdateShortServiceResp, type=SUpdateShortServiceResp
  impl type SWarningDisplayAvailable: category=STRUCTURE
    element status: implementation-data-type=DataTypes/UInt8
  sender receiver interface WarningDisplayAvailable: invalidation-policy{data-element=WarningDisplayAvailableData, handle-invalid=DONT-INVALIDATE}
    data WarningDisplayAvailableData: implementation-data-type=SWarningDisplayAvailable, type=SWarningDisplayAvailable
  client server interface UclInitShutdown
    operation Impl_Initialize: possible-error=UclInitShutdown/E_NOT_OK
    operation Impl_Shutdown: possible-error=UclInitShutdown/E_NOT_OK
    error E_NOT_OK: error-code=1
  client server interface UclSystemCallbacks
    operation ErrorNotification
      arg DLInst: implementation-data-type=DataTypes/UInt8, type=DataTypes/UInt8, direction=IN
      arg ErrorCode: implementation-data-type=SInt32, type=SInt32, direction=IN
    operation LinkStatusChanged
      arg DLInst: implementation-data-type=DataTypes/UInt8, type=DataTypes/UInt8, direction=IN
      arg Status: implementation-data-type=SInt32, type=SInt32, direction=IN
  impl type EDidType: category=VALUE, base-type=uint8, compu {0=EDidType_Read, 1=EDidType_Write, 2=EDidType_Last}, range raw 0..2
  impl type data_u8_256: category=ARRAY
    element ArrayElement: category=VALUE, array-size=256, array-size-semantics=FIXED-SIZE, base-type=uint8
  impl type SDiagDIDRequest: category=STRUCTURE
    4 x element, all with category=TYPE_REFERENCE:
      did: implementation-data-type=UInt16
      didType: implementation-data-type=EDidType
      dataLen: implementation-data-type=UInt16
      data: implementation-data-type=data_u8_256
  sender receiver interface DiagDIDRequest_Q: invalidation-policy{data-element=DiagDIDRequestData, handle-invalid=DONT-INVALIDATE}
    data DiagDIDRequestData: implementation-data-type=SDiagDIDRequest, sw-impl-policy=QUEUED, type=SDiagDIDRequest
  impl type EIOCtrlOptType: category=VALUE, base-type=uint8, compu {0=EIOCtrlOptType_returnControlToECU, 1=EIOCtrlOptType_resetToDefault, 2=EIOCtrlOptType_freezeCurrentState, 3=EIOCtrlOptType_shortTermAdjustment, 4=EIOCtrlOptType_Last}, range raw 0..4
  impl type SDiagIOCtrlRequest: category=STRUCTURE
    4 x element, all with category=TYPE_REFERENCE:
      did: implementation-data-type=UInt16
      optionCtrl: implementation-data-type=EIOCtrlOptType
      dataLen: implementation-data-type=UInt16
      data: implementation-data-type=data_u8_256
  sender receiver interface DiagIOCtrlRequest_Q: invalidation-policy{data-element=DiagIOCtrlRequestData, handle-invalid=DONT-INVALIDATE}
    data DiagIOCtrlRequestData: implementation-data-type=SDiagIOCtrlRequest, sw-impl-policy=QUEUED, type=SDiagIOCtrlRequest
  impl type ERoutineType: category=VALUE, base-type=uint8, compu {0=ERoutineType_Start, 1=ERoutineType_Stop, 2=ERoutineType_QueryResults, 3=ERoutineType_Last}, range raw 0..3
  impl type SDiagRoutineRequest: category=STRUCTURE
    4 x element, all with category=TYPE_REFERENCE:
      routineId: implementation-data-type=UInt16
      routineType: implementation-data-type=ERoutineType
      dataLen: implementation-data-type=UInt16
      data: implementation-data-type=data_u8_256
  sender receiver interface DiagRoutineRequest_Q: invalidation-policy{data-element=DiagRoutineRequestData, handle-invalid=DONT-INVALIDATE}
    data DiagRoutineRequestData: implementation-data-type=SDiagRoutineRequest, sw-impl-policy=QUEUED, type=SDiagRoutineRequest
  impl type EDisplayPower: category=VALUE, base-type=uint8, compu {0=EDisplayPower_Off, 1=EDisplayPower_On, 2=EDisplayPower_Last}, range raw 0..2
  impl type SDisplaySetPower: category=STRUCTURE
    element displayId: implementation-data-type=UInt32
    element state: implementation-data-type=EDisplayPower
  sender receiver interface DisplaySetPower: invalidation-policy{data-element=DisplaySetPower/DisplaySetPowerData, handle-invalid=DONT-INVALIDATE}
    data DisplaySetPowerData: implementation-data-type=SDisplaySetPower, type=SDisplaySetPower
  impl type data_u8_2: category=ARRAY
    element ArrayElement: category=VALUE, array-size=2, array-size-semantics=FIXED-SIZE, base-type=uint8
  impl type SFRTT_Status: category=STRUCTURE
    element mask: implementation-data-type=data_u8_2
  sender receiver interface FRTT_Status: invalidation-policy{data-element=FRTT_StatusData, handle-invalid=DONT-INVALIDATE}
    data FRTT_StatusData: implementation-data-type=SFRTT_Status, type=SFRTT_Status
  impl type EGaugeUnit: category=VALUE, base-type=uint8, compu {0=EGaugeUnit_Mph, 1=EGaugeUnit_Kmph, 2=EGaugeUnit_Centigrade, 3=EGaugeUnit_Farenheit, 4=EGaugeUnit_Psi, 5=EGaugeUnit_Pa, 6=EGaugeUnit_Bar, 7=EGaugeUnit_Kmpl, 8=EGaugeUnit_Mpg, 9=EGaugeUnit_Ltr, 10=EGaugeUnit_Gal, 11=EGaugeUnit_Km, 12=EGaugeUnit_Mile, 13=EGaugeUnit_Last}, range raw 0..13
  impl type SGaugeInfo: category=STRUCTURE
    5 x element, all with category=TYPE_REFERENCE:
      id: implementation-data-type=DataTypes/UInt8
      position: implementation-data-type=UInt16
      digitalData: implementation-data-type=SInt32
      unit: implementation-data-type=EGaugeUnit
      dynData: implementation-data-type=UInt16
  impl type SFastGuageInfo: category=STRUCTURE
    element gaugeInfo_4: implementation-data-type=SGaugeInfo
  sender receiver interface FastGaugeInfo: invalidation-policy{data-element=FastGaugeInfoData, handle-invalid=DONT-INVALIDATE}
    data FastGaugeInfoData: implementation-data-type=SFastGuageInfo, type=SFastGuageInfo
  impl type SHealthDumpGetData: category=STRUCTURE
    element reserved: implementation-data-type=DataTypes/UInt8
  sender receiver interface HealthDumpGetData_Q: invalidation-policy{data-element=HealthDumpGetDataData, handle-invalid=DONT-INVALIDATE}
    data HealthDumpGetDataData: implementation-data-type=SHealthDumpGetData, sw-impl-policy=QUEUED, type=SHealthDumpGetData
  impl type SHealthDumpGetHdr: category=STRUCTURE
    element encrypt: implementation-data-type=DataTypes/UInt8
  sender receiver interface HealthDumpGetHdr_Q: invalidation-policy{data-element=HealthDumpGetHdrData, handle-invalid=DONT-INVALIDATE}
    data HealthDumpGetHdrData: implementation-data-type=SHealthDumpGetHdr, sw-impl-policy=QUEUED, type=SHealthDumpGetHdr
  impl type EIgnitionStatus: category=VALUE, base-type=uint8, compu {0=EIgnitionStatus_Off, 1=EIgnitionStatus_Acc, 2=EIgnitionStatus_Start, 3=EIgnitionStatus_Run, 4=EIgnitionStatus_Last}, range raw 0..4
  impl type SIgnState: category=STRUCTURE
    element state: implementation-data-type=EIgnitionStatus
  sender receiver interface IgnState_Q: invalidation-policy{data-element=IgnStateData, handle-invalid=DONT-INVALIDATE}
    data IgnStateData: implementation-data-type=SIgnState, sw-impl-policy=QUEUED, type=SIgnState
  impl type SPowerSystemStateReqChange: category=STRUCTURE
    element state: implementation-data-type=ESystemState
    element domainId: implementation-data-type=EDomainId
  sender receiver interface PowerSystemStateReqChange: invalidation-policy{data-element=PowerSystemStateReqChangeData, handle-invalid=DONT-INVALIDATE}
    data PowerSystemStateReqChangeData: implementation-data-type=SPowerSystemStateReqChange, type=SPowerSystemStateReqChange
  impl type SRTT_Icon: category=STRUCTURE
    element icon: implementation-data-type=data_u8_2
  sender receiver interface RTT_Icon: invalidation-policy{data-element=RTT_IconData, handle-invalid=DONT-INVALIDATE}
    data RTT_IconData: implementation-data-type=SRTT_Icon, type=SRTT_Icon
  impl type SRTT_Status: category=STRUCTURE
    element mask: implementation-data-type=data_u8_2
  sender receiver interface RTT_Status: invalidation-policy{data-element=RTT_StatusData, handle-invalid=DONT-INVALIDATE}
    data RTT_StatusData: implementation-data-type=SRTT_Status, type=SRTT_Status
  impl type SRTT_Toggle: category=STRUCTURE
    element positions: implementation-data-type=DataTypes/UInt8
    element display: implementation-data-type=DataTypes/UInt8
  sender receiver interface RTT_Toggle: invalidation-policy{data-element=RTT_ToggleData, handle-invalid=DONT-INVALIDATE}
    data RTT_ToggleData: implementation-data-type=SRTT_Toggle, type=SRTT_Toggle
  impl type SShiftInd: category=STRUCTURE
    6 x element, all with category=TYPE_REFERENCE, implementation-data-type=DataTypes/UInt8:
      Shift_Ind_Pos
      Shift_Ind_BlinkReq
      Shift_Ind_DisplayDecState
      Shift_Ind_Down
      Shift_Ind_Screen_ShiftType
      Shift_Ind_Up
  impl type SShiftPosIndStatus: category=STRUCTURE
    element status: implementation-data-type=SShiftInd
  sender receiver interface ShiftPosIndStatus: invalidation-policy{data-element=ShiftPosIndStatusData, handle-invalid=DONT-INVALIDATE}
    data ShiftPosIndStatusData: implementation-data-type=SShiftPosIndStatus, type=SShiftPosIndStatus
  impl type SSlowGuageInfo: category=STRUCTURE
    element gaugeInfo: implementation-data-type=SGaugeInfo
  sender receiver interface SlowGaugeInfo: invalidation-policy{data-element=SlowGaugeInfoData, handle-invalid=DONT-INVALIDATE}
    data SlowGaugeInfoData: implementation-data-type=SSlowGuageInfo, type=SSlowGuageInfo
  impl type data_u8_15: category=ARRAY
    element ArrayElement: category=VALUE, array-size=15, array-size-semantics=FIXED-SIZE, base-type=uint8
  impl type STT_Status: category=STRUCTURE
    element mask: implementation-data-type=data_u8_15
  sender receiver interface TT_Status: invalidation-policy{data-element=TT_StatusData, handle-invalid=DONT-INVALIDATE}
    data TT_StatusData: implementation-data-type=STT_Status, type=STT_Status
  impl type data_u8_512: category=ARRAY
    element ArrayElement: category=VALUE, array-size=512, array-size-semantics=FIXED-SIZE, base-type=uint8
  impl type SUpdateLongServiceReq: category=STRUCTURE
    7 x element, all with category=TYPE_REFERENCE:
      msgId: implementation-data-type=UInt16
      msgSize: implementation-data-type=UInt16
      memoryType: implementation-data-type=DataTypes/UInt8
      memoryCmd: implementation-data-type=DataTypes/UInt8
      sid: implementation-data-type=DataTypes/UInt8
      length: implementation-data-type=UInt32
      data: implementation-data-type=data_u8_512
  sender receiver interface UpdateLongServiceReq: invalidation-policy{data-element=UpdateLongServiceReqData, handle-invalid=DONT-INVALIDATE}
    data UpdateLongServiceReqData: implementation-data-type=SUpdateLongServiceReq, type=SUpdateLongServiceReq
  impl type SUpdateShortServiceReq: category=STRUCTURE
    7 x element, all with category=TYPE_REFERENCE:
      msgId: implementation-data-type=UInt16
      msgSize: implementation-data-type=UInt16
      memoryType: implementation-data-type=DataTypes/UInt8
      memoryCmd: implementation-data-type=DataTypes/UInt8
      sid: implementation-data-type=DataTypes/UInt8
      length: implementation-data-type=UInt32
      data: implementation-data-type=data_u8_64
  sender receiver interface UpdateShortServiceReq: invalidation-policy{data-element=UpdateShortServiceReqData, handle-invalid=DONT-INVALIDATE}
    data UpdateShortServiceReqData: implementation-data-type=SUpdateShortServiceReq, type=SUpdateShortServiceReq
  impl type SWarningExtDisplay: category=STRUCTURE
    element show: implementation-data-type=DataTypes/UInt8
    element warningId: implementation-data-type=UInt16
    element dynData: implementation-data-type=data_u8_8
  sender receiver interface WarningExtDisplay: invalidation-policy{data-element=WarningExtDisplayData, handle-invalid=DONT-INVALIDATE}
    data WarningExtDisplayData: implementation-data-type=SWarningExtDisplay, type=SWarningExtDisplay
  impl type EDmnChangeReqStatus_t: category=VALUE, base-type=uint8, compu {0=EDmnChangeReqStatus_NoReq, 1=EDmnChangeReqStatus_WaitAwakeTime, 2=EDmnChangeReqStatus_WaitShutdonwTime, 3=EDmnChangeReqStatus_PrevReqPending, 4=EDmnChangeReqStatus_ReqSucceed, 5=EDmnChangeReqStatus_ReqFail, 6=EDmnChangeReqStatus_ReqTimedOut, 7=EDmnChangeReqStatus_DmnNotReady}, range raw 0..7
  client server interface if_CS_DmnSystemStateChange
    operation DmnSystemStateChangeReq: possible-error=if_CS_DmnSystemStateChange/E_NOT_OK
      arg DmnId: implementation-data-type=EDomainId, type=EDomainId, direction=IN
      arg DmnState: implementation-data-type=ESystemState, type=ESystemState, direction=IN
    operation DmnSystemStateChangeStatus
      arg DmnId: implementation-data-type=EDomainId, type=EDomainId, direction=IN
      arg DmnStatus: implementation-data-type=EDmnChangeReqStatus_t, type=EDmnChangeReqStatus_t, direction=OUT
    error E_NOT_OK: error-code=1
  client server interface if_CS_DmnMonitoring
    operation StartDomainMonitoring: possible-error=if_CS_DmnMonitoring/E_NOT_OK
      arg DmnID: implementation-data-type=EDomainId, type=EDomainId, direction=IN
    operation StopDomainMonitoring: possible-error=if_CS_DmnMonitoring/E_NOT_OK
      arg DmnID: implementation-data-type=EDomainId, type=EDomainId, direction=IN
    error E_NOT_OK: error-code=1
  impl type EUclLinkState_t: category=VALUE, base-type=uint8, compu {0=EUclLinkState_Not_Rcvd, 1=EUclLinkState_Down, 2=EUclLinkState_Up, 3=EUclLinkState_Last}, range raw 0..3
  impl type EDmnHealthState_t: category=VALUE, base-type=uint8, compu {0=EDmnHealth_Active, 1=EDmnHealth_UCL_Fatal_Error, 2=EDmnHealth_HB_Miss, 3=EDmnHealth_Fatal_Error, 4=EDmnHealth_Rcvd_Inv_SeqCnt, 5=EDmnHealth_First_HB_Rcv_Time_Expired, 6=EDmnHealth_First_LinkUp_Time_Expired, 7=EDmnHealth_Shutdown_Time_Expired, 8=EDmnHealth_Last}, range raw 0..8
  impl type EDmnOverallState_t: category=VALUE, base-type=uint8, compu {0=DMN_NOT_READY, 1=DMN_READY}, range raw 0..1
  impl type SDmnStatus: category=STRUCTURE
    6 x element, all with category=TYPE_REFERENCE:
      dmnId: implementation-data-type=EDomainId
      linkStatus: implementation-data-type=EUclLinkState_t
      uclErrCode: implementation-data-type=SInt32
      dmnHealthState: implementation-data-type=EDmnHealthState_t
      state: implementation-data-type=ESystemState
      dmnStatus: implementation-data-type=EDmnOverallState_t
  sender receiver interface if_SR_DmnInfo: invalidation-policy{data-element=SDmnStatus, handle-invalid=DONT-INVALIDATE}
    data SDmnStatus: implementation-data-type=SDmnStatus, type=SDmnStatus
  sender receiver interface If_SR_SleepStatus: invalidation-policy{data-element=SleepManager_SleepStatus, handle-invalid=DONT-INVALIDATE}
    data SleepManager_SleepStatus: implementation-data-type=DataTypes/UInt8, type=DataTypes/UInt8
  impl type ShiftPositionInd: category=VALUE, base-type=uint8, compu {1=Shift_PosInd_Ind_S, 2=Shift_PosInd_Ind_M, 3=Shift_PosInd_Ind_D}, range raw 1..3
  sender receiver interface TI_ShiftIndicator: invalidation-policy{data-element=ShiftModeIndicator, handle-invalid=DONT-INVALIDATE}
    data ShiftModeIndicator: implementation-data-type=ShiftPositionInd, type=ShiftPositionInd
  impl type ShiftPosition: category=VALUE, base-type=uint8, compu {16=Shift_PosInd_P, 32=Shift_PosInd_R, 48=Shift_PosInd_N, 64=Shift_PosInd_D, 80=Shift_PosInd_B, 96=Shift_PosInd_SD}, range raw 16..96
  sender receiver interface TI_ShiftPosition: invalidation-policy{data-element=ShiftPosition, handle-invalid=DONT-INVALIDATE}
    data ShiftPosition: implementation-data-type=ShiftPosition, type=ShiftPosition
  impl type ShiftposData_Type: category=STRUCTURE
    5 x element, all with category=TYPE_REFERENCE:
      Shift_Up_Ind: implementation-data-type=DataTypes/UInt8
      DisplayDecState: implementation-data-type=DataTypes/UInt8
      Shift_Ind_Pos: implementation-data-type=UInt16
      Shift_Down_Ind: implementation-data-type=DataTypes/UInt8
      Screen_ShiftType: implementation-data-type=DataTypes/UInt8
  sender receiver interface TI_SR_Shiftpos_Data: invalidation-policy{data-element=ShiftPos_Data, handle-invalid=DONT-INVALIDATE}
    data ShiftPos_Data: implementation-data-type=ShiftposData_Type, type=ShiftposData_Type
  sender receiver interface TIIndicatorStatusUpdt: invalidation-policy{data-element=TIUpdateIndicatorStatus, handle-invalid=DONT-INVALIDATE}
    data TIUpdateIndicatorStatus: implementation-data-type=DataTypes/UInt8, type=DataTypes/UInt8
  impl type tRxSafeSignalId:
    category=VALUE
    base-type=uint8
    compu {0=eSCSBZRIn, 1=eSCSACCELIn, 2=ePBKLABIn, 3=eDBKLABIn, 4=eABIn, 5=eB_PKBLPIn, 6=eB_EPBWLIn, 7=eB_EPBMIDIn, 8=eB_CPKBIn, 9=eVSCOFFIn, 10=eVSCEXISTIn, 11=eTRCOFFIn, 12=eSLP_WLIn, 13=eMCBWIn, 14=eECBEXISTIn, 15=eEBW_MIDIn, 16=eBRK_MIDIn, 17=eBHEXISTIn, 18=eB_EBWIn, 19=eB_DAINDPIn, 20=eB_DAINDCIn, 21=eB_DACINDIn, 22=eB_BUZZERIn, 23=eB_BRLVIn, 24=eB_BRKWIn, 25=eB_ALSDIn, 26=eB_ABSIn, 27=eABS_MIDIn, 28=ePWIINFOIn, 29=eTRCCONRRIn, 30=eTRCCONRLIn, 31=eTRCCONFRIn, 32=eTRCCONFLIn, 33=eB_EBW2In, 34=eB_BUZZE2In, 35=eB_BRLV2In, 36=eB_BRKW2In, 37=eEndOfRxSafeSignal}
    range raw 0..37
  impl type tRxSafeSignalStatus: category=VALUE, base-type=uint8, compu {0=eSIGNAL_OK, 1=eSIGNAL_MISSING, 2=eSIGNAL_NEVER_RECEIVED, 4=eSIGNAL_INVALID}, range raw 0..4
  client server interface if_CS_ComAbsSafeRx
    7 x operation:
      Mdl_SafetyAdapter_ReloadMissingTimer
        arg SignalId: implementation-data-type=tRxSafeSignalId, type=tRxSafeSignalId, direction=IN
      RxCanVarInit
      RxCan_GetSafeSignalValue: possible-error=if_CS_ComAbsSafeRx/E_NOT_OK
        arg SignalId: implementation-data-type=tRxSafeSignalId, type=tRxSafeSignalId, direction=IN
        arg pSignalValue: implementation-data-type=DataTypes/UInt8, type=DataTypes/UInt8, direction=OUT
        arg pSignalStatus: implementation-data-type=tRxSafeSignalStatus, type=tRxSafeSignalStatus, direction=OUT
      RxCan_SetSignalInitValue: possible-error=if_CS_ComAbsSafeRx/E_NOT_OK
        arg SignalId: implementation-data-type=tRxSafeSignalId, type=tRxSafeSignalId, direction=IN
        arg pSignalValue: implementation-data-type=DataTypes/UInt8, type=DataTypes/UInt8, direction=OUT
      RxCan_SignalInvalidProcessingControl
        arg SignalId: implementation-data-type=tRxSafeSignalId, type=tRxSafeSignalId, direction=IN
        arg Status: implementation-data-type=Boolean, type=Boolean, direction=IN
      RxCan_SignalMissingProcessingControl
        arg SignalId: implementation-data-type=tRxSafeSignalId, type=tRxSafeSignalId, direction=IN
        arg Status: implementation-data-type=Boolean, type=Boolean, direction=IN
      RxCan_SignalNRProcessingControl
        arg SignalId: implementation-data-type=tRxSafeSignalId, type=tRxSafeSignalId, direction=IN
        arg Status: implementation-data-type=Boolean, type=Boolean, direction=IN
    error E_NOT_OK: error-code=1
  sender receiver interface TI_SafetyAdapter_AppMode: invalidation-policy{data-element=SafetyAdapter_AppMode, handle-invalid=DONT-INVALIDATE}
    data SafetyAdapter_AppMode: implementation-data-type=VehicleActiveModes, type=VehicleActiveModes
  sender receiver interface TI_SafetyAdapter_ClusterMode: invalidation-policy{data-element=SafetyAdapter_CurrentClusterMode, handle-invalid=DONT-INVALIDATE}
    data SafetyAdapter_CurrentClusterMode: implementation-data-type=DataTypes/UInt8, type=DataTypes/UInt8
  sender receiver interface TI_SafetyAdapter_Ign_Substate: invalidation-policy{data-element=SafetyAdapter_Ign_Substate, handle-invalid=DONT-INVALIDATE}
    data SafetyAdapter_Ign_Substate: implementation-data-type=IgntionSubstateType, type=IgntionSubstateType
  impl type tRxSafeSignalJustRcvdStatus: category=VALUE, base-type=uint8, compu {0=eJust_Received, 1=eNot_Just_Received}, range raw 0..1
  client server interface TI_SafetyAdapter_Just_Rxed_Status
    operation RxCan_SignalClearJustRcvdStatus
      arg SignalId: implementation-data-type=tRxSafeSignalId, type=tRxSafeSignalId, direction=IN
    operation RxCan_SignalGetJustRcvdStatus
      arg SignalId: implementation-data-type=tRxSafeSignalId, type=tRxSafeSignalId, direction=IN
      arg pJustRcvdStatus: implementation-data-type=tRxSafeSignalJustRcvdStatus, type=tRxSafeSignalJustRcvdStatus, direction=INOUT
  52 x sender receiver interface:
    TI_SafetyAdapter_VoltageMode
      data SafetyAdapter_HVSD1: implementation-data-type=DataTypes/UInt8, type=DataTypes/UInt8
      data SafetyAdapter_LVSD1: implementation-data-type=DataTypes/UInt8, type=DataTypes/UInt8
      invalidation-policys:
        data-element=SafetyAdapter_HVSD1, handle-invalid=DONT-INVALIDATE
        data-element=SafetyAdapter_LVSD1, handle-invalid=DONT-INVALIDATE
    if_SR_RxAB: invalidation-policy{data-element=AB, handle-invalid=DONT-INVALIDATE}
      data AB: implementation-data-type=DataTypes/UInt8, type=DataTypes/UInt8
    if_SR_RxABS_MID: invalidation-policy{data-element=ABS_MID, handle-invalid=DONT-INVALIDATE}
      data ABS_MID: implementation-data-type=DataTypes/UInt8, type=DataTypes/UInt8
    if_SR_RxBHEXIST: invalidation-policy{data-element=BHEXIST, handle-invalid=DONT-INVALIDATE}
      data BHEXIST: implementation-data-type=DataTypes/UInt8, type=DataTypes/UInt8
    if_SR_RxBRK_MID: invalidation-policy{data-element=BRK_MID, handle-invalid=DONT-INVALIDATE}
      data BRK_MID: implementation-data-type=DataTypes/UInt8, type=DataTypes/UInt8
    if_SR_RxB_ABS: invalidation-policy{data-element=B_ABS, handle-invalid=DONT-INVALIDATE}
      data B_ABS: implementation-data-type=DataTypes/UInt8, type=DataTypes/UInt8
    if_SR_RxB_ALSD: invalidation-policy{data-element=B_ALSD, handle-invalid=DONT-INVALIDATE}
      data B_ALSD: implementation-data-type=DataTypes/UInt8, type=DataTypes/UInt8
    if_SR_RxB_BRKW: invalidation-policy{data-element=B_BRKW, handle-invalid=DONT-INVALIDATE}
      data B_BRKW: implementation-data-type=DataTypes/UInt8, type=DataTypes/UInt8
    if_SR_RxB_BRKW2: invalidation-policy{data-element=B_BRKW2, handle-invalid=DONT-INVALIDATE}
      data B_BRKW2: implementation-data-type=DataTypes/UInt8, type=DataTypes/UInt8
    if_SR_RxB_BRLV: invalidation-policy{data-element=B_BRLV, handle-invalid=DONT-INVALIDATE}
      data B_BRLV: implementation-data-type=DataTypes/UInt8, type=DataTypes/UInt8
    if_SR_RxB_BRLV2: invalidation-policy{data-element=B_BRLV2, handle-invalid=DONT-INVALIDATE}
      data B_BRLV2: implementation-data-type=DataTypes/UInt8, type=DataTypes/UInt8
    if_SR_RxB_BUZZE2: invalidation-policy{data-element=B_BUZZE2, handle-invalid=DONT-INVALIDATE}
      data B_BUZZE2: implementation-data-type=DataTypes/UInt8, type=DataTypes/UInt8
    if_SR_RxB_BUZZER: invalidation-policy{data-element=B_BUZZER, handle-invalid=DONT-INVALIDATE}
      data B_BUZZER: implementation-data-type=DataTypes/UInt8, type=DataTypes/UInt8
    if_SR_RxB_CPKB: invalidation-policy{data-element=B_CPKB, handle-invalid=DONT-INVALIDATE}
      data B_CPKB: implementation-data-type=DataTypes/UInt8, type=DataTypes/UInt8
    if_SR_RxB_DACIND: invalidation-policy{data-element=B_DACIND, handle-invalid=DONT-INVALIDATE}
      data B_DACIND: implementation-data-type=DataTypes/UInt8, type=DataTypes/UInt8
    if_SR_RxB_DAINDC: invalidation-policy{data-element=B_DAINDC, handle-invalid=DONT-INVALIDATE}
      data B_DAINDC: implementation-data-type=DataTypes/UInt8, type=DataTypes/UInt8
    if_SR_RxB_DAINDP: invalidation-policy{data-element=B_DAINDP, handle-invalid=DONT-INVALIDATE}
      data B_DAINDP: implementation-data-type=DataTypes/UInt8, type=DataTypes/UInt8
    if_SR_RxB_EBW: invalidation-policy{data-element=B_EBW, handle-invalid=DONT-INVALIDATE}
      data B_EBW: implementation-data-type=DataTypes/UInt8, type=DataTypes/UInt8
    if_SR_RxB_EBW2: invalidation-policy{data-element=B_EBW2, handle-invalid=DONT-INVALIDATE}
      data B_EBW2: implementation-data-type=DataTypes/UInt8, type=DataTypes/UInt8
    if_SR_RxB_EPBMID: invalidation-policy{data-element=B_EPBMID, handle-invalid=DONT-INVALIDATE}
      data B_EPBMID: implementation-data-type=DataTypes/UInt8, type=DataTypes/UInt8
    if_SR_RxB_EPBWL: invalidation-policy{data-element=B_EPBWL, handle-invalid=DONT-INVALIDATE}
      data B_EPBWL: implementation-data-type=DataTypes/UInt8, type=DataTypes/UInt8
    if_SR_RxB_PKBLP: invalidation-policy{data-element=B_PKBLP, handle-invalid=DONT-INVALIDATE}
      data B_PKBLP: implementation-data-type=DataTypes/UInt8, type=DataTypes/UInt8
    if_SR_RxDBKLAB: invalidation-policy{data-element=DBKLAB, handle-invalid=DONT-INVALIDATE}
      data DBKLAB: implementation-data-type=DataTypes/UInt8, type=DataTypes/UInt8
    if_SR_RxEBW_MID: invalidation-policy{data-element=EBW_MID, handle-invalid=DONT-INVALIDATE}
      data EBW_MID: implementation-data-type=DataTypes/UInt8, type=DataTypes/UInt8
    if_SR_RxECBEXIST: invalidation-policy{data-element=ECBEXIST, handle-invalid=DONT-INVALIDATE}
      data ECBEXIST: implementation-data-type=DataTypes/UInt8, type=DataTypes/UInt8
    if_SR_RxMCBW: invalidation-policy{data-element=MCBW, handle-invalid=DONT-INVALIDATE}
      data MCBW: implementation-data-type=DataTypes/UInt8, type=DataTypes/UInt8
    if_SR_RxPBKLAB: invalidation-policy{data-element=PBKLAB, handle-invalid=DONT-INVALIDATE}
      data PBKLAB: implementation-data-type=DataTypes/UInt8, type=DataTypes/UInt8
    if_SR_RxPWIINFO: invalidation-policy{data-element=PWIINFO, handle-invalid=DONT-INVALIDATE}
      data PWIINFO: implementation-data-type=DataTypes/UInt8, type=DataTypes/UInt8
    if_SR_RxSCSACCEL: invalidation-policy{data-element=SCSACCEL, handle-invalid=DONT-INVALIDATE}
      data SCSACCEL: implementation-data-type=DataTypes/UInt8, type=DataTypes/UInt8
    if_SR_RxSCSBZR: invalidation-policy{data-element=SCSBZR, handle-invalid=DONT-INVALIDATE}
      data SCSBZR: implementation-data-type=DataTypes/UInt8, type=DataTypes/UInt8
    if_SR_RxSLP_WL: invalidation-policy{data-element=SLP_WL, handle-invalid=DONT-INVALIDATE}
      data SLP_WL: implementation-data-type=DataTypes/UInt8, type=DataTypes/UInt8
    if_SR_RxTRCCONFL: invalidation-policy{data-element=TRCCONFL, handle-invalid=DONT-INVALIDATE}
      data TRCCONFL: implementation-data-type=DataTypes/UInt8, type=DataTypes/UInt8
    if_SR_RxTRCCONFR: invalidation-policy{data-element=TRCCONFR, handle-invalid=DONT-INVALIDATE}
      data TRCCONFR: implementation-data-type=DataTypes/UInt8, type=DataTypes/UInt8
    if_SR_RxTRCCONRL: invalidation-policy{data-element=TRCCONRL, handle-invalid=DONT-INVALIDATE}
      data TRCCONRL: implementation-data-type=DataTypes/UInt8, type=DataTypes/UInt8
    if_SR_RxTRCCONRR: invalidation-policy{data-element=TRCCONRR, handle-invalid=DONT-INVALIDATE}
      data TRCCONRR: implementation-data-type=DataTypes/UInt8, type=DataTypes/UInt8
    if_SR_RxTRCOFF: invalidation-policy{data-element=TRCOFF, handle-invalid=DONT-INVALIDATE}
      data TRCOFF: implementation-data-type=DataTypes/UInt8, type=DataTypes/UInt8
    if_SR_RxVSCEXIST: invalidation-policy{data-element=VSCEXIST, handle-invalid=DONT-INVALIDATE}
      data VSCEXIST: implementation-data-type=DataTypes/UInt8, type=DataTypes/UInt8
    if_SR_RxVSCOFF: invalidation-policy{data-element=VSCOFF, handle-invalid=DONT-INVALIDATE}
      data VSCOFF: implementation-data-type=DataTypes/UInt8, type=DataTypes/UInt8
    if_CS_SndCtrlVolumeRequest_dummy: invalidation-policy{data-element=UpdateChimeVolume, handle-invalid=DONT-INVALIDATE}
      data UpdateChimeVolume: implementation-data-type=DataTypes/UInt8, type=DataTypes/UInt8
    TI_CS_NVM_Adapter_GetNVM_FlashCustBuzzerSPL_Dummy: invalidation-policy{data-element=Nvmdata, handle-invalid=DONT-INVALIDATE}
      data Nvmdata: implementation-data-type=DataTypes/UInt8, type=DataTypes/UInt8
    TI_SR_Tacho_Analog_out: invalidation-policy{data-element=Analog_Tacho, handle-invalid=DONT-INVALIDATE}
      data Analog_Tacho: implementation-data-type=UInt16, type=UInt16
    TI_SR_Diag_Display_speed_Value: invalidation-policy{data-element=Diag_Digital_Speed_Value, handle-invalid=DONT-INVALIDATE}
      data Diag_Digital_Speed_Value: implementation-data-type=UInt16, type=UInt16
    TI_SR_Tacho_Digital_out: invalidation-policy{data-element=Digital_Tacho, handle-invalid=DONT-INVALIDATE}
      data Digital_Tacho: implementation-data-type=UInt16, type=UInt16
    TI_SR_Meter_DisplayDistanceUnit: invalidation-policy{data-element=DisplayUnit, handle-invalid=DONT-INVALIDATE}
      data DisplayUnit: implementation-data-type=DataTypes/UInt8, type=DataTypes/UInt8
    TI_SR_DispSpeedA: invalidation-policy{data-element=DispSpeedVal, handle-invalid=DONT-INVALIDATE}
      data DispSpeedVal: implementation-data-type=UInt16, type=UInt16
    TI_Display_speed_Value: invalidation-policy{data-element=Digital_Speed_Value, handle-invalid=DONT-INVALIDATE}
      data Digital_Speed_Value: implementation-data-type=UInt16, type=UInt16
    TI_SR_Tacho_Needle_Transparent: invalidation-policy{data-element=Needle_TR, handle-invalid=DONT-INVALIDATE}
      data Needle_TR: implementation-data-type=DataTypes/UInt8, type=DataTypes/UInt8
    TI_SR_SubDisplaySpeed_Value: invalidation-policy{data-element=SubDispSpeedVal, handle-invalid=DONT-INVALIDATE}
      data SubDispSpeedVal: implementation-data-type=UInt16, type=UInt16
    TI_SR_Tacho_Unit: invalidation-policy{data-element=Digital_TachoUnit, handle-invalid=DONT-INVALIDATE}
      data Digital_TachoUnit: implementation-data-type=Boolean, type=Boolean
    TI_SR_Tacho_RED_Start_RPM: invalidation-policy{data-element=RED_Start_RPM, handle-invalid=DONT-INVALIDATE}
      data RED_Start_RPM: implementation-data-type=DataTypes/UInt8, type=DataTypes/UInt8
    TI_SR_Tacho_RPM_MAX: invalidation-policy{data-element=REVP_RPM_MAX, handle-invalid=DONT-INVALIDATE}
      data REVP_RPM_MAX: implementation-data-type=DataTypes/UInt8, type=DataTypes/UInt8
    TI_SR_SubSpeedUnitValue: invalidation-policy{data-element=SubSpeedunit, handle-invalid=DONT-INVALIDATE}
      data SubSpeedunit: implementation-data-type=DataTypes/UInt8, type=DataTypes/UInt8
  impl type CountryCode_FuncType: category=VALUE, base-type=uint8, compu {0=eFUNC_CANADA, 1=eFUNC_NORTH_AMERICA, 2=eFUNC_MEXICO, 3=eFUNC_GENERAL_EXPORT, 4=eFUNC_UK, 5=eFUNC_EUROPE, 6=eFUNC_SOUTH_AFRICA, 7=eFUNC_MIDDLE_EAST_ASIA, 8=eFUNC_JAPAN, 9=eFUNC_INDIA, 10=eFUNC_KOREA, 11=eFUNC_TAIWAN, 12=eFUNC_CHINA, 13=eFUNC_HONG_KONG, 14=eFUNC_AUSTRALIA}, range raw 0..14
  7 x sender receiver interface:
    TI_SR_CountryCode_Func: invalidation-policy{data-element=CountryCode_Func, handle-invalid=DONT-INVALIDATE}
      data CountryCode_Func: implementation-data-type=CountryCode_FuncType, type=CountryCode_FuncType
    TI_SPD_SP1_In_Status: invalidation-policy{data-element=SP1_In_Status, handle-invalid=DONT-INVALIDATE}
      data SP1_In_Status: implementation-data-type=UInt16, type=UInt16
    TI_SPD_Selection_Table: invalidation-policy{data-element=Speed_Selection_Table, handle-invalid=DONT-INVALIDATE}
      data Speed_Selection_Table: implementation-data-type=DataTypes/UInt8, type=DataTypes/UInt8
    TI_SPD_Target2_Status: invalidation-policy{data-element=Spd_Target2_Status, handle-invalid=DONT-INVALIDATE}
      data Spd_Target2_Status: implementation-data-type=UInt16, type=UInt16
    TI_SPD_Target_Status: invalidation-policy{data-element=Spd_Target_Status, handle-invalid=DONT-INVALIDATE}
      data Spd_Target_Status: implementation-data-type=UInt16, type=UInt16
    TI_SPD_Trim2_Status: invalidation-policy{data-element=Spd_Trim2_Status, handle-invalid=DONT-INVALIDATE}
      data Spd_Trim2_Status: implementation-data-type=UInt16, type=UInt16
    TI_SPD_Trim_Status: invalidation-policy{data-element=Spd_Trim_Status, handle-invalid=DONT-INVALIDATE}
      data Spd_Trim_Status: implementation-data-type=UInt16, type=UInt16
  client server interface TI_CS_LinearInterpolation
    4 x operation:
      Get_LinearInterpolateByte
        arg ptr_table: implementation-data-type=DataTypes/UInt8, type=DataTypes/UInt8, direction=OUT
        arg lookupvalue: implementation-data-type=DataTypes/UInt8, type=DataTypes/UInt8, direction=IN
        arg Ptr_Lin_Return: implementation-data-type=DataTypes/UInt8, type=DataTypes/UInt8, direction=OUT
      Get_LinearInterpolateSByte
        arg ptr_table: implementation-data-type=SInt8, type=SInt8, direction=OUT
        arg lookupvalue: implementation-data-type=SInt8, type=SInt8, direction=IN
        arg Ptr_Lin_Return: implementation-data-type=SInt8, type=SInt8, direction=OUT
      Get_LinearInterpolateSWord
        arg ptr_table: implementation-data-type=SInt16, type=SInt16, direction=OUT
        arg lookupvalue: implementation-data-type=SInt16, type=SInt16, direction=IN
        arg Ptr_Lin_Return: implementation-data-type=SInt16, type=SInt16, direction=OUT
      Get_LinearInterpolateWord
        arg ptr_table: implementation-data-type=UInt16, type=UInt16, direction=OUT
        arg lookupvalue: implementation-data-type=UInt16, type=UInt16, direction=IN
        arg Ptr_Lin_Return: implementation-data-type=UInt16, type=UInt16, direction=OUT
  sender receiver interface TI_SR_CaculatedTachoValue: invalidation-policy{data-element=CalTachoValue, handle-invalid=DONT-INVALIDATE}
    data CalTachoValue: implementation-data-type=UInt16, type=UInt16
  sender receiver interface TI_SR_Tacho_Revp_Disp: invalidation-policy{data-element=REVP_DISP, handle-invalid=DONT-INVALIDATE}
    data REVP_DISP: implementation-data-type=Boolean, type=Boolean
  sender receiver interface TI_SR_Tacho_Revp_RPM: invalidation-policy{data-element=REVP_RPM, handle-invalid=DONT-INVALIDATE}
    data REVP_RPM: implementation-data-type=UInt16, type=UInt16
  6 x client server interface:
    TI_CS_NE1_Notify
      operation NE1_Recieve_Notify_Value
        arg NE1_SignalVal: implementation-data-type=UInt16, type=UInt16, direction=IN
    TI_UpdateCdd_GenericDIDRequestHandler
      operation UpdateCdd_GenericDIDRequestHandler: possible-error=TI_UpdateCdd_GenericDIDRequestHandler/E_NOT_OK
        7 x arg:
          OpStatus: implementation-data-type=DataTypes/UInt8, type=DataTypes/UInt8, direction=IN
          DID_Action: implementation-data-type=DataTypes/UInt8, type=DataTypes/UInt8, direction=IN
          DID: implementation-data-type=UInt16, type=UInt16, direction=IN
          ReqLength: implementation-data-type=UInt32, type=UInt32, direction=IN
          Buff: implementation-data-type=DataTypes/UInt8, type=DataTypes/UInt8, direction=IN
          ResLength: implementation-data-type=UInt32, type=UInt32, direction=OUT
          ErrorCode: implementation-data-type=DataTypes/UInt8, type=DataTypes/UInt8, direction=OUT
      error E_NOT_OK: error-code=1
    TI_UpdateCdd_GenericDownloadRequestHandler
      operation UpdateCdd_GenericDownloadRequestHandler: possible-error=TI_UpdateCdd_GenericDownloadRequestHandler/E_NOT_OK
        6 x arg:
          OpStatus: implementation-data-type=DataTypes/UInt8, type=DataTypes/UInt8, direction=IN
          DataFormatIdentifier: implementation-data-type=DataTypes/UInt8, type=DataTypes/UInt8, direction=IN
          MemoryAddress: implementation-data-type=UInt32, type=UInt32, direction=IN
          MemorySize: implementation-data-type=UInt32, type=UInt32, direction=IN
          BlockLength: implementation-data-type=UInt32, type=UInt32, direction=OUT
          ErrorCode: implementation-data-type=DataTypes/UInt8, type=DataTypes/UInt8, direction=OUT
      error E_NOT_OK: error-code=1
    TI_UpdateCdd_GenericRIDRequestHandler
      operation UpdateCdd_GenericRIDRequestHandler: possible-error=TI_UpdateCdd_GenericRIDRequestHandler/E_NOT_OK
        7 x arg:
          OpStatus: implementation-data-type=DataTypes/UInt8, type=DataTypes/UInt8, direction=IN
          RID_Action: implementation-data-type=DataTypes/UInt8, type=DataTypes/UInt8, direction=IN
          RID: implementation-data-type=UInt16, type=UInt16, direction=IN
          ReqLength: implementation-data-type=UInt32, type=UInt32, direction=IN
          Buff: implementation-data-type=DataTypes/UInt8, type=DataTypes/UInt8, direction=OUT
          ResLength: implementation-data-type=UInt32, type=UInt32, direction=OUT
          ErrorCode: implementation-data-type=DataTypes/UInt8, type=DataTypes/UInt8, direction=OUT
      error E_NOT_OK: error-code=1
    TI_UpdateCdd_GenericTransferDataHandler
      operation UpdateCdd_GenericTransferDataHandler: possible-error=TI_UpdateCdd_GenericTransferDataHandler/E_NOT_OK
        6 x arg:
          OpStatus: implementation-data-type=DataTypes/UInt8, type=DataTypes/UInt8, direction=IN
          MemoryIdentifier: implementation-data-type=DataTypes/UInt8, type=DataTypes/UInt8, direction=IN
          MemoryAddress: implementation-data-type=UInt32, type=UInt32, direction=IN
          MemorySize: implementation-data-type=UInt32, type=UInt32, direction=IN
          MemoryData: implementation-data-type=DataTypes/UInt8, type=DataTypes/UInt8, direction=IN
          ErrorCode: implementation-data-type=DataTypes/UInt8, type=DataTypes/UInt8, direction=OUT
      error E_NOT_OK: error-code=1
    TI_UpdateCdd_GenericTransferExitHandler
      operation UpdateCdd_GenericTransferExitHandler: possible-error=TI_UpdateCdd_GenericTransferExitHandler/E_NOT_OK
        6 x arg:
          OpStatus: implementation-data-type=DataTypes/UInt8, type=DataTypes/UInt8, direction=IN
          RequestfParameterRecord: implementation-data-type=DataTypes/UInt8, type=DataTypes/UInt8, direction=IN
          RequestParameterRecordSize: implementation-data-type=UInt32, type=UInt32, direction=IN
          ResponseParameterRecord: implementation-data-type=DataTypes/UInt8, type=DataTypes/UInt8, direction=OUT
          ResponseParameterRecordSize: implementation-data-type=UInt32, type=UInt32, direction=OUT
          ErrorCode: implementation-data-type=DataTypes/UInt8, type=DataTypes/UInt8, direction=OUT
      error E_NOT_OK: error-code=1
  impl type teDiagOpStatus: category=VALUE, base-type=uint8, compu {0=DIAG_INITIAL, 1=DIAG_PENDING, 2=DIAG_CANCEL, 3=DIAG_FORCE_RCRRP_OK, 64=DIAG_FORCE_RCRRP_NOT_OK}, range raw 0..64
  impl type teDIDOperation: category=VALUE, base-type=uint8, compu {0=eRead, 1=eWrite, 2=eSTA, 3=eRCTECU, 4=eCheckConditions, 5=eRST2DEFAULT, 6=eFCS, 7=eLengthCheck}, range raw 0..7
  client server interface TI_DID_App_Diag_Action
    operation DID_DiagAction: possible-error=TI_DID_App_Diag_Action/E_NOT_OK
      5 x arg:
        OpStatus: implementation-data-type=teDiagOpStatus, type=teDiagOpStatus, direction=IN
        DIDNum: implementation-data-type=UInt16, type=UInt16, direction=IN
        Data: implementation-data-type=DataTypes/UInt8, type=DataTypes/UInt8, direction=INOUT
        pNrc: implementation-data-type=DataTypes/UInt8, type=DataTypes/UInt8, direction=INOUT
        eOperation: implementation-data-type=teDIDOperation, type=teDIDOperation, direction=IN
    error E_NOT_OK: error-code=1
  impl type Dcm_NegativeResponseCodeType: category=VALUE, base-type=uint8, range raw 0..255
  client server interface TI_DiagEntrySts
    operation Diag_Entry_Status: possible-error=TI_DiagEntrySts/E_NOT_OK
      6 x arg:
        SID: implementation-data-type=DataTypes/UInt8, type=DataTypes/UInt8, direction=IN
        RequestData: implementation-data-type=DataTypes/UInt8, type=DataTypes/UInt8, direction=OUT
        RequestDataSize: implementation-data-type=UInt16, type=UInt16, direction=IN
        ReqType: implementation-data-type=DataTypes/UInt8, type=DataTypes/UInt8, direction=IN
        SourceAddress: implementation-data-type=UInt16, type=UInt16, direction=IN
        ErrorCode: implementation-data-type=Dcm_NegativeResponseCodeType, type=Dcm_NegativeResponseCodeType, direction=OUT
    error E_NOT_OK: error-code=1
  impl type teRoutineOperation: category=VALUE, base-type=uint8, compu {0=eRoutineStart, 1=eRoutineStop, 2=eRoutineResult}, range raw 0..2
  client server interface TI_RID_App_Diag_Action
    operation RID_DiagAction: possible-error=TI_RID_App_Diag_Action/E_NOT_OK
      7 x arg:
        OpStatus: implementation-data-type=teDiagOpStatus, type=teDiagOpStatus, direction=IN
        RIDNum: implementation-data-type=UInt16, type=UInt16, direction=IN
        Out_RoutineInfo: implementation-data-type=DataTypes/UInt8, type=DataTypes/UInt8, direction=INOUT
        Data: implementation-data-type=DataTypes/UInt8, type=DataTypes/UInt8, direction=INOUT
        DataLength: implementation-data-type=UInt16, type=UInt16, direction=OUT
        pNrc: implementation-data-type=DataTypes/UInt8, type=DataTypes/UInt8, direction=INOUT
        eOperation: implementation-data-type=teRoutineOperation, type=teRoutineOperation, direction=IN
    error E_NOT_OK: error-code=1
  client server interface TI_DemExt_ClearDTC
    operation DemExt_ClearDTC: possible-error=TI_DemExt_ClearDTC/E_NOT_OK
      arg ClientId: implementation-data-type=DataTypes/UInt8, type=DataTypes/UInt8, direction=IN
    error E_NOT_OK: error-code=1
  impl type Dem_EventIdType: category=VALUE, base-type=uint16, range raw 0..65535
  impl type Dem_EventStatusType: category=VALUE, base-type=uint8, range raw 0..255
  client server interface TI_DemExt_SetEventStatus
    operation DemExt_SetEventStatus: possible-error=TI_DemExt_SetEventStatus/E_NOT_OK
      arg EventId: implementation-data-type=Dem_EventIdType, type=Dem_EventIdType, direction=IN
      arg EventStatus: implementation-data-type=Dem_EventStatusType, type=Dem_EventStatusType, direction=IN
    error E_NOT_OK: error-code=1
  impl type Dem_OperationCycleStateType: category=VALUE, base-type=uint8, range raw 0..255
  client server interface TI_DemExt_SetOperationCycleState
    operation DemExt_SetOperationCycleState: possible-error=TI_DemExt_SetOperationCycleState/E_NOT_OK
      arg OperationCycleId: implementation-data-type=DataTypes/UInt8, type=DataTypes/UInt8, direction=IN
      arg CycleState: implementation-data-type=Dem_OperationCycleStateType, type=Dem_OperationCycleStateType, direction=IN
    error E_NOT_OK: error-code=1
  impl type Dem_DTCFormatType: category=VALUE, base-type=uint8, range raw 0..255
  client server interface TI_DemExt_GetDTCOfEvent
    operation DemExt_GetDTCOfEvent: possible-error=TI_DemExt_GetDTCOfEvent/E_NOT_OK
      arg EventId: implementation-data-type=Dem_EventIdType, type=Dem_EventIdType, direction=IN
      arg DTCFormat: implementation-data-type=Dem_DTCFormatType, type=Dem_DTCFormatType, direction=IN
      arg DTCOfEvent: implementation-data-type=UInt32, type=UInt32, direction=OUT
    error E_NOT_OK: error-code=1
  client server interface TI_DemExt_GetDTCSelectionResult
    operation DemExt_GetDTCSelectionResult: possible-error=TI_DemExt_GetDTCSelectionResult/E_NOT_OK
      arg ClientId: implementation-data-type=DataTypes/UInt8, type=DataTypes/UInt8, direction=IN
    error E_NOT_OK: error-code=1
  client server interface TI_DemExt_GetDTCSelectionResultForClearDTC
    operation DemExt_GetDTCSelectionResultForClearDTC: possible-error=TI_DemExt_GetDTCSelectionResultForClearDTC/E_NOT_OK
      arg ClientId: implementation-data-type=DataTypes/UInt8, type=DataTypes/UInt8, direction=IN
    error E_NOT_OK: error-code=1
  impl type Dem_DebouncingStateType: category=VALUE, base-type=uint8, range raw 0..255
  client server interface TI_DemExt_GetDebouncingOfEvent
    operation DemExt_GetDebouncingOfEvent: possible-error=TI_DemExt_GetDebouncingOfEvent/E_NOT_OK
      arg EventId: implementation-data-type=Dem_EventIdType, type=Dem_EventIdType, direction=IN
      arg DebouncingState: implementation-data-type=Dem_DebouncingStateType, type=Dem_DebouncingStateType, direction=OUT
    error E_NOT_OK: error-code=1
  client server interface TI_DemExt_GetEventExtendedDataRecordEx
    operation DemExt_GetEventExtendedDataRecordEx: possible-error=TI_DemExt_GetEventExtendedDataRecordEx/E_NOT_OK
      4 x arg:
        EventId: implementation-data-type=Dem_EventIdType, type=Dem_EventIdType, direction=IN
        RecordNumber: implementation-data-type=DataTypes/UInt8, type=DataTypes/UInt8, direction=IN
        DestBuffer: implementation-data-type=DataTypes/UInt8, type=DataTypes/UInt8, direction=OUT
        BufSize: implementation-data-type=UInt16, type=UInt16, direction=INOUT
    error E_NOT_OK: error-code=1
  client server interface TI_DemExt_GetEventFreezeFrameDataEx
    operation DemExt_GetEventFreezeFrameDataEx: possible-error=TI_DemExt_GetEventFreezeFrameDataEx/E_NOT_OK
      5 x arg:
        EventId: implementation-data-type=Dem_EventIdType, type=Dem_EventIdType, direction=IN
        RecordNumber: implementation-data-type=DataTypes/UInt8, type=DataTypes/UInt8, direction=IN
        DataId: implementation-data-type=UInt16, type=UInt16, direction=IN
        DestBuffer: implementation-data-type=DataTypes/UInt8, type=DataTypes/UInt8, direction=OUT
        BufSize: implementation-data-type=UInt16, type=UInt16, direction=INOUT
    error E_NOT_OK: error-code=1
  impl type Dem_UdsStatusByteType: category=VALUE, base-type=uint8, range raw 0..255
  client server interface TI_DemExt_GetEventUdsStatus
    operation DemExt_GetEventUdsStatus: possible-error=TI_DemExt_GetEventUdsStatus/E_NOT_OK
      arg EventId: implementation-data-type=Dem_EventIdType, type=Dem_EventIdType, direction=IN
      arg UDSStatusByte: implementation-data-type=Dem_UdsStatusByteType, type=Dem_UdsStatusByteType, direction=OUT
    error E_NOT_OK: error-code=1
  client server interface TI_DemExt_GetFaultDetectionCounter
    operation DemExt_GetFaultDetectionCounter: possible-error=TI_DemExt_GetFaultDetectionCounter/E_NOT_OK
      arg EventId: implementation-data-type=Dem_EventIdType, type=Dem_EventIdType, direction=IN
      arg FaultDetectionCounter: implementation-data-type=SInt8, type=SInt8, direction=OUT
    error E_NOT_OK: error-code=1
  impl type Dem_DTCOriginType: category=VALUE, base-type=uint8, range raw 0..255
  7 x client server interface:
    TI_DemExt_GetNumberOfEventMemoryEntries
      operation DemExt_GetNumberOfEventMemoryEntries: possible-error=TI_DemExt_GetNumberOfEventMemoryEntries/E_NOT_OK
        arg ClientId: implementation-data-type=DataTypes/UInt8, type=DataTypes/UInt8, direction=IN
        arg DTCOrigin: implementation-data-type=Dem_DTCOriginType, type=Dem_DTCOriginType, direction=IN
        arg NumberOfEventMemoryEntries: implementation-data-type=DataTypes/UInt8, type=DataTypes/UInt8, direction=OUT
      error E_NOT_OK: error-code=1
    TI_DemExt_GetOperationCycleState
      operation DemExt_GetOperationCycleState: possible-error=TI_DemExt_GetOperationCycleState/E_NOT_OK
        arg OperationCycleId: implementation-data-type=DataTypes/UInt8, type=DataTypes/UInt8, direction=IN
        arg CycleState: implementation-data-type=Dem_OperationCycleStateType, type=Dem_OperationCycleStateType, direction=OUT
      error E_NOT_OK: error-code=1
    TI_DemExt_SelectDTC
      operation DemExt_SelectDTC: possible-error=TI_DemExt_SelectDTC/E_NOT_OK
        4 x arg, all with direction=IN:
          ClientId: implementation-data-type=DataTypes/UInt8, type=DataTypes/UInt8
          DTC: implementation-data-type=UInt32, type=UInt32
          DTCFormat: implementation-data-type=Dem_DTCFormatType, type=Dem_DTCFormatType
          DTCOrigin: implementation-data-type=Dem_DTCOriginType, type=Dem_DTCOriginType
      error E_NOT_OK: error-code=1
    TI_DemExt_SetEnableCondition
      operation DemExt_SetEnableCondition: possible-error=TI_DemExt_SetEnableCondition/E_NOT_OK
        arg EnableConditionID: implementation-data-type=DataTypes/UInt8, type=DataTypes/UInt8, direction=IN
        arg ConditionFulfilled: implementation-data-type=Boolean, type=Boolean, direction=IN
      error E_NOT_OK: error-code=1
    TI_DemExt_SetEventAvailable
      operation DemExt_SetEventAvailable: possible-error=TI_DemExt_SetEventAvailable/E_NOT_OK
        arg EventId: implementation-data-type=Dem_EventIdType, type=Dem_EventIdType, direction=IN
        arg AvailableStatus: implementation-data-type=Boolean, type=Boolean, direction=IN
      error E_NOT_OK: error-code=1
    TI_DemExt_SetStorageCondition
      operation DemExt_SetStorageCondition: possible-error=TI_DemExt_SetStorageCondition/E_NOT_OK
        arg StorageConditionID: implementation-data-type=DataTypes/UInt8, type=DataTypes/UInt8, direction=IN
        arg ConditionFulfilled: implementation-data-type=Boolean, type=Boolean, direction=IN
      error E_NOT_OK: error-code=1
    TI_Display_I2cSeqCallback
      operation I2cSeqEndCallback
  impl type EGammaCorrectionStatus: category=VALUE, base-type=uint8, compu {0=eDisplayCdd_GammaCorrection_None, 1=eDisplayCdd_GammaCorrection_OnGoing, 2=eDisplayCdd_GammaCorrection_Success, 3=eDisplayCdd_GammaCorrection_Failure}, range raw 0..3
  client server interface TI_Display_GammaCorrection
    operation GetGammaCorrectionStatus
      arg GmaCrStatus: implementation-data-type=EGammaCorrectionStatus, type=EGammaCorrectionStatus, direction=OUT
    operation SetGammaCorrection: possible-error=TI_Display_GammaCorrection/E_NOT_OK
      arg GmaSetPtr: implementation-data-type=DataTypes/UInt8, type=DataTypes/UInt8, direction=OUT
      arg datalength: implementation-data-type=DataTypes/UInt8, type=DataTypes/UInt8, direction=IN
    error E_NOT_OK: error-code=1
  sender receiver interface TI_DisplaySetPower: invalidation-policy{data-element=TI_DisplaySetPower/DisplaySetPowerData, handle-invalid=DONT-INVALIDATE}
    data DisplaySetPowerData: implementation-data-type=SDisplaySetPower, type=SDisplaySetPower
  impl type EDisplayCddStatus: category=VALUE, base-type=uint8, compu {0=eDisplayNotReady, 1=eDisplayReady, 2=eDisplayBusy, 3=eDisplayFaultHandle, 4=eDisplayMaxStatus}, range raw 0..4
  client server interface TI_Display_Status
    operation GetStatus: possible-error=TI_Display_Status/E_NOT_OK
      arg DeviceId: implementation-data-type=EDisplayType, type=EDisplayType, direction=IN
      arg DeviceStatus: implementation-data-type=EDisplayCddStatus, type=EDisplayCddStatus, direction=OUT
      arg DisplayPowerState: implementation-data-type=EDisplayPowerState, type=EDisplayPowerState, direction=OUT
    operation SetState: possible-error=TI_Display_Status/E_NOT_OK
      arg DeviceID: implementation-data-type=EDisplayType, type=EDisplayType, direction=IN
      arg PowerState: implementation-data-type=EDisplayPowerState, type=EDisplayPowerState, direction=IN
    error E_NOT_OK: error-code=1
  client server interface TI_FltM_HandlePostReset
    operation FltM_HandlePostReset
  impl type eFltM_FaultIdType:
    category=VALUE
    base-type=uint16
    compu {65281=E_OS_ACCESS, 65282=E_OS_CALLLEVEL, 65283=E_OS_ID, 65284=E_OS_LIMIT, 65285=E_OS_NOFUNC, 65286=E_OS_RESOURCE, 65287=E_OS_STATE, 65288=E_OS_VALUE, 65289=E_OS_SERVICEID, 65290=E_OS_ILLEGAL_ADDRESS, 65291=E_OS_MISSINGEND, 65292=E_OS_DISABLEDINT, 65293=E_OS_STACKFAULT, 65294=E_OS_PROTECTION_MEMORY, 65295=E_OS_PROTECTION_TIME, 65296=E_OS_PROTECTION_ARRIVAL, 65297=E_OS_PROTECTION_LOCKED, 65298=E_OS_PROTECTION_EXCEPTION, 65299=E_OS_INTERFERENCE_DEADLOCK, 65300=E_OS_NESTING_DEADLOCK, 65301=E_OS_SPINLOCK, 65302=E_OS_CORE, 65303=E_OS_PARAM_POINTER, 65304=E_OS_SHUTDOWN, 65305=E_OS_SYS_API_ERROR, 65520=E_OS_SYS_ASSERTION, 65521=E_OS_SYS_DISABLED, 65522=E_OS_SYS_NO_BARRIER_PARTICIPANT, 65523=E_OS_SYS_UNIMPLEMENTED_FUNCTIONALITY, 65524=E_OS_SYS_NO_NTFSTACK, 65525=E_OS_SYS_OVERFLOW, 65526=E_OS_SYS_KILL_KERNEL_OBJ, 65527=E_OS_SYS_NO_RESTARTTASK, 65528=E_OS_SYS_CALL_NOT_ALLOWED, 65529=E_OS_SYS_FUNCTION_UNAVAILABLE, 65530=E_OS_SYS_PROTECTION_SYSCALL, 65531=E_OS_SYS_PROTECTION_IRQ, 65532=E_OS_SYS_OVERLOAD, 65533=E_OS_SYS_CROSS_CORE_REQUESTED, 64001=E_ARM_NMI_EVENT, 64002=E_ARM_HARD_FAULT, 64003=E_ARM_MEMMANAGE_FAULT, 64004=E_ARM_BUS_FAULT, 64005=E_ARM_USAGE_FAULT, 64006=E_ARM_DEBUG_MONITOR, 64007=E_ARM_PENDING_SV, 64241=E_ARM_UNDEFINED_INSTRUCTION, 64242=E_ARM_Supervisor_Call, 64243=E_ARM_PREFETCH_ABORT, 64244=E_ARM_DATA_ABORT, 64245=E_ARM_SUPERVISOR, 64246=E_ARM_UNDEFINED, 64247=E_ARM_SVC, 64248=E_ARM_PREFETCH_ABORT_R5, 64249=E_ARM_PREFETCH_ABOR_R5, 64257=NVM_E_HARDWARE, 64258=NVM_E_INTEGRITY_FAILED, 64259=E_NVM_REQ_FAILED, 64260=E_NVM_WRONG_BLOCK_ID, 64261=E_NVM_VERIFY_FAILED, 64262=E_NVM_LOSS_OF_REDUNDANCY, 64263=E_NVM_WRITE_FAILED, 64264=E_NVM_READ_FAILED, 64512=RESET_UNDEFINED, 64513=POWER_ON_RESET, 64514=MCU_PORz, 64515=SW_MAIN_PORz, 64516=MCU_RESETz, 64517=SW_MCU_WARMRSTz, 64518=MAIN_RESETz_REQ, 64519=SW_MAIN_WARMRSTz, 64520=VTM_THERMAL_RESET, 64521=ESM_ERRORz, 64522=SMS_COLD_OUT_RST_n, 64523=SMS_WARM_OUT_RST_n, 64524=DM_WDT_RST_n, 63745=DET_ERROR, 63746=WDGM_ALIVE_FAIL, 63747=FOTA_RESET, 63748=DIAG_RESET, 63749=RAM_TST_ERROR, 63750=CAN_LOOP_TEST_ERROR, 63751=FLS_TST_ERROR, 63752=EARLY_WAKEUP, 63753=CORE_SYS_TST_ERROR, 63754=WAKEUP_SEQ_TIMELIMIT_FAULT, 63755=TFT_RECOVERYTIMELIMIT_FAULT, 63756=NVM_WRITE_FAIL, 63757=ADC_TEST, 63758=WDM_TIMER_FAIL, 63759=CM_TEST_FAIL, 63760=DMA_TEST_FAIL, 63761=PPU_TEST_FAIL, 63762=POWER_SUPPLY_FAULT, 63763=ECC_FAULT, 63764=DCC_FAIL, 63765=OCOC_FAIL, 63766=GIP_HEALTH_FAIL, 63767=HSM_WDG_FAIL, 63768=POK_FAULT, 63769=DM_WDG_FAIL, 63770=FIREWALL_ACCESS_FAIL, 63771=FALSH_INTEGRITY_FAIL, 63772=TOG_FAULT, 63773=VTM_FAULT, 63774=DM_SAFETY_CHECK_PWR_FAIL, 63775=DM_SAFETY_CHECK_RES_FAIL, 63776=TIFS_SAFETY_CHECK_FWL_FAIL, 63777=SCI_CLIENT_PM_CLOCK_FAIL, 63778=SCI_CLIENT_PM_RESET_FAIL, 63779=SCI_CLIENT_PM_LPM_FAIL, 63780=SCI_CLIENT_RM_IRQ_FAIL, 63781=SCI_CLIENT_RM_FWL_FAIL, 63782=SCI_CLIENT_RM_UDMA_FAIL, 63783=SCI_CLIENT_RM_PSIL_FAIL, 63784=DM_BOOT_STAGE1_FAIL, 63785=DM_BOOT_STAGE2_FAIL, 63786=DM_DDR_FAIL, 63787=DM_eMMC_FAIL, 63788=DM_QSPI_FAIL, 63789=DM_STACK_FAIL, 63790=DM_OS_ERROR, 63791=DM_SCI_SERVER_FAIL, 63792=JTAG_PWD_FEED_FAIL, 63793=BM_SB_FAIL, 63794=FBL_SB_FAIL, 63795=APP_SB_FAIL, 63796=CRC_SB_FAIL, 63797=HSM_OS_ERROR, 63798=HSM_MAC_FAIL, 63799=HSM_CIPHER_FAIL, 63800=HSM_KEY_FAIL, 63801=HSM_SEED_FAIL, 63802=HSM_FWL_FAIL, 63784=EXT_WDG_RESET, 63785=EXT_WDG_COMM_ERROR}
    range raw 63745..65533
  impl type eFltM_FaultStatusType: category=VALUE, base-type=uint8, compu {0=FLTM_NONE, 1=FLTM_INACTIVE, 2=FLTM_ACTIVE, 3=FLTM_CHANGED}, range raw 0..3
  client server interface TI_FltM_ReportFault
    operation FltM_ReportFault: possible-error=TI_FltM_ReportFault/E_NOT_OK
      4 x arg:
        FaultId: implementation-data-type=eFltM_FaultIdType, type=eFltM_FaultIdType, direction=IN
        FaultStatus: implementation-data-type=eFltM_FaultStatusType, type=eFltM_FaultStatusType, direction=IN
        LogData: implementation-data-type=DataTypes/UInt8, type=DataTypes/UInt8, direction=OUT
        LogLength: implementation-data-type=UInt16, type=UInt16, direction=IN
    error E_NOT_OK: error-code=1
  impl type Dlt_SessionIDType: category=VALUE, base-type=uint32, range raw 0..4294967295
  impl type Dlt_MessageArgumentCount: category=VALUE, base-type=uint16, range raw 0..65535
  5 x impl type:
    Dlt_MessageLogLevelType: category=VALUE, base-type=uint8, compu {0=DLT_LOG_OFF, 1=DLT_LOG_FATAL, 2=DLT_LOG_ERROR, 3=DLT_LOG_WARN, 4=DLT_LOG_INFO, 5=DLT_LOG_DEBUG, 6=DLT_LOG_VERBOSE}, range raw 0..6
    Dlt_MessageOptionsType: category=VALUE, base-type=uint8, range raw 0..255
    Dlt_ContextIDType: category=ARRAY
      element ArrayElement: category=VALUE, array-size=4, array-size-semantics=FIXED-SIZE, base-type=uint8
    Dlt_ApplicationIDType: category=ARRAY
      element ArrayElement: category=VALUE, array-size=4, array-size-semantics=FIXED-SIZE, base-type=uint8
    Dlt_MessageLogInfoType: category=STRUCTURE
      5 x element, all with category=TYPE_REFERENCE:
        argCount: implementation-data-type=Dlt_MessageArgumentCount
        logLevel: implementation-data-type=Dlt_MessageLogLevelType
        options: implementation-data-type=Dlt_MessageOptionsType
        contextId: implementation-data-type=Dlt_ContextIDType
        appId: implementation-data-type=Dlt_ApplicationIDType
  5 x client server interface:
    If_CS_Dlt_SendLogMessage
      operation SendLogMessage: possible-error=If_CS_Dlt_SendLogMessage/E_NOT_OK
        4 x arg:
          sessionId: implementation-data-type=Dlt_SessionIDType, type=Dlt_SessionIDType, direction=IN
          logInfo: implementation-data-type=Dlt_MessageLogInfoType, type=Dlt_MessageLogInfoType, direction=IN
          logData: implementation-data-type=DataTypes/UInt8, type=DataTypes/UInt8, direction=OUT
          logDataLength: implementation-data-type=UInt16, type=UInt16, direction=IN
      error E_NOT_OK: error-code=1
    TI_RstM_ClearResetHistory
      operation RstM_GetResetHistory: possible-error=TI_RstM_ClearResetHistory/E_NOT_OK
      error E_NOT_OK: error-code=1
    TI_RstM_GetLastResetReason
      operation RstM_GetLastResetReason: possible-error=TI_RstM_GetLastResetReason/E_NOT_OK
        arg pFaultId: implementation-data-type=eFltM_FaultIdType, type=eFltM_FaultIdType, direction=OUT
      error E_NOT_OK: error-code=1
    TI_RstM_GetResetCount
      operation RstM_GetResetCount: possible-error=TI_RstM_GetResetCount/E_NOT_OK
        arg FaultId: implementation-data-type=eFltM_FaultIdType, type=eFltM_FaultIdType, direction=IN
        arg count: implementation-data-type=DataTypes/UInt8, type=DataTypes/UInt8, direction=OUT
      error E_NOT_OK: error-code=1
    TI_RstM_GetResetHistory
      operation RstM_GetResetHistory: possible-error=TI_RstM_GetResetHistory/E_NOT_OK
        arg ResetHistory: implementation-data-type=DataTypes/UInt8, type=DataTypes/UInt8, direction=OUT
      error E_NOT_OK: error-code=1
  impl type RstM_ResetType: category=VALUE, base-type=uint8, compu {0=NONE, 1=PMIC_RESET, 2=MCU_RESET}, range raw 0..2
  4 x client server interface:
    TI_RstM_RequestSwReset
      operation RstM_RequestSwReset: possible-error=TI_RstM_RequestSwReset/E_NOT_OK
        4 x arg:
          FaultId: implementation-data-type=eFltM_FaultIdType, type=eFltM_FaultIdType, direction=IN
          ResetType: implementation-data-type=RstM_ResetType, type=RstM_ResetType, direction=IN
          LogData: implementation-data-type=DataTypes/UInt8, type=DataTypes/UInt8, direction=OUT
          LogLength: implementation-data-type=UInt16, type=UInt16, direction=IN
      error E_NOT_OK: error-code=1
    if_CS_DltExt_GetResetInfo
      operation GetResetInfo: possible-error=if_CS_DltExt_GetResetInfo/E_NOT_OK
        arg ResetHistory: implementation-data-type=DataTypes/UInt8, type=DataTypes/UInt8, direction=OUT
      error E_NOT_OK: error-code=1
    If_CS_Dlt_DetForwardErrorTrace
      operation DetForwardErrorTrace
        4 x arg, all with direction=IN:
          moduleId: implementation-data-type=UInt16, type=UInt16
          instanceId: implementation-data-type=DataTypes/UInt8, type=DataTypes/UInt8
          apiId: implementation-data-type=DataTypes/UInt8, type=DataTypes/UInt8
          errorId: implementation-data-type=DataTypes/UInt8, type=DataTypes/UInt8
    If_CS_Dlt_GetDefaultLogLevel
      operation GetDefaultLogLevel: possible-error=If_CS_Dlt_GetDefaultLogLevel/E_NOT_OK
        arg defaultLogLevel: implementation-data-type=Dlt_MessageLogLevelType, type=Dlt_MessageLogLevelType, direction=OUT
      error E_NOT_OK: error-code=1
  impl type Dlt_LogChannelNameType: category=ARRAY
    element ArrayElement: category=VALUE, array-size=4, array-size-semantics=FIXED-SIZE, base-type=uint8
  client server interface If_CS_Dlt_GetDefaultTraceStatus
    operation GetDefaultTraceStatus: possible-error=If_CS_Dlt_GetDefaultTraceStatus/E_NOT_OK
      arg logChannelName: implementation-data-type=Dlt_LogChannelNameType, type=Dlt_LogChannelNameType, direction=OUT
      arg traceStatus: implementation-data-type=Boolean, type=Boolean, direction=OUT
    error E_NOT_OK: error-code=1
  client server interface If_CS_Dlt_GetLogChannelNames
    operation GetLogChannelNames: possible-error=If_CS_Dlt_GetLogChannelNames/E_NOT_OK
      arg numberOfLogChannels: implementation-data-type=DataTypes/UInt8, type=DataTypes/UInt8, direction=OUT
      arg logChannelNames: implementation-data-type=Dlt_LogChannelNameType, type=Dlt_LogChannelNameType, direction=OUT
    error E_NOT_OK: error-code=1
  client server interface If_CS_Dlt_GetLogChannelThreshold
    operation GetLogChannelThreshold: possible-error=If_CS_Dlt_GetLogChannelThreshold/E_NOT_OK
      arg logChannelName: implementation-data-type=Dlt_LogChannelNameType, type=Dlt_LogChannelNameType, direction=OUT
      arg logChannelThreshold: implementation-data-type=Dlt_MessageLogLevelType, type=Dlt_MessageLogLevelType, direction=OUT
      arg traceStatus: implementation-data-type=Boolean, type=Boolean, direction=OUT
    error E_NOT_OK: error-code=1
  impl type Dlt_ContextIdInfoType: category=STRUCTURE
    5 x element, all with category=TYPE_REFERENCE:
      contextId: implementation-data-type=Dlt_ContextIDType
      logLevel: implementation-data-type=Dlt_MessageLogLevelType
      traceStatus: implementation-data-type=DataTypes/UInt8
      lenContextDescription: implementation-data-type=UInt16
      contextDesc: implementation-data-type=DataTypes/UInt8
  impl type Dlt_ApplicationIdInfoType: category=STRUCTURE
    5 x element, all with category=TYPE_REFERENCE:
      appId: implementation-data-type=Dlt_ApplicationIDType
      contextIdCount: implementation-data-type=UInt16
      contextInfoList: implementation-data-type=Dlt_ContextIdInfoType
      appDescLen: implementation-data-type=UInt16
      appDesc: implementation-data-type=DataTypes/UInt8
  impl type Dlt_LogInfoType: category=STRUCTURE
    element appIdCount: implementation-data-type=UInt16
    element appIdInfo: implementation-data-type=Dlt_ApplicationIdInfoType
  5 x client server interface:
    If_CS_Dlt_GetLogInfo
      operation GetLogInfo: possible-error=If_CS_Dlt_GetLogInfo/E_NOT_OK
        5 x arg:
          options: implementation-data-type=DataTypes/UInt8, type=DataTypes/UInt8, direction=IN
          appId: implementation-data-type=Dlt_ApplicationIDType, type=Dlt_ApplicationIDType, direction=OUT
          contextId: implementation-data-type=Dlt_ContextIDType, type=Dlt_ContextIDType, direction=OUT
          status: implementation-data-type=DataTypes/UInt8, type=DataTypes/UInt8, direction=OUT
          logInfo: implementation-data-type=Dlt_LogInfoType, type=Dlt_LogInfoType, direction=OUT
      error E_NOT_OK: error-code=1
    If_CS_Dlt_GetTraceStatus
      operation GetTraceStatus: possible-error=If_CS_Dlt_GetTraceStatus/E_NOT_OK
        arg appId: implementation-data-type=Dlt_ApplicationIDType, type=Dlt_ApplicationIDType, direction=OUT
        arg contextId: implementation-data-type=Dlt_ContextIDType, type=Dlt_ContextIDType, direction=OUT
        arg traceStatus: implementation-data-type=Boolean, type=Boolean, direction=OUT
      error E_NOT_OK: error-code=1
    If_CS_Dlt_InjectCall_SESSION
      operation InjectCall_SESSION
        5 x arg:
          appId: implementation-data-type=Dlt_ApplicationIDType, type=Dlt_ApplicationIDType, direction=OUT
          contextId: implementation-data-type=Dlt_ContextIDType, type=Dlt_ContextIDType, direction=OUT
          serviceId: implementation-data-type=UInt32, type=UInt32, direction=IN
          dataLength: implementation-data-type=UInt32, type=UInt32, direction=IN
          data: implementation-data-type=DataTypes/UInt8, type=DataTypes/UInt8, direction=OUT
    If_CS_Dlt_RegisterContext
      operation RegisterContext: possible-error=If_CS_Dlt_RegisterContext/E_NOT_OK
        7 x arg:
          sessionId: implementation-data-type=Dlt_SessionIDType, type=Dlt_SessionIDType, direction=IN
          appId: implementation-data-type=Dlt_ApplicationIDType, type=Dlt_ApplicationIDType, direction=OUT
          contextId: implementation-data-type=Dlt_ContextIDType, type=Dlt_ContextIDType, direction=OUT
          appDescription: implementation-data-type=DataTypes/UInt8, type=DataTypes/UInt8, direction=OUT
          lenAppDescription: implementation-data-type=DataTypes/UInt8, type=DataTypes/UInt8, direction=IN
          contextDescription: implementation-data-type=DataTypes/UInt8, type=DataTypes/UInt8, direction=OUT
          lenContextDescription: implementation-data-type=DataTypes/UInt8, type=DataTypes/UInt8, direction=IN
      error E_NOT_OK: error-code=1
    If_CS_Dlt_ResetToFactoryDefault
      operation ResetToFactoryDefault: possible-error=If_CS_Dlt_ResetToFactoryDefault/E_NOT_OK
      error E_NOT_OK: error-code=1
  impl type Dlt_MessageTraceType: category=VALUE, base-type=uint8, compu {1=DLT_TRACE_VARIABLE, 2=DLT_TRACE_FUNCTION_IN, 3=DLT_TRACE_FUNCTION_OUT, 4=DLT_TRACE_STATE, 5=DLT_TRACE_VFB}, range raw 1..5
  impl type Dlt_MessageTraceInfoType: category=STRUCTURE
    4 x element, all with category=TYPE_REFERENCE:
      traceInfo: implementation-data-type=Dlt_MessageTraceType
      options: implementation-data-type=Dlt_MessageOptionsType
      context: implementation-data-type=Dlt_ContextIDType
      appId: implementation-data-type=Dlt_ApplicationIDType
  client server interface If_CS_Dlt_SendTraceMessage
    operation SendTraceMessage: possible-error=If_CS_Dlt_SendTraceMessage/E_NOT_OK
      4 x arg:
        sessionId: implementation-data-type=Dlt_SessionIDType, type=Dlt_SessionIDType, direction=IN
        traceInfo: implementation-data-type=Dlt_MessageTraceInfoType, type=Dlt_MessageTraceInfoType, direction=IN
        traceData: implementation-data-type=DataTypes/UInt8, type=DataTypes/UInt8, direction=OUT
        traceDataLength: implementation-data-type=UInt16, type=UInt16, direction=IN
    error E_NOT_OK: error-code=1
  client server interface If_CS_Dlt_SetDefaultLogLevel
    operation SetDefaultLogLevel: possible-error=If_CS_Dlt_SetDefaultLogLevel/E_NOT_OK
      arg newLogLevel: implementation-data-type=Dlt_MessageLogLevelType, type=Dlt_MessageLogLevelType, direction=IN
    error E_NOT_OK: error-code=1
  client server interface If_CS_Dlt_SetDefaultTraceStatus
    operation SetDefaultTraceStatus: possible-error=If_CS_Dlt_SetDefaultTraceStatus/E_NOT_OK
      arg newTraceStatus: implementation-data-type=Boolean, type=Boolean, direction=IN
      arg logChannelName: implementation-data-type=Dlt_LogChannelNameType, type=Dlt_LogChannelNameType, direction=OUT
    error E_NOT_OK: error-code=1
  impl type Dlt_AssignmentOperation: category=VALUE, base-type=uint8, compu {1=DLT_ASSIGN_ADD, 2=DLT_ASSIGN_REMOVE}, range raw 1..2
  7 x client server interface:
    If_CS_Dlt_SetLogChannelAssignment
      operation SetLogChannelAssignment: possible-error=If_CS_Dlt_SetLogChannelAssignment/E_NOT_OK
        4 x arg:
          appId: implementation-data-type=Dlt_ApplicationIDType, type=Dlt_ApplicationIDType, direction=OUT
          contextId: implementation-data-type=Dlt_ContextIDType, type=Dlt_ContextIDType, direction=OUT
          logChannelName: implementation-data-type=Dlt_LogChannelNameType, type=Dlt_LogChannelNameType, direction=OUT
          addRemoveOp: implementation-data-type=Dlt_AssignmentOperation, type=Dlt_AssignmentOperation, direction=IN
      error E_NOT_OK: error-code=1
    If_CS_Dlt_SetLogChannelThreshold
      operation SetLogChannelThreshold: possible-error=If_CS_Dlt_SetLogChannelThreshold/E_NOT_OK
        arg logChannelName: implementation-data-type=Dlt_LogChannelNameType, type=Dlt_LogChannelNameType, direction=OUT
        arg newThreshold: implementation-data-type=Dlt_MessageLogLevelType, type=Dlt_MessageLogLevelType, direction=IN
        arg newTraceStatus: implementation-data-type=Boolean, type=Boolean, direction=IN
      error E_NOT_OK: error-code=1
    If_CS_Dlt_SetLogLevel
      operation SetLogLevel: possible-error=If_CS_Dlt_SetLogLevel/E_NOT_OK
        arg appId: implementation-data-type=Dlt_ApplicationIDType, type=Dlt_ApplicationIDType, direction=OUT
        arg contextId: implementation-data-type=Dlt_ContextIDType, type=Dlt_ContextIDType, direction=OUT
        arg newLogLevel: implementation-data-type=Dlt_MessageLogLevelType, type=Dlt_MessageLogLevelType, direction=IN
      error E_NOT_OK: error-code=1
    If_CS_Dlt_SetTraceStatus
      operation SetTraceStatus: possible-error=If_CS_Dlt_SetTraceStatus/E_NOT_OK
        arg appId: implementation-data-type=Dlt_ApplicationIDType, type=Dlt_ApplicationIDType, direction=OUT
        arg contextId: implementation-data-type=Dlt_ContextIDType, type=Dlt_ContextIDType, direction=OUT
        arg newTraceStatus: implementation-data-type=Boolean, type=Boolean, direction=IN
      error E_NOT_OK: error-code=1
    If_CS_Dlt_StoreConfiguration
      operation StoreConfiguration: possible-error=If_CS_Dlt_StoreConfiguration/E_NOT_OK
      error E_NOT_OK: error-code=1
    If_CS_Dlt_UnregisterContext
      operation UnregisterContext: possible-error=If_CS_Dlt_UnregisterContext/E_NOT_OK
        arg sessionId: implementation-data-type=Dlt_SessionIDType, type=Dlt_SessionIDType, direction=IN
        arg appId: implementation-data-type=Dlt_ApplicationIDType, type=Dlt_ApplicationIDType, direction=OUT
        arg contextId: implementation-data-type=Dlt_ContextIDType, type=Dlt_ContextIDType, direction=OUT
      error E_NOT_OK: error-code=1
    TI_EcuMExt_GetResetReason
      operation GetResetReason: possible-error=TI_EcuMExt_GetResetReason/E_NOT_OK
      error E_NOT_OK: error-code=1
  impl type EcuM_UserType: category=VALUE, base-type=uint8, range raw 0..255
  client server interface TI_EcuMExt_ReleaseRUN
    operation ReleaseRUN: possible-error=TI_EcuMExt_ReleaseRUN/E_NOT_OK
      arg user: implementation-data-type=EcuM_UserType, type=EcuM_UserType, direction=IN
    error E_NOT_OK: error-code=1
  client server interface TI_EcuMExt_RequestRUN
    operation RequestRUN: possible-error=TI_EcuMExt_RequestRUN/E_NOT_OK
      arg user: implementation-data-type=EcuM_UserType, type=EcuM_UserType, direction=IN
    error E_NOT_OK: error-code=1
  client server interface if_CS_EcuAppM
    operation EcuAppM_SetWakeupSources
      arg WakeupSource: implementation-data-type=UInt32, type=UInt32, direction=IN
    operation Init
  impl type Rtc_TimeType: category=STRUCTURE
    7 x element, all with category=TYPE_REFERENCE:
      year: implementation-data-type=UInt16
      month: implementation-data-type=DataTypes/UInt8
      week: implementation-data-type=DataTypes/UInt8
      day: implementation-data-type=DataTypes/UInt8
      hour: implementation-data-type=DataTypes/UInt8
      minute: implementation-data-type=DataTypes/UInt8
      second: implementation-data-type=DataTypes/UInt8
  impl type Rtc_AlarmType: category=STRUCTURE
    element day: implementation-data-type=DataTypes/UInt8
    element minute: implementation-data-type=DataTypes/UInt8
    element hour: implementation-data-type=DataTypes/UInt8
  client server interface if_CS_TIRtcServices
    4 x operation, all with possible-error=if_CS_TIRtcServices/E_NOT_OK:
      RtcCdd_ClearAlarm
      RtcCdd_GetTime
        arg p_time: implementation-data-type=Rtc_TimeType, type=Rtc_TimeType, direction=OUT
      RtcCdd_SetAlarm
        arg p_alarm: implementation-data-type=Rtc_AlarmType, type=Rtc_AlarmType, direction=IN
      RtcCdd_SetTime
        arg p_time: implementation-data-type=Rtc_TimeType, type=Rtc_TimeType, direction=IN
    error E_NOT_OK: error-code=1
  client server interface if_CS_SndCdd_AmpDiag
    operation GetSpeaker_status: possible-error=if_CS_SndCdd_AmpDiag/E_NOT_OK
      arg SpkrState: implementation-data-type=DataTypes/UInt8, type=DataTypes/UInt8, direction=OUT
      arg SpkrDiagStatus: implementation-data-type=DataTypes/UInt8, type=DataTypes/UInt8, direction=OUT
    operation SpkrAmp_Recovery: possible-error=if_CS_SndCdd_AmpDiag/E_NOT_OK
    error E_NOT_OK: error-code=1
  impl type ELastToneStatus: category=VALUE, base-type=boolean, range raw 0..1
  impl type ESndToneInterruptableType: category=VALUE, base-type=uint8, compu {0=eSndToneInterruptableType_NotInterruptible, 1=eSndToneInterruptableType_Interruptible}, range raw 0..1
  impl type SSndToneDB: category=STRUCTURE
    8 x element, all with category=TYPE_REFERENCE:
      pRawTone_ID: implementation-data-type=UInt32
      ToneDeadTime: implementation-data-type=UInt32
      ToneRepetitions: implementation-data-type=DataTypes/UInt8
      Tone_Mixer_Volume: implementation-data-type=DataTypes/UInt8
      Tone_Mixer_FadeIn_Time: implementation-data-type=DataTypes/UInt8
      Tone_Mixer_FadeOut_Time: implementation-data-type=DataTypes/UInt8
      eToneInterruptible: implementation-data-type=ESndToneInterruptableType
      pLinkedTone: implementation-data-type=SSndToneDB
  impl type SSndChimeDB: category=STRUCTURE
    9 x element, all with category=TYPE_REFERENCE:
      eChimeID: implementation-data-type=EChimeID
      ChimeRepeatCnt: implementation-data-type=DataTypes/UInt8
      pLinkedTone: implementation-data-type=SSndToneDB
      pChimeEndToneID: implementation-data-type=SSndToneDB
      UniqueWaveID: implementation-data-type=DataTypes/UInt8
      ChimeChnlBaseVolume: implementation-data-type=DataTypes/UInt8
      SecondaryLinkedToneID: implementation-data-type=SSndToneDB
      SecondaryLinkedEndToneID: implementation-data-type=SSndToneDB
      SafetyChime: implementation-data-type=DataTypes/UInt8
  impl type EChimeType: category=VALUE, base-type=uint8, compu {0=eChimeEvent, 15=eChimeContinuous}, range raw 0..15
  impl type SSndCddChimeData: category=STRUCTURE
    element ChannelId: implementation-data-type=DataTypes/UInt8
    element ChimeType: implementation-data-type=EChimeType
    element DynamicDeadTime: implementation-data-type=UInt16
  impl type ESndInterruptType: category=VALUE, base-type=uint8, compu {0=eSndCdd_InterruptType_None, 1=eSndCdd_InterruptType_TypeA, 2=eSndCdd_InterruptType_TypeB, 3=eSndCdd_InterruptType_TypeDA, 4=eSndCdd_InterruptType_TypeDB, 5=eSndCdd_InterruptType_Immidiate, 6=eSndCdd_InterruptType_Tone, 7=eSndCdd_InterruptType_SoundUnit, 8=eSndCdd_InterruptType_TypeC, 9=eSndCdd_InterruptType_TypeD}, range raw 0..9
  client server interface if_CS_Sndcdd_Services
    16 x operation, all with possible-error=if_CS_Sndcdd_Services/E_NOT_OK:
      CheckChimeStatus
        arg ChimeId: implementation-data-type=EChimeID, type=EChimeID, direction=IN
        arg pChimeStatus: implementation-data-type=EChimeStatus, type=EChimeStatus, direction=OUT
      CheckLastToneStatus
        arg ChimeId: implementation-data-type=EChimeID, type=EChimeID, direction=IN
        arg pLastToneStatus: implementation-data-type=ELastToneStatus, type=ELastToneStatus, direction=OUT
      ClearChimeResumeInfoBuffer
        arg ChimeId: implementation-data-type=EChimeID, type=EChimeID, direction=IN
      GetChimeResumeInfoBuffer
        arg ChimeId: implementation-data-type=EChimeID, type=EChimeID, direction=IN
        arg Resume_Count: implementation-data-type=DataTypes/UInt8, type=DataTypes/UInt8, direction=OUT
      RequestCustomChime
        arg pCustomChimeDescP: implementation-data-type=SSndChimeDB, type=SSndChimeDB, direction=OUT
      RequestToClear_SafetyChimeErrorStatus
        arg ChimeId: implementation-data-type=EChimeID, type=EChimeID, direction=IN
      RequestToStart
        arg ChimeId: implementation-data-type=EChimeID, type=EChimeID, direction=IN
        arg ChimeDataBase: implementation-data-type=SSndCddChimeData, type=SSndCddChimeData, direction=IN
      RequestToStop
        arg ChannelId: implementation-data-type=DataTypes/UInt8, type=DataTypes/UInt8, direction=IN
        arg StopMethod: implementation-data-type=ESndInterruptType, type=ESndInterruptType, direction=IN
      SetChimeResumeInfoBuffer
        arg ChimeId: implementation-data-type=EChimeID, type=EChimeID, direction=IN
        arg ChimeChannelIdData: implementation-data-type=DataTypes/UInt8, type=DataTypes/UInt8, direction=IN
        arg Resume_Count: implementation-data-type=DataTypes/UInt8, type=DataTypes/UInt8, direction=OUT
      SetDynamicDeadTime
        arg ChannelId: implementation-data-type=DataTypes/UInt8, type=DataTypes/UInt8, direction=IN
        arg DeadTime: implementation-data-type=UInt16, type=UInt16, direction=IN
      SetUserPersonalizationVolume
        arg VolumePercentage: implementation-data-type=DataTypes/UInt8, type=DataTypes/UInt8, direction=IN
      StopCustomChime
        arg pCustomChimeDescP: implementation-data-type=SSndChimeDB, type=SSndChimeDB, direction=OUT
      UpdateChannelVolume
        arg ChannelId: implementation-data-type=DataTypes/UInt8, type=DataTypes/UInt8, direction=IN
        arg VolumePercentage: implementation-data-type=DataTypes/UInt8, type=DataTypes/UInt8, direction=IN
      UpdateChimeInfoBuffer
        arg ChimeId: implementation-data-type=EChimeID, type=EChimeID, direction=IN
        arg ChimeChannelIdData: implementation-data-type=DataTypes/UInt8, type=DataTypes/UInt8, direction=IN
      UpdateChimeVolume
        arg ChimeId: implementation-data-type=DataTypes/UInt8, type=DataTypes/UInt8, direction=IN
        arg VolumeLevel: implementation-data-type=DataTypes/UInt8, type=DataTypes/UInt8, direction=IN
      ischannelavailable
        arg ChannelId: implementation-data-type=DataTypes/UInt8, type=DataTypes/UInt8, direction=IN
    error E_NOT_OK: error-code=1
  client server interface TI_DID_DiagAction
    operation DID_DiagAction: possible-error=TI_DID_DiagAction/E_NOT_OK
      5 x arg:
        OpStatus: implementation-data-type=teDiagOpStatus, type=teDiagOpStatus, direction=IN
        DIDNum: implementation-data-type=UInt16, type=UInt16, direction=IN
        Data: implementation-data-type=DataTypes/UInt8, type=DataTypes/UInt8, direction=OUT
        pNrc: implementation-data-type=DataTypes/UInt8, type=DataTypes/UInt8, direction=OUT
        eOperation: implementation-data-type=teDIDOperation, type=teDIDOperation, direction=IN
    error E_NOT_OK: error-code=1
  impl type EDcmExtAction: category=VALUE, base-type=uint8, compu {0=eDcmExtAction_Read, 1=eDcmExtAction_Write, 2=eDcmExtAction_IOCtrl, 3=eDcmExtAction_RetCtrlEcu, 4=eDcmExtAction_RoutineStart, 5=eDcmExtAction_RoutineStop, 6=eDcmExtAction__RoutineResult, 7=eDcmExtAction_CheckConditions, 8=eDcmExtAction_Reset}, range raw 0..8
  client server interface TI_Meet_Mgrdiagcdd_Action
    operation Meet_Mgrdiagcdd_Action: possible-error=TI_Meet_Mgrdiagcdd_Action/E_NOT_OK
      4 x arg, all with direction=OUT:
        Action: implementation-data-type=EDcmExtAction, type=EDcmExtAction
        Data: implementation-data-type=DataTypes/UInt8, type=DataTypes/UInt8
        Length: implementation-data-type=DataTypes/UInt8, type=DataTypes/UInt8
        DID: implementation-data-type=UInt32, type=UInt32
    error E_NOT_OK: error-code=1
  client server interface TI_RID_DiagAction
    operation RID_DiagAction: possible-error=TI_RID_DiagAction/E_NOT_OK
      7 x arg:
        OpStatus: implementation-data-type=teDiagOpStatus, type=teDiagOpStatus, direction=IN
        RIDNum: implementation-data-type=UInt16, type=UInt16, direction=IN
        Out_RoutineInfo: implementation-data-type=DataTypes/UInt8, type=DataTypes/UInt8, direction=OUT
        Data: implementation-data-type=DataTypes/UInt8, type=DataTypes/UInt8, direction=OUT
        DataLength: implementation-data-type=UInt16, type=UInt16, direction=OUT
        pNrc: implementation-data-type=DataTypes/UInt8, type=DataTypes/UInt8, direction=OUT
        eOperation: implementation-data-type=teRoutineOperation, type=teRoutineOperation, direction=IN
    error E_NOT_OK: error-code=1
  impl type EMeetModeStatus: category=VALUE, base-type=uint8, compu {0=eManufModeActive, 1=eManufModeInActive}, range raw 0..1
  client server interface TI_Read_ManufModeStatus
    operation Read_ManufModeStatus: possible-error=TI_Read_ManufModeStatus/E_NOT_OK
      arg currentstate: implementation-data-type=EMeetModeStatus, type=EMeetModeStatus, direction=OUT
    error E_NOT_OK: error-code=1
  client server interface TI_Write_Mfg_Flag
    operation Write_Mfg_Flag: possible-error=TI_Write_Mfg_Flag/E_NOT_OK
      arg pdata: implementation-data-type=UInt16, type=UInt16, direction=OUT
    error E_NOT_OK: error-code=1
  sender receiver interface TI_SleepReq: invalidation-policy{data-element=SleepReqData, handle-invalid=DONT-INVALIDATE}
    data SleepReqData: implementation-data-type=Boolean, type=Boolean
  client server interface If_CS_DltExt_SendLogMessage
    operation SendLogMessage: possible-error=If_CS_DltExt_SendLogMessage/E_NOT_OK
      5 x arg:
        payLoadHeader: implementation-data-type=DataTypes/UInt8, type=DataTypes/UInt8, direction=OUT
        payLoad: implementation-data-type=DataTypes/UInt8, type=DataTypes/UInt8, direction=OUT
        payLoadHeaderLength: implementation-data-type=UInt16, type=UInt16, direction=IN
        payLoadLength: implementation-data-type=UInt16, type=UInt16, direction=IN
        logLevel: implementation-data-type=DataTypes/UInt8, type=DataTypes/UInt8, direction=IN
    error E_NOT_OK: error-code=1
  client server interface If_CS_SetCounterToDefault
    operation SetCounterToDefault
  client server interface If_CS_SetLogsToDefault
    operation SetLogsToDefault
  sender receiver interface TI_ppSR_ComCallout: invalidation-policy{data-element=ABS0x102_Status, handle-invalid=DONT-INVALIDATE}
    data ABS0x102_Status: implementation-data-type=Boolean, type=Boolean
  client server interface TI_DcmExt_Confirmation
    operation DcmExt_Confirmation
      arg Result: implementation-data-type=DataTypes/UInt8, type=DataTypes/UInt8, direction=IN
  impl type Dcm_OpStatusType: category=VALUE, base-type=uint8, range raw 0..255
  impl type Dcm_DspDidIdentifierTableType: category=VALUE, base-type=uint16, range raw 0..65535
  4 x client server interface:
    TI_DcmExt_Service_Iocontrol
      operation DcmExt_Service_Iocontrol: possible-error=TI_DcmExt_Service_Iocontrol/E_NOT_OK
        4 x arg:
          OpStatus: implementation-data-type=Dcm_OpStatusType, type=Dcm_OpStatusType, direction=IN
          DataPointer: implementation-data-type=DataTypes/UInt8, type=DataTypes/UInt8, direction=INOUT
          pNrc: implementation-data-type=Dcm_NegativeResponseCodeType, type=Dcm_NegativeResponseCodeType, direction=INOUT
          did: implementation-data-type=Dcm_DspDidIdentifierTableType, type=Dcm_DspDidIdentifierTableType, direction=IN
      error E_NOT_OK: error-code=1
    TI_DcmExt_Services_CndChk
      operation DcmExt_Services_CndChk: possible-error=TI_DcmExt_Services_CndChk/E_NOT_OK
        arg OpStatus: implementation-data-type=Dcm_OpStatusType, type=Dcm_OpStatusType, direction=IN
        arg pNrc: implementation-data-type=Dcm_NegativeResponseCodeType, type=Dcm_NegativeResponseCodeType, direction=INOUT
        arg did: implementation-data-type=Dcm_DspDidIdentifierTableType, type=Dcm_DspDidIdentifierTableType, direction=IN
      error E_NOT_OK: error-code=1
    TI_DcmExt_Services_DataRead
      operation DcmExt_Services_DataRead: possible-error=TI_DcmExt_Services_DataRead/E_NOT_OK
        4 x arg:
          OpStatus: implementation-data-type=Dcm_OpStatusType, type=Dcm_OpStatusType, direction=IN
          pDataPointer: implementation-data-type=DataTypes/UInt8, type=DataTypes/UInt8, direction=INOUT
          did: implementation-data-type=Dcm_DspDidIdentifierTableType, type=Dcm_DspDidIdentifierTableType, direction=IN
          pNrc: implementation-data-type=Dcm_NegativeResponseCodeType, type=Dcm_NegativeResponseCodeType, direction=INOUT
      error E_NOT_OK: error-code=1
    TI_DcmExt_Services_DataWrite
      operation DcmExt_Services_DataWrite: possible-error=TI_DcmExt_Services_DataWrite/E_NOT_OK
        4 x arg:
          OpStatus: implementation-data-type=Dcm_OpStatusType, type=Dcm_OpStatusType, direction=IN
          DataPointer: implementation-data-type=DataTypes/UInt8, type=DataTypes/UInt8, direction=INOUT
          pNrc: implementation-data-type=Dcm_NegativeResponseCodeType, type=Dcm_NegativeResponseCodeType, direction=INOUT
          did: implementation-data-type=Dcm_DspDidIdentifierTableType, type=Dcm_DspDidIdentifierTableType, direction=IN
      error E_NOT_OK: error-code=1
  impl type Dcm_MsgLenType: category=VALUE, base-type=uint32, range raw 0..4294967295
  client server interface TI_DcmExt_Services_LenChk
    operation DcmExt_Services_LenChk: possible-error=TI_DcmExt_Services_LenChk/E_NOT_OK
      4 x arg:
        OpStatus: implementation-data-type=Dcm_OpStatusType, type=Dcm_OpStatusType, direction=IN
        pNrc: implementation-data-type=Dcm_NegativeResponseCodeType, type=Dcm_NegativeResponseCodeType, direction=INOUT
        Length: implementation-data-type=Dcm_MsgLenType, type=Dcm_MsgLenType, direction=INOUT
        did: implementation-data-type=Dcm_DspDidIdentifierTableType, type=Dcm_DspDidIdentifierTableType, direction=IN
    error E_NOT_OK: error-code=1
  impl type Dcm_DspRidIdentifierTableType: category=VALUE, base-type=uint16, range raw 0..65535
  client server interface TI_DcmExt_Services_RoutineResults
    operation DcmExt_Services_RoutineResults: possible-error=TI_DcmExt_Services_RoutineResults/E_NOT_OK
      6 x arg:
        OpStatus: implementation-data-type=Dcm_OpStatusType, type=Dcm_OpStatusType, direction=IN
        pOut_RoutineInfo: implementation-data-type=DataTypes/UInt8, type=DataTypes/UInt8, direction=INOUT
        Out_Results_Response: implementation-data-type=DataTypes/UInt8, type=DataTypes/UInt8, direction=INOUT
        DataLength: implementation-data-type=UInt32, type=UInt32, direction=INOUT
        pNrc: implementation-data-type=Dcm_NegativeResponseCodeType, type=Dcm_NegativeResponseCodeType, direction=INOUT
        Rid: implementation-data-type=Dcm_DspRidIdentifierTableType, type=Dcm_DspRidIdentifierTableType, direction=IN
    error E_NOT_OK: error-code=1
  client server interface TI_DcmExt_Services_RoutineStart
    operation DcmExt_Services_RoutineStart: possible-error=TI_DcmExt_Services_RoutineStart/E_NOT_OK
      5 x arg:
        OpStatus: implementation-data-type=Dcm_OpStatusType, type=Dcm_OpStatusType, direction=IN
        pOut_RoutineInfo: implementation-data-type=DataTypes/UInt8, type=DataTypes/UInt8, direction=INOUT
        DataLength: implementation-data-type=UInt32, type=UInt32, direction=INOUT
        pNrc: implementation-data-type=Dcm_NegativeResponseCodeType, type=Dcm_NegativeResponseCodeType, direction=INOUT
        Rid: implementation-data-type=Dcm_DspRidIdentifierTableType, type=Dcm_DspRidIdentifierTableType, direction=IN
    error E_NOT_OK: error-code=1
  client server interface TI_DcmExt_Services_RoutineStop
    operation DcmExt_Services_RoutineStop: possible-error=TI_DcmExt_Services_RoutineStop/E_NOT_OK
      5 x arg:
        OpStatus: implementation-data-type=Dcm_OpStatusType, type=Dcm_OpStatusType, direction=IN
        pOut_RoutineInfo: implementation-data-type=DataTypes/UInt8, type=DataTypes/UInt8, direction=INOUT
        DataLength: implementation-data-type=UInt32, type=UInt32, direction=INOUT
        pNrc: implementation-data-type=Dcm_NegativeResponseCodeType, type=Dcm_NegativeResponseCodeType, direction=INOUT
        Rid: implementation-data-type=Dcm_DspRidIdentifierTableType, type=Dcm_DspRidIdentifierTableType, direction=IN
    error E_NOT_OK: error-code=1
package /E40_Platform_System_SystemPackage/Types/DataConstrs
  range UInt16_DataConstraint: raw 0..65535
  range UInt32_DataConstraint: raw 0..4294967295
  range Boolean_DataConstraint: raw 0..1
  range SInt32_DataConstraint: raw -2147483648..2147483647
  range UInt8_DataConstraint: raw 0..255
  range SInt8_DataConstraint: raw -128..127
  range SInt16_DataConstraint: raw -32768..32767
  range UInt8_DataConstraint: raw 0..255
