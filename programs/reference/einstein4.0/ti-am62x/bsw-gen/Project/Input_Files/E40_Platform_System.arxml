[part 9 of 10: packages /E40_Platform_System_SystemPackage/Components to /E40_Platform_System_SystemPackage/Types]
AUTOSAR XML (schema 4-2-1)
package /E40_Platform_System_SystemPackage/Components  (continued)
  application sw component type DcmExt  (continued)
    behavior IB_DcmExt  (continued)
      10 x runnable, all with can-be-invoked-concurrently=true:  (continued)
        DcmExt_Services_RoutineStop
          data-receive-point-by-arguments:
            95 x access:
              DRA_rp_SR_JobStatus_JobStatus_BsConst_Audio_Element: accessed-variable=rp_SR_JobStatus.JobStatus_BsConst_Audio_Element
              DRA_rp_SR_JobStatus_JobStatus_BsConst_BsConst_Illumination_ReservedByte: accessed-variable=rp_SR_JobStatus.JobStatus_BsConst_BsConst_Illumination_ReservedByte
              DRA_rp_SR_JobStatus_JobStatus_BsConst_BsConst_Illumination_ReservedByte_SafeCopy1: accessed-variable=rp_SR_JobStatus.JobStatus_BsConst_BsConst_Illumination_ReservedByte_SafeCopy1
              DRA_rp_SR_JobStatus_JobStatus_BsConst_BsConst_Illumination_ReservedByte_SafeCopy2: accessed-variable=rp_SR_JobStatus.JobStatus_BsConst_BsConst_Illumination_ReservedByte_SafeCopy2
              DRA_rp_SR_JobStatus_JobStatus_BsConst_Communication_Element: accessed-variable=rp_SR_JobStatus.JobStatus_BsConst_Communication_Element
              DRA_rp_SR_JobStatus_JobStatus_BsConst_Compensation_Line_Shift_b: accessed-variable=rp_SR_JobStatus.JobStatus_BsConst_Compensation_Line_Shift_b
              DRA_rp_SR_JobStatus_JobStatus_BsConst_Compensation_Line_Shift_b_SafeCopy1: accessed-variable=rp_SR_JobStatus.JobStatus_BsConst_Compensation_Line_Shift_b_SafeCopy1
              DRA_rp_SR_JobStatus_JobStatus_BsConst_Compensation_Line_Shift_b_SafeCopy2: accessed-variable=rp_SR_JobStatus.JobStatus_BsConst_Compensation_Line_Shift_b_SafeCopy2
              DRA_rp_SR_JobStatus_JobStatus_BsConst_Compensation_Line_Slope_m: accessed-variable=rp_SR_JobStatus.JobStatus_BsConst_Compensation_Line_Slope_m
              DRA_rp_SR_JobStatus_JobStatus_BsConst_Compensation_Line_Slope_m_SafeCopy1: accessed-variable=rp_SR_JobStatus.JobStatus_BsConst_Compensation_Line_Slope_m_SafeCopy1
              DRA_rp_SR_JobStatus_JobStatus_BsConst_Compensation_Line_Slope_m_SafeCopy2: accessed-variable=rp_SR_JobStatus.JobStatus_BsConst_Compensation_Line_Slope_m_SafeCopy2
              DRA_rp_SR_JobStatus_JobStatus_BsConst_Derating_Backlight_Disable: accessed-variable=rp_SR_JobStatus.JobStatus_BsConst_Derating_Backlight_Disable
              DRA_rp_SR_JobStatus_JobStatus_BsConst_Derating_Backlight_Disable_SafeCopy1: accessed-variable=rp_SR_JobStatus.JobStatus_BsConst_Derating_Backlight_Disable_SafeCopy1
              DRA_rp_SR_JobStatus_JobStatus_BsConst_Derating_Backlight_Disable_SafeCopy2: accessed-variable=rp_SR_JobStatus.JobStatus_BsConst_Derating_Backlight_Disable_SafeCopy2
              DRA_rp_SR_JobStatus_JobStatus_BsConst_Display_Illum_Max_Level: accessed-variable=rp_SR_JobStatus.JobStatus_BsConst_Display_Illum_Max_Level
              DRA_rp_SR_JobStatus_JobStatus_BsConst_Display_Illum_Max_Level_SafeCopy1: accessed-variable=rp_SR_JobStatus.JobStatus_BsConst_Display_Illum_Max_Level_SafeCopy1
              DRA_rp_SR_JobStatus_JobStatus_BsConst_Display_Illum_Max_Level_SafeCopy2: accessed-variable=rp_SR_JobStatus.JobStatus_BsConst_Display_Illum_Max_Level_SafeCopy2
              DRA_rp_SR_JobStatus_JobStatus_BsConst_EngOffTimer_Element: accessed-variable=rp_SR_JobStatus.JobStatus_BsConst_EngOffTimer_Element
              DRA_rp_SR_JobStatus_JobStatus_BsConst_FuelGauge_Element: accessed-variable=rp_SR_JobStatus.JobStatus_BsConst_FuelGauge_Element
              DRA_rp_SR_JobStatus_JobStatus_BsConst_Lookup_Curve_HotSpot_Coef_X: accessed-variable=rp_SR_JobStatus.JobStatus_BsConst_Lookup_Curve_HotSpot_Coef_X
              DRA_rp_SR_JobStatus_JobStatus_BsConst_Lookup_Curve_HotSpot_Coef_X_SafeCopy1: accessed-variable=rp_SR_JobStatus.JobStatus_BsConst_Lookup_Curve_HotSpot_Coef_X_SafeCopy1
              DRA_rp_SR_JobStatus_JobStatus_BsConst_Lookup_Curve_HotSpot_Coef_X_SafeCopy2: accessed-variable=rp_SR_JobStatus.JobStatus_BsConst_Lookup_Curve_HotSpot_Coef_X_SafeCopy2
              DRA_rp_SR_JobStatus_JobStatus_BsConst_Lookup_Curve_HotSpot_Coef_Y: accessed-variable=rp_SR_JobStatus.JobStatus_BsConst_Lookup_Curve_HotSpot_Coef_Y
              DRA_rp_SR_JobStatus_JobStatus_BsConst_Lookup_Curve_HotSpot_Coef_Y_SafeCopy1: accessed-variable=rp_SR_JobStatus.JobStatus_BsConst_Lookup_Curve_HotSpot_Coef_Y_SafeCopy1
              DRA_rp_SR_JobStatus_JobStatus_BsConst_Lookup_Curve_HotSpot_Coef_Y_SafeCopy2: accessed-variable=rp_SR_JobStatus.JobStatus_BsConst_Lookup_Curve_HotSpot_Coef_Y_SafeCopy2
              DRA_rp_SR_JobStatus_JobStatus_BsConst_OilGauge_Element: accessed-variable=rp_SR_JobStatus.JobStatus_BsConst_OilGauge_Element
              DRA_rp_SR_JobStatus_JobStatus_BsConst_PCB_Temperature_Sensor_Conv: accessed-variable=rp_SR_JobStatus.JobStatus_BsConst_PCB_Temperature_Sensor_Conv
              DRA_rp_SR_JobStatus_JobStatus_BsConst_PCB_Temperature_Sensor_Conv_SafeCopy1: accessed-variable=rp_SR_JobStatus.JobStatus_BsConst_PCB_Temperature_Sensor_Conv_SafeCopy1
              DRA_rp_SR_JobStatus_JobStatus_BsConst_PCB_Temperature_Sensor_Conv_SafeCopy2: accessed-variable=rp_SR_JobStatus.JobStatus_BsConst_PCB_Temperature_Sensor_Conv_SafeCopy2
              DRA_rp_SR_JobStatus_JobStatus_BsConst_PWM_boost_bypass_duty: accessed-variable=rp_SR_JobStatus.JobStatus_BsConst_PWM_boost_bypass_duty
              DRA_rp_SR_JobStatus_JobStatus_BsConst_PWM_boost_bypass_duty_SafeCopy1: accessed-variable=rp_SR_JobStatus.JobStatus_BsConst_PWM_boost_bypass_duty_SafeCopy1
              DRA_rp_SR_JobStatus_JobStatus_BsConst_PWM_boost_bypass_duty_SafeCopy2: accessed-variable=rp_SR_JobStatus.JobStatus_BsConst_PWM_boost_bypass_duty_SafeCopy2
              DRA_rp_SR_JobStatus_JobStatus_BsConst_PowerGauge_Element: accessed-variable=rp_SR_JobStatus.JobStatus_BsConst_PowerGauge_Element
              DRA_rp_SR_JobStatus_JobStatus_BsConst_Power_Element: accessed-variable=rp_SR_JobStatus.JobStatus_BsConst_Power_Element
              DRA_rp_SR_JobStatus_JobStatus_BsConst_RealTimeClock_Element: accessed-variable=rp_SR_JobStatus.JobStatus_BsConst_RealTimeClock_Element
              DRA_rp_SR_JobStatus_JobStatus_BsConst_ServiceReminder_Element: accessed-variable=rp_SR_JobStatus.JobStatus_BsConst_ServiceReminder_Element
              DRA_rp_SR_JobStatus_JobStatus_BsConst_SpeedoGauge_Element: accessed-variable=rp_SR_JobStatus.JobStatus_BsConst_SpeedoGauge_Element
              DRA_rp_SR_JobStatus_JobStatus_BsConst_TachoGauge_Element: accessed-variable=rp_SR_JobStatus.JobStatus_BsConst_TachoGauge_Element
              DRA_rp_SR_JobStatus_JobStatus_BsConst_TempGauge_Element: accessed-variable=rp_SR_JobStatus.JobStatus_BsConst_TempGauge_Element
              DRA_rp_SR_JobStatus_JobStatus_BsConst_Temp_Threshold_Hysteresis_Derating: accessed-variable=rp_SR_JobStatus.JobStatus_BsConst_Temp_Threshold_Hysteresis_Derating
              DRA_rp_SR_JobStatus_JobStatus_BsConst_Temp_Threshold_Hysteresis_Derating_SafeCopy1: accessed-variable=rp_SR_JobStatus.JobStatus_BsConst_Temp_Threshold_Hysteresis_Derating_SafeCopy1
              DRA_rp_SR_JobStatus_JobStatus_BsConst_Temp_Threshold_Hysteresis_Derating_SafeCopy2: accessed-variable=rp_SR_JobStatus.JobStatus_BsConst_Temp_Threshold_Hysteresis_Derating_SafeCopy2
              DRA_rp_SR_JobStatus_JobStatus_BsConst_Temperature_Sensor_Conv: accessed-variable=rp_SR_JobStatus.JobStatus_BsConst_Temperature_Sensor_Conv
              DRA_rp_SR_JobStatus_JobStatus_BsConst_Temperature_Sensor_Conv_SafeCopy1: accessed-variable=rp_SR_JobStatus.JobStatus_BsConst_Temperature_Sensor_Conv_SafeCopy1
              DRA_rp_SR_JobStatus_JobStatus_BsConst_Temperature_Sensor_Conv_SafeCopy2: accessed-variable=rp_SR_JobStatus.JobStatus_BsConst_Temperature_Sensor_Conv_SafeCopy2
              DRA_rp_SR_JobStatus_JobStatus_BsConst_TripComputer_Element: accessed-variable=rp_SR_JobStatus.JobStatus_BsConst_TripComputer_Element
              DRA_rp_SR_JobStatus_JobStatus_BsConst_Warning_Element: accessed-variable=rp_SR_JobStatus.JobStatus_BsConst_Warning_Element
              DRA_rp_SR_JobStatus_JobStatus_BsCys_Certicificate_Element: accessed-variable=rp_SR_JobStatus.JobStatus_BsCys_Certicificate_Element
              DRA_rp_SR_JobStatus_JobStatus_BsDiag_Dtc_Element: accessed-variable=rp_SR_JobStatus.JobStatus_BsDiag_Dtc_Element
              DRA_rp_SR_JobStatus_JobStatus_BsDiag_ErrorRecord_Element: accessed-variable=rp_SR_JobStatus.JobStatus_BsDiag_ErrorRecord_Element
              DRA_rp_SR_JobStatus_JobStatus_BsReten_Audio_Element: accessed-variable=rp_SR_JobStatus.JobStatus_BsReten_Audio_Element
              DRA_rp_SR_JobStatus_JobStatus_BsReten_Communication_Element: accessed-variable=rp_SR_JobStatus.JobStatus_BsReten_Communication_Element
              DRA_rp_SR_JobStatus_JobStatus_BsReten_Display_Element: accessed-variable=rp_SR_JobStatus.JobStatus_BsReten_Display_Element
              DRA_rp_SR_JobStatus_JobStatus_BsReten_Gauges_Element: accessed-variable=rp_SR_JobStatus.JobStatus_BsReten_Gauges_Element
              DRA_rp_SR_JobStatus_JobStatus_BsReten_Illumination_Element: accessed-variable=rp_SR_JobStatus.JobStatus_BsReten_Illumination_Element
              DRA_rp_SR_JobStatus_JobStatus_BsReten_Odometer_Element: accessed-variable=rp_SR_JobStatus.JobStatus_BsReten_Odometer_Element
              DRA_rp_SR_JobStatus_JobStatus_BsReten_Personalization_Element: accessed-variable=rp_SR_JobStatus.JobStatus_BsReten_Personalization_Element
              DRA_rp_SR_JobStatus_JobStatus_BsReten_Power_Element: accessed-variable=rp_SR_JobStatus.JobStatus_BsReten_Power_Element
              DRA_rp_SR_JobStatus_JobStatus_BsReten_RealTimeClock_Element: accessed-variable=rp_SR_JobStatus.JobStatus_BsReten_RealTimeClock_Element
              DRA_rp_SR_JobStatus_JobStatus_BsReten_Tripcomputer_Element: accessed-variable=rp_SR_JobStatus.JobStatus_BsReten_Tripcomputer_Element
              DRA_rp_SR_JobStatus_JobStatus_BsReten_VisDlt_Element: accessed-variable=rp_SR_JobStatus.JobStatus_BsReten_VisDlt_Element
              DRA_rp_SR_JobStatus_JobStatus_BsReten_Warning_Element: accessed-variable=rp_SR_JobStatus.JobStatus_BsReten_Warning_Element
              DRA_rp_SR_JobStatus_JobStatus_BsRt_CusDlt_Element: accessed-variable=rp_SR_JobStatus.JobStatus_BsRt_CusDlt_Element
              DRA_rp_SR_JobStatus_JobStatus_BsRt_FuelGauge_Element: accessed-variable=rp_SR_JobStatus.JobStatus_BsRt_FuelGauge_Element
              DRA_rp_SR_JobStatus_JobStatus_BsRt_Illumination_Element: accessed-variable=rp_SR_JobStatus.JobStatus_BsRt_Illumination_Element
              DRA_rp_SR_JobStatus_JobStatus_BsRt_Odometer_Element: accessed-variable=rp_SR_JobStatus.JobStatus_BsRt_Odometer_Element
              DRA_rp_SR_JobStatus_JobStatus_BsRt_OilGauge_Element: accessed-variable=rp_SR_JobStatus.JobStatus_BsRt_OilGauge_Element
              DRA_rp_SR_JobStatus_JobStatus_BsRt_Personalization_Element: accessed-variable=rp_SR_JobStatus.JobStatus_BsRt_Personalization_Element
              DRA_rp_SR_JobStatus_JobStatus_BsRt_PowerGauge_Element: accessed-variable=rp_SR_JobStatus.JobStatus_BsRt_PowerGauge_Element
              DRA_rp_SR_JobStatus_JobStatus_BsRt_RealTimeClock_Element: accessed-variable=rp_SR_JobStatus.JobStatus_BsRt_RealTimeClock_Element
              DRA_rp_SR_JobStatus_JobStatus_BsRt_SpeedoGauge_Element: accessed-variable=rp_SR_JobStatus.JobStatus_BsRt_SpeedoGauge_Element
              DRA_rp_SR_JobStatus_JobStatus_BsRt_TachoGauge_Element: accessed-variable=rp_SR_JobStatus.JobStatus_BsRt_TachoGauge_Element
              DRA_rp_SR_JobStatus_JobStatus_BsRt_TempGauge_Element: accessed-variable=rp_SR_JobStatus.JobStatus_BsRt_TempGauge_Element
              DRA_rp_SR_JobStatus_JobStatus_BsRt_TripComputer_Element: accessed-variable=rp_SR_JobStatus.JobStatus_BsRt_TripComputer_Element
              DRA_rp_SR_JobStatus_JobStatus_BsRt_Warning_Element: accessed-variable=rp_SR_JobStatus.JobStatus_BsRt_Warning_Element
              DRA_rp_SR_JobStatus_JobStatus_BsShare_AssemblyManufacturingDate: accessed-variable=rp_SR_JobStatus.JobStatus_BsShare_AssemblyManufacturingDate
              DRA_rp_SR_JobStatus_JobStatus_BsShare_AssemblyPlantNumber: accessed-variable=rp_SR_JobStatus.JobStatus_BsShare_AssemblyPlantNumber
              DRA_rp_SR_JobStatus_JobStatus_BsShare_EcuPartNumber_Element: accessed-variable=rp_SR_JobStatus.JobStatus_BsShare_EcuPartNumber_Element
              DRA_rp_SR_JobStatus_JobStatus_BsShare_HWModification: accessed-variable=rp_SR_JobStatus.JobStatus_BsShare_HWModification
              DRA_rp_SR_JobStatus_JobStatus_BsShare_PCBSerialNumber: accessed-variable=rp_SR_JobStatus.JobStatus_BsShare_PCBSerialNumber
              DRA_rp_SR_JobStatus_JobStatus_BsShare_ProductSerialNumber: accessed-variable=rp_SR_JobStatus.JobStatus_BsShare_ProductSerialNumber
              DRA_rp_SR_JobStatus_JobStatus_BsShare_SMTManufacturingDate: accessed-variable=rp_SR_JobStatus.JobStatus_BsShare_SMTManufacturingDate
              DRA_rp_SR_JobStatus_JobStatus_BsShare_SMTPlantNumber: accessed-variable=rp_SR_JobStatus.JobStatus_BsShare_SMTPlantNumber
              DRA_rp_SR_JobStatus_JobStatus_BsShare_SwUpdFotaFinPrint_Element: accessed-variable=rp_SR_JobStatus.JobStatus_BsShare_SwUpdFotaFinPrint_Element
              DRA_rp_SR_JobStatus_JobStatus_BsShare_SwUpdFotaMode_Element: accessed-variable=rp_SR_JobStatus.JobStatus_BsShare_SwUpdFotaMode_Element
              DRA_rp_SR_JobStatus_JobStatus_BsShare_SwUpdFotaStatus_Element: accessed-variable=rp_SR_JobStatus.JobStatus_BsShare_SwUpdFotaStatus_Element
              DRA_rp_SR_JobStatus_JobStatus_BsShare_SwUpdFotadecrypt_Element: accessed-variable=rp_SR_JobStatus.JobStatus_BsShare_SwUpdFotadecrypt_Element
              DRA_rp_SR_JobStatus_JobStatus_BsShare_SwUpdReflash_Element: accessed-variable=rp_SR_JobStatus.JobStatus_BsShare_SwUpdReflash_Element
              DRA_rp_SR_JobStatus_JobStatus_BsShare_VehicleConfig_Element: accessed-variable=rp_SR_JobStatus.JobStatus_BsShare_VehicleConfig_Element
              DRA_rp_SR_JobStatus_JobStatus_BsShare_VisMeet_EOLEntry_Element: accessed-variable=rp_SR_JobStatus.JobStatus_BsShare_VisMeet_EOLEntry_Element
              DRA_rp_SR_JobStatus_JobStatus_BsShare_VisMeet_Element: accessed-variable=rp_SR_JobStatus.JobStatus_BsShare_VisMeet_Element
              DRA_rp_SR_JobStatus_JobStatus_BsShare_VisteonPCBPartNumber: accessed-variable=rp_SR_JobStatus.JobStatus_BsShare_VisteonPCBPartNumber
              DRA_rp_SR_JobStatus_JobStatus_BsShare_VisteonPartNumber: accessed-variable=rp_SR_JobStatus.JobStatus_BsShare_VisteonPartNumber
              DRA_rp_SR_JobStatus_JobStatus_RefCys_Certicificate1_Element: accessed-variable=rp_SR_JobStatus.JobStatus_RefCys_Certicificate1_Element
              DRA_rp_SR_JobStatus_JobStatus_RefCys_Certicificate_Element: accessed-variable=rp_SR_JobStatus.JobStatus_RefCys_Certicificate_Element
          200 x sync call, all with timeout=0.0:
            OA_rp_CS_DID_App_DiagAction_DID_DiagAction: operation=rp_CS_DID_App_DiagAction.DID_DiagAction
            OA_rp_CS_DID_DiagAction_DID_DiagAction: operation=rp_CS_DID_DiagAction.DID_DiagAction
            OA_rp_CS_DiagEntryStatus_Diag_Entry_Status: operation=rp_CS_DiagEntryStatus.Diag_Entry_Status
            OA_rp_CS_MemAbsGet_Get_BsShare_SwUpdReflash_Element: operation=rp_CS_MemAbsGet.Get_BsShare_SwUpdReflash_Element
            OA_rp_CS_MemAbsGet_Get_BsShare_SwUpdFotaMode_Element: operation=rp_CS_MemAbsGet.Get_BsShare_SwUpdFotaMode_Element
            OA_rp_CS_MemAbsGet_Get_BsShare_SwUpdFotaFinPrint_Element: operation=rp_CS_MemAbsGet.Get_BsShare_SwUpdFotaFinPrint_Element
            OA_rp_CS_MemAbsGet_Get_BsShare_SwUpdFotaStatus_Element: operation=rp_CS_MemAbsGet.Get_BsShare_SwUpdFotaStatus_Element
            OA_rp_CS_MemAbsGet_Get_BsShare_SwUpdFotadecrypt_Element: operation=rp_CS_MemAbsGet.Get_BsShare_SwUpdFotadecrypt_Element
            OA_rp_CS_MemAbsGet_Get_BsShare_EcuPartNumber_Element: operation=rp_CS_MemAbsGet.Get_BsShare_EcuPartNumber_Element
            OA_rp_CS_MemAbsGet_Get_BsShare_VisteonPartNumber: operation=rp_CS_MemAbsGet.Get_BsShare_VisteonPartNumber
            OA_rp_CS_MemAbsGet_Get_BsShare_VisteonPCBPartNumber: operation=rp_CS_MemAbsGet.Get_BsShare_VisteonPCBPartNumber
            OA_rp_CS_MemAbsGet_Get_BsShare_ProductSerialNumber: operation=rp_CS_MemAbsGet.Get_BsShare_ProductSerialNumber
            OA_rp_CS_MemAbsGet_Get_BsShare_PCBSerialNumber: operation=rp_CS_MemAbsGet.Get_BsShare_PCBSerialNumber
            OA_rp_CS_MemAbsGet_Get_BsShare_SMTManufacturingDate: operation=rp_CS_MemAbsGet.Get_BsShare_SMTManufacturingDate
            OA_rp_CS_MemAbsGet_Get_BsShare_AssemblyManufacturingDate: operation=rp_CS_MemAbsGet.Get_BsShare_AssemblyManufacturingDate
            OA_rp_CS_MemAbsGet_Get_BsShare_SMTPlantNumber: operation=rp_CS_MemAbsGet.Get_BsShare_SMTPlantNumber
            OA_rp_CS_MemAbsGet_Get_BsShare_AssemblyPlantNumber: operation=rp_CS_MemAbsGet.Get_BsShare_AssemblyPlantNumber
            OA_rp_CS_MemAbsGet_Get_BsShare_HWModification: operation=rp_CS_MemAbsGet.Get_BsShare_HWModification
            OA_rp_CS_MemAbsGet_Get_BsShare_VisMeet_Element: operation=rp_CS_MemAbsGet.Get_BsShare_VisMeet_Element
            OA_rp_CS_MemAbsGet_Get_BsShare_VisMeet_EOLEntry_Element: operation=rp_CS_MemAbsGet.Get_BsShare_VisMeet_EOLEntry_Element
            OA_rp_CS_MemAbsGet_Get_BsShare_VehicleConfig_Element: operation=rp_CS_MemAbsGet.Get_BsShare_VehicleConfig_Element
            OA_rp_CS_MemAbsGet_Get_BsConst_SpeedoGauge_Element: operation=rp_CS_MemAbsGet.Get_BsConst_SpeedoGauge_Element
            OA_rp_CS_MemAbsGet_Get_BsConst_TachoGauge_Element: operation=rp_CS_MemAbsGet.Get_BsConst_TachoGauge_Element
            OA_rp_CS_MemAbsGet_Get_BsConst_FuelGauge_Element: operation=rp_CS_MemAbsGet.Get_BsConst_FuelGauge_Element
            OA_rp_CS_MemAbsGet_Get_BsConst_TempGauge_Element: operation=rp_CS_MemAbsGet.Get_BsConst_TempGauge_Element
            OA_rp_CS_MemAbsGet_Get_BsConst_PowerGauge_Element: operation=rp_CS_MemAbsGet.Get_BsConst_PowerGauge_Element
            OA_rp_CS_MemAbsGet_Get_BsConst_OilGauge_Element: operation=rp_CS_MemAbsGet.Get_BsConst_OilGauge_Element
            OA_rp_CS_MemAbsGet_Get_BsConst_TripComputer_Element: operation=rp_CS_MemAbsGet.Get_BsConst_TripComputer_Element
            OA_rp_CS_MemAbsGet_Get_BsConst_Compensation_Line_Slope_m: operation=rp_CS_MemAbsGet.Get_BsConst_Compensation_Line_Slope_m
            OA_rp_CS_MemAbsGet_Get_BsConst_Compensation_Line_Shift_b: operation=rp_CS_MemAbsGet.Get_BsConst_Compensation_Line_Shift_b
            OA_rp_CS_MemAbsGet_Get_BsConst_Lookup_Curve_HotSpot_Coef_X: operation=rp_CS_MemAbsGet.Get_BsConst_Lookup_Curve_HotSpot_Coef_X
            OA_rp_CS_MemAbsGet_Get_BsConst_Lookup_Curve_HotSpot_Coef_Y: operation=rp_CS_MemAbsGet.Get_BsConst_Lookup_Curve_HotSpot_Coef_Y
            OA_rp_CS_MemAbsGet_Get_BsConst_Temp_Threshold_Hysteresis_Derating: operation=rp_CS_MemAbsGet.Get_BsConst_Temp_Threshold_Hysteresis_Derating
            OA_rp_CS_MemAbsGet_Get_BsConst_Derating_Backlight_Disable: operation=rp_CS_MemAbsGet.Get_BsConst_Derating_Backlight_Disable
            OA_rp_CS_MemAbsGet_Get_BsConst_Temperature_Sensor_Conv: operation=rp_CS_MemAbsGet.Get_BsConst_Temperature_Sensor_Conv
            OA_rp_CS_MemAbsGet_Get_BsConst_PCB_Temperature_Sensor_Conv: operation=rp_CS_MemAbsGet.Get_BsConst_PCB_Temperature_Sensor_Conv
            OA_rp_CS_MemAbsGet_Get_BsConst_Display_Illum_Max_Level: operation=rp_CS_MemAbsGet.Get_BsConst_Display_Illum_Max_Level
            OA_rp_CS_MemAbsGet_Get_BsConst_PWM_boost_bypass_duty: operation=rp_CS_MemAbsGet.Get_BsConst_PWM_boost_bypass_duty
            OA_rp_CS_MemAbsGet_Get_BsConst_BsConst_Illumination_ReservedByte: operation=rp_CS_MemAbsGet.Get_BsConst_BsConst_Illumination_ReservedByte
            OA_rp_CS_MemAbsGet_Get_BsConst_Compensation_Line_Slope_m_SafeCopy1: operation=rp_CS_MemAbsGet.Get_BsConst_Compensation_Line_Slope_m_SafeCopy1
            OA_rp_CS_MemAbsGet_Get_BsConst_Compensation_Line_Shift_b_SafeCopy1: operation=rp_CS_MemAbsGet.Get_BsConst_Compensation_Line_Shift_b_SafeCopy1
            OA_rp_CS_MemAbsGet_Get_BsConst_Lookup_Curve_HotSpot_Coef_X_SafeCopy1: operation=rp_CS_MemAbsGet.Get_BsConst_Lookup_Curve_HotSpot_Coef_X_SafeCopy1
            OA_rp_CS_MemAbsGet_Get_BsConst_Lookup_Curve_HotSpot_Coef_Y_SafeCopy1: operation=rp_CS_MemAbsGet.Get_BsConst_Lookup_Curve_HotSpot_Coef_Y_SafeCopy1
            OA_rp_CS_MemAbsGet_Get_BsConst_Temp_Threshold_Hysteresis_Derating_SafeCopy1: operation=rp_CS_MemAbsGet.Get_BsConst_Temp_Threshold_Hysteresis_Derating_SafeCopy1
            OA_rp_CS_MemAbsGet_Get_BsConst_Derating_Backlight_Disable_SafeCopy1: operation=rp_CS_MemAbsGet.Get_BsConst_Derating_Backlight_Disable_SafeCopy1
            OA_rp_CS_MemAbsGet_Get_BsConst_Temperature_Sensor_Conv_SafeCopy1: operation=rp_CS_MemAbsGet.Get_BsConst_Temperature_Sensor_Conv_SafeCopy1
            OA_rp_CS_MemAbsGet_Get_BsConst_PCB_Temperature_Sensor_Conv_SafeCopy1: operation=rp_CS_MemAbsGet.Get_BsConst_PCB_Temperature_Sensor_Conv_SafeCopy1
            OA_rp_CS_MemAbsGet_Get_BsConst_Display_Illum_Max_Level_SafeCopy1: operation=rp_CS_MemAbsGet.Get_BsConst_Display_Illum_Max_Level_SafeCopy1
            OA_rp_CS_MemAbsGet_Get_BsConst_PWM_boost_bypass_duty_SafeCopy1: operation=rp_CS_MemAbsGet.Get_BsConst_PWM_boost_bypass_duty_SafeCopy1
            OA_rp_CS_MemAbsGet_Get_BsConst_BsConst_Illumination_ReservedByte_SafeCopy1: operation=rp_CS_MemAbsGet.Get_BsConst_BsConst_Illumination_ReservedByte_SafeCopy1
            OA_rp_CS_MemAbsGet_Get_BsConst_Compensation_Line_Slope_m_SafeCopy2: operation=rp_CS_MemAbsGet.Get_BsConst_Compensation_Line_Slope_m_SafeCopy2
            OA_rp_CS_MemAbsGet_Get_BsConst_Compensation_Line_Shift_b_SafeCopy2: operation=rp_CS_MemAbsGet.Get_BsConst_Compensation_Line_Shift_b_SafeCopy2
            OA_rp_CS_MemAbsGet_Get_BsConst_Lookup_Curve_HotSpot_Coef_X_SafeCopy2: operation=rp_CS_MemAbsGet.Get_BsConst_Lookup_Curve_HotSpot_Coef_X_SafeCopy2
            OA_rp_CS_MemAbsGet_Get_BsConst_Lookup_Curve_HotSpot_Coef_Y_SafeCopy2: operation=rp_CS_MemAbsGet.Get_BsConst_Lookup_Curve_HotSpot_Coef_Y_SafeCopy2
            OA_rp_CS_MemAbsGet_Get_BsConst_Temp_Threshold_Hysteresis_Derating_SafeCopy2: operation=rp_CS_MemAbsGet.Get_BsConst_Temp_Threshold_Hysteresis_Derating_SafeCopy2
            OA_rp_CS_MemAbsGet_Get_BsConst_Derating_Backlight_Disable_SafeCopy2: operation=rp_CS_MemAbsGet.Get_BsConst_Derating_Backlight_Disable_SafeCopy2
            OA_rp_CS_MemAbsGet_Get_BsConst_Temperature_Sensor_Conv_SafeCopy2: operation=rp_CS_MemAbsGet.Get_BsConst_Temperature_Sensor_Conv_SafeCopy2
            OA_rp_CS_MemAbsGet_Get_BsConst_PCB_Temperature_Sensor_Conv_SafeCopy2: operation=rp_CS_MemAbsGet.Get_BsConst_PCB_Temperature_Sensor_Conv_SafeCopy2
            OA_rp_CS_MemAbsGet_Get_BsConst_Display_Illum_Max_Level_SafeCopy2: operation=rp_CS_MemAbsGet.Get_BsConst_Display_Illum_Max_Level_SafeCopy2
            OA_rp_CS_MemAbsGet_Get_BsConst_PWM_boost_bypass_duty_SafeCopy2: operation=rp_CS_MemAbsGet.Get_BsConst_PWM_boost_bypass_duty_SafeCopy2
            OA_rp_CS_MemAbsGet_Get_BsConst_BsConst_Illumination_ReservedByte_SafeCopy2: operation=rp_CS_MemAbsGet.Get_BsConst_BsConst_Illumination_ReservedByte_SafeCopy2
            OA_rp_CS_MemAbsGet_Get_BsConst_Audio_Element: operation=rp_CS_MemAbsGet.Get_BsConst_Audio_Element
            OA_rp_CS_MemAbsGet_Get_BsConst_Warning_Element: operation=rp_CS_MemAbsGet.Get_BsConst_Warning_Element
            OA_rp_CS_MemAbsGet_Get_BsConst_RealTimeClock_Element: operation=rp_CS_MemAbsGet.Get_BsConst_RealTimeClock_Element
            OA_rp_CS_MemAbsGet_Get_BsConst_Communication_Element: operation=rp_CS_MemAbsGet.Get_BsConst_Communication_Element
            OA_rp_CS_MemAbsGet_Get_BsConst_Power_Element: operation=rp_CS_MemAbsGet.Get_BsConst_Power_Element
            OA_rp_CS_MemAbsGet_Get_BsConst_ServiceReminder_Element: operation=rp_CS_MemAbsGet.Get_BsConst_ServiceReminder_Element
            OA_rp_CS_MemAbsGet_Get_BsConst_EngOffTimer_Element: operation=rp_CS_MemAbsGet.Get_BsConst_EngOffTimer_Element
            OA_rp_CS_MemAbsGet_Get_BsCys_Certicificate_Element: operation=rp_CS_MemAbsGet.Get_BsCys_Certicificate_Element
            OA_rp_CS_MemAbsGet_Get_RefCys_Certicificate_Element: operation=rp_CS_MemAbsGet.Get_RefCys_Certicificate_Element
            OA_rp_CS_MemAbsGet_Get_RefCys_Certicificate1_Element: operation=rp_CS_MemAbsGet.Get_RefCys_Certicificate1_Element
            OA_rp_CS_MemAbsGet_Get_BsRt_Odometer_Element: operation=rp_CS_MemAbsGet.Get_BsRt_Odometer_Element
            OA_rp_CS_MemAbsGet_Get_BsRt_SpeedoGauge_Element: operation=rp_CS_MemAbsGet.Get_BsRt_SpeedoGauge_Element
            OA_rp_CS_MemAbsGet_Get_BsRt_TachoGauge_Element: operation=rp_CS_MemAbsGet.Get_BsRt_TachoGauge_Element
            OA_rp_CS_MemAbsGet_Get_BsRt_FuelGauge_Element: operation=rp_CS_MemAbsGet.Get_BsRt_FuelGauge_Element
            OA_rp_CS_MemAbsGet_Get_BsRt_TempGauge_Element: operation=rp_CS_MemAbsGet.Get_BsRt_TempGauge_Element
            OA_rp_CS_MemAbsGet_Get_BsRt_PowerGauge_Element: operation=rp_CS_MemAbsGet.Get_BsRt_PowerGauge_Element
            OA_rp_CS_MemAbsGet_Get_BsRt_OilGauge_Element: operation=rp_CS_MemAbsGet.Get_BsRt_OilGauge_Element
            OA_rp_CS_MemAbsGet_Get_BsRt_TripComputer_Element: operation=rp_CS_MemAbsGet.Get_BsRt_TripComputer_Element
            OA_rp_CS_MemAbsGet_Get_BsRt_Warning_Element: operation=rp_CS_MemAbsGet.Get_BsRt_Warning_Element
            OA_rp_CS_MemAbsGet_Get_BsRt_RealTimeClock_Element: operation=rp_CS_MemAbsGet.Get_BsRt_RealTimeClock_Element
            OA_rp_CS_MemAbsGet_Get_BsRt_Personalization_Element: operation=rp_CS_MemAbsGet.Get_BsRt_Personalization_Element
            OA_rp_CS_MemAbsGet_Get_BsRt_Illumination_Element: operation=rp_CS_MemAbsGet.Get_BsRt_Illumination_Element
            OA_rp_CS_MemAbsGet_Get_BsRt_CusDlt_Element: operation=rp_CS_MemAbsGet.Get_BsRt_CusDlt_Element
            OA_rp_CS_MemAbsGet_Get_BsReten_Odometer_Element: operation=rp_CS_MemAbsGet.Get_BsReten_Odometer_Element
            OA_rp_CS_MemAbsGet_Get_BsReten_Gauges_Element: operation=rp_CS_MemAbsGet.Get_BsReten_Gauges_Element
            OA_rp_CS_MemAbsGet_Get_BsReten_Tripcomputer_Element: operation=rp_CS_MemAbsGet.Get_BsReten_Tripcomputer_Element
            OA_rp_CS_MemAbsGet_Get_BsReten_Illumination_Element: operation=rp_CS_MemAbsGet.Get_BsReten_Illumination_Element
            OA_rp_CS_MemAbsGet_Get_BsReten_Audio_Element: operation=rp_CS_MemAbsGet.Get_BsReten_Audio_Element
            OA_rp_CS_MemAbsGet_Get_BsReten_Warning_Element: operation=rp_CS_MemAbsGet.Get_BsReten_Warning_Element
            OA_rp_CS_MemAbsGet_Get_BsReten_RealTimeClock_Element: operation=rp_CS_MemAbsGet.Get_BsReten_RealTimeClock_Element
            OA_rp_CS_MemAbsGet_Get_BsReten_Communication_Element: operation=rp_CS_MemAbsGet.Get_BsReten_Communication_Element
            OA_rp_CS_MemAbsGet_Get_BsReten_Personalization_Element: operation=rp_CS_MemAbsGet.Get_BsReten_Personalization_Element
            OA_rp_CS_MemAbsGet_Get_BsReten_VisDlt_Element: operation=rp_CS_MemAbsGet.Get_BsReten_VisDlt_Element
            OA_rp_CS_MemAbsGet_Get_BsReten_Power_Element: operation=rp_CS_MemAbsGet.Get_BsReten_Power_Element
            OA_rp_CS_MemAbsGet_Get_BsReten_Display_Element: operation=rp_CS_MemAbsGet.Get_BsReten_Display_Element
            OA_rp_CS_MemAbsGet_Get_BsDiag_ErrorRecord_Element: operation=rp_CS_MemAbsGet.Get_BsDiag_ErrorRecord_Element
            OA_rp_CS_MemAbsGet_Get_BsDiag_Dtc_Element: operation=rp_CS_MemAbsGet.Get_BsDiag_Dtc_Element
            OA_rp_CS_MemAbsSet_Set_BsShare_SwUpdReflash_Element: operation=rp_CS_MemAbsSet.Set_BsShare_SwUpdReflash_Element
            OA_rp_CS_MemAbsSet_Set_BsShare_SwUpdFotaMode_Element: operation=rp_CS_MemAbsSet.Set_BsShare_SwUpdFotaMode_Element
            OA_rp_CS_MemAbsSet_Set_BsShare_SwUpdFotaFinPrint_Element: operation=rp_CS_MemAbsSet.Set_BsShare_SwUpdFotaFinPrint_Element
            OA_rp_CS_MemAbsSet_Set_BsShare_SwUpdFotaStatus_Element: operation=rp_CS_MemAbsSet.Set_BsShare_SwUpdFotaStatus_Element
            OA_rp_CS_MemAbsSet_Set_BsShare_SwUpdFotadecrypt_Element: operation=rp_CS_MemAbsSet.Set_BsShare_SwUpdFotadecrypt_Element
            OA_rp_CS_MemAbsSet_Set_BsShare_EcuPartNumber_Element: operation=rp_CS_MemAbsSet.Set_BsShare_EcuPartNumber_Element
            OA_rp_CS_MemAbsSet_Set_BsShare_VisteonPartNumber: operation=rp_CS_MemAbsSet.Set_BsShare_VisteonPartNumber
            OA_rp_CS_MemAbsSet_Set_BsShare_VisteonPCBPartNumber: operation=rp_CS_MemAbsSet.Set_BsShare_VisteonPCBPartNumber
            OA_rp_CS_MemAbsSet_Set_BsShare_ProductSerialNumber: operation=rp_CS_MemAbsSet.Set_BsShare_ProductSerialNumber
            OA_rp_CS_MemAbsSet_Set_BsShare_PCBSerialNumber: operation=rp_CS_MemAbsSet.Set_BsShare_PCBSerialNumber
            OA_rp_CS_MemAbsSet_Set_BsShare_SMTManufacturingDate: operation=rp_CS_MemAbsSet.Set_BsShare_SMTManufacturingDate
            OA_rp_CS_MemAbsSet_Set_BsShare_AssemblyManufacturingDate: operation=rp_CS_MemAbsSet.Set_BsShare_AssemblyManufacturingDate
            OA_rp_CS_MemAbsSet_Set_BsShare_SMTPlantNumber: operation=rp_CS_MemAbsSet.Set_BsShare_SMTPlantNumber
            OA_rp_CS_MemAbsSet_Set_BsShare_AssemblyPlantNumber: operation=rp_CS_MemAbsSet.Set_BsShare_AssemblyPlantNumber
            OA_rp_CS_MemAbsSet_Set_BsShare_HWModification: operation=rp_CS_MemAbsSet.Set_BsShare_HWModification
            OA_rp_CS_MemAbsSet_Set_BsShare_VisMeet_Element: operation=rp_CS_MemAbsSet.Set_BsShare_VisMeet_Element
            OA_rp_CS_MemAbsSet_Set_BsShare_VisMeet_EOLEntry_Element: operation=rp_CS_MemAbsSet.Set_BsShare_VisMeet_EOLEntry_Element
            OA_rp_CS_MemAbsSet_Set_BsShare_VehicleConfig_Element: operation=rp_CS_MemAbsSet.Set_BsShare_VehicleConfig_Element
            OA_rp_CS_MemAbsSet_Set_BsConst_SpeedoGauge_Element: operation=rp_CS_MemAbsSet.Set_BsConst_SpeedoGauge_Element
            OA_rp_CS_MemAbsSet_Set_BsConst_TachoGauge_Element: operation=rp_CS_MemAbsSet.Set_BsConst_TachoGauge_Element
            OA_rp_CS_MemAbsSet_Set_BsConst_FuelGauge_Element: operation=rp_CS_MemAbsSet.Set_BsConst_FuelGauge_Element
            OA_rp_CS_MemAbsSet_Set_BsConst_TempGauge_Element: operation=rp_CS_MemAbsSet.Set_BsConst_TempGauge_Element
            OA_rp_CS_MemAbsSet_Set_BsConst_PowerGauge_Element: operation=rp_CS_MemAbsSet.Set_BsConst_PowerGauge_Element
            OA_rp_CS_MemAbsSet_Set_BsConst_OilGauge_Element: operation=rp_CS_MemAbsSet.Set_BsConst_OilGauge_Element
            OA_rp_CS_MemAbsSet_Set_BsConst_TripComputer_Element: operation=rp_CS_MemAbsSet.Set_BsConst_TripComputer_Element
            OA_rp_CS_MemAbsSet_Set_BsConst_Compensation_Line_Slope_m: operation=rp_CS_MemAbsSet.Set_BsConst_Compensation_Line_Slope_m
            OA_rp_CS_MemAbsSet_Set_BsConst_Compensation_Line_Shift_b: operation=rp_CS_MemAbsSet.Set_BsConst_Compensation_Line_Shift_b
            OA_rp_CS_MemAbsSet_Set_BsConst_Lookup_Curve_HotSpot_Coef_X: operation=rp_CS_MemAbsSet.Set_BsConst_Lookup_Curve_HotSpot_Coef_X
            OA_rp_CS_MemAbsSet_Set_BsConst_Lookup_Curve_HotSpot_Coef_Y: operation=rp_CS_MemAbsSet.Set_BsConst_Lookup_Curve_HotSpot_Coef_Y
            OA_rp_CS_MemAbsSet_Set_BsConst_Temp_Threshold_Hysteresis_Derating: operation=rp_CS_MemAbsSet.Set_BsConst_Temp_Threshold_Hysteresis_Derating
            OA_rp_CS_MemAbsSet_Set_BsConst_Derating_Backlight_Disable: operation=rp_CS_MemAbsSet.Set_BsConst_Derating_Backlight_Disable
            OA_rp_CS_MemAbsSet_Set_BsConst_Temperature_Sensor_Conv: operation=rp_CS_MemAbsSet.Set_BsConst_Temperature_Sensor_Conv
            OA_rp_CS_MemAbsSet_Set_BsConst_PCB_Temperature_Sensor_Conv: operation=rp_CS_MemAbsSet.Set_BsConst_PCB_Temperature_Sensor_Conv
            OA_rp_CS_MemAbsSet_Set_BsConst_Display_Illum_Max_Level: operation=rp_CS_MemAbsSet.Set_BsConst_Display_Illum_Max_Level
            OA_rp_CS_MemAbsSet_Set_BsConst_PWM_boost_bypass_duty: operation=rp_CS_MemAbsSet.Set_BsConst_PWM_boost_bypass_duty
            OA_rp_CS_MemAbsSet_Set_BsConst_BsConst_Illumination_ReservedByte: operation=rp_CS_MemAbsSet.Set_BsConst_BsConst_Illumination_ReservedByte
            OA_rp_CS_MemAbsSet_Set_BsConst_Compensation_Line_Slope_m_SafeCopy1: operation=rp_CS_MemAbsSet.Set_BsConst_Compensation_Line_Slope_m_SafeCopy1
            OA_rp_CS_MemAbsSet_Set_BsConst_Compensation_Line_Shift_b_SafeCopy1: operation=rp_CS_MemAbsSet.Set_BsConst_Compensation_Line_Shift_b_SafeCopy1
            OA_rp_CS_MemAbsSet_Set_BsConst_Lookup_Curve_HotSpot_Coef_X_SafeCopy1: operation=rp_CS_MemAbsSet.Set_BsConst_Lookup_Curve_HotSpot_Coef_X_SafeCopy1
            OA_rp_CS_MemAbsSet_Set_BsConst_Lookup_Curve_HotSpot_Coef_Y_SafeCopy1: operation=rp_CS_MemAbsSet.Set_BsConst_Lookup_Curve_HotSpot_Coef_Y_SafeCopy1
            OA_rp_CS_MemAbsSet_Set_BsConst_Temp_Threshold_Hysteresis_Derating_SafeCopy1: operation=rp_CS_MemAbsSet.Set_BsConst_Temp_Threshold_Hysteresis_Derating_SafeCopy1
            OA_rp_CS_MemAbsSet_Set_BsConst_Derating_Backlight_Disable_SafeCopy1: operation=rp_CS_MemAbsSet.Set_BsConst_Derating_Backlight_Disable_SafeCopy1
            OA_rp_CS_MemAbsSet_Set_BsConst_Temperature_Sensor_Conv_SafeCopy1: operation=rp_CS_MemAbsSet.Set_BsConst_Temperature_Sensor_Conv_SafeCopy1
            OA_rp_CS_MemAbsSet_Set_BsConst_PCB_Temperature_Sensor_Conv_SafeCopy1: operation=rp_CS_MemAbsSet.Set_BsConst_PCB_Temperature_Sensor_Conv_SafeCopy1
            OA_rp_CS_MemAbsSet_Set_BsConst_Display_Illum_Max_Level_SafeCopy1: operation=rp_CS_MemAbsSet.Set_BsConst_Display_Illum_Max_Level_SafeCopy1
            OA_rp_CS_MemAbsSet_Set_BsConst_PWM_boost_bypass_duty_SafeCopy1: operation=rp_CS_MemAbsSet.Set_BsConst_PWM_boost_bypass_duty_SafeCopy1
            OA_rp_CS_MemAbsSet_Set_BsConst_BsConst_Illumination_ReservedByte_SafeCopy1: operation=rp_CS_MemAbsSet.Set_BsConst_BsConst_Illumination_ReservedByte_SafeCopy1
            OA_rp_CS_MemAbsSet_Set_BsConst_Compensation_Line_Slope_m_SafeCopy2: operation=rp_CS_MemAbsSet.Set_BsConst_Compensation_Line_Slope_m_SafeCopy2
            OA_rp_CS_MemAbsSet_Set_BsConst_Compensation_Line_Shift_b_SafeCopy2: operation=rp_CS_MemAbsSet.Set_BsConst_Compensation_Line_Shift_b_SafeCopy2
            OA_rp_CS_MemAbsSet_Set_BsConst_Lookup_Curve_HotSpot_Coef_X_SafeCopy2: operation=rp_CS_MemAbsSet.Set_BsConst_Lookup_Curve_HotSpot_Coef_X_SafeCopy2
            OA_rp_CS_MemAbsSet_Set_BsConst_Lookup_Curve_HotSpot_Coef_Y_SafeCopy2: operation=rp_CS_MemAbsSet.Set_BsConst_Lookup_Curve_HotSpot_Coef_Y_SafeCopy2
            OA_rp_CS_MemAbsSet_Set_BsConst_Temp_Threshold_Hysteresis_Derating_SafeCopy2: operation=rp_CS_MemAbsSet.Set_BsConst_Temp_Threshold_Hysteresis_Derating_SafeCopy2
            OA_rp_CS_MemAbsSet_Set_BsConst_Derating_Backlight_Disable_SafeCopy2: operation=rp_CS_MemAbsSet.Set_BsConst_Derating_Backlight_Disable_SafeCopy2
            OA_rp_CS_MemAbsSet_Set_BsConst_Temperature_Sensor_Conv_SafeCopy2: operation=rp_CS_MemAbsSet.Set_BsConst_Temperature_Sensor_Conv_SafeCopy2
            OA_rp_CS_MemAbsSet_Set_BsConst_PCB_Temperature_Sensor_Conv_SafeCopy2: operation=rp_CS_MemAbsSet.Set_BsConst_PCB_Temperature_Sensor_Conv_SafeCopy2
            OA_rp_CS_MemAbsSet_Set_BsConst_Display_Illum_Max_Level_SafeCopy2: operation=rp_CS_MemAbsSet.Set_BsConst_Display_Illum_Max_Level_SafeCopy2
            OA_rp_CS_MemAbsSet_Set_BsConst_PWM_boost_bypass_duty_SafeCopy2: operation=rp_CS_MemAbsSet.Set_BsConst_PWM_boost_bypass_duty_SafeCopy2
            OA_rp_CS_MemAbsSet_Set_BsConst_BsConst_Illumination_ReservedByte_SafeCopy2: operation=rp_CS_MemAbsSet.Set_BsConst_BsConst_Illumination_ReservedByte_SafeCopy2
            OA_rp_CS_MemAbsSet_Set_BsConst_Audio_Element: operation=rp_CS_MemAbsSet.Set_BsConst_Audio_Element
            OA_rp_CS_MemAbsSet_Set_BsConst_Warning_Element: operation=rp_CS_MemAbsSet.Set_BsConst_Warning_Element
            OA_rp_CS_MemAbsSet_Set_BsConst_RealTimeClock_Element: operation=rp_CS_MemAbsSet.Set_BsConst_RealTimeClock_Element
            OA_rp_CS_MemAbsSet_Set_BsConst_Communication_Element: operation=rp_CS_MemAbsSet.Set_BsConst_Communication_Element
            OA_rp_CS_MemAbsSet_Set_BsConst_Power_Element: operation=rp_CS_MemAbsSet.Set_BsConst_Power_Element
            OA_rp_CS_MemAbsSet_Set_BsConst_ServiceReminder_Element: operation=rp_CS_MemAbsSet.Set_BsConst_ServiceReminder_Element
            OA_rp_CS_MemAbsSet_Set_BsConst_EngOffTimer_Element: operation=rp_CS_MemAbsSet.Set_BsConst_EngOffTimer_Element
            OA_rp_CS_MemAbsSet_Set_BsCys_Certicificate_Element: operation=rp_CS_MemAbsSet.Set_BsCys_Certicificate_Element
            OA_rp_CS_MemAbsSet_Set_RefCys_Certicificate_Element: operation=rp_CS_MemAbsSet.Set_RefCys_Certicificate_Element
            OA_rp_CS_MemAbsSet_Set_RefCys_Certicificate1_Element: operation=rp_CS_MemAbsSet.Set_RefCys_Certicificate1_Element
            OA_rp_CS_MemAbsSet_Set_BsRt_Odometer_Element: operation=rp_CS_MemAbsSet.Set_BsRt_Odometer_Element
            OA_rp_CS_MemAbsSet_Set_BsRt_SpeedoGauge_Element: operation=rp_CS_MemAbsSet.Set_BsRt_SpeedoGauge_Element
            OA_rp_CS_MemAbsSet_Set_BsRt_TachoGauge_Element: operation=rp_CS_MemAbsSet.Set_BsRt_TachoGauge_Element
            OA_rp_CS_MemAbsSet_Set_BsRt_FuelGauge_Element: operation=rp_CS_MemAbsSet.Set_BsRt_FuelGauge_Element
            OA_rp_CS_MemAbsSet_Set_BsRt_TempGauge_Element: operation=rp_CS_MemAbsSet.Set_BsRt_TempGauge_Element
            OA_rp_CS_MemAbsSet_Set_BsRt_PowerGauge_Element: operation=rp_CS_MemAbsSet.Set_BsRt_PowerGauge_Element
            OA_rp_CS_MemAbsSet_Set_BsRt_OilGauge_Element: operation=rp_CS_MemAbsSet.Set_BsRt_OilGauge_Element
            OA_rp_CS_MemAbsSet_Set_BsRt_TripComputer_Element: operation=rp_CS_MemAbsSet.Set_BsRt_TripComputer_Element
            OA_rp_CS_MemAbsSet_Set_BsRt_Warning_Element: operation=rp_CS_MemAbsSet.Set_BsRt_Warning_Element
            OA_rp_CS_MemAbsSet_Set_BsRt_RealTimeClock_Element: operation=rp_CS_MemAbsSet.Set_BsRt_RealTimeClock_Element
            OA_rp_CS_MemAbsSet_Set_BsRt_Personalization_Element: operation=rp_CS_MemAbsSet.Set_BsRt_Personalization_Element
            OA_rp_CS_MemAbsSet_Set_BsRt_Illumination_Element: operation=rp_CS_MemAbsSet.Set_BsRt_Illumination_Element
            OA_rp_CS_MemAbsSet_Set_BsRt_CusDlt_Element: operation=rp_CS_MemAbsSet.Set_BsRt_CusDlt_Element
            OA_rp_CS_MemAbsSet_Set_BsReten_Odometer_Element: operation=rp_CS_MemAbsSet.Set_BsReten_Odometer_Element
            OA_rp_CS_MemAbsSet_Set_BsReten_Gauges_Element: operation=rp_CS_MemAbsSet.Set_BsReten_Gauges_Element
            OA_rp_CS_MemAbsSet_Set_BsReten_Tripcomputer_Element: operation=rp_CS_MemAbsSet.Set_BsReten_Tripcomputer_Element
            OA_rp_CS_MemAbsSet_Set_BsReten_Illumination_Element: operation=rp_CS_MemAbsSet.Set_BsReten_Illumination_Element
            OA_rp_CS_MemAbsSet_Set_BsReten_Audio_Element: operation=rp_CS_MemAbsSet.Set_BsReten_Audio_Element
            OA_rp_CS_MemAbsSet_Set_BsReten_Warning_Element: operation=rp_CS_MemAbsSet.Set_BsReten_Warning_Element
            OA_rp_CS_MemAbsSet_Set_BsReten_RealTimeClock_Element: operation=rp_CS_MemAbsSet.Set_BsReten_RealTimeClock_Element
            OA_rp_CS_MemAbsSet_Set_BsReten_Communication_Element: operation=rp_CS_MemAbsSet.Set_BsReten_Communication_Element
            OA_rp_CS_MemAbsSet_Set_BsReten_Personalization_Element: operation=rp_CS_MemAbsSet.Set_BsReten_Personalization_Element
            OA_rp_CS_MemAbsSet_Set_BsReten_VisDlt_Element: operation=rp_CS_MemAbsSet.Set_BsReten_VisDlt_Element
            OA_rp_CS_MemAbsSet_Set_BsReten_Power_Element: operation=rp_CS_MemAbsSet.Set_BsReten_Power_Element
            OA_rp_CS_MemAbsSet_Set_BsReten_Display_Element: operation=rp_CS_MemAbsSet.Set_BsReten_Display_Element
            OA_rp_CS_MemAbsSet_Set_BsDiag_ErrorRecord_Element: operation=rp_CS_MemAbsSet.Set_BsDiag_ErrorRecord_Element
            OA_rp_CS_MemAbsSet_Set_BsDiag_Dtc_Element: operation=rp_CS_MemAbsSet.Set_BsDiag_Dtc_Element
            OA_rp_CS_RID_App_DiagAction_RID_DiagAction: operation=rp_CS_RID_App_DiagAction.RID_DiagAction
            OA_rp_CS_RID_DiagAction_RID_DiagAction: operation=rp_CS_RID_DiagAction.RID_DiagAction
            OA_rp_CS_UpdateCdd_DID_DiagAction_UpdateCdd_GenericDIDRequestHandler: operation=rp_CS_UpdateCdd_DID_DiagAction.UpdateCdd_GenericDIDRequestHandler
            OA_rp_CS_UpdateCdd_RID_DiagAction_UpdateCdd_GenericRIDRequestHandler: operation=rp_CS_UpdateCdd_RID_DiagAction.UpdateCdd_GenericRIDRequestHandler
            OA_rp_CS_UpdateCdd_Service_0x34_Handler_UpdateCdd_GenericDownloadRequestHandler: operation=rp_CS_UpdateCdd_Service_0x34_Handler.UpdateCdd_GenericDownloadRequestHandler
            OA_rp_CS_UpdateCdd_Service_0x36_Handler_UpdateCdd_GenericTransferDataHandler: operation=rp_CS_UpdateCdd_Service_0x36_Handler.UpdateCdd_GenericTransferDataHandler
            OA_rp_CS_UpdateCdd_Service_0x37_Handler_UpdateCdd_GenericTransferExitHandler: operation=rp_CS_UpdateCdd_Service_0x37_Handler.UpdateCdd_GenericTransferExitHandler
        DcmExt_MainFunction
          data-receive-point-by-arguments:
            95 x access:
              DRA_rp_SR_JobStatus_JobStatus_BsConst_Audio_Element: accessed-variable=rp_SR_JobStatus.JobStatus_BsConst_Audio_Element
              DRA_rp_SR_JobStatus_JobStatus_BsConst_BsConst_Illumination_ReservedByte: accessed-variable=rp_SR_JobStatus.JobStatus_BsConst_BsConst_Illumination_ReservedByte
              DRA_rp_SR_JobStatus_JobStatus_BsConst_BsConst_Illumination_ReservedByte_SafeCopy1: accessed-variable=rp_SR_JobStatus.JobStatus_BsConst_BsConst_Illumination_ReservedByte_SafeCopy1
              DRA_rp_SR_JobStatus_JobStatus_BsConst_BsConst_Illumination_ReservedByte_SafeCopy2: accessed-variable=rp_SR_JobStatus.JobStatus_BsConst_BsConst_Illumination_ReservedByte_SafeCopy2
              DRA_rp_SR_JobStatus_JobStatus_BsConst_Communication_Element: accessed-variable=rp_SR_JobStatus.JobStatus_BsConst_Communication_Element
              DRA_rp_SR_JobStatus_JobStatus_BsConst_Compensation_Line_Shift_b: accessed-variable=rp_SR_JobStatus.JobStatus_BsConst_Compensation_Line_Shift_b
              DRA_rp_SR_JobStatus_JobStatus_BsConst_Compensation_Line_Shift_b_SafeCopy1: accessed-variable=rp_SR_JobStatus.JobStatus_BsConst_Compensation_Line_Shift_b_SafeCopy1
              DRA_rp_SR_JobStatus_JobStatus_BsConst_Compensation_Line_Shift_b_SafeCopy2: accessed-variable=rp_SR_JobStatus.JobStatus_BsConst_Compensation_Line_Shift_b_SafeCopy2
              DRA_rp_SR_JobStatus_JobStatus_BsConst_Compensation_Line_Slope_m: accessed-variable=rp_SR_JobStatus.JobStatus_BsConst_Compensation_Line_Slope_m
              DRA_rp_SR_JobStatus_JobStatus_BsConst_Compensation_Line_Slope_m_SafeCopy1: accessed-variable=rp_SR_JobStatus.JobStatus_BsConst_Compensation_Line_Slope_m_SafeCopy1
              DRA_rp_SR_JobStatus_JobStatus_BsConst_Compensation_Line_Slope_m_SafeCopy2: accessed-variable=rp_SR_JobStatus.JobStatus_BsConst_Compensation_Line_Slope_m_SafeCopy2
              DRA_rp_SR_JobStatus_JobStatus_BsConst_Derating_Backlight_Disable: accessed-variable=rp_SR_JobStatus.JobStatus_BsConst_Derating_Backlight_Disable
              DRA_rp_SR_JobStatus_JobStatus_BsConst_Derating_Backlight_Disable_SafeCopy1: accessed-variable=rp_SR_JobStatus.JobStatus_BsConst_Derating_Backlight_Disable_SafeCopy1
              DRA_rp_SR_JobStatus_JobStatus_BsConst_Derating_Backlight_Disable_SafeCopy2: accessed-variable=rp_SR_JobStatus.JobStatus_BsConst_Derating_Backlight_Disable_SafeCopy2
              DRA_rp_SR_JobStatus_JobStatus_BsConst_Display_Illum_Max_Level: accessed-variable=rp_SR_JobStatus.JobStatus_BsConst_Display_Illum_Max_Level
              DRA_rp_SR_JobStatus_JobStatus_BsConst_Display_Illum_Max_Level_SafeCopy1: accessed-variable=rp_SR_JobStatus.JobStatus_BsConst_Display_Illum_Max_Level_SafeCopy1
              DRA_rp_SR_JobStatus_JobStatus_BsConst_Display_Illum_Max_Level_SafeCopy2: accessed-variable=rp_SR_JobStatus.JobStatus_BsConst_Display_Illum_Max_Level_SafeCopy2
              DRA_rp_SR_JobStatus_JobStatus_BsConst_EngOffTimer_Element: accessed-variable=rp_SR_JobStatus.JobStatus_BsConst_EngOffTimer_Element
              DRA_rp_SR_JobStatus_JobStatus_BsConst_FuelGauge_Element: accessed-variable=rp_SR_JobStatus.JobStatus_BsConst_FuelGauge_Element
              DRA_rp_SR_JobStatus_JobStatus_BsConst_Lookup_Curve_HotSpot_Coef_X: accessed-variable=rp_SR_JobStatus.JobStatus_BsConst_Lookup_Curve_HotSpot_Coef_X
              DRA_rp_SR_JobStatus_JobStatus_BsConst_Lookup_Curve_HotSpot_Coef_X_SafeCopy1: accessed-variable=rp_SR_JobStatus.JobStatus_BsConst_Lookup_Curve_HotSpot_Coef_X_SafeCopy1
              DRA_rp_SR_JobStatus_JobStatus_BsConst_Lookup_Curve_HotSpot_Coef_X_SafeCopy2: accessed-variable=rp_SR_JobStatus.JobStatus_BsConst_Lookup_Curve_HotSpot_Coef_X_SafeCopy2
              DRA_rp_SR_JobStatus_JobStatus_BsConst_Lookup_Curve_HotSpot_Coef_Y: accessed-variable=rp_SR_JobStatus.JobStatus_BsConst_Lookup_Curve_HotSpot_Coef_Y
              DRA_rp_SR_JobStatus_JobStatus_BsConst_Lookup_Curve_HotSpot_Coef_Y_SafeCopy1: accessed-variable=rp_SR_JobStatus.JobStatus_BsConst_Lookup_Curve_HotSpot_Coef_Y_SafeCopy1
              DRA_rp_SR_JobStatus_JobStatus_BsConst_Lookup_Curve_HotSpot_Coef_Y_SafeCopy2: accessed-variable=rp_SR_JobStatus.JobStatus_BsConst_Lookup_Curve_HotSpot_Coef_Y_SafeCopy2
              DRA_rp_SR_JobStatus_JobStatus_BsConst_OilGauge_Element: accessed-variable=rp_SR_JobStatus.JobStatus_BsConst_OilGauge_Element
              DRA_rp_SR_JobStatus_JobStatus_BsConst_PCB_Temperature_Sensor_Conv: accessed-variable=rp_SR_JobStatus.JobStatus_BsConst_PCB_Temperature_Sensor_Conv
              DRA_rp_SR_JobStatus_JobStatus_BsConst_PCB_Temperature_Sensor_Conv_SafeCopy1: accessed-variable=rp_SR_JobStatus.JobStatus_BsConst_PCB_Temperature_Sensor_Conv_SafeCopy1
              DRA_rp_SR_JobStatus_JobStatus_BsConst_PCB_Temperature_Sensor_Conv_SafeCopy2: accessed-variable=rp_SR_JobStatus.JobStatus_BsConst_PCB_Temperature_Sensor_Conv_SafeCopy2
              DRA_rp_SR_JobStatus_JobStatus_BsConst_PWM_boost_bypass_duty: accessed-variable=rp_SR_JobStatus.JobStatus_BsConst_PWM_boost_bypass_duty
              DRA_rp_SR_JobStatus_JobStatus_BsConst_PWM_boost_bypass_duty_SafeCopy1: accessed-variable=rp_SR_JobStatus.JobStatus_BsConst_PWM_boost_bypass_duty_SafeCopy1
              DRA_rp_SR_JobStatus_JobStatus_BsConst_PWM_boost_bypass_duty_SafeCopy2: accessed-variable=rp_SR_JobStatus.JobStatus_BsConst_PWM_boost_bypass_duty_SafeCopy2
              DRA_rp_SR_JobStatus_JobStatus_BsConst_PowerGauge_Element: accessed-variable=rp_SR_JobStatus.JobStatus_BsConst_PowerGauge_Element
              DRA_rp_SR_JobStatus_JobStatus_BsConst_Power_Element: accessed-variable=rp_SR_JobStatus.JobStatus_BsConst_Power_Element
              DRA_rp_SR_JobStatus_JobStatus_BsConst_RealTimeClock_Element: accessed-variable=rp_SR_JobStatus.JobStatus_BsConst_RealTimeClock_Element
              DRA_rp_SR_JobStatus_JobStatus_BsConst_ServiceReminder_Element: accessed-variable=rp_SR_JobStatus.JobStatus_BsConst_ServiceReminder_Element
              DRA_rp_SR_JobStatus_JobStatus_BsConst_SpeedoGauge_Element: accessed-variable=rp_SR_JobStatus.JobStatus_BsConst_SpeedoGauge_Element
              DRA_rp_SR_JobStatus_JobStatus_BsConst_TachoGauge_Element: accessed-variable=rp_SR_JobStatus.JobStatus_BsConst_TachoGauge_Element
              DRA_rp_SR_JobStatus_JobStatus_BsConst_TempGauge_Element: accessed-variable=rp_SR_JobStatus.JobStatus_BsConst_TempGauge_Element
              DRA_rp_SR_JobStatus_JobStatus_BsConst_Temp_Threshold_Hysteresis_Derating: accessed-variable=rp_SR_JobStatus.JobStatus_BsConst_Temp_Threshold_Hysteresis_Derating
              DRA_rp_SR_JobStatus_JobStatus_BsConst_Temp_Threshold_Hysteresis_Derating_SafeCopy1: accessed-variable=rp_SR_JobStatus.JobStatus_BsConst_Temp_Threshold_Hysteresis_Derating_SafeCopy1
              DRA_rp_SR_JobStatus_JobStatus_BsConst_Temp_Threshold_Hysteresis_Derating_SafeCopy2: accessed-variable=rp_SR_JobStatus.JobStatus_BsConst_Temp_Threshold_Hysteresis_Derating_SafeCopy2
              DRA_rp_SR_JobStatus_JobStatus_BsConst_Temperature_Sensor_Conv: accessed-variable=rp_SR_JobStatus.JobStatus_BsConst_Temperature_Sensor_Conv
              DRA_rp_SR_JobStatus_JobStatus_BsConst_Temperature_Sensor_Conv_SafeCopy1: accessed-variable=rp_SR_JobStatus.JobStatus_BsConst_Temperature_Sensor_Conv_SafeCopy1
              DRA_rp_SR_JobStatus_JobStatus_BsConst_Temperature_Sensor_Conv_SafeCopy2: accessed-variable=rp_SR_JobStatus.JobStatus_BsConst_Temperature_Sensor_Conv_SafeCopy2
              DRA_rp_SR_JobStatus_JobStatus_BsConst_TripComputer_Element: accessed-variable=rp_SR_JobStatus.JobStatus_BsConst_TripComputer_Element
              DRA_rp_SR_JobStatus_JobStatus_BsConst_Warning_Element: accessed-variable=rp_SR_JobStatus.JobStatus_BsConst_Warning_Element
              DRA_rp_SR_JobStatus_JobStatus_BsCys_Certicificate_Element: accessed-variable=rp_SR_JobStatus.JobStatus_BsCys_Certicificate_Element
              DRA_rp_SR_JobStatus_JobStatus_BsDiag_Dtc_Element: accessed-variable=rp_SR_JobStatus.JobStatus_BsDiag_Dtc_Element
              DRA_rp_SR_JobStatus_JobStatus_BsDiag_ErrorRecord_Element: accessed-variable=rp_SR_JobStatus.JobStatus_BsDiag_ErrorRecord_Element
              DRA_rp_SR_JobStatus_JobStatus_BsReten_Audio_Element: accessed-variable=rp_SR_JobStatus.JobStatus_BsReten_Audio_Element
              DRA_rp_SR_JobStatus_JobStatus_BsReten_Communication_Element: accessed-variable=rp_SR_JobStatus.JobStatus_BsReten_Communication_Element
              DRA_rp_SR_JobStatus_JobStatus_BsReten_Display_Element: accessed-variable=rp_SR_JobStatus.JobStatus_BsReten_Display_Element
              DRA_rp_SR_JobStatus_JobStatus_BsReten_Gauges_Element: accessed-variable=rp_SR_JobStatus.JobStatus_BsReten_Gauges_Element
              DRA_rp_SR_JobStatus_JobStatus_BsReten_Illumination_Element: accessed-variable=rp_SR_JobStatus.JobStatus_BsReten_Illumination_Element
              DRA_rp_SR_JobStatus_JobStatus_BsReten_Odometer_Element: accessed-variable=rp_SR_JobStatus.JobStatus_BsReten_Odometer_Element
              DRA_rp_SR_JobStatus_JobStatus_BsReten_Personalization_Element: accessed-variable=rp_SR_JobStatus.JobStatus_BsReten_Personalization_Element
              DRA_rp_SR_JobStatus_JobStatus_BsReten_Power_Element: accessed-variable=rp_SR_JobStatus.JobStatus_BsReten_Power_Element
              DRA_rp_SR_JobStatus_JobStatus_BsReten_RealTimeClock_Element: accessed-variable=rp_SR_JobStatus.JobStatus_BsReten_RealTimeClock_Element
              DRA_rp_SR_JobStatus_JobStatus_BsReten_Tripcomputer_Element: accessed-variable=rp_SR_JobStatus.JobStatus_BsReten_Tripcomputer_Element
              DRA_rp_SR_JobStatus_JobStatus_BsReten_VisDlt_Element: accessed-variable=rp_SR_JobStatus.JobStatus_BsReten_VisDlt_Element
              DRA_rp_SR_JobStatus_JobStatus_BsReten_Warning_Element: accessed-variable=rp_SR_JobStatus.JobStatus_BsReten_Warning_Element
              DRA_rp_SR_JobStatus_JobStatus_BsRt_CusDlt_Element: accessed-variable=rp_SR_JobStatus.JobStatus_BsRt_CusDlt_Element
              DRA_rp_SR_JobStatus_JobStatus_BsRt_FuelGauge_Element: accessed-variable=rp_SR_JobStatus.JobStatus_BsRt_FuelGauge_Element
              DRA_rp_SR_JobStatus_JobStatus_BsRt_Illumination_Element: accessed-variable=rp_SR_JobStatus.JobStatus_BsRt_Illumination_Element
              DRA_rp_SR_JobStatus_JobStatus_BsRt_Odometer_Element: accessed-variable=rp_SR_JobStatus.JobStatus_BsRt_Odometer_Element
              DRA_rp_SR_JobStatus_JobStatus_BsRt_OilGauge_Element: accessed-variable=rp_SR_JobStatus.JobStatus_BsRt_OilGauge_Element
              DRA_rp_SR_JobStatus_JobStatus_BsRt_Personalization_Element: accessed-variable=rp_SR_JobStatus.JobStatus_BsRt_Personalization_Element
              DRA_rp_SR_JobStatus_JobStatus_BsRt_PowerGauge_Element: accessed-variable=rp_SR_JobStatus.JobStatus_BsRt_PowerGauge_Element
              DRA_rp_SR_JobStatus_JobStatus_BsRt_RealTimeClock_Element: accessed-variable=rp_SR_JobStatus.JobStatus_BsRt_RealTimeClock_Element
              DRA_rp_SR_JobStatus_JobStatus_BsRt_SpeedoGauge_Element: accessed-variable=rp_SR_JobStatus.JobStatus_BsRt_SpeedoGauge_Element
              DRA_rp_SR_JobStatus_JobStatus_BsRt_TachoGauge_Element: accessed-variable=rp_SR_JobStatus.JobStatus_BsRt_TachoGauge_Element
              DRA_rp_SR_JobStatus_JobStatus_BsRt_TempGauge_Element: accessed-variable=rp_SR_JobStatus.JobStatus_BsRt_TempGauge_Element
              DRA_rp_SR_JobStatus_JobStatus_BsRt_TripComputer_Element: accessed-variable=rp_SR_JobStatus.JobStatus_BsRt_TripComputer_Element
              DRA_rp_SR_JobStatus_JobStatus_BsRt_Warning_Element: accessed-variable=rp_SR_JobStatus.JobStatus_BsRt_Warning_Element
              DRA_rp_SR_JobStatus_JobStatus_BsShare_AssemblyManufacturingDate: accessed-variable=rp_SR_JobStatus.JobStatus_BsShare_AssemblyManufacturingDate
              DRA_rp_SR_JobStatus_JobStatus_BsShare_AssemblyPlantNumber: accessed-variable=rp_SR_JobStatus.JobStatus_BsShare_AssemblyPlantNumber
              DRA_rp_SR_JobStatus_JobStatus_BsShare_EcuPartNumber_Element: accessed-variable=rp_SR_JobStatus.JobStatus_BsShare_EcuPartNumber_Element
              DRA_rp_SR_JobStatus_JobStatus_BsShare_HWModification: accessed-variable=rp_SR_JobStatus.JobStatus_BsShare_HWModification
              DRA_rp_SR_JobStatus_JobStatus_BsShare_PCBSerialNumber: accessed-variable=rp_SR_JobStatus.JobStatus_BsShare_PCBSerialNumber
              DRA_rp_SR_JobStatus_JobStatus_BsShare_ProductSerialNumber: accessed-variable=rp_SR_JobStatus.JobStatus_BsShare_ProductSerialNumber
              DRA_rp_SR_JobStatus_JobStatus_BsShare_SMTManufacturingDate: accessed-variable=rp_SR_JobStatus.JobStatus_BsShare_SMTManufacturingDate
              DRA_rp_SR_JobStatus_JobStatus_BsShare_SMTPlantNumber: accessed-variable=rp_SR_JobStatus.JobStatus_BsShare_SMTPlantNumber
              DRA_rp_SR_JobStatus_JobStatus_BsShare_SwUpdFotaFinPrint_Element: accessed-variable=rp_SR_JobStatus.JobStatus_BsShare_SwUpdFotaFinPrint_Element
              DRA_rp_SR_JobStatus_JobStatus_BsShare_SwUpdFotaMode_Element: accessed-variable=rp_SR_JobStatus.JobStatus_BsShare_SwUpdFotaMode_Element
              DRA_rp_SR_JobStatus_JobStatus_BsShare_SwUpdFotaStatus_Element: accessed-variable=rp_SR_JobStatus.JobStatus_BsShare_SwUpdFotaStatus_Element
              DRA_rp_SR_JobStatus_JobStatus_BsShare_SwUpdFotadecrypt_Element: accessed-variable=rp_SR_JobStatus.JobStatus_BsShare_SwUpdFotadecrypt_Element
              DRA_rp_SR_JobStatus_JobStatus_BsShare_SwUpdReflash_Element: accessed-variable=rp_SR_JobStatus.JobStatus_BsShare_SwUpdReflash_Element
              DRA_rp_SR_JobStatus_JobStatus_BsShare_VehicleConfig_Element: accessed-variable=rp_SR_JobStatus.JobStatus_BsShare_VehicleConfig_Element
              DRA_rp_SR_JobStatus_JobStatus_BsShare_VisMeet_EOLEntry_Element: accessed-variable=rp_SR_JobStatus.JobStatus_BsShare_VisMeet_EOLEntry_Element
              DRA_rp_SR_JobStatus_JobStatus_BsShare_VisMeet_Element: accessed-variable=rp_SR_JobStatus.JobStatus_BsShare_VisMeet_Element
              DRA_rp_SR_JobStatus_JobStatus_BsShare_VisteonPCBPartNumber: accessed-variable=rp_SR_JobStatus.JobStatus_BsShare_VisteonPCBPartNumber
              DRA_rp_SR_JobStatus_JobStatus_BsShare_VisteonPartNumber: accessed-variable=rp_SR_JobStatus.JobStatus_BsShare_VisteonPartNumber
              DRA_rp_SR_JobStatus_JobStatus_RefCys_Certicificate1_Element: accessed-variable=rp_SR_JobStatus.JobStatus_RefCys_Certicificate1_Element
              DRA_rp_SR_JobStatus_JobStatus_RefCys_Certicificate_Element: accessed-variable=rp_SR_JobStatus.JobStatus_RefCys_Certicificate_Element
          200 x sync call, all with timeout=0.0:
            OA_rp_CS_DID_App_DiagAction_DID_DiagAction: operation=rp_CS_DID_App_DiagAction.DID_DiagAction
            OA_rp_CS_DID_DiagAction_DID_DiagAction: operation=rp_CS_DID_DiagAction.DID_DiagAction
            OA_rp_CS_DiagEntryStatus_Diag_Entry_Status: operation=rp_CS_DiagEntryStatus.Diag_Entry_Status
            OA_rp_CS_MemAbsGet_Get_BsShare_SwUpdReflash_Element: operation=rp_CS_MemAbsGet.Get_BsShare_SwUpdReflash_Element
            OA_rp_CS_MemAbsGet_Get_BsShare_SwUpdFotaMode_Element: operation=rp_CS_MemAbsGet.Get_BsShare_SwUpdFotaMode_Element
            OA_rp_CS_MemAbsGet_Get_BsShare_SwUpdFotaFinPrint_Element: operation=rp_CS_MemAbsGet.Get_BsShare_SwUpdFotaFinPrint_Element
            OA_rp_CS_MemAbsGet_Get_BsShare_SwUpdFotaStatus_Element: operation=rp_CS_MemAbsGet.Get_BsShare_SwUpdFotaStatus_Element
            OA_rp_CS_MemAbsGet_Get_BsShare_SwUpdFotadecrypt_Element: operation=rp_CS_MemAbsGet.Get_BsShare_SwUpdFotadecrypt_Element
            OA_rp_CS_MemAbsGet_Get_BsShare_EcuPartNumber_Element: operation=rp_CS_MemAbsGet.Get_BsShare_EcuPartNumber_Element
            OA_rp_CS_MemAbsGet_Get_BsShare_VisteonPartNumber: operation=rp_CS_MemAbsGet.Get_BsShare_VisteonPartNumber
            OA_rp_CS_MemAbsGet_Get_BsShare_VisteonPCBPartNumber: operation=rp_CS_MemAbsGet.Get_BsShare_VisteonPCBPartNumber
            OA_rp_CS_MemAbsGet_Get_BsShare_ProductSerialNumber: operation=rp_CS_MemAbsGet.Get_BsShare_ProductSerialNumber
            OA_rp_CS_MemAbsGet_Get_BsShare_PCBSerialNumber: operation=rp_CS_MemAbsGet.Get_BsShare_PCBSerialNumber
            OA_rp_CS_MemAbsGet_Get_BsShare_SMTManufacturingDate: operation=rp_CS_MemAbsGet.Get_BsShare_SMTManufacturingDate
            OA_rp_CS_MemAbsGet_Get_BsShare_AssemblyManufacturingDate: operation=rp_CS_MemAbsGet.Get_BsShare_AssemblyManufacturingDate
            OA_rp_CS_MemAbsGet_Get_BsShare_SMTPlantNumber: operation=rp_CS_MemAbsGet.Get_BsShare_SMTPlantNumber
            OA_rp_CS_MemAbsGet_Get_BsShare_AssemblyPlantNumber: operation=rp_CS_MemAbsGet.Get_BsShare_AssemblyPlantNumber
            OA_rp_CS_MemAbsGet_Get_BsShare_HWModification: operation=rp_CS_MemAbsGet.Get_BsShare_HWModification
            OA_rp_CS_MemAbsGet_Get_BsShare_VisMeet_Element: operation=rp_CS_MemAbsGet.Get_BsShare_VisMeet_Element
            OA_rp_CS_MemAbsGet_Get_BsShare_VisMeet_EOLEntry_Element: operation=rp_CS_MemAbsGet.Get_BsShare_VisMeet_EOLEntry_Element
            OA_rp_CS_MemAbsGet_Get_BsShare_VehicleConfig_Element: operation=rp_CS_MemAbsGet.Get_BsShare_VehicleConfig_Element
            OA_rp_CS_MemAbsGet_Get_BsConst_SpeedoGauge_Element: operation=rp_CS_MemAbsGet.Get_BsConst_SpeedoGauge_Element
            OA_rp_CS_MemAbsGet_Get_BsConst_TachoGauge_Element: operation=rp_CS_MemAbsGet.Get_BsConst_TachoGauge_Element
            OA_rp_CS_MemAbsGet_Get_BsConst_FuelGauge_Element: operation=rp_CS_MemAbsGet.Get_BsConst_FuelGauge_Element
            OA_rp_CS_MemAbsGet_Get_BsConst_TempGauge_Element: operation=rp_CS_MemAbsGet.Get_BsConst_TempGauge_Element
            OA_rp_CS_MemAbsGet_Get_BsConst_PowerGauge_Element: operation=rp_CS_MemAbsGet.Get_BsConst_PowerGauge_Element
            OA_rp_CS_MemAbsGet_Get_BsConst_OilGauge_Element: operation=rp_CS_MemAbsGet.Get_BsConst_OilGauge_Element
            OA_rp_CS_MemAbsGet_Get_BsConst_TripComputer_Element: operation=rp_CS_MemAbsGet.Get_BsConst_TripComputer_Element
            OA_rp_CS_MemAbsGet_Get_BsConst_Compensation_Line_Slope_m: operation=rp_CS_MemAbsGet.Get_BsConst_Compensation_Line_Slope_m
            OA_rp_CS_MemAbsGet_Get_BsConst_Compensation_Line_Shift_b: operation=rp_CS_MemAbsGet.Get_BsConst_Compensation_Line_Shift_b
            OA_rp_CS_MemAbsGet_Get_BsConst_Lookup_Curve_HotSpot_Coef_X: operation=rp_CS_MemAbsGet.Get_BsConst_Lookup_Curve_HotSpot_Coef_X
            OA_rp_CS_MemAbsGet_Get_BsConst_Lookup_Curve_HotSpot_Coef_Y: operation=rp_CS_MemAbsGet.Get_BsConst_Lookup_Curve_HotSpot_Coef_Y
            OA_rp_CS_MemAbsGet_Get_BsConst_Temp_Threshold_Hysteresis_Derating: operation=rp_CS_MemAbsGet.Get_BsConst_Temp_Threshold_Hysteresis_Derating
            OA_rp_CS_MemAbsGet_Get_BsConst_Derating_Backlight_Disable: operation=rp_CS_MemAbsGet.Get_BsConst_Derating_Backlight_Disable
            OA_rp_CS_MemAbsGet_Get_BsConst_Temperature_Sensor_Conv: operation=rp_CS_MemAbsGet.Get_BsConst_Temperature_Sensor_Conv
            OA_rp_CS_MemAbsGet_Get_BsConst_PCB_Temperature_Sensor_Conv: operation=rp_CS_MemAbsGet.Get_BsConst_PCB_Temperature_Sensor_Conv
            OA_rp_CS_MemAbsGet_Get_BsConst_Display_Illum_Max_Level: operation=rp_CS_MemAbsGet.Get_BsConst_Display_Illum_Max_Level
            OA_rp_CS_MemAbsGet_Get_BsConst_PWM_boost_bypass_duty: operation=rp_CS_MemAbsGet.Get_BsConst_PWM_boost_bypass_duty
            OA_rp_CS_MemAbsGet_Get_BsConst_BsConst_Illumination_ReservedByte: operation=rp_CS_MemAbsGet.Get_BsConst_BsConst_Illumination_ReservedByte
            OA_rp_CS_MemAbsGet_Get_BsConst_Compensation_Line_Slope_m_SafeCopy1: operation=rp_CS_MemAbsGet.Get_BsConst_Compensation_Line_Slope_m_SafeCopy1
            OA_rp_CS_MemAbsGet_Get_BsConst_Compensation_Line_Shift_b_SafeCopy1: operation=rp_CS_MemAbsGet.Get_BsConst_Compensation_Line_Shift_b_SafeCopy1
            OA_rp_CS_MemAbsGet_Get_BsConst_Lookup_Curve_HotSpot_Coef_X_SafeCopy1: operation=rp_CS_MemAbsGet.Get_BsConst_Lookup_Curve_HotSpot_Coef_X_SafeCopy1
            OA_rp_CS_MemAbsGet_Get_BsConst_Lookup_Curve_HotSpot_Coef_Y_SafeCopy1: operation=rp_CS_MemAbsGet.Get_BsConst_Lookup_Curve_HotSpot_Coef_Y_SafeCopy1
            OA_rp_CS_MemAbsGet_Get_BsConst_Temp_Threshold_Hysteresis_Derating_SafeCopy1: operation=rp_CS_MemAbsGet.Get_BsConst_Temp_Threshold_Hysteresis_Derating_SafeCopy1
            OA_rp_CS_MemAbsGet_Get_BsConst_Derating_Backlight_Disable_SafeCopy1: operation=rp_CS_MemAbsGet.Get_BsConst_Derating_Backlight_Disable_SafeCopy1
            OA_rp_CS_MemAbsGet_Get_BsConst_Temperature_Sensor_Conv_SafeCopy1: operation=rp_CS_MemAbsGet.Get_BsConst_Temperature_Sensor_Conv_SafeCopy1
            OA_rp_CS_MemAbsGet_Get_BsConst_PCB_Temperature_Sensor_Conv_SafeCopy1: operation=rp_CS_MemAbsGet.Get_BsConst_PCB_Temperature_Sensor_Conv_SafeCopy1
            OA_rp_CS_MemAbsGet_Get_BsConst_Display_Illum_Max_Level_SafeCopy1: operation=rp_CS_MemAbsGet.Get_BsConst_Display_Illum_Max_Level_SafeCopy1
            OA_rp_CS_MemAbsGet_Get_BsConst_PWM_boost_bypass_duty_SafeCopy1: operation=rp_CS_MemAbsGet.Get_BsConst_PWM_boost_bypass_duty_SafeCopy1
            OA_rp_CS_MemAbsGet_Get_BsConst_BsConst_Illumination_ReservedByte_SafeCopy1: operation=rp_CS_MemAbsGet.Get_BsConst_BsConst_Illumination_ReservedByte_SafeCopy1
            OA_rp_CS_MemAbsGet_Get_BsConst_Compensation_Line_Slope_m_SafeCopy2: operation=rp_CS_MemAbsGet.Get_BsConst_Compensation_Line_Slope_m_SafeCopy2
            OA_rp_CS_MemAbsGet_Get_BsConst_Compensation_Line_Shift_b_SafeCopy2: operation=rp_CS_MemAbsGet.Get_BsConst_Compensation_Line_Shift_b_SafeCopy2
            OA_rp_CS_MemAbsGet_Get_BsConst_Lookup_Curve_HotSpot_Coef_X_SafeCopy2: operation=rp_CS_MemAbsGet.Get_BsConst_Lookup_Curve_HotSpot_Coef_X_SafeCopy2
            OA_rp_CS_MemAbsGet_Get_BsConst_Lookup_Curve_HotSpot_Coef_Y_SafeCopy2: operation=rp_CS_MemAbsGet.Get_BsConst_Lookup_Curve_HotSpot_Coef_Y_SafeCopy2
            OA_rp_CS_MemAbsGet_Get_BsConst_Temp_Threshold_Hysteresis_Derating_SafeCopy2: operation=rp_CS_MemAbsGet.Get_BsConst_Temp_Threshold_Hysteresis_Derating_SafeCopy2
            OA_rp_CS_MemAbsGet_Get_BsConst_Derating_Backlight_Disable_SafeCopy2: operation=rp_CS_MemAbsGet.Get_BsConst_Derating_Backlight_Disable_SafeCopy2
            OA_rp_CS_MemAbsGet_Get_BsConst_Temperature_Sensor_Conv_SafeCopy2: operation=rp_CS_MemAbsGet.Get_BsConst_Temperature_Sensor_Conv_SafeCopy2
            OA_rp_CS_MemAbsGet_Get_BsConst_PCB_Temperature_Sensor_Conv_SafeCopy2: operation=rp_CS_MemAbsGet.Get_BsConst_PCB_Temperature_Sensor_Conv_SafeCopy2
            OA_rp_CS_MemAbsGet_Get_BsConst_Display_Illum_Max_Level_SafeCopy2: operation=rp_CS_MemAbsGet.Get_BsConst_Display_Illum_Max_Level_SafeCopy2
            OA_rp_CS_MemAbsGet_Get_BsConst_PWM_boost_bypass_duty_SafeCopy2: operation=rp_CS_MemAbsGet.Get_BsConst_PWM_boost_bypass_duty_SafeCopy2
            OA_rp_CS_MemAbsGet_Get_BsConst_BsConst_Illumination_ReservedByte_SafeCopy2: operation=rp_CS_MemAbsGet.Get_BsConst_BsConst_Illumination_ReservedByte_SafeCopy2
            OA_rp_CS_MemAbsGet_Get_BsConst_Audio_Element: operation=rp_CS_MemAbsGet.Get_BsConst_Audio_Element
            OA_rp_CS_MemAbsGet_Get_BsConst_Warning_Element: operation=rp_CS_MemAbsGet.Get_BsConst_Warning_Element
            OA_rp_CS_MemAbsGet_Get_BsConst_RealTimeClock_Element: operation=rp_CS_MemAbsGet.Get_BsConst_RealTimeClock_Element
            OA_rp_CS_MemAbsGet_Get_BsConst_Communication_Element: operation=rp_CS_MemAbsGet.Get_BsConst_Communication_Element
            OA_rp_CS_MemAbsGet_Get_BsConst_Power_Element: operation=rp_CS_MemAbsGet.Get_BsConst_Power_Element
            OA_rp_CS_MemAbsGet_Get_BsConst_ServiceReminder_Element: operation=rp_CS_MemAbsGet.Get_BsConst_ServiceReminder_Element
            OA_rp_CS_MemAbsGet_Get_BsConst_EngOffTimer_Element: operation=rp_CS_MemAbsGet.Get_BsConst_EngOffTimer_Element
            OA_rp_CS_MemAbsGet_Get_BsCys_Certicificate_Element: operation=rp_CS_MemAbsGet.Get_BsCys_Certicificate_Element
            OA_rp_CS_MemAbsGet_Get_RefCys_Certicificate_Element: operation=rp_CS_MemAbsGet.Get_RefCys_Certicificate_Element
            OA_rp_CS_MemAbsGet_Get_RefCys_Certicificate1_Element: operation=rp_CS_MemAbsGet.Get_RefCys_Certicificate1_Element
            OA_rp_CS_MemAbsGet_Get_BsRt_Odometer_Element: operation=rp_CS_MemAbsGet.Get_BsRt_Odometer_Element
            OA_rp_CS_MemAbsGet_Get_BsRt_SpeedoGauge_Element: operation=rp_CS_MemAbsGet.Get_BsRt_SpeedoGauge_Element
            OA_rp_CS_MemAbsGet_Get_BsRt_TachoGauge_Element: operation=rp_CS_MemAbsGet.Get_BsRt_TachoGauge_Element
            OA_rp_CS_MemAbsGet_Get_BsRt_FuelGauge_Element: operation=rp_CS_MemAbsGet.Get_BsRt_FuelGauge_Element
            OA_rp_CS_MemAbsGet_Get_BsRt_TempGauge_Element: operation=rp_CS_MemAbsGet.Get_BsRt_TempGauge_Element
            OA_rp_CS_MemAbsGet_Get_BsRt_PowerGauge_Element: operation=rp_CS_MemAbsGet.Get_BsRt_PowerGauge_Element
            OA_rp_CS_MemAbsGet_Get_BsRt_OilGauge_Element: operation=rp_CS_MemAbsGet.Get_BsRt_OilGauge_Element
            OA_rp_CS_MemAbsGet_Get_BsRt_TripComputer_Element: operation=rp_CS_MemAbsGet.Get_BsRt_TripComputer_Element
            OA_rp_CS_MemAbsGet_Get_BsRt_Warning_Element: operation=rp_CS_MemAbsGet.Get_BsRt_Warning_Element
            OA_rp_CS_MemAbsGet_Get_BsRt_RealTimeClock_Element: operation=rp_CS_MemAbsGet.Get_BsRt_RealTimeClock_Element
            OA_rp_CS_MemAbsGet_Get_BsRt_Personalization_Element: operation=rp_CS_MemAbsGet.Get_BsRt_Personalization_Element
            OA_rp_CS_MemAbsGet_Get_BsRt_Illumination_Element: operation=rp_CS_MemAbsGet.Get_BsRt_Illumination_Element
            OA_rp_CS_MemAbsGet_Get_BsRt_CusDlt_Element: operation=rp_CS_MemAbsGet.Get_BsRt_CusDlt_Element
            OA_rp_CS_MemAbsGet_Get_BsReten_Odometer_Element: operation=rp_CS_MemAbsGet.Get_BsReten_Odometer_Element
            OA_rp_CS_MemAbsGet_Get_BsReten_Gauges_Element: operation=rp_CS_MemAbsGet.Get_BsReten_Gauges_Element
            OA_rp_CS_MemAbsGet_Get_BsReten_Tripcomputer_Element: operation=rp_CS_MemAbsGet.Get_BsReten_Tripcomputer_Element
            OA_rp_CS_MemAbsGet_Get_BsReten_Illumination_Element: operation=rp_CS_MemAbsGet.Get_BsReten_Illumination_Element
            OA_rp_CS_MemAbsGet_Get_BsReten_Audio_Element: operation=rp_CS_MemAbsGet.Get_BsReten_Audio_Element
            OA_rp_CS_MemAbsGet_Get_BsReten_Warning_Element: operation=rp_CS_MemAbsGet.Get_BsReten_Warning_Element
            OA_rp_CS_MemAbsGet_Get_BsReten_RealTimeClock_Element: operation=rp_CS_MemAbsGet.Get_BsReten_RealTimeClock_Element
            OA_rp_CS_MemAbsGet_Get_BsReten_Communication_Element: operation=rp_CS_MemAbsGet.Get_BsReten_Communication_Element
            OA_rp_CS_MemAbsGet_Get_BsReten_Personalization_Element: operation=rp_CS_MemAbsGet.Get_BsReten_Personalization_Element
            OA_rp_CS_MemAbsGet_Get_BsReten_VisDlt_Element: operation=rp_CS_MemAbsGet.Get_BsReten_VisDlt_Element
            OA_rp_CS_MemAbsGet_Get_BsReten_Power_Element: operation=rp_CS_MemAbsGet.Get_BsReten_Power_Element
            OA_rp_CS_MemAbsGet_Get_BsReten_Display_Element: operation=rp_CS_MemAbsGet.Get_BsReten_Display_Element
            OA_rp_CS_MemAbsGet_Get_BsDiag_ErrorRecord_Element: operation=rp_CS_MemAbsGet.Get_BsDiag_ErrorRecord_Element
            OA_rp_CS_MemAbsGet_Get_BsDiag_Dtc_Element: operation=rp_CS_MemAbsGet.Get_BsDiag_Dtc_Element
            OA_rp_CS_MemAbsSet_Set_BsShare_SwUpdReflash_Element: operation=rp_CS_MemAbsSet.Set_BsShare_SwUpdReflash_Element
            OA_rp_CS_MemAbsSet_Set_BsShare_SwUpdFotaMode_Element: operation=rp_CS_MemAbsSet.Set_BsShare_SwUpdFotaMode_Element
            OA_rp_CS_MemAbsSet_Set_BsShare_SwUpdFotaFinPrint_Element: operation=rp_CS_MemAbsSet.Set_BsShare_SwUpdFotaFinPrint_Element
            OA_rp_CS_MemAbsSet_Set_BsShare_SwUpdFotaStatus_Element: operation=rp_CS_MemAbsSet.Set_BsShare_SwUpdFotaStatus_Element
            OA_rp_CS_MemAbsSet_Set_BsShare_SwUpdFotadecrypt_Element: operation=rp_CS_MemAbsSet.Set_BsShare_SwUpdFotadecrypt_Element
            OA_rp_CS_MemAbsSet_Set_BsShare_EcuPartNumber_Element: operation=rp_CS_MemAbsSet.Set_BsShare_EcuPartNumber_Element
            OA_rp_CS_MemAbsSet_Set_BsShare_VisteonPartNumber: operation=rp_CS_MemAbsSet.Set_BsShare_VisteonPartNumber
            OA_rp_CS_MemAbsSet_Set_BsShare_VisteonPCBPartNumber: operation=rp_CS_MemAbsSet.Set_BsShare_VisteonPCBPartNumber
            OA_rp_CS_MemAbsSet_Set_BsShare_ProductSerialNumber: operation=rp_CS_MemAbsSet.Set_BsShare_ProductSerialNumber
            OA_rp_CS_MemAbsSet_Set_BsShare_PCBSerialNumber: operation=rp_CS_MemAbsSet.Set_BsShare_PCBSerialNumber
            OA_rp_CS_MemAbsSet_Set_BsShare_SMTManufacturingDate: operation=rp_CS_MemAbsSet.Set_BsShare_SMTManufacturingDate
            OA_rp_CS_MemAbsSet_Set_BsShare_AssemblyManufacturingDate: operation=rp_CS_MemAbsSet.Set_BsShare_AssemblyManufacturingDate
            OA_rp_CS_MemAbsSet_Set_BsShare_SMTPlantNumber: operation=rp_CS_MemAbsSet.Set_BsShare_SMTPlantNumber
            OA_rp_CS_MemAbsSet_Set_BsShare_AssemblyPlantNumber: operation=rp_CS_MemAbsSet.Set_BsShare_AssemblyPlantNumber
            OA_rp_CS_MemAbsSet_Set_BsShare_HWModification: operation=rp_CS_MemAbsSet.Set_BsShare_HWModification
            OA_rp_CS_MemAbsSet_Set_BsShare_VisMeet_Element: operation=rp_CS_MemAbsSet.Set_BsShare_VisMeet_Element
            OA_rp_CS_MemAbsSet_Set_BsShare_VisMeet_EOLEntry_Element: operation=rp_CS_MemAbsSet.Set_BsShare_VisMeet_EOLEntry_Element
            OA_rp_CS_MemAbsSet_Set_BsShare_VehicleConfig_Element: operation=rp_CS_MemAbsSet.Set_BsShare_VehicleConfig_Element
            OA_rp_CS_MemAbsSet_Set_BsConst_SpeedoGauge_Element: operation=rp_CS_MemAbsSet.Set_BsConst_SpeedoGauge_Element
            OA_rp_CS_MemAbsSet_Set_BsConst_TachoGauge_Element: operation=rp_CS_MemAbsSet.Set_BsConst_TachoGauge_Element
            OA_rp_CS_MemAbsSet_Set_BsConst_FuelGauge_Element: operation=rp_CS_MemAbsSet.Set_BsConst_FuelGauge_Element
            OA_rp_CS_MemAbsSet_Set_BsConst_TempGauge_Element: operation=rp_CS_MemAbsSet.Set_BsConst_TempGauge_Element
            OA_rp_CS_MemAbsSet_Set_BsConst_PowerGauge_Element: operation=rp_CS_MemAbsSet.Set_BsConst_PowerGauge_Element
            OA_rp_CS_MemAbsSet_Set_BsConst_OilGauge_Element: operation=rp_CS_MemAbsSet.Set_BsConst_OilGauge_Element
            OA_rp_CS_MemAbsSet_Set_BsConst_TripComputer_Element: operation=rp_CS_MemAbsSet.Set_BsConst_TripComputer_Element
            OA_rp_CS_MemAbsSet_Set_BsConst_Compensation_Line_Slope_m: operation=rp_CS_MemAbsSet.Set_BsConst_Compensation_Line_Slope_m
            OA_rp_CS_MemAbsSet_Set_BsConst_Compensation_Line_Shift_b: operation=rp_CS_MemAbsSet.Set_BsConst_Compensation_Line_Shift_b
            OA_rp_CS_MemAbsSet_Set_BsConst_Lookup_Curve_HotSpot_Coef_X: operation=rp_CS_MemAbsSet.Set_BsConst_Lookup_Curve_HotSpot_Coef_X
            OA_rp_CS_MemAbsSet_Set_BsConst_Lookup_Curve_HotSpot_Coef_Y: operation=rp_CS_MemAbsSet.Set_BsConst_Lookup_Curve_HotSpot_Coef_Y
            OA_rp_CS_MemAbsSet_Set_BsConst_Temp_Threshold_Hysteresis_Derating: operation=rp_CS_MemAbsSet.Set_BsConst_Temp_Threshold_Hysteresis_Derating
            OA_rp_CS_MemAbsSet_Set_BsConst_Derating_Backlight_Disable: operation=rp_CS_MemAbsSet.Set_BsConst_Derating_Backlight_Disable
            OA_rp_CS_MemAbsSet_Set_BsConst_Temperature_Sensor_Conv: operation=rp_CS_MemAbsSet.Set_BsConst_Temperature_Sensor_Conv
            OA_rp_CS_MemAbsSet_Set_BsConst_PCB_Temperature_Sensor_Conv: operation=rp_CS_MemAbsSet.Set_BsConst_PCB_Temperature_Sensor_Conv
            OA_rp_CS_MemAbsSet_Set_BsConst_Display_Illum_Max_Level: operation=rp_CS_MemAbsSet.Set_BsConst_Display_Illum_Max_Level
            OA_rp_CS_MemAbsSet_Set_BsConst_PWM_boost_bypass_duty: operation=rp_CS_MemAbsSet.Set_BsConst_PWM_boost_bypass_duty
            OA_rp_CS_MemAbsSet_Set_BsConst_BsConst_Illumination_ReservedByte: operation=rp_CS_MemAbsSet.Set_BsConst_BsConst_Illumination_ReservedByte
            OA_rp_CS_MemAbsSet_Set_BsConst_Compensation_Line_Slope_m_SafeCopy1: operation=rp_CS_MemAbsSet.Set_BsConst_Compensation_Line_Slope_m_SafeCopy1
            OA_rp_CS_MemAbsSet_Set_BsConst_Compensation_Line_Shift_b_SafeCopy1: operation=rp_CS_MemAbsSet.Set_BsConst_Compensation_Line_Shift_b_SafeCopy1
            OA_rp_CS_MemAbsSet_Set_BsConst_Lookup_Curve_HotSpot_Coef_X_SafeCopy1: operation=rp_CS_MemAbsSet.Set_BsConst_Lookup_Curve_HotSpot_Coef_X_SafeCopy1
            OA_rp_CS_MemAbsSet_Set_BsConst_Lookup_Curve_HotSpot_Coef_Y_SafeCopy1: operation=rp_CS_MemAbsSet.Set_BsConst_Lookup_Curve_HotSpot_Coef_Y_SafeCopy1
            OA_rp_CS_MemAbsSet_Set_BsConst_Temp_Threshold_Hysteresis_Derating_SafeCopy1: operation=rp_CS_MemAbsSet.Set_BsConst_Temp_Threshold_Hysteresis_Derating_SafeCopy1
            OA_rp_CS_MemAbsSet_Set_BsConst_Derating_Backlight_Disable_SafeCopy1: operation=rp_CS_MemAbsSet.Set_BsConst_Derating_Backlight_Disable_SafeCopy1
            OA_rp_CS_MemAbsSet_Set_BsConst_Temperature_Sensor_Conv_SafeCopy1: operation=rp_CS_MemAbsSet.Set_BsConst_Temperature_Sensor_Conv_SafeCopy1
            OA_rp_CS_MemAbsSet_Set_BsConst_PCB_Temperature_Sensor_Conv_SafeCopy1: operation=rp_CS_MemAbsSet.Set_BsConst_PCB_Temperature_Sensor_Conv_SafeCopy1
            OA_rp_CS_MemAbsSet_Set_BsConst_Display_Illum_Max_Level_SafeCopy1: operation=rp_CS_MemAbsSet.Set_BsConst_Display_Illum_Max_Level_SafeCopy1
            OA_rp_CS_MemAbsSet_Set_BsConst_PWM_boost_bypass_duty_SafeCopy1: operation=rp_CS_MemAbsSet.Set_BsConst_PWM_boost_bypass_duty_SafeCopy1
            OA_rp_CS_MemAbsSet_Set_BsConst_BsConst_Illumination_ReservedByte_SafeCopy1: operation=rp_CS_MemAbsSet.Set_BsConst_BsConst_Illumination_ReservedByte_SafeCopy1
            OA_rp_CS_MemAbsSet_Set_BsConst_Compensation_Line_Slope_m_SafeCopy2: operation=rp_CS_MemAbsSet.Set_BsConst_Compensation_Line_Slope_m_SafeCopy2
            OA_rp_CS_MemAbsSet_Set_BsConst_Compensation_Line_Shift_b_SafeCopy2: operation=rp_CS_MemAbsSet.Set_BsConst_Compensation_Line_Shift_b_SafeCopy2
            OA_rp_CS_MemAbsSet_Set_BsConst_Lookup_Curve_HotSpot_Coef_X_SafeCopy2: operation=rp_CS_MemAbsSet.Set_BsConst_Lookup_Curve_HotSpot_Coef_X_SafeCopy2
            OA_rp_CS_MemAbsSet_Set_BsConst_Lookup_Curve_HotSpot_Coef_Y_SafeCopy2: operation=rp_CS_MemAbsSet.Set_BsConst_Lookup_Curve_HotSpot_Coef_Y_SafeCopy2
            OA_rp_CS_MemAbsSet_Set_BsConst_Temp_Threshold_Hysteresis_Derating_SafeCopy2: operation=rp_CS_MemAbsSet.Set_BsConst_Temp_Threshold_Hysteresis_Derating_SafeCopy2
            OA_rp_CS_MemAbsSet_Set_BsConst_Derating_Backlight_Disable_SafeCopy2: operation=rp_CS_MemAbsSet.Set_BsConst_Derating_Backlight_Disable_SafeCopy2
            OA_rp_CS_MemAbsSet_Set_BsConst_Temperature_Sensor_Conv_SafeCopy2: operation=rp_CS_MemAbsSet.Set_BsConst_Temperature_Sensor_Conv_SafeCopy2
            OA_rp_CS_MemAbsSet_Set_BsConst_PCB_Temperature_Sensor_Conv_SafeCopy2: operation=rp_CS_MemAbsSet.Set_BsConst_PCB_Temperature_Sensor_Conv_SafeCopy2
            OA_rp_CS_MemAbsSet_Set_BsConst_Display_Illum_Max_Level_SafeCopy2: operation=rp_CS_MemAbsSet.Set_BsConst_Display_Illum_Max_Level_SafeCopy2
            OA_rp_CS_MemAbsSet_Set_BsConst_PWM_boost_bypass_duty_SafeCopy2: operation=rp_CS_MemAbsSet.Set_BsConst_PWM_boost_bypass_duty_SafeCopy2
            OA_rp_CS_MemAbsSet_Set_BsConst_BsConst_Illumination_ReservedByte_SafeCopy2: operation=rp_CS_MemAbsSet.Set_BsConst_BsConst_Illumination_ReservedByte_SafeCopy2
            OA_rp_CS_MemAbsSet_Set_BsConst_Audio_Element: operation=rp_CS_MemAbsSet.Set_BsConst_Audio_Element
            OA_rp_CS_MemAbsSet_Set_BsConst_Warning_Element: operation=rp_CS_MemAbsSet.Set_BsConst_Warning_Element
            OA_rp_CS_MemAbsSet_Set_BsConst_RealTimeClock_Element: operation=rp_CS_MemAbsSet.Set_BsConst_RealTimeClock_Element
            OA_rp_CS_MemAbsSet_Set_BsConst_Communication_Element: operation=rp_CS_MemAbsSet.Set_BsConst_Communication_Element
            OA_rp_CS_MemAbsSet_Set_BsConst_Power_Element: operation=rp_CS_MemAbsSet.Set_BsConst_Power_Element
            OA_rp_CS_MemAbsSet_Set_BsConst_ServiceReminder_Element: operation=rp_CS_MemAbsSet.Set_BsConst_ServiceReminder_Element
            OA_rp_CS_MemAbsSet_Set_BsConst_EngOffTimer_Element: operation=rp_CS_MemAbsSet.Set_BsConst_EngOffTimer_Element
            OA_rp_CS_MemAbsSet_Set_BsCys_Certicificate_Element: operation=rp_CS_MemAbsSet.Set_BsCys_Certicificate_Element
            OA_rp_CS_MemAbsSet_Set_RefCys_Certicificate_Element: operation=rp_CS_MemAbsSet.Set_RefCys_Certicificate_Element
            OA_rp_CS_MemAbsSet_Set_RefCys_Certicificate1_Element: operation=rp_CS_MemAbsSet.Set_RefCys_Certicificate1_Element
            OA_rp_CS_MemAbsSet_Set_BsRt_Odometer_Element: operation=rp_CS_MemAbsSet.Set_BsRt_Odometer_Element
            OA_rp_CS_MemAbsSet_Set_BsRt_SpeedoGauge_Element: operation=rp_CS_MemAbsSet.Set_BsRt_SpeedoGauge_Element
            OA_rp_CS_MemAbsSet_Set_BsRt_TachoGauge_Element: operation=rp_CS_MemAbsSet.Set_BsRt_TachoGauge_Element
            OA_rp_CS_MemAbsSet_Set_BsRt_FuelGauge_Element: operation=rp_CS_MemAbsSet.Set_BsRt_FuelGauge_Element
            OA_rp_CS_MemAbsSet_Set_BsRt_TempGauge_Element: operation=rp_CS_MemAbsSet.Set_BsRt_TempGauge_Element
            OA_rp_CS_MemAbsSet_Set_BsRt_PowerGauge_Element: operation=rp_CS_MemAbsSet.Set_BsRt_PowerGauge_Element
            OA_rp_CS_MemAbsSet_Set_BsRt_OilGauge_Element: operation=rp_CS_MemAbsSet.Set_BsRt_OilGauge_Element
            OA_rp_CS_MemAbsSet_Set_BsRt_TripComputer_Element: operation=rp_CS_MemAbsSet.Set_BsRt_TripComputer_Element
            OA_rp_CS_MemAbsSet_Set_BsRt_Warning_Element: operation=rp_CS_MemAbsSet.Set_BsRt_Warning_Element
            OA_rp_CS_MemAbsSet_Set_BsRt_RealTimeClock_Element: operation=rp_CS_MemAbsSet.Set_BsRt_RealTimeClock_Element
            OA_rp_CS_MemAbsSet_Set_BsRt_Personalization_Element: operation=rp_CS_MemAbsSet.Set_BsRt_Personalization_Element
            OA_rp_CS_MemAbsSet_Set_BsRt_Illumination_Element: operation=rp_CS_MemAbsSet.Set_BsRt_Illumination_Element
            OA_rp_CS_MemAbsSet_Set_BsRt_CusDlt_Element: operation=rp_CS_MemAbsSet.Set_BsRt_CusDlt_Element
            OA_rp_CS_MemAbsSet_Set_BsReten_Odometer_Element: operation=rp_CS_MemAbsSet.Set_BsReten_Odometer_Element
            OA_rp_CS_MemAbsSet_Set_BsReten_Gauges_Element: operation=rp_CS_MemAbsSet.Set_BsReten_Gauges_Element
            OA_rp_CS_MemAbsSet_Set_BsReten_Tripcomputer_Element: operation=rp_CS_MemAbsSet.Set_BsReten_Tripcomputer_Element
            OA_rp_CS_MemAbsSet_Set_BsReten_Illumination_Element: operation=rp_CS_MemAbsSet.Set_BsReten_Illumination_Element
            OA_rp_CS_MemAbsSet_Set_BsReten_Audio_Element: operation=rp_CS_MemAbsSet.Set_BsReten_Audio_Element
            OA_rp_CS_MemAbsSet_Set_BsReten_Warning_Element: operation=rp_CS_MemAbsSet.Set_BsReten_Warning_Element
            OA_rp_CS_MemAbsSet_Set_BsReten_RealTimeClock_Element: operation=rp_CS_MemAbsSet.Set_BsReten_RealTimeClock_Element
            OA_rp_CS_MemAbsSet_Set_BsReten_Communication_Element: operation=rp_CS_MemAbsSet.Set_BsReten_Communication_Element
            OA_rp_CS_MemAbsSet_Set_BsReten_Personalization_Element: operation=rp_CS_MemAbsSet.Set_BsReten_Personalization_Element
            OA_rp_CS_MemAbsSet_Set_BsReten_VisDlt_Element: operation=rp_CS_MemAbsSet.Set_BsReten_VisDlt_Element
            OA_rp_CS_MemAbsSet_Set_BsReten_Power_Element: operation=rp_CS_MemAbsSet.Set_BsReten_Power_Element
            OA_rp_CS_MemAbsSet_Set_BsReten_Display_Element: operation=rp_CS_MemAbsSet.Set_BsReten_Display_Element
            OA_rp_CS_MemAbsSet_Set_BsDiag_ErrorRecord_Element: operation=rp_CS_MemAbsSet.Set_BsDiag_ErrorRecord_Element
            OA_rp_CS_MemAbsSet_Set_BsDiag_Dtc_Element: operation=rp_CS_MemAbsSet.Set_BsDiag_Dtc_Element
            OA_rp_CS_RID_App_DiagAction_RID_DiagAction: operation=rp_CS_RID_App_DiagAction.RID_DiagAction
            OA_rp_CS_RID_DiagAction_RID_DiagAction: operation=rp_CS_RID_DiagAction.RID_DiagAction
            OA_rp_CS_UpdateCdd_DID_DiagAction_UpdateCdd_GenericDIDRequestHandler: operation=rp_CS_UpdateCdd_DID_DiagAction.UpdateCdd_GenericDIDRequestHandler
            OA_rp_CS_UpdateCdd_RID_DiagAction_UpdateCdd_GenericRIDRequestHandler: operation=rp_CS_UpdateCdd_RID_DiagAction.UpdateCdd_GenericRIDRequestHandler
            OA_rp_CS_UpdateCdd_Service_0x34_Handler_UpdateCdd_GenericDownloadRequestHandler: operation=rp_CS_UpdateCdd_Service_0x34_Handler.UpdateCdd_GenericDownloadRequestHandler
            OA_rp_CS_UpdateCdd_Service_0x36_Handler_UpdateCdd_GenericTransferDataHandler: operation=rp_CS_UpdateCdd_Service_0x36_Handler.UpdateCdd_GenericTransferDataHandler
            OA_rp_CS_UpdateCdd_Service_0x37_Handler_UpdateCdd_GenericTransferExitHandler: operation=rp_CS_UpdateCdd_Service_0x37_Handler.UpdateCdd_GenericTransferExitHandler
  95 x constant specification:
    DcmExtJobStatus_BsConst_Audio_ElementValue0: value-spec=DcmExtJobStatus_BsConst_Audio_ElementValue0:0
    DcmExtJobStatus_BsConst_BsConst_Illumination_ReservedByteValue0: value-spec=DcmExtJobStatus_BsConst_BsConst_Illumination_ReservedByteValue0:0
    DcmExtJobStatus_BsConst_BsConst_Illumination_ReservedByte_SafeCopy1Value0: value-spec=DcmExtJobStatus_BsConst_BsConst_Illumination_ReservedByte_SafeCopy1Value0:0
    DcmExtJobStatus_BsConst_BsConst_Illumination_ReservedByte_SafeCopy2Value0: value-spec=DcmExtJobStatus_BsConst_BsConst_Illumination_ReservedByte_SafeCopy2Value0:0
    DcmExtJobStatus_BsConst_Communication_ElementValue0: value-spec=DcmExtJobStatus_BsConst_Communication_ElementValue0:0
    DcmExtJobStatus_BsConst_Compensation_Line_Shift_bValue0: value-spec=DcmExtJobStatus_BsConst_Compensation_Line_Shift_bValue0:0
    DcmExtJobStatus_BsConst_Compensation_Line_Shift_b_SafeCopy1Value0: value-spec=DcmExtJobStatus_BsConst_Compensation_Line_Shift_b_SafeCopy1Value0:0
    DcmExtJobStatus_BsConst_Compensation_Line_Shift_b_SafeCopy2Value0: value-spec=DcmExtJobStatus_BsConst_Compensation_Line_Shift_b_SafeCopy2Value0:0
    DcmExtJobStatus_BsConst_Compensation_Line_Slope_mValue0: value-spec=DcmExtJobStatus_BsConst_Compensation_Line_Slope_mValue0:0
    DcmExtJobStatus_BsConst_Compensation_Line_Slope_m_SafeCopy1Value0: value-spec=DcmExtJobStatus_BsConst_Compensation_Line_Slope_m_SafeCopy1Value0:0
    DcmExtJobStatus_BsConst_Compensation_Line_Slope_m_SafeCopy2Value0: value-spec=DcmExtJobStatus_BsConst_Compensation_Line_Slope_m_SafeCopy2Value0:0
    DcmExtJobStatus_BsConst_Derating_Backlight_DisableValue0: value-spec=DcmExtJobStatus_BsConst_Derating_Backlight_DisableValue0:0
    DcmExtJobStatus_BsConst_Derating_Backlight_Disable_SafeCopy1Value0: value-spec=DcmExtJobStatus_BsConst_Derating_Backlight_Disable_SafeCopy1Value0:0
    DcmExtJobStatus_BsConst_Derating_Backlight_Disable_SafeCopy2Value0: value-spec=DcmExtJobStatus_BsConst_Derating_Backlight_Disable_SafeCopy2Value0:0
    DcmExtJobStatus_BsConst_Display_Illum_Max_LevelValue0: value-spec=DcmExtJobStatus_BsConst_Display_Illum_Max_LevelValue0:0
    DcmExtJobStatus_BsConst_Display_Illum_Max_Level_SafeCopy1Value0: value-spec=DcmExtJobStatus_BsConst_Display_Illum_Max_Level_SafeCopy1Value0:0
    DcmExtJobStatus_BsConst_Display_Illum_Max_Level_SafeCopy2Value0: value-spec=DcmExtJobStatus_BsConst_Display_Illum_Max_Level_SafeCopy2Value0:0
    DcmExtJobStatus_BsConst_EngOffTimer_ElementValue0: value-spec=DcmExtJobStatus_BsConst_EngOffTimer_ElementValue0:0
    DcmExtJobStatus_BsConst_FuelGauge_ElementValue0: value-spec=DcmExtJobStatus_BsConst_FuelGauge_ElementValue0:0
    DcmExtJobStatus_BsConst_Lookup_Curve_HotSpot_Coef_XValue0: value-spec=DcmExtJobStatus_BsConst_Lookup_Curve_HotSpot_Coef_XValue0:0
    DcmExtJobStatus_BsConst_Lookup_Curve_HotSpot_Coef_X_SafeCopy1Value0: value-spec=DcmExtJobStatus_BsConst_Lookup_Curve_HotSpot_Coef_X_SafeCopy1Value0:0
    DcmExtJobStatus_BsConst_Lookup_Curve_HotSpot_Coef_X_SafeCopy2Value0: value-spec=DcmExtJobStatus_BsConst_Lookup_Curve_HotSpot_Coef_X_SafeCopy2Value0:0
    DcmExtJobStatus_BsConst_Lookup_Curve_HotSpot_Coef_YValue0: value-spec=DcmExtJobStatus_BsConst_Lookup_Curve_HotSpot_Coef_YValue0:0
    DcmExtJobStatus_BsConst_Lookup_Curve_HotSpot_Coef_Y_SafeCopy1Value0: value-spec=DcmExtJobStatus_BsConst_Lookup_Curve_HotSpot_Coef_Y_SafeCopy1Value0:0
    DcmExtJobStatus_BsConst_Lookup_Curve_HotSpot_Coef_Y_SafeCopy2Value0: value-spec=DcmExtJobStatus_BsConst_Lookup_Curve_HotSpot_Coef_Y_SafeCopy2Value0:0
    DcmExtJobStatus_BsConst_OilGauge_ElementValue0: value-spec=DcmExtJobStatus_BsConst_OilGauge_ElementValue0:0
    DcmExtJobStatus_BsConst_PCB_Temperature_Sensor_ConvValue0: value-spec=DcmExtJobStatus_BsConst_PCB_Temperature_Sensor_ConvValue0:0
    DcmExtJobStatus_BsConst_PCB_Temperature_Sensor_Conv_SafeCopy1Value0: value-spec=DcmExtJobStatus_BsConst_PCB_Temperature_Sensor_Conv_SafeCopy1Value0:0
    DcmExtJobStatus_BsConst_PCB_Temperature_Sensor_Conv_SafeCopy2Value0: value-spec=DcmExtJobStatus_BsConst_PCB_Temperature_Sensor_Conv_SafeCopy2Value0:0
    DcmExtJobStatus_BsConst_PWM_boost_bypass_dutyValue0: value-spec=DcmExtJobStatus_BsConst_PWM_boost_bypass_dutyValue0:0
    DcmExtJobStatus_BsConst_PWM_boost_bypass_duty_SafeCopy1Value0: value-spec=DcmExtJobStatus_BsConst_PWM_boost_bypass_duty_SafeCopy1Value0:0
    DcmExtJobStatus_BsConst_PWM_boost_bypass_duty_SafeCopy2Value0: value-spec=DcmExtJobStatus_BsConst_PWM_boost_bypass_duty_SafeCopy2Value0:0
    DcmExtJobStatus_BsConst_PowerGauge_ElementValue0: value-spec=DcmExtJobStatus_BsConst_PowerGauge_ElementValue0:0
    DcmExtJobStatus_BsConst_Power_ElementValue0: value-spec=DcmExtJobStatus_BsConst_Power_ElementValue0:0
    DcmExtJobStatus_BsConst_RealTimeClock_ElementValue0: value-spec=DcmExtJobStatus_BsConst_RealTimeClock_ElementValue0:0
    DcmExtJobStatus_BsConst_ServiceReminder_ElementValue0: value-spec=DcmExtJobStatus_BsConst_ServiceReminder_ElementValue0:0
    DcmExtJobStatus_BsConst_SpeedoGauge_ElementValue0: value-spec=DcmExtJobStatus_BsConst_SpeedoGauge_ElementValue0:0
    DcmExtJobStatus_BsConst_TachoGauge_ElementValue0: value-spec=DcmExtJobStatus_BsConst_TachoGauge_ElementValue0:0
    DcmExtJobStatus_BsConst_TempGauge_ElementValue0: value-spec=DcmExtJobStatus_BsConst_TempGauge_ElementValue0:0
    DcmExtJobStatus_BsConst_Temp_Threshold_Hysteresis_DeratingValue0: value-spec=DcmExtJobStatus_BsConst_Temp_Threshold_Hysteresis_DeratingValue0:0
    DcmExtJobStatus_BsConst_Temp_Threshold_Hysteresis_Derating_SafeCopy1Value0: value-spec=DcmExtJobStatus_BsConst_Temp_Threshold_Hysteresis_Derating_SafeCopy1Value0:0
    DcmExtJobStatus_BsConst_Temp_Threshold_Hysteresis_Derating_SafeCopy2Value0: value-spec=DcmExtJobStatus_BsConst_Temp_Threshold_Hysteresis_Derating_SafeCopy2Value0:0
    DcmExtJobStatus_BsConst_Temperature_Sensor_ConvValue0: value-spec=DcmExtJobStatus_BsConst_Temperature_Sensor_ConvValue0:0
    DcmExtJobStatus_BsConst_Temperature_Sensor_Conv_SafeCopy1Value0: value-spec=DcmExtJobStatus_BsConst_Temperature_Sensor_Conv_SafeCopy1Value0:0
    DcmExtJobStatus_BsConst_Temperature_Sensor_Conv_SafeCopy2Value0: value-spec=DcmExtJobStatus_BsConst_Temperature_Sensor_Conv_SafeCopy2Value0:0
    DcmExtJobStatus_BsConst_TripComputer_ElementValue0: value-spec=DcmExtJobStatus_BsConst_TripComputer_ElementValue0:0
    DcmExtJobStatus_BsConst_Warning_ElementValue0: value-spec=DcmExtJobStatus_BsConst_Warning_ElementValue0:0
    DcmExtJobStatus_BsCys_Certicificate_ElementValue0: value-spec=DcmExtJobStatus_BsCys_Certicificate_ElementValue0:0
    DcmExtJobStatus_BsDiag_Dtc_ElementValue0: value-spec=DcmExtJobStatus_BsDiag_Dtc_ElementValue0:0
    DcmExtJobStatus_BsDiag_ErrorRecord_ElementValue0: value-spec=DcmExtJobStatus_BsDiag_ErrorRecord_ElementValue0:0
    DcmExtJobStatus_BsReten_Audio_ElementValue0: value-spec=DcmExtJobStatus_BsReten_Audio_ElementValue0:0
    DcmExtJobStatus_BsReten_Communication_ElementValue0: value-spec=DcmExtJobStatus_BsReten_Communication_ElementValue0:0
    DcmExtJobStatus_BsReten_Display_ElementValue0: value-spec=DcmExtJobStatus_BsReten_Display_ElementValue0:0
    DcmExtJobStatus_BsReten_Gauges_ElementValue0: value-spec=DcmExtJobStatus_BsReten_Gauges_ElementValue0:0
    DcmExtJobStatus_BsReten_Illumination_ElementValue0: value-spec=DcmExtJobStatus_BsReten_Illumination_ElementValue0:0
    DcmExtJobStatus_BsReten_Odometer_ElementValue0: value-spec=DcmExtJobStatus_BsReten_Odometer_ElementValue0:0
    DcmExtJobStatus_BsReten_Personalization_ElementValue0: value-spec=DcmExtJobStatus_BsReten_Personalization_ElementValue0:0
    DcmExtJobStatus_BsReten_Power_ElementValue0: value-spec=DcmExtJobStatus_BsReten_Power_ElementValue0:0
    DcmExtJobStatus_BsReten_RealTimeClock_ElementValue0: value-spec=DcmExtJobStatus_BsReten_RealTimeClock_ElementValue0:0
    DcmExtJobStatus_BsReten_Tripcomputer_ElementValue0: value-spec=DcmExtJobStatus_BsReten_Tripcomputer_ElementValue0:0
    DcmExtJobStatus_BsReten_VisDlt_ElementValue0: value-spec=DcmExtJobStatus_BsReten_VisDlt_ElementValue0:0
    DcmExtJobStatus_BsReten_Warning_ElementValue0: value-spec=DcmExtJobStatus_BsReten_Warning_ElementValue0:0
    DcmExtJobStatus_BsRt_CusDlt_ElementValue0: value-spec=DcmExtJobStatus_BsRt_CusDlt_ElementValue0:0
    DcmExtJobStatus_BsRt_FuelGauge_ElementValue0: value-spec=DcmExtJobStatus_BsRt_FuelGauge_ElementValue0:0
    DcmExtJobStatus_BsRt_Illumination_ElementValue0: value-spec=DcmExtJobStatus_BsRt_Illumination_ElementValue0:0
    DcmExtJobStatus_BsRt_Odometer_ElementValue0: value-spec=DcmExtJobStatus_BsRt_Odometer_ElementValue0:0
    DcmExtJobStatus_BsRt_OilGauge_ElementValue0: value-spec=DcmExtJobStatus_BsRt_OilGauge_ElementValue0:0
    DcmExtJobStatus_BsRt_Personalization_ElementValue0: value-spec=DcmExtJobStatus_BsRt_Personalization_ElementValue0:0
    DcmExtJobStatus_BsRt_PowerGauge_ElementValue0: value-spec=DcmExtJobStatus_BsRt_PowerGauge_ElementValue0:0
    DcmExtJobStatus_BsRt_RealTimeClock_ElementValue0: value-spec=DcmExtJobStatus_BsRt_RealTimeClock_ElementValue0:0
    DcmExtJobStatus_BsRt_SpeedoGauge_ElementValue0: value-spec=DcmExtJobStatus_BsRt_SpeedoGauge_ElementValue0:0
    DcmExtJobStatus_BsRt_TachoGauge_ElementValue0: value-spec=DcmExtJobStatus_BsRt_TachoGauge_ElementValue0:0
    DcmExtJobStatus_BsRt_TempGauge_ElementValue0: value-spec=DcmExtJobStatus_BsRt_TempGauge_ElementValue0:0
    DcmExtJobStatus_BsRt_TripComputer_ElementValue0: value-spec=DcmExtJobStatus_BsRt_TripComputer_ElementValue0:0
    DcmExtJobStatus_BsRt_Warning_ElementValue0: value-spec=DcmExtJobStatus_BsRt_Warning_ElementValue0:0
    DcmExtJobStatus_BsShare_AssemblyManufacturingDateValue0: value-spec=DcmExtJobStatus_BsShare_AssemblyManufacturingDateValue0:0
    DcmExtJobStatus_BsShare_AssemblyPlantNumberValue0: value-spec=DcmExtJobStatus_BsShare_AssemblyPlantNumberValue0:0
    DcmExtJobStatus_BsShare_EcuPartNumber_ElementValue0: value-spec=DcmExtJobStatus_BsShare_EcuPartNumber_ElementValue0:0
    DcmExtJobStatus_BsShare_HWModificationValue0: value-spec=DcmExtJobStatus_BsShare_HWModificationValue0:0
    DcmExtJobStatus_BsShare_PCBSerialNumberValue0: value-spec=DcmExtJobStatus_BsShare_PCBSerialNumberValue0:0
    DcmExtJobStatus_BsShare_ProductSerialNumberValue0: value-spec=DcmExtJobStatus_BsShare_ProductSerialNumberValue0:0
    DcmExtJobStatus_BsShare_SMTManufacturingDateValue0: value-spec=DcmExtJobStatus_BsShare_SMTManufacturingDateValue0:0
    DcmExtJobStatus_BsShare_SMTPlantNumberValue0: value-spec=DcmExtJobStatus_BsShare_SMTPlantNumberValue0:0
    DcmExtJobStatus_BsShare_SwUpdFotaFinPrint_ElementValue0: value-spec=DcmExtJobStatus_BsShare_SwUpdFotaFinPrint_ElementValue0:0
    DcmExtJobStatus_BsShare_SwUpdFotaMode_ElementValue0: value-spec=DcmExtJobStatus_BsShare_SwUpdFotaMode_ElementValue0:0
    DcmExtJobStatus_BsShare_SwUpdFotaStatus_ElementValue0: value-spec=DcmExtJobStatus_BsShare_SwUpdFotaStatus_ElementValue0:0
    DcmExtJobStatus_BsShare_SwUpdFotadecrypt_ElementValue0: value-spec=DcmExtJobStatus_BsShare_SwUpdFotadecrypt_ElementValue0:0
    DcmExtJobStatus_BsShare_SwUpdReflash_ElementValue0: value-spec=DcmExtJobStatus_BsShare_SwUpdReflash_ElementValue0:0
    DcmExtJobStatus_BsShare_VehicleConfig_ElementValue0: value-spec=DcmExtJobStatus_BsShare_VehicleConfig_ElementValue0:0
    DcmExtJobStatus_BsShare_VisMeet_EOLEntry_ElementValue0: value-spec=DcmExtJobStatus_BsShare_VisMeet_EOLEntry_ElementValue0:0
    DcmExtJobStatus_BsShare_VisMeet_ElementValue0: value-spec=DcmExtJobStatus_BsShare_VisMeet_ElementValue0:0
    DcmExtJobStatus_BsShare_VisteonPCBPartNumberValue0: value-spec=DcmExtJobStatus_BsShare_VisteonPCBPartNumberValue0:0
    DcmExtJobStatus_BsShare_VisteonPartNumberValue0: value-spec=DcmExtJobStatus_BsShare_VisteonPartNumberValue0:0
    DcmExtJobStatus_RefCys_Certicificate1_ElementValue0: value-spec=DcmExtJobStatus_RefCys_Certicificate1_ElementValue0:0
    DcmExtJobStatus_RefCys_Certicificate_ElementValue0: value-spec=DcmExtJobStatus_RefCys_Certicificate_ElementValue0:0
  swc implementation IMPL_DcmExt: programming-language=C, behavior=IB_DcmExt
    code-descriptors:
      code CodeDescriptor
package /E40_Platform_System_SystemPackage/Compositions
  composition sw component type E40_Platform_System
    58 x component:
      CBacklightCdd: type=CBacklightCdd
      CBattMdl: type=CBattMdl
      CCDD_EcuPowerM: type=CCDD_EcuPowerM
      CComAbsCtrl: type=CComAbsCtrl
      CComAbsMdl: type=CComAbsMdl
      CCtrl_Telltale: type=CCtrl_Telltale
      DcmApp: type=DcmApp
      DemApp: type=DemApp
      CDisplayCdd: type=CDisplayCdd
      CFltM: type=CFltM
      CFltMExt: type=CFltMExt
      GdtCdd: type=GdtCdd
      CIoExp: type=CIoExp
      CMeetCdd: type=CMeetCdd
      CPmicCdd: type=CPmicCdd
      RtcCdd: type=RtcCdd
      SafeNvM: type=SafeNvM
      CSleepManager: type=CSleepManager
      CSndCdd: type=CSndCdd
      CUpdateCdd: type=CUpdateCdd
      CView_Telltale: type=CView_Telltale
      CWarnMsg_Core_Observer: type=CWarnMsg_Core_Observer
      ComCallout: type=ComCallout
      ComMExt: type=ComMExt
      CorTst: type=CorTst
      Ctrl_Dim: type=Ctrl_Dim
      Ctrl_WSS: type=Ctrl_WSS
      Ctrl_warning: type=Ctrl_warning
      DcmExt: type=DcmExt
      DemExt: type=DemExt
      Dlt: type=Dlt
      DltExt: type=DltExt
      DmnMgr: type=DmnMgr
      EcuAppM: type=EcuAppM
      EcuMExt: type=EcuMExt
      FastGaugeAdapter: type=FastGaugeAdapter
      FlsTst: type=FlsTst
      IoHwAb: type=IoHwAb
      Mdl_Airbag: type=Mdl_Airbag
      Mdl_Dim: type=Mdl_Dim
      Mdl_Gear: type=Mdl_Gear
      Mdl_Linear_Interpolation: type=Mdl_Linear_Interpolation
      Mdl_SafetyAdapter: type=Mdl_SafetyAdapter
      Mdl_Speed: type=Mdl_Speed
      Mdl_Tacho: type=Mdl_Tacho
      Mdl_TurnHazard: type=Mdl_TurnHazard
      Mdl_wAirbag: type=Mdl_wAirbag
      Mdl_wFuelLidOpen: type=Mdl_wFuelLidOpen
      MemAbstractMdl: type=MemAbstractMdl
      NvMExt: type=NvMExt
      RamTst: type=RamTst
      RstM: type=RstM
      SlowGaugeAdapter: type=SlowGaugeAdapter
      SysTst: type=SysTst
      TmExt: type=TmExt
      UclProxyCdd: type=UclProxyCdd
      View_Speed: type=View_Speed
      WarnMsg_Core_TmrSupport: type=WarnMsg_Core_TmrSupport
    connect IoHwAb.ppIoHwAb_Din -> CBacklightCdd.rpIoHwAb_Din
    connect IoHwAb.ppIoHwAb_DOut -> CBacklightCdd.rpIoHwAb_DOut
    connect IoHwAb.ppIoHwAb_PWM -> CBacklightCdd.rpIoHwAb_PWM
    connect IoHwAb.ppIoHwAb_Din -> CBattMdl.rpIoHwAb_Din
    connect IoHwAb.ppIoHwAb_DOut -> CBattMdl.rpIoHwAb_DOut
    connect IoHwAb.ppIoHwAb_ADC -> CBattMdl.rpIoHwAb_ADC
    connect IoHwAb.ppIoHwAb_Din -> CCDD_EcuPowerM.rpIoHwAb_Din
    connect IoHwAb.ppIoHwAb_DOut -> CCDD_EcuPowerM.rpIoHwAb_DOut
    connect IoHwAb.ppIoHwAb_PWM -> CCDD_EcuPowerM.rpIoHwAb_PWM
    connect IoHwAb.ppIoHwAb_ADC -> CCDD_EcuPowerM.rpIoHwAb_ADC
    connect IoHwAb.ppIoHwAb_Din -> CComAbsCtrl.rp_CS_IoHwAb_Din
    connect ComMExt.ppComMExt -> CComAbsCtrl.rpCSComMExt
    connect CComAbsMdl.pp_CS_RxCanMdl -> CComAbsCtrl.rpCSRxCanMdl
    connect CComAbsMdl.pp_CS_TxCanMdl -> CComAbsCtrl.rpCSTxCanMdl
    assembly sw connector E40_Platform_System_CS_Ctrl_WSSrp_CS_RxCanMdl_CComAbsMdlpp_CS_RxCanMdl_if_CS_ComAbsRx: requester=Ctrl_WSS.rp_CS_RxCanMdl
    connect IoHwAb.ppIoHwAb_Din -> Ctrl_WSS.rpIoHwAb_Din
    connect ComMExt.ppComMExt -> Ctrl_WSS.rpComMExt
    connect NvMExt.pp_CS_NvMExt_SleepOperations -> Ctrl_WSS.rp_CS_NvMExt_SleepOperations
    connect TmExt.pp_CS_TmExt_Timer_Stop -> Ctrl_WSS.rp_CS_TmExt_Timer_Stop
    connect TmExt.pp_CS_TmExt_Timer_IsElapsed -> Ctrl_WSS.rp_CS_TmExt_Timer_Elapsed
    connect TmExt.pp_CS_TmExt_Timer_Start -> Ctrl_WSS.rp_CS_TmExt_Timer_Start
    connect TmExt.pp_CS_TmExt_Timer_IsStarted -> Ctrl_WSS.rp_CS_TmExt_Timer_Started
    connect IoHwAb.ppIoHwAb_ADC -> Ctrl_WSS.rpIoHwAb_ADC
    assembly sw connector E40_Platform_System_CS_Mdl_Dimrp_CS_RxCanMdl_CComAbsMdlpp_CS_RxCanMdl_if_CS_ComAbsRx: requester=Mdl_Dim.rp_CS_RxCanMdl
    connect Ctrl_WSS.ppIgnSubstate -> Mdl_Dim.rpIgnSubstate
    connect Ctrl_WSS.pp_VehicleAppMode -> Mdl_Dim.rpVehicleAppMode
    connect Ctrl_WSS.pp_TFTDisplayOn -> Mdl_Dim.rp_TFTDisplayOn
    connect Ctrl_WSS.pp_Variant_status -> Mdl_Dim.rp_Variant_Status
    connect IoHwAb.ppIoHwAb_PWM -> Ctrl_Dim.rp_PwmSetDuty
    connect Mdl_Dim.pp_IlumStep -> Ctrl_Dim.rp_IlumStep
    connect CBattMdl.ppSR_BattMdl_AVP -> Ctrl_Dim.rpSR_PowerCdd_AVP
    assembly sw connector E40_Platform_System_CS_Ctrl_Dimrp_GetNVM_IlluminationElement_MemAbstractMdlpp_CS_MemAbsGet_if_CS_MemAbsGet: requester=Ctrl_Dim.rp_GetNVM_IlluminationElement
    connect MemAbstractMdl.pp_CS_MemAbsSet -> Ctrl_Dim.rp_SetNVM_IlluminationElement
    connect IoHwAb.ppIoHwAb_Din -> Ctrl_Dim.rpIoHwAb_Din
    connect Ctrl_WSS.pp_ClusterMode -> Ctrl_Dim.rp_ClusterMode
    connect Ctrl_WSS.ppIgnSubstate -> Ctrl_Dim.rpIgnSubstate
    connect Ctrl_WSS.pp_VehicleAppMode -> Ctrl_Dim.rpVehicleAppMode
    connect CComAbsMdl.pp_CS_RxCanMdl -> Ctrl_Dim.rp_CS_CanRx
    connect Mdl_Dim.pp_RheostatDayStep -> Ctrl_Dim.rp_RheostatDayStep
    connect Mdl_Dim.pp_RheostatNightStep -> Ctrl_Dim.rp_RheostatNightStep
    connect Mdl_Dim.pp_illum_rheostat_change -> Ctrl_Dim.rp_Rheostat_Change
    connect Ctrl_WSS.pp_TFTDisplayOn -> Ctrl_Dim.rp_TFTDisplayOn
    connect Ctrl_WSS.pp_AppMdl_Sleep -> Ctrl_Dim.rp_ILL_ReadyToSleep
    connect MemAbstractMdl.pp_CS_MemAbsGet -> Ctrl_Dim.rp_CS_MemAbsGet
    connect Ctrl_Dim.pp_IsFadeEffectInProgress -> Mdl_Dim.rp_PWMRate_status
    connect Ctrl_Dim.pp_GetCurrent_Duty -> Mdl_Dim.rp_Current_duty
    connect Ctrl_Dim.pp_StopPwmUpdate -> Mdl_Dim.rp_StopPwmUpdate
    connect Ctrl_Dim.pp_UpdatePwmDirect -> Mdl_Dim.rp_UpdatePwmDirect
    connect Ctrl_Dim.pp_UpdatePwmWithTimeExp -> Mdl_Dim.rp_PwmWithTimeExp
    connect Ctrl_Dim.pp_UpdatePwmWithTime -> Mdl_Dim.rp_PwmWithTime
    connect Ctrl_WSS.pp_AppMdl_Sleep -> Mdl_Dim.rp_ILL_ReadyToSleep
    connect CComAbsMdl.pp_CS_RxCanMdl -> Mdl_Dim.rp_CS_CanRx
    connect Ctrl_WSS.pp_ClusterMode -> Mdl_Dim.rp_ClusterMode
    connect IoHwAb.ppIoHwAb_Din -> Mdl_Dim.rpIoHwAb_Din
    assembly sw connector E40_Platform_System_CS_Mdl_Dimrp_CS_MemAbsSet_MemAbstractMdlpp_CS_MemAbsSet_if_CS_MemAbsSet: requester=Mdl_Dim.rp_CS_MemAbsSet
    assembly sw connector E40_Platform_System_CS_Mdl_Dimrp_CS_MemAbsGet_MemAbstractMdlpp_CS_MemAbsGet_if_CS_MemAbsGet: requester=Mdl_Dim.rp_CS_MemAbsGet
    connect Ctrl_WSS.pp_ClusterMode -> Ctrl_warning.rp_ClusterMode
    connect Ctrl_WSS.ppIgnSubstate -> Ctrl_warning.rpIgnSubstate
    connect Ctrl_warning.ppCtrlWarningStatus -> Mdl_Dim.rpUpdateDIMWarning
    connect MemAbstractMdl.pp_CS_MemAbsGet -> Mdl_Dim.rp_GetNVM_IlluminationData
    connect IoHwAb.ppIoHwAb_ADC -> Mdl_Dim.rp_IoHwAb_ADC
    connect Ctrl_Dim.pp_IlumDayNightRequired -> Mdl_Dim.rp_IlumDayNightRequired
    connect Ctrl_Dim.pp_IlumDayNightStatus -> Mdl_Dim.rp_IlumDayNightStatus
    connect Ctrl_Dim.pp_Ctrl_Ready_to_Sleep -> Mdl_Dim.rp_Ctrl_Ready_to_Sleep
    connect MemAbstractMdl.pp_CS_MemAbsSet -> Mdl_Dim.rp_SetNVM_IlluminationData
    connect Mdl_Dim.pp_IlumDayNightStatus -> Ctrl_WSS.rp_IlumDayNightStatus
    connect Ctrl_WSS.pp_ClusterMode -> CWarnMsg_Core_Observer.rp_ClusterMode
    connect Ctrl_WSS.ppIgnSubstate -> CWarnMsg_Core_Observer.rpIgnSubstate
    connect Ctrl_warning.ppWarningActiveStatus -> CWarnMsg_Core_Observer.rp_ActiveWarningSts
    connect Ctrl_warning.ppWarnDisplayStatus -> CWarnMsg_Core_Observer.rp_UpdateDisplayStatus
    connect UclProxyCdd.pSR_HealthDomainFatalError -> DmnMgr.rSR_HealthDomainFatalError
    connect UclProxyCdd.pSR_HealthDomainHeartbeat -> DmnMgr.rSR_HealthDomainHeartbeat
    connect UclProxyCdd.pSR_HealthDumpData -> DmnMgr.rSR_HealthDumpData
    connect UclProxyCdd.pSR_HealthDumpHdrInfo -> DmnMgr.rSR_HealthDumpHdrInfo
    connect UclProxyCdd.pSR_PowerExtendShutdownTime -> DmnMgr.rSR_PowerExtendShutdownTime
    connect UclProxyCdd.pSR_PowerKeepSystemAwake -> DmnMgr.rSR_PowerKeepSystemAwake
    connect UclProxyCdd.pSR_PowerSystemState -> DmnMgr.rSR_PowerSystemState
    connect UclProxyCdd.ppCS_UclInitShutdown -> DmnMgr.rpCS_UclInitShutdown
    connect DmnMgr.ppSR_DmnInfo -> DmnMgr.rpSR_DmnInfo
    connect CSleepManager.ppSR_SleepStatus -> DmnMgr.rpSR_SleepStatus
    connect DmnMgr.ppCS_UclSystemCallbacks -> UclProxyCdd.rCS_UclSystemCallbacks
    connect DmnMgr.pSR_HealthDumpGetHdr -> UclProxyCdd.rSR_HealthDumpGetHdr
    connect DmnMgr.pSR_HealthDumpGetData -> UclProxyCdd.rSR_HealthDumpGetData
    connect DmnMgr.pSR_PowerSystemStateReqChange -> UclProxyCdd.rSR_PowerSystemStateReqChange
    connect Ctrl_WSS.ppIgnSubstate -> Mdl_Gear.rpIgnSubstate
    connect Ctrl_WSS.pp_VehicleAppMode -> Mdl_Gear.rpVehicleAppMode
    assembly sw connector E40_Platform_System_CS_Mdl_Gearrp_CS_RxCanMdl_CComAbsMdlpp_CS_RxCanMdl_if_CS_ComAbsRx: requester=Mdl_Gear.rp_CS_RxCanMdl
    connect Ctrl_WSS.pp_Variant_status -> Mdl_Gear.rp_Variant_Status
    connect CComAbsMdl.pp_CS_RxCanMdl -> Mdl_Gear.rp_CS_CanRx
    connect Ctrl_WSS.pp_ClusterMode -> Mdl_Gear.rp_ClusterMode
    connect Ctrl_WSS.pp_HMIReady -> Mdl_Gear.rp_HMI_Ready_Status
    connect Mdl_Gear.pp_Shiftpos_ShiftPosIndStatus -> UclProxyCdd.rSR_ShiftPosIndStatus
    connect Ctrl_Dim.pSR_IlluminationData -> UclProxyCdd.rSR_IlluminationData
    connect CWarnMsg_Core_Observer.pp_HUDWarningDisplay -> UclProxyCdd.rSR_HudWarningDisplay
    connect CWarnMsg_Core_Observer.pp_TPMSWarnPayload -> UclProxyCdd.rSR_TpmsWarningData
    connect CWarnMsg_Core_Observer.pp_WarningDisplay -> UclProxyCdd.rSR_WarningDisplay
    connect Ctrl_WSS.pp_ClusterMode -> CView_Telltale.rp_ClusterMode
    connect Ctrl_WSS.ppIgnSubstate -> Mdl_Airbag.rpIgnSubstate
    connect Ctrl_WSS.pp_VehicleAppMode -> Mdl_Airbag.rp_VehicleAppMode
    connect IoHwAb.ppIoHwAb_Din -> Mdl_SafetyAdapter.rp_IOHWab_Din
    connect IoHwAb.ppIoHwAb_ADC -> Mdl_SafetyAdapter.rp_IoHwAb_ADC
    connect ComMExt.ppComMExt -> Mdl_SafetyAdapter.rpComMExt
    connect Ctrl_WSS.pp_ClusterMode -> Mdl_SafetyAdapter.rp_ctrlwss_Clustermode
    connect CCtrl_Telltale.pp_Init -> Mdl_SafetyAdapter.rp_Init_rp_Init_CCtrl_Telltale
    connect CView_Telltale.pp_Init -> Mdl_SafetyAdapter.rp_Init_rp_Init_CView_Telltale
    connect Mdl_Airbag.pp_Init -> Mdl_SafetyAdapter.rp_Init_rp_Init_Mdl_Airbag
    connect Mdl_SafetyAdapter.pp_CS_RxCanSafe -> Mdl_Airbag.rp_CS_CanAdapterRx
    connect Ctrl_WSS.pp_ClusterMode -> Mdl_Airbag.rp_ClusterMode
    connect CComAbsMdl.pp_CS_RxCanMdl -> Mdl_Airbag.rp_CS_CanRx
    connect Mdl_Airbag.pp_Airbag_TT_Status -> CView_Telltale.rpTelltlaeStatus_rp_Airbag_TT_Status
    connect Ctrl_WSS.pp_ClusterMode -> Mdl_TurnHazard.rp_ClusterMode
    connect IoHwAb.ppIoHwAb_Din -> Mdl_TurnHazard.rpCS_IoHwAbInp
    connect Mdl_TurnHazard.pp_TurnHazard_LeftInd_Sts -> CView_Telltale.rpTelltlaeStatus_rp_TurnHazard_LeftInd_Sts
    connect Mdl_TurnHazard.pp_TurnHazard_RightInd_Sts -> CView_Telltale.rpTelltlaeStatus_rp_TurnHazard_RightInd_Sts
    connect CCtrl_Telltale.ppBlinkStatusArray -> CView_Telltale.rpBlinkStatusArray
    connect CCtrl_Telltale.ppTelltaleStatusOP -> CView_Telltale.rpTelltaleStatusOP
    connect Ctrl_WSS.pp_HMIReady -> CView_Telltale.rp_HMIReady
    connect CView_Telltale.ppTelltaleSts -> UclProxyCdd.rSR_TT_Status
    connect Ctrl_WSS.ppIgnSubstate -> FastGaugeAdapter.rpIgnSubstate
    connect Ctrl_WSS.pp_ClusterMode -> FastGaugeAdapter.rp_ClusterMode
    connect Ctrl_WSS.ppIgnSubstate -> View_Speed.rpIgnSubstate
    connect MemAbstractMdl.pp_CS_MemAbsGet -> View_Speed.rp_CS_MemAbsGet
    connect Ctrl_WSS.ppIgnSubstate -> Mdl_Speed.rpIgnSubstate
    connect MemAbstractMdl.pp_CS_MemAbsGet -> Mdl_Speed.rp_CS_MemAbsGet
    connect CComAbsMdl.pp_CS_RxCanMdl -> Mdl_Speed.rp_CS_CanRx
    connect Ctrl_WSS.pp_ClusterMode -> Mdl_Speed.rp_ClusterMode
    connect Mdl_Linear_Interpolation.pp_LinearInterpolateWord -> Mdl_Speed.rp_CS_LinerInterpolation
    connect IoHwAb.ppIoHwAb_ADC -> Mdl_Speed.rpIoHwAb_ADC
    connect Mdl_Speed.pp_SPD_SP1_In_Status -> View_Speed.rp_SPD_SP1_In_Status
    connect Mdl_Speed.pp_SPD_Target_Status -> View_Speed.rp_SPD_Target_Status
    connect Mdl_Speed.pp_SPD_Trim_Status -> View_Speed.rp_SPD_Trim_Status
    connect CComAbsMdl.pp_CS_TxCanMdl -> View_Speed.rp_CS_TxCanMdl
    connect CComAbsMdl.pp_CS_RxCanMdl -> View_Speed.rp_CS_RxCanMdl
    connect Ctrl_WSS.pp_ClusterMode -> View_Speed.rp_ClusterMode
    connect Mdl_Speed.pp_SPD_Target2_Status -> View_Speed.rp_SPD_Target2_Status
    connect Mdl_Speed.pp_SPD_Trim2_Status -> View_Speed.rp_SPD_Trim2_Status
    connect Mdl_Speed.pp_SPD_Selection_Table -> View_Speed.rp_SPD_Selection_Table
    connect View_Speed.pp_Display_speed_Value -> FastGaugeAdapter.rp_Display_speed_Value
    connect View_Speed.pp_SubDisplaySpeed_Value -> FastGaugeAdapter.rp_SubDisplaySpeed_Value
    connect Ctrl_WSS.ppIgnSubstate -> Mdl_Tacho.rpIgnSubstate
    connect CComAbsMdl.pp_CS_RxCanMdl -> Mdl_Tacho.rp_CS_RxCanMdl
    connect Ctrl_WSS.pp_ClusterMode -> Mdl_Tacho.rp_ClusterMode
    connect Mdl_Speed.pp_SPD_SP1_In_Status -> Mdl_Tacho.rp_SPD_SP1_In_Status
    connect Mdl_Tacho.pp_Analog_Tacho -> FastGaugeAdapter.rp_Analog_Tacho
    connect Mdl_Tacho.pp_Digital_Tacho -> FastGaugeAdapter.rp_Digital_Tacho
    connect Mdl_Tacho.pp_Needle_Transparent -> FastGaugeAdapter.rp_Needle_Transparent
    connect Mdl_Tacho.pp_Tacho_RED_Start_RPM -> FastGaugeAdapter.rp_Tacho_RED_Start_RPM
    connect Mdl_Tacho.pp_TC_Unit -> FastGaugeAdapter.rp_TC_Unit
    connect Mdl_Tacho.pp_Tacho_RPM_MAX -> FastGaugeAdapter.rp_Tacho_RPM_MAX
    connect Ctrl_WSS.pp_HMIReady -> FastGaugeAdapter.rp_HMIReadyState
    connect FastGaugeAdapter.pp_FastGaugeInfo -> UclProxyCdd.rSR_FastGaugeInfo
    connect Ctrl_WSS.ppIgnSubstate -> SlowGaugeAdapter.rpIgnSubstate
    connect Ctrl_WSS.pp_ClusterMode -> SlowGaugeAdapter.rp_ClusterMode
    connect Ctrl_WSS.pp_HMIReady -> SlowGaugeAdapter.rp_HMIReadyState
    connect SlowGaugeAdapter.pp_SlowGaugeInfo -> UclProxyCdd.rSR_SlowGaugeInfo
    connect UclProxyCdd.pSR_UpdateShortServiceResp -> CUpdateCdd.rp_SR_UpdateShortServiceResponse
    connect CUpdateCdd.pp_SR_UpdateShortServiceRequest -> UclProxyCdd.rSR_UpdateShortServiceReq
    connect CUpdateCdd.pp_SR_UpdateLongServiceRequest -> UclProxyCdd.rSR_UpdateLongServiceReq
    connect UclProxyCdd.pSR_WarningStatus -> CWarnMsg_Core_Observer.rp_WarningStatus
    connect Mdl_Dim.pp_illumStarterstatus -> CWarnMsg_Core_Observer.rp_IllumStartSts
    connect Ctrl_WSS.pp_HMIReady -> CWarnMsg_Core_Observer.rp_HMIReadySts
    connect Ctrl_warning.ppWarnDisplayPayload -> CWarnMsg_Core_Observer.rp_UpdateDisplayPayload
    connect Ctrl_warning.ppActiveWarningStatus -> CWarnMsg_Core_Observer.rpActiveWarningStatus
    connect CComAbsMdl.pp_CS_TxCanMdl -> CWarnMsg_Core_Observer.rp_CS_TxCanMdl
    connect UclProxyCdd.pSR_HudWarningStatus -> CWarnMsg_Core_Observer.rp_HUDWarningStatus
    connect CWarnMsg_Core_Observer.pp_Init -> Ctrl_WSS.rp_Init_rp_Init_CWarnMsg_Core_Observer
    connect Ctrl_Dim.pp_Init -> Ctrl_WSS.rp_Init_rp_Init_Ctrl_Dim
    connect Ctrl_warning.pp_Init -> Ctrl_WSS.rp_Init_rp_Init_Ctrl_warning
    connect FastGaugeAdapter.pp_Init -> Ctrl_WSS.rp_Init_rp_Init_FastGaugeAdapter
    connect Mdl_Dim.pp_Init -> Ctrl_WSS.rp_Init_rp_Init_Mdl_Dim
    connect Mdl_Gear.pp_Init -> Ctrl_WSS.rp_Init_rp_Init_Mdl_Gear
    connect Mdl_Linear_Interpolation.pp_Init -> Ctrl_WSS.rp_Init_rp_Init_Mdl_Linear_Interpolation
    connect Mdl_Speed.pp_Init -> Ctrl_WSS.rp_Init_rp_Init_Mdl_Speed
    connect Mdl_Tacho.pp_Init -> Ctrl_WSS.rp_Init_rp_Init_Mdl_Tacho
    connect Mdl_TurnHazard.pp_Init -> Ctrl_WSS.rp_Init_rp_Init_Mdl_TurnHazard
    connect Ctrl_warning.ppCtrlWarningStatus -> Mdl_wAirbag.rpUpdateAirbagWarning
    connect Ctrl_WSS.ppIgnSubstate -> Mdl_wAirbag.rpIgnSubstate
    connect Ctrl_WSS.pp_ClusterMode -> Mdl_wAirbag.rp_ClusterMode
    connect CComAbsMdl.pp_CS_RxCanMdl -> Mdl_wAirbag.rp_CS_CanAdapterSafeRx
    connect Ctrl_WSS.pp_VehicleAppMode -> Mdl_wAirbag.rp_Vehiclestate
    connect Mdl_wAirbag.pp_Init -> Ctrl_WSS.rp_Init_rp_Init_Mdl_wAirbag
    connect Ctrl_warning.ppCtrlWarningStatus -> Mdl_wFuelLidOpen.rpUpdateFuelLidOpenWarning
    connect Ctrl_WSS.ppIgnSubstate -> Mdl_wFuelLidOpen.rpIgnSubstate
    connect CComAbsMdl.pp_CS_RxCanMdl -> Mdl_wFuelLidOpen.rp_CS_RxCanAdapterMdl
    connect Ctrl_WSS.pp_ClusterMode -> Mdl_wFuelLidOpen.rp_ClusterMode
    connect Mdl_wFuelLidOpen.pp_Init -> Ctrl_WSS.rp_Init_rp_Init_Mdl_wFuelLidOpen
    connect SlowGaugeAdapter.pp_Init -> Ctrl_WSS.rp_Init_rp_Init_SlowGaugeAdapter
    connect View_Speed.pp_Init -> Ctrl_WSS.rp_Init_rp_Init_View_Speed
    connect TmExt.pp_CS_TmExt_Timer_IsElapsed -> WarnMsg_Core_TmrSupport.rp_CS_TmExt_Timer_Elapsed
    connect TmExt.pp_CS_TmExt_Timer_Start -> WarnMsg_Core_TmrSupport.rp_CS_TmExt_Timer_Start
    connect TmExt.pp_CS_TmExt_Timer_IsStarted -> WarnMsg_Core_TmrSupport.rp_CS_TmExt_Timer_Started
    connect TmExt.pp_CS_TmExt_Timer_Stop -> WarnMsg_Core_TmrSupport.rp_CS_TmExt_Timer_Stop
    connect WarnMsg_Core_TmrSupport.pp_Init -> Ctrl_WSS.rp_Init_rp_Init_WarnMsg_Core_TmrSupport
    connect CComAbsMdl.pp_CS_RxCanMdl -> Ctrl_WSS.rp_CS_ComAbsRx
    connect MemAbstractMdl.pp_CS_MemAbs_NvMWriteStatus -> Ctrl_WSS.rp_CS_MemAbs_NvMWriteStatus
    connect NvMExt.pp_CS_NvMExt_GetNvMExtReadAllStatus -> Ctrl_WSS.rp_CS_NvMExt_GetNvMExtReadAllStatus
    connect Mdl_TurnHazard.pp_TurnHazard_TurnL_Sts -> Ctrl_WSS.rp_TurnHzdTurnL_Status
    connect Mdl_TurnHazard.pp_TurnHazard_TurnR_Sts -> Ctrl_WSS.rp_TurnHzdTurnR_Status
    connect Mdl_Gear.pp_ShiftPositionDisplay -> Ctrl_WSS.rp_ShiftPositionDisp
    connect CCtrl_Telltale.ppTelltaleStatusOP -> Ctrl_WSS.rpTelltaleStatusOP
    connect CCtrl_Telltale.ppBlinkStatusArray -> Ctrl_WSS.rp_BlinkStsArray
    connect UclProxyCdd.pSR_MainHMIReadyStatus -> Ctrl_WSS.rpUclHMIReadySts
    connect Ctrl_WSS.ppIgnSubstate -> CCtrl_Telltale.rpIgnSubstate
    connect Mdl_Airbag.pp_Airbag_TT_Status -> CCtrl_Telltale.rpTelltlaeStatus_rp_Airbag_TT_Status
    connect Mdl_TurnHazard.pp_TurnHazard_LeftInd_Sts -> CCtrl_Telltale.rpTelltlaeStatus_rp_TurnHazard_LeftInd_Sts
    connect Mdl_TurnHazard.pp_TurnHazard_RightInd_Sts -> CCtrl_Telltale.rpTelltlaeStatus_rp_TurnHazard_RightInd_Sts
    connect Ctrl_WSS.pp_ClusterMode -> CCtrl_Telltale.rp_ClusterMode
    connect CBattMdl.ppSR_BattMdl_AVP -> CCtrl_Telltale.rpSR_BattMdl_AVP
    connect Ctrl_WSS.pp_HMIReady -> CCtrl_Telltale.rpHmiReadyState
    connect DemExt.pp_CS_DemExt_ClearDTC -> DemApp.rp_CS_DemExt_ClearDTC
    connect DemExt.pp_CS_DemExt_SetEventStatus -> DemApp.rp_CS_DemExt_SetEventStatus
    connect DemExt.pp_CS_DemExt_SetOperationCycleState -> DemApp.rp_CS_DemExt_SetOperationCycleState
    connect CBacklightCdd.pp_CS_Backlight_Status -> CDisplayCdd.rp_CS_Backlight_Status
    connect CBacklightCdd.pp_CS_Backlight_Notify -> CDisplayCdd.rp_CS_Backlight_Notify
    connect IoHwAb.ppIoHwAb_DOut -> CDisplayCdd.rpIoHwAb_SetDout
    connect UclProxyCdd.pSR_DisplayCurrentState -> CDisplayCdd.rpSRDisplayCurrentState
    connect CBacklightCdd.pp_CmpLibCmd_CBacklightCdd -> EcuAppM.rp_CmpLibCmd_rp_CmpLibCmd_CBacklightCdd
    connect CBattMdl.pp_CmpLibCmd_CBattMdl -> EcuAppM.rp_CmpLibCmd_rp_CmpLibCmd_CBattMdl
    connect CCDD_EcuPowerM.pp_CmpLibCmd -> EcuAppM.rp_CmpLibCmd_rp_CmpLibCmd_CCDD_EcuPowerM
    connect CComAbsCtrl.pp_CmpLibCmd_CComAbsCtrl -> EcuAppM.rp_CmpLibCmd_rp_CmpLibCmd_CComAbsCtrl
    connect CComAbsMdl.pp_CmpLibCmd_CComAbsMdl -> EcuAppM.rp_CmpLibCmd_rp_CmpLibCmd_CComAbsMdl
    connect CCtrl_Telltale.pp_CmpLibCmd -> EcuAppM.rp_CmpLibCmd_rp_CmpLibCmd_CCtrl_Telltale
    connect DcmApp.pp_CmpLibCmd_CDcmApp -> EcuAppM.rp_CmpLibCmd_rp_CmpLibCmd_CDcmArp
    connect DemApp.pp_CmpLibCmd_CDemApp -> EcuAppM.rp_CmpLibCmd_rp_CmpLibCmd_CDemArp
    connect CDisplayCdd.pp_CmpLibCmd_CDisplayCdd -> EcuAppM.rp_CmpLibCmd_rp_CmpLibCmd_CDisplayCdd
    connect DmnMgr.pp_CmpLibCmd_CDmnMgr -> EcuAppM.rp_CmpLibCmd_rp_CmpLibCmd_CDmnMgr
    connect CFltM.pp_CmpLibCmd_CFltM -> EcuAppM.rp_CmpLibCmd_rp_CmpLibCmd_CFltM
    connect CFltM.pp_CS_FltM_ReportFault -> CFltMExt.rp_CS_FltM_ReportFault
    connect CFltMExt.pp_CmpLibCmd_CFltMExt -> EcuAppM.rp_CmpLibCmd_rp_CmpLibCmd_CFltMExt
    connect TmExt.pp_CS_TmExt_Timer_GetElapsedTime -> GdtCdd.rp_GdtCddTimer_getElapsedTime
    connect TmExt.pp_CS_TmExt_Timer_Start -> GdtCdd.rp_GdtCddTimer_Start
    connect TmExt.pp_CS_TmExt_Timer_Stop -> GdtCdd.rp_GdtTimerStop
    connect GdtCdd.pp_CmpLibCmd_CGdtCdd -> EcuAppM.rp_CmpLibCmd_rp_CmpLibCmd_CGdtCdd
    connect CIoExp.pp_CmpLibCmd_CIoExp -> EcuAppM.rp_CmpLibCmd_rp_CmpLibCmd_CIoExp
    connect CPmicCdd.pp_CmpLibCmd_CPmicCdd -> EcuAppM.rp_CmpLibCmd_rp_CmpLibCmd_CPmicCdd
    connect IoHwAb.ppIoHwAb_ADC -> RtcCdd.rp_CS_IoHwAb_ADC
    connect IoHwAb.ppIoHwAb_Din -> RtcCdd.rp_IoHwAb_Din
    connect IoHwAb.ppIoHwAb_DOut -> RtcCdd.rp_IoHwAb_DOut
    connect RtcCdd.pp_CmpLibCmd_CRTCCdd -> EcuAppM.rp_CmpLibCmd_rp_CmpLibCmd_CRTCCdd
    connect SafeNvM.pp_CmpLibCmd_CSafeNvM -> EcuAppM.rp_CmpLibCmd_rp_CmpLibCmd_CSafeNvM
    connect CSleepManager.pp_CmpLibCmd -> EcuAppM.rp_CmpLibCmd_rp_CmpLibCmd_CSleepManager
    connect CSndCdd.pp_CmpLibCmd_CSndCdd -> EcuAppM.rp_CmpLibCmd_rp_CmpLibCmd_CSndCdd
    connect UclProxyCdd.pp_CmpLibCmd_CUclProxyCdd -> EcuAppM.rp_CmpLibCmd_rp_CmpLibCmd_CUclProxyCdd
    connect CUpdateCdd.pp_CmpLibCmd_CUpdateCdd -> EcuAppM.rp_CmpLibCmd_rp_CmpLibCmd_CUpdateCdd
    connect CView_Telltale.pp_CmpLibCmd -> EcuAppM.rp_CmpLibCmd_rp_CmpLibCmd_CView_Telltale
    connect CWarnMsg_Core_Observer.pp_CmpLibCmd -> EcuAppM.rp_CmpLibCmd_rp_CmpLibCmd_CWarnMsg_Core_Observer
    connect CorTst.pp_CmpLibCmd_CorTst -> EcuAppM.rp_CmpLibCmd_rp_CmpLibCmd_CorTst
    connect Ctrl_WSS.pp_CmpLibCmd -> EcuAppM.rp_CmpLibCmd_rp_CmpLibCmd_Ctrl_WSS
    connect FlsTst.pp_CmpLibCmd_FlsTst -> EcuAppM.rp_CmpLibCmd_rp_CmpLibCmd_FlsTst
    connect IoHwAb.ppIoHwAb_ADC -> CMeetCdd.rpIoHwAb_ADC
    connect IoHwAb.ppIoHwAb_Din -> CMeetCdd.rpIoHwAb_Din
    connect IoHwAb.ppIoHwAb_DOut -> CMeetCdd.rpIoHwAb_DOut
    connect IoHwAb.ppIoHwAb_PWM -> CMeetCdd.rpIoHwAb_PWM
    connect MemAbstractMdl.pp_CS_MemAbsGet -> CMeetCdd.rp_CS_MemAbsGet
    connect MemAbstractMdl.pp_CS_MemAbsSet -> CMeetCdd.rp_CS_MemAbsSet
    connect MemAbstractMdl.pp_SR_JobStatus -> CMeetCdd.rp_SR_JobStatus
    connect CMeetCdd.pp_CmpLibCmd_MeetCdd -> EcuAppM.rp_CmpLibCmd_rp_CmpLibCmd_MeetCdd
    connect MemAbstractMdl.pp_CmpLibCmd_MemAbstractMdl -> EcuAppM.rp_CmpLibCmd_rp_CmpLibCmd_MemAbstractMdl
    connect RamTst.pp_CmpLibCmd_RamTst -> EcuAppM.rp_CmpLibCmd_rp_CmpLibCmd_RamTst
    connect SysTst.pp_CmpLibCmd_SysTst -> EcuAppM.rp_CmpLibCmd_rp_CmpLibCmd_SysTst
    connect CBacklightCdd.pp_CS_Backlight_service -> EcuAppM.rp_CS_Backlight_service
    connect CSleepManager.ppSR_SleepStatus -> EcuAppM.rpSR_SleepStatus
    connect CCDD_EcuPowerM.ppCS_RequestPower -> EcuAppM.rpCS_RequestPower
    connect NvMExt.pp_CS_NvmExtStartReadAll -> EcuAppM.rp_CS_NvmExtStartReadAll
    connect NvMExt.pp_CS_NvMExt_SleepOperations -> EcuAppM.rp_CS_NvMExt_SleepOperations
    connect NvMExt.pp_CS_NvMExt_GetNvMExtReadAllStatus -> EcuAppM.rp_CS_NvMExt_GetNvMExtReadAllStatus
    connect EcuMExt.ppCS_EcumExt_ReleaseRUN -> EcuAppM.rpCS_EcumExt_ReleaseRUN
    connect EcuMExt.ppCS_EcumExt_RequestRUN -> EcuAppM.rpCS_EcumExt_RequestRUN
    connect EcuAppM.ppCS_EcuAppM -> EcuMExt.rpCS_EcuAppM
    connect EcuMExt.ppCS_EcumExt_GetResetReason -> Dlt.rpCS_EcumExt_GetResetReason
    connect Dlt.ppCS_Dlt_SendLogMessage -> RstM.rp_CS_Dlt_SendLogMessage
    connect MemAbstractMdl.pp_CS_MemAbsGet -> DltExt.rp_CS_MemAbsGet
    connect MemAbstractMdl.pp_CS_MemAbsSet -> DltExt.rp_CS_MemAbsSet
    connect MemAbstractMdl.pp_CS_MemAbs_NvMWriteStatus -> DltExt.rp_CS_MemAbs_NvMWriteStatus
    connect DltExt.ppCs_DltExt_GetResetInfo -> RstM.rp_CS_DltExt_GetResetInfo
    connect RstM.pp_CS_RstM_GetResetCount -> CFltM.rp_CS_RstM_GetResetCount
    connect RstM.pp_CS_RstM_RequestSwReset -> CFltM.rp_CS_RstM_RequestSwReset
    connect RstM.pp_CS_RstM_GetLastResetReason -> CFltM.rp_CS_RstM_GetLastResetReason
    connect DemExt.pp_CS_DemExt_SetEventStatus -> CFltM.rp_CS_DemExt_SetEventStatus
    connect RstM.pp_CS_RstM_GetResetHistory -> CFltM.rp_CS_RstM_GetResetHistory
    connect RstM.pp_CS_RstM_ClearResetHistory -> CFltM.rp_CS_RstM_ClearResetHistory
    connect Dlt.ppCS_Dlt_SendLogMessage -> CFltM.rp_CS_Dlt_SendLogMessage
    connect MemAbstractMdl.pp_SR_JobStatus -> DcmExt.rp_SR_JobStatus
    connect CMeetCdd.pp_CS_RID_DiagAction -> DcmExt.rp_CS_RID_DiagAction
    connect MemAbstractMdl.pp_CS_MemAbsSet -> DcmExt.rp_CS_MemAbsSet
    connect MemAbstractMdl.pp_CS_MemAbsGet -> DcmExt.rp_CS_MemAbsGet
    connect CMeetCdd.pp_CS_DID_DiagAction -> DcmExt.rp_CS_DID_DiagAction
    connect DcmApp.pp_CS_DID_App_Diag_Action -> DcmExt.rp_CS_DID_App_DiagAction
    connect DcmApp.pp_CS_RID_App_Diag_Action -> DcmExt.rp_CS_RID_App_DiagAction
    connect DcmApp.pp_CS_DiagEntryStatus -> DcmExt.rp_CS_DiagEntryStatus
    connect CUpdateCdd.pp_CS_UpdateCdd_GenericDIDRequestHandler -> DcmExt.rp_CS_UpdateCdd_DID_DiagAction
    connect CUpdateCdd.pp_CS_UpdateCdd_GenericRIDRequestHandler -> DcmExt.rp_CS_UpdateCdd_RID_DiagAction
    connect CUpdateCdd.pp_CS_UpdateCdd_GenericDownloadRequestHandler -> DcmExt.rp_CS_UpdateCdd_Service_0x34_Handler
    connect CUpdateCdd.pp_CS_UpdateCdd_GenericTransferDataHandler -> DcmExt.rp_CS_UpdateCdd_Service_0x36_Handler
    connect CUpdateCdd.pp_CS_UpdateCdd_GenericTransferExitHandler -> DcmExt.rp_CS_UpdateCdd_Service_0x37_Handler
package /E40_Platform_System_SystemPackage/Types
  impl type EDisplayType: category=VALUE, base-type=uint8, compu {0=e_Display10Inch, 1=e_DisplayMaxDevice}, range raw 0..1
  impl type EDisplayPowerState: category=VALUE, base-type=uint8, compu {0=eDisplayIdle, 1=eDisplayPowerON, 2=eDisplayNormal, 3=eDisplayPowerOFF, 4=eDisplayFault_Handle, 5=eDisplayMaxPowerState}, range raw 0..5
  client server interface TI_Backlight_NotifyDispaly
    operation NotifyDisplayPowerState: possible-error=TI_Backlight_NotifyDispaly/E_NOT_OK
      arg DeviceId: implementation-data-type=EDisplayType, type=EDisplayType, direction=IN
      arg CompletedPowerState: implementation-data-type=EDisplayPowerState, type=EDisplayPowerState, direction=IN
    error E_NOT_OK: error-code=1
  impl type EDeviceStatus: category=VALUE, base-type=uint8, compu {0=eDeviceNotReady, 1=eDeviceInitialized, 2=eDeviceReady, 3=eDeviceBusy, 4=eDeviceFault, 5=eDeviceMaxState}, range raw 0..5
  client server interface TI_Backlight_Status
    operation GetStatus: possible-error=TI_Backlight_Status/E_NOT_OK
      arg DeviceName: implementation-data-type=EDisplayType, type=EDisplayType, direction=IN
      arg DeviceStatus: implementation-data-type=EDeviceStatus, type=EDeviceStatus, direction=OUT
    error E_NOT_OK: error-code=1
  client server interface TI_Backlight_Service
    operation GetBrightnessValue: possible-error=TI_Backlight_Service/E_NOT_OK
      arg DeviceName: implementation-data-type=EDisplayType, type=EDisplayType, direction=IN
      arg BrightnessPercentValue: implementation-data-type=UInt16, type=UInt16, direction=OUT
    operation GetThermalValue: possible-error=TI_Backlight_Service/E_NOT_OK
      arg DeviceName: implementation-data-type=EDisplayType, type=EDisplayType, direction=IN
      arg TempValueInMilliCelsius: implementation-data-type=UInt32, type=UInt32, direction=OUT
    operation SetBrightnessValue: possible-error=TI_Backlight_Service/E_NOT_OK
      arg DeviceName: implementation-data-type=EDisplayType, type=EDisplayType, direction=IN
      arg BrightnessPercentValue: implementation-data-type=UInt16, type=UInt16, direction=IN
    error E_NOT_OK: error-code=1
  impl type ECmpCmd: category=VALUE, base-type=uint8, compu {0=eCmpCmd_Init, 1=eCmpCmd_DeInit, 2=eCmpCmd_Activate, 3=eCmpCmd_DeActivate}, range raw 0..3
  client server interface if_CS_ModeOnCommand
    operation Impl_OnCommand: possible-error=if_CS_ModeOnCommand/E_NOT_OK
      arg cmdP: implementation-data-type=ECmpCmd, type=ECmpCmd, direction=IN
    error E_NOT_OK: error-code=1
  impl type IoHwAb_DOutGroupIdType: category=VALUE, base-type=sint32, compu {0=eIO_DOutGroupIdCount}, range raw -2147483647..2147483647
  impl type IoHwAb_ErrorType: category=VALUE, base-type=uint8, compu {2=E_NO_ERROR, 3=E_ERROR, 4=E_ADC_ERROR, 5=E_DOUT_ID_INVALID, 6=E_DIN_ID_INVALID, 7=E_ADC_ID_INVALID, 8=IOHWAB_E_ADC_ERROR, 9=IOHWAB_E_ADC_ID_INVALID, 10=IOHWAB_E_ERROR, 11=IOHWAB_E_DOUT_ID_INVALID, 12=IOHWAB_E_NO_ERROR, 13=IOHWAB_E_DIN_ID_INVALID}, range raw 2..13
  impl type IoHwAb_DOutSignalIdType:
    category=VALUE
    base-type=uint8
    compu {0=eIO_DOUT_DO_5VSW2_3V3_EN, 1=eIO_DOUT_PARK_BRAKE_TT_OUT, 2=eIO_DOUT_DO_SYC1, 3=eIO_DOUT_SEAT_BELT_TT_MCUOUT, 4=eIO_DOUT_TURN_LEFT_TT_MCUOUT, 5=eIO_DOUT_DO_LCD_BL_PWR_EN, 6=eIO_DOUT_DO_3V3_DISP_SW_EN, 7=eIO_DOUT_AMP_SHTD, 8=eIO_DOUT_FUEL_RHEO_SUP_EN, 9=eIO_DOUT_DO_LCD_STBYB, 10=eIO_DOUT_SBATT2_EN, 11=eIO_DOUT_BRAKE_TT_MCUOUT, 12=eIO_DOUT_AIRBAG_TT_MCUOUT, 13=eIO_DOUT_TURN_RIGHT_TT_MCUOUT, 14=eIO_DOUT_DO_SMPS_5V_SW_EN, 15=eIO_DOUT_PCS_OFF_TT_MCUOUT, 16=eIO_DOUT_ABS_TT_MCUOUT, 17=eIO_DOUT_SLIP_TT_MCUOUT, 18=eIO_DOUT_VCS_OFF_TT_MCUOUT, 19=eIO_DOUT_ECB_EPB_TT_MCUOUT, 20=eIO_DOUT_Flasher_FL_RL_OUT, 21=eIO_DOUT_Flasher_DEN1, 22=eIO_DOUT_Flasher_DSEL1, 23=eIO_DOUT_Flasher_FR_RR_OUT, 24=eIO_DOUT_DO_LCD_RST, 25=eIO_DOUT_DO_SMPS_1V2_EN, 26=eIO_DO_MAX, 27=eIO_DOUT_DO_DISP_RESET, 28=eIO_DOUT_DO_DISP_STBY, 29=eIO_DOUT_DO_TFT_BL_EN, 30=eIO_DOUT_DO_PWM_DIMMING, 31=eIO_DOUT_DO_RTC_INTN, 32=eIO_DOUT_DO_SOC_PWR_LATCH, 33=eIO_DOUT_DO_1V2_EN, 34=eIO_DOUT_DO_EN_5V, 35=eIO_DOUT_DO_ENET_EN, 36=eIO_DOUT_DO_LIN_NSLP, 37=eIO_DOUT_DO_MCU_RESETSTAZ, 38=eIO_DOUT_DO_3V3_DISP, 39=eIO_DOUT_DO_MD_TOUCH_RST, 40=eIO_DOUT_DO_VPP_EN, 41=eIO_DOUT_DO_MD_GNSS_BOOT_EN, 42=eIO_DOUT_DO_MD_GNSS_RESETP, 43=eIO_DOUT_DO_MD_GNSS_PWR_EN, 44=eIO_DOUT_DO_BLU_OPAMP_PWR_EN, 45=eIO_DOUT_DO_BLU_DWALED_EN, 46=eIO_DOUT_DO_TCON_BYPASS_MODE, 47=eIO_DOUT_DO_TCON_BYPASS_SEL0, 48=eIO_DOUT_DO_TCON_BYPASS_SEL1, 49=eIO_DOUT_DO_SOC_FPDLINK3_PDB, 50=eIO_DOUT_DO_SOC_FPDLINK3_INTB, 51=eIO_DOUT_DO_SOC_FPDLINK3_BISTEN, 52=eIO_DOUT_DO_ENET_RSTB, 53=eIO_DOUT_DO_EN_BUCK_FALD, 54=eIO_DOUT_DO_MCU_AMUX_S1, 55=eIO_DOUT_DO_MCU_AMUX_S0, 56=eIO_DOUT_DO_TCON_SPI0_CS0, 57=eIO_DOUT_DO_SPI_CAN_CS, 58=eIO_DOUT_DESER_SPI1_DO, 59=eIO_DOUT_DO_SOC_TCON_GRBN, 60=eIO_DOUT_DO_TFT_CSB}
    range raw 0..60
  client server interface TI_IOHWAB_SetDout
    operation SetOutputGroup: possible-error=TI_IOHWAB_SetDout/E_NOT_OK
      arg InputId: implementation-data-type=IoHwAb_DOutGroupIdType, type=IoHwAb_DOutGroupIdType, direction=IN
      arg OutputGroup: implementation-data-type=UInt32, type=UInt32, direction=IN
      arg ErrorStatus: implementation-data-type=IoHwAb_ErrorType, type=IoHwAb_ErrorType, direction=OUT
    operation SetOutputPin: possible-error=TI_IOHWAB_SetDout/E_NOT_OK
      arg InputId: implementation-data-type=IoHwAb_DOutSignalIdType, type=IoHwAb_DOutSignalIdType, direction=IN
      arg OutputSignal: implementation-data-type=Boolean, type=Boolean, direction=IN
      arg ErrorStatus: implementation-data-type=IoHwAb_ErrorType, type=IoHwAb_ErrorType, direction=OUT
    error E_NOT_OK: error-code=1
  impl type IoHwAb_DInSignalIdType:
    category=VALUE
    base-type=uint8
    compu {0=eIO_DIN_DI_AL_HAZARD, 1=eIO_DIN_DI_AH_IGNITION, 2=eIO_DIN_DI_SMPS_3V3_PG, 3=eIO_DIN_STOP_LAMP_MCU, 4=eIO_DIN_DI_AL_BRAKE_LEVEL, 5=eIO_DIN_DI_AL_OIL_W, 6=eIO_DIN_DI_AL_DRV_SEAT_BUCKLE, 7=eIO_DIN_DI_AL_WASHER_LEVEL_SW, 8=eIO_DIN_ODO_TripKnobInput, 9=eIO_DIN_DI_AL_VACUUM, 10=eIO_DIN_DI_LCD_BL_PWR_FAULT, 11=eIO_DIN_DI_AL_FUEL_LID_EFI_ECU, 12=eIO_DIN_DI_TT_SHIFT_ERR, 13=eIO_DIN_MAX, 14=eIO_DIN_DI_PMIC_INTN, 15=eIO_DIN_DI_MCU_PORZ, 16=eIO_DIN_DI_SBATT2_ERR, 17=eIO_DIN_DI_FALD_PG, 18=eIO_DIN_DI_MD_TOUCH_INTN, 19=eIO_DIN_DI_BL_FAULT, 20=eIO_DIN_DI_SOC_FPDLINK3_LOCK, 21=eIO_DIN_DI_SOC_FPDLINK3_PASS, 22=eIO_DIN_DI_ENET_MII_INT, 23=eIO_DIN_DI_IGN_MON, 24=eIO_DIN_DI_CABLE_DETECT, 25=eIO_DIN_DI_TCON_IND_OUT, 26=eIO_DIN_DI_SPI_CAN_TCON_SDI, 27=eIO_DIN_DI_MCU_FALD_CONN_CHK, 28=eIO_DIN_DI_LDO_1V2_FAULTN, 29=eIO_DIN_DI_TFT_ER_DET}
    range raw 0..29
  impl type IoHwAb_DInGroupIdType: category=VALUE, base-type=sint32, compu {0=eIO_DInGroupIdCount}, range raw -2147483647..2147483647
  client server interface TI_IOHWAB_GetDIn
    4 x operation, all with possible-error=TI_IOHWAB_GetDIn/E_NOT_OK:
      GetAsyncRawInput
        arg InputId: implementation-data-type=IoHwAb_DInSignalIdType, type=IoHwAb_DInSignalIdType, direction=IN
        arg AsyncInput: implementation-data-type=Boolean, type=Boolean, direction=OUT
        arg ErrorStatus: implementation-data-type=IoHwAb_ErrorType, type=IoHwAb_ErrorType, direction=OUT
      GetInputGroup
        arg InputId: implementation-data-type=IoHwAb_DInGroupIdType, type=IoHwAb_DInGroupIdType, direction=IN
        arg SyncInput: implementation-data-type=UInt32, type=UInt32, direction=OUT
        arg ErrorStatus: implementation-data-type=IoHwAb_ErrorType, type=IoHwAb_ErrorType, direction=OUT
      GetProcessedInput
        arg InputId: implementation-data-type=IoHwAb_DInSignalIdType, type=IoHwAb_DInSignalIdType, direction=IN
        arg InputSignal: implementation-data-type=Boolean, type=Boolean, direction=OUT
        arg ErrorStatus: implementation-data-type=IoHwAb_ErrorType, type=IoHwAb_ErrorType, direction=OUT
      GetSyncRawInput
        arg InputId: implementation-data-type=IoHwAb_DInSignalIdType, type=IoHwAb_DInSignalIdType, direction=IN
        arg SyncInput: implementation-data-type=Boolean, type=Boolean, direction=OUT
        arg ErrorStatus: implementation-data-type=IoHwAb_ErrorType, type=IoHwAb_ErrorType, direction=OUT
    error E_NOT_OK: error-code=1
  impl type IoHwAb_PwmSignalIdType: category=VALUE, base-type=uint8, compu {0=eIO_PWM_MCU_BUZZER_AMPLCTRL, 1=eIO_PWM_HIGH_BEAM_TT_MCUOUT, 2=eIO_PWM_FUEL_TEMP_GAUG_TEXT_PWM_OUT, 3=eIO_PWM_PWM_OUT_ILL2, 4=eIO_PWM_PWM_OUT_ILL1, 5=eIO_PWM_BG_Dimming_PWM, 6=eIO_PWM_PWM_GREEN_TT_DIMMING, 7=eIO_PWM_CXPI_CLK, 8=eIO_PWM_PWM_LCD_BL_DIMMING, 9=eIO_PWM_MAX}, range raw 0..9
  client server interface TI_IOHWAB_PWM
    operation PwmSetDuty: possible-error=TI_IOHWAB_PWM/E_NOT_OK
      arg PwmId: implementation-data-type=IoHwAb_PwmSignalIdType, type=IoHwAb_PwmSignalIdType, direction=IN
      arg Pwm_Duty: implementation-data-type=UInt16, type=UInt16, direction=IN
      arg ErrorStatus: implementation-data-type=IoHwAb_ErrorType, type=IoHwAb_ErrorType, direction=OUT
    operation PwmSetDutyAndPeriod: possible-error=TI_IOHWAB_PWM/E_NOT_OK
      4 x arg:
        PwmId: implementation-data-type=IoHwAb_PwmSignalIdType, type=IoHwAb_PwmSignalIdType, direction=IN
        Pwm_Period: implementation-data-type=UInt32, type=UInt32, direction=IN
        Pwm_Duty: implementation-data-type=UInt16, type=UInt16, direction=IN
        ErrorStatus: implementation-data-type=IoHwAb_ErrorType, type=IoHwAb_ErrorType, direction=OUT
    operation PwmSetIdeal: possible-error=TI_IOHWAB_PWM/E_NOT_OK
      arg PwmId: implementation-data-type=IoHwAb_PwmSignalIdType, type=IoHwAb_PwmSignalIdType, direction=IN
      arg ErrorStatus: implementation-data-type=IoHwAb_ErrorType, type=IoHwAb_ErrorType, direction=OUT
    error E_NOT_OK: error-code=1
  impl type IoHwAb_AdcSignalIdType:
    category=VALUE
    base-type=uint8
    compu {16=eIO_ADC_ADC_FUEL_5V_MON, 17=eIO_ADC_ADC_FUEL_MAIN, 2=eIO_ADC_IGN_AD, 3=eIO_ADC_FUEL_SEND_SUB_MICRO_AD, 4=eIO_ADC_AI_BATTERY, 5=eIO_ADC_AI_LCD_NTC, 6=eIO_ADC_AI_TEMP_RTC, 7=eIO_ADC_Flasher_Diag_sense_1, 8=eIO_ADC_STR_SW2_ADIN, 9=eIO_ADC_STR_SW1_ADIN, 10=eIO_ADC_RHEO_SW_IN_ADIN, 11=eIO_ADC_ADC_RHEO_5V_MON_ADIN, 12=eIO_ADC_Flasher_Diag_sense_2, 13=eIO_ADC_AdcChannel_Vdb, 14=eIO_ADC_AdcChannel_Vtemp, 15=eIO_ADC_MAX, 0=eIO_ADC_AI_SAMPLE_1, 1=eIO_ADC_AI_SAMPLE_2}
    range raw 0..17
  client server interface TI_IOHWAB_GetAdc
    operation GetAsyncRawAdc: possible-error=TI_IOHWAB_GetAdc/E_NOT_OK
      arg AdcId: implementation-data-type=IoHwAb_AdcSignalIdType, type=IoHwAb_AdcSignalIdType, direction=IN
      arg AsyncRawAdc: implementation-data-type=UInt16, type=UInt16, direction=OUT
      arg ErrorStatus: implementation-data-type=IoHwAb_ErrorType, type=IoHwAb_ErrorType, direction=OUT
    operation GetProcessedAdc: possible-error=TI_IOHWAB_GetAdc/E_NOT_OK
      arg AdcId: implementation-data-type=IoHwAb_AdcSignalIdType, type=IoHwAb_AdcSignalIdType, direction=IN
      arg ProcessedAdc: implementation-data-type=SInt32, type=SInt32, direction=OUT
      arg ErrorStatus: implementation-data-type=IoHwAb_ErrorType, type=IoHwAb_ErrorType, direction=OUT
    operation GetSyncRawAdc: possible-error=TI_IOHWAB_GetAdc/E_NOT_OK
      arg AdcId: implementation-data-type=IoHwAb_AdcSignalIdType, type=IoHwAb_AdcSignalIdType, direction=IN
      arg SyncRawAdc: implementation-data-type=UInt16, type=UInt16, direction=OUT
      arg ErrorStatus: implementation-data-type=IoHwAb_ErrorType, type=IoHwAb_ErrorType, direction=OUT
    error E_NOT_OK: error-code=1
  impl type eIOPulseInputId: category=VALUE, base-type=sint32, compu {0=eIOPulseInputIdCount}, range raw -2147483647..2147483647
  impl type SPulseInputConfigParam: category=STRUCTURE
    16 x element, all with category=TYPE_REFERENCE:
      MissingRecoveryTimeoutInMicroSec: implementation-data-type=UInt32
      ValidPeriodMinInMicroSec: implementation-data-type=UInt32
      ValidPeriodMaxInMicroSec: implementation-data-type=UInt32
      HystLimitForPeriodMinInMicroSec: implementation-data-type=UInt32
      HystRcvryForPeriodMinInMicroSec: implementation-data-type=UInt32
      HystLimitForPeriodMaxInMicroSec: implementation-data-type=UInt32
      HystRcvryForPeriodMaxInMicroSec: implementation-data-type=UInt32
      ValidDutyMinInPercentage: implementation-data-type=UInt16
      ValidDutyMaxInPercentage: implementation-data-type=UInt16
      HystLimitForDutyMinInPercentage: implementation-data-type=UInt16
      HystRcvryForDutyMinInPercentage: implementation-data-type=UInt16
      HystLimitForDutyMaxInPercentage: implementation-data-type=UInt16
      HystRcvryForDutyMaxInPercentage: implementation-data-type=UInt16
      InValidTimeoutInMilliSec: implementation-data-type=UInt16
      InValidRecoveryTimeoutInMilliSec: implementation-data-type=UInt16
      MissingTimeoutInMilliSec: implementation-data-type=UInt16
  impl type SSpeedCalcParam: category=STRUCTURE
    element Pulses_Per_Revolution: implementation-data-type=UInt32
    element Revolutions_Per_Unit: implementation-data-type=UInt32
    element Tuning_Factor: implementation-data-type=UInt32
  client server interface TI_IOHWAB_Pulse
    7 x operation, all with possible-error=TI_IOHWAB_Pulse/E_NOT_OK:
      GetCurrentSignalStatus_PulseInput
        arg PulseInputId: implementation-data-type=eIOPulseInputId, type=eIOPulseInputId, direction=IN
        arg SignalStatus: implementation-data-type=UInt16, type=UInt16, direction=OUT
        arg ErrorStatus: implementation-data-type=IoHwAb_ErrorType, type=IoHwAb_ErrorType, direction=OUT
      GetCurrentSpeed_PulseInput
        arg PulseInputId: implementation-data-type=eIOPulseInputId, type=eIOPulseInputId, direction=IN
        arg SpeedVal: implementation-data-type=UInt32, type=UInt32, direction=OUT
        arg ErrorStatus: implementation-data-type=IoHwAb_ErrorType, type=IoHwAb_ErrorType, direction=OUT
      GetRollingCount_PulseInput
        arg PulseInputId: implementation-data-type=eIOPulseInputId, type=eIOPulseInputId, direction=IN
        arg EdgeCount: implementation-data-type=DataTypes/UInt8, type=DataTypes/UInt8, direction=OUT
        arg ErrorStatus: implementation-data-type=IoHwAb_ErrorType, type=IoHwAb_ErrorType, direction=OUT
      ResetRollingCount_PulseInput
        arg PulseInputId: implementation-data-type=eIOPulseInputId, type=eIOPulseInputId, direction=IN
        arg ErrorStatus: implementation-data-type=IoHwAb_ErrorType, type=IoHwAb_ErrorType, direction=OUT
      Start_Signal_Measurement_PulseInput
        4 x arg:
          PulseInputId: implementation-data-type=eIOPulseInputId, type=eIOPulseInputId, direction=IN
          PulseInputChnlCfgParam: implementation-data-type=SPulseInputConfigParam, type=SPulseInputConfigParam, direction=OUT
          SpdCalParam: implementation-data-type=SSpeedCalcParam, type=SSpeedCalcParam, direction=OUT
          ErrorStatus: implementation-data-type=IoHwAb_ErrorType, type=IoHwAb_ErrorType, direction=OUT
      Stop_Signal_Measurement_PulseInput
        arg PulseInputId: implementation-data-type=eIOPulseInputId, type=eIOPulseInputId, direction=IN
        arg ErrorStatus: implementation-data-type=IoHwAb_ErrorType, type=IoHwAb_ErrorType, direction=OUT
      Update_CalibParam_PulseInput
        arg PulseInputId: implementation-data-type=eIOPulseInputId, type=eIOPulseInputId, direction=IN
        arg SpdCalParam: implementation-data-type=SSpeedCalcParam, type=SSpeedCalcParam, direction=OUT
        arg ErrorStatus: implementation-data-type=IoHwAb_ErrorType, type=IoHwAb_ErrorType, direction=OUT
    error E_NOT_OK: error-code=1
  sender receiver interface TI_BattMdl_AVP
    14 x data, all with implementation-data-type=Boolean, type=Boolean:
      HVP0Flag
      HVSD{0..4}Flag
      LVP0Flag
      LVP1Flag
      LVSD{0..4}Flag
      SVPFlag
    invalidation-policys:
      data-element=HVP0Flag, handle-invalid=DONT-INVALIDATE
      data-element=HVSD{0..4}Flag, handle-invalid=DONT-INVALIDATE
      data-element=LVP0Flag, handle-invalid=DONT-INVALIDATE
      data-element=LVP1Flag, handle-invalid=DONT-INVALIDATE
      data-element=LVSD{0..4}Flag, handle-invalid=DONT-INVALIDATE
      data-element=SVPFlag, handle-invalid=DONT-INVALIDATE
  sender receiver interface TI_BattMdl_Voltage: invalidation-policy{data-element=OverVoltageInterruptFlag, handle-invalid=DONT-INVALIDATE}
    data OverVoltageInterruptFlag: implementation-data-type=Boolean, type=Boolean
  client server interface TI_EcuPowerM
    operation EcuPowerM_GetDeviceStatus: possible-error=TI_EcuPowerM/E_NOT_OK
      arg device: implementation-data-type=DataTypes/UInt8, type=DataTypes/UInt8, direction=IN
      arg status: implementation-data-type=DataTypes/UInt8, type=DataTypes/UInt8, direction=OUT
    operation EcuPowerM_RequestPower: possible-error=TI_EcuPowerM/E_NOT_OK
      arg device: implementation-data-type=DataTypes/UInt8, type=DataTypes/UInt8, direction=IN
      arg request: implementation-data-type=DataTypes/UInt8, type=DataTypes/UInt8, direction=IN
    error E_NOT_OK: error-code=1
  client server interface TI_ComMExt
    14 x operation:
      CAN_ActivateSilentCommunication: possible-error=TI_ComMExt/E_NOT_OK
        arg Channel: implementation-data-type=DataTypes/UInt8, type=DataTypes/UInt8, direction=IN
      CAN_CommControlActivateRx: possible-error=TI_ComMExt/E_NOT_OK
        arg Channel: implementation-data-type=DataTypes/UInt8, type=DataTypes/UInt8, direction=IN
      CAN_CommControlActivateTx: possible-error=TI_ComMExt/E_NOT_OK
        arg Channel: implementation-data-type=DataTypes/UInt8, type=DataTypes/UInt8, direction=IN
      CAN_CommControlDeActivateRx: possible-error=TI_ComMExt/E_NOT_OK
        arg Channel: implementation-data-type=DataTypes/UInt8, type=DataTypes/UInt8, direction=IN
      CAN_CommControlDeActivateTx: possible-error=TI_ComMExt/E_NOT_OK
        arg Channel: implementation-data-type=DataTypes/UInt8, type=DataTypes/UInt8, direction=IN
      CAN_CommControlSetDone
        arg PduInitRequest: implementation-data-type=Boolean, type=Boolean, direction=IN
      CAN_DeActivateSilentCommunication: possible-error=TI_ComMExt/E_NOT_OK
        arg Channel: implementation-data-type=DataTypes/UInt8, type=DataTypes/UInt8, direction=IN
      CAN_GetCurrentComMode: possible-error=TI_ComMExt/E_NOT_OK
        arg Channel: implementation-data-type=DataTypes/UInt8, type=DataTypes/UInt8, direction=IN
        arg ComMode: implementation-data-type=DataTypes/UInt8, type=DataTypes/UInt8, direction=OUT
      CAN_ReleaseCommunication: possible-error=TI_ComMExt/E_NOT_OK
        arg Channel: implementation-data-type=DataTypes/UInt8, type=DataTypes/UInt8, direction=IN
      CAN_RequestCommunication: possible-error=TI_ComMExt/E_NOT_OK
        arg Channel: implementation-data-type=DataTypes/UInt8, type=DataTypes/UInt8, direction=IN
      GetBusOffStatus: possible-error=TI_ComMExt/E_NOT_OK
        arg Channel: implementation-data-type=DataTypes/UInt8, type=DataTypes/UInt8, direction=IN
        arg BusOffStatus: implementation-data-type=Boolean, type=Boolean, direction=OUT
      Get_MCAN_ERR_PIN_Status: possible-error=TI_ComMExt/E_NOT_OK
        arg fl_pin_status_BOOL: implementation-data-type=Boolean, type=Boolean, direction=OUT
      Impl_MainFunction
      Init
    error E_NOT_OK: error-code=1
  impl type tRxSignalId: category=VALUE, base-type=uint8, compu {0=eDayNightModeIn, 1=eIllumination_levelIn, 2=eAmbient_Light_levelIn, 3=ePowerModeIn, 4=eTransportModeIn, 5=eGearModeIn, 6=eGearRecommendationIn, 7=eGearIn, 8=eWarningIn, 9=eGearStatusIn, 10=eEngineSpeedIn, 11=eVehicleSpeedABSIn, 12=eAirbagIn, 13=eAlive_101In, 14=eCRC_101In, 15=eEndOfRxSignal}, range raw 0..15
  impl type tRxSignalStatus: category=VALUE, base-type=uint8, compu {0=eSIGNAL_OK, 1=eSIGNAL_MISSING, 2=eSIGNAL_NEVER_RECEIVED, 4=eSIGNAL_INVALID}, range raw 0..4
  impl type tRxSignalJustRcvdStatus: category=VALUE, base-type=uint8, compu {0=eJust_Received, 1=eNot_Just_Received}, range raw 0..1
  client server interface if_CS_ComAbsRx
    9 x operation:
      RxCan_GetSignalValue: possible-error=if_CS_ComAbsRx/E_NOT_OK
        arg SignalId: implementation-data-type=tRxSignalId, type=tRxSignalId, direction=IN
        arg pSignalValue: implementation-data-type=DataTypes/UInt8, type=DataTypes/UInt8, direction=OUT
        arg pSignalStatus: implementation-data-type=tRxSignalStatus, type=tRxSignalStatus, direction=OUT
      RxCan_GetSignalValueU8Arr: possible-error=if_CS_ComAbsRx/E_NOT_OK
        4 x arg:
          SignalId: implementation-data-type=tRxSignalId, type=tRxSignalId, direction=IN
          pSignalValue: implementation-data-type=DataTypes/UInt8, type=DataTypes/UInt8, direction=OUT
          pSignalStatus: implementation-data-type=tRxSignalStatus, type=tRxSignalStatus, direction=OUT
          pSignalLength: implementation-data-type=UInt32, type=UInt32, direction=OUT
      RxCan_SetSignalInitValue: possible-error=if_CS_ComAbsRx/E_NOT_OK
        arg SignalId: implementation-data-type=tRxSignalId, type=tRxSignalId, direction=IN
        arg pSignalValue: implementation-data-type=DataTypes/UInt8, type=DataTypes/UInt8, direction=OUT
      RxCan_SetSignalInitValueU8Arr: possible-error=if_CS_ComAbsRx/E_NOT_OK
        arg SignalId: implementation-data-type=tRxSignalId, type=tRxSignalId, direction=IN
        arg pSignaValue: implementation-data-type=DataTypes/UInt8, type=DataTypes/UInt8, direction=OUT
        arg pSignalLength: implementation-data-type=UInt32, type=UInt32, direction=OUT
      RxCan_SignalClearJustRcvdStatus
        arg SignalId: implementation-data-type=tRxSignalId, type=tRxSignalId, direction=IN
      RxCan_SignalGetJustRcvdStatus
        arg SignalId: implementation-data-type=tRxSignalId, type=tRxSignalId, direction=IN
        arg pJustRcvdStatus: implementation-data-type=tRxSignalJustRcvdStatus, type=tRxSignalJustRcvdStatus, direction=INOUT
      RxCan_SignalInvalidProcessingControl
        arg SignalId: implementation-data-type=tRxSignalId, type=tRxSignalId, direction=IN
        arg Status: implementation-data-type=Boolean, type=Boolean, direction=IN
      RxCan_SignalMissingProcessingControl
        arg SignalId: implementation-data-type=tRxSignalId, type=tRxSignalId, direction=IN
        arg Status: implementation-data-type=Boolean, type=Boolean, direction=IN
      RxCan_SignalNRProcessingControl
        arg SignalId: implementation-data-type=tRxSignalId, type=tRxSignalId, direction=IN
        arg Status: implementation-data-type=Boolean, type=Boolean, direction=IN
    error E_NOT_OK: error-code=1
  impl type tTxSignalId:
    category=VALUE
    base-type=uint8
    compu {0=eSecureTxByte0Out, 1=eSecureTxByte1Out, 2=eSecureTxByte2Out, 3=eSecureTxByte3Out, 4=eMAC_TxOut, 5=eFV_TxOut, 6=eBattery_VoltageOut, 7=eOdometerOut, 8=eVehicleSpeedICOut, 9=eIllumination_PWMOut, 10=eDebug1_Byte0Out, 11=eDebug1_Byte1Out, 12=eDebug1_Byte2Out, 13=eDebug1_Byte3Out, 14=eDebug1_Byte4Out, 15=eDebug1_Byte5Out, 16=eDebug1_Byte6Out, 17=eDebug1_Byte7Out, 18=eDebug2_Byte0Out, 19=eDebug2_Byte1Out, 20=eDebug2_Byte2Out, 21=eDebug2_Byte3Out, 22=eDebug2_Byte4Out, 23=eDebug2_Byte5Out, 24=eDebug2_Byte6Out, 25=eDebug2_Byte7Out, 26=eDebug3_Byte0Out, 27=eDebug3_Byte1Out, 28=eDebug3_Byte2Out, 29=eDebug3_Byte3Out, 30=eDebug3_Byte4Out, 31=eDebug3_Byte5Out, 32=eDebug3_Byte6Out, 33=eDebug3_Byte7Out, 34=eDebug4_Byte0Out, 35=eDebug4_Byte1Out, 36=eDebug4_Byte2Out, 37=eDebug4_Byte3Out, 38=eDebug4_Byte4Out, 39=eDebug4_Byte5Out, 40=eDebug4_Byte6Out, 41=eDebug4_Byte7Out, 42=eDebug5_Byte0Out, 43=eDebug5_Byte1Out, 44=eDebug5_Byte2Out, 45=eDebug5_Byte3Out, 46=eDebug5_Byte4Out, 47=eDebug5_Byte5Out, 48=eDebug5_Byte6Out, 49=eDebug5_Byte7Out, 50=eEndOfTxSignal}
    range raw 0..50
  impl type tTxSigConfirmStatus: category=VALUE, base-type=uint8, compu {0=eTxSigConfirmStatus_Cleared, 1=eTxSigConfirmStatus_Set, 2=eTxSigConfirmStatus_NotSupported}, range raw 0..2
  client server interface if_CS_ComAbsTx
    5 x operation:
      TxCan_ClearCanSignalTxConfirmation
        arg SignalId: implementation-data-type=tTxSignalId, type=tTxSignalId, direction=IN
      TxCan_GetCanSignalTxConfirmation
        arg SignalId: implementation-data-type=tTxSignalId, type=tTxSignalId, direction=IN
        arg pStatus: implementation-data-type=tTxSigConfirmStatus, type=tTxSigConfirmStatus, direction=OUT
      TxCan_SetSignalFromRetentionBuffer: possible-error=if_CS_ComAbsTx/E_NOT_OK
        arg SignalId: implementation-data-type=tTxSignalId, type=tTxSignalId, direction=IN
      TxCan_SetSignalValue: possible-error=if_CS_ComAbsTx/E_NOT_OK
        arg SignalId: implementation-data-type=tTxSignalId, type=tTxSignalId, direction=IN
        arg pTxSignalData: implementation-data-type=DataTypes/UInt8, type=DataTypes/UInt8, direction=INOUT
      TxCan_SetSignalValueU8Arr: possible-error=if_CS_ComAbsTx/E_NOT_OK
        arg SignalId: implementation-data-type=tTxSignalId, type=tTxSignalId, direction=IN
        arg pTxSignalData: implementation-data-type=DataTypes/UInt8, type=DataTypes/UInt8, direction=INOUT
        arg SignalLength: implementation-data-type=UInt32, type=UInt32, direction=IN
    error E_NOT_OK: error-code=1
  65 x sender receiver interface:
    if_SR_TxBattery_Voltage: invalidation-policy{data-element=Battery_Voltage, handle-invalid=DONT-INVALIDATE}
      data Battery_Voltage: implementation-data-type=DataTypes/UInt8, type=DataTypes/UInt8
    if_SR_TxDebug1_Byte0: invalidation-policy{data-element=Debug1_Byte0, handle-invalid=DONT-INVALIDATE}
      data Debug1_Byte0: implementation-data-type=DataTypes/UInt8, type=DataTypes/UInt8
    if_SR_TxDebug1_Byte1: invalidation-policy{data-element=Debug1_Byte1, handle-invalid=DONT-INVALIDATE}
      data Debug1_Byte1: implementation-data-type=DataTypes/UInt8, type=DataTypes/UInt8
    if_SR_TxDebug1_Byte2: invalidation-policy{data-element=Debug1_Byte2, handle-invalid=DONT-INVALIDATE}
      data Debug1_Byte2: implementation-data-type=DataTypes/UInt8, type=DataTypes/UInt8
    if_SR_TxDebug1_Byte3: invalidation-policy{data-element=Debug1_Byte3, handle-invalid=DONT-INVALIDATE}
      data Debug1_Byte3: implementation-data-type=DataTypes/UInt8, type=DataTypes/UInt8
    if_SR_TxDebug1_Byte4: invalidation-policy{data-element=Debug1_Byte4, handle-invalid=DONT-INVALIDATE}
      data Debug1_Byte4: implementation-data-type=DataTypes/UInt8, type=DataTypes/UInt8
    if_SR_TxDebug1_Byte5: invalidation-policy{data-element=Debug1_Byte5, handle-invalid=DONT-INVALIDATE}
      data Debug1_Byte5: implementation-data-type=DataTypes/UInt8, type=DataTypes/UInt8
    if_SR_TxDebug1_Byte6: invalidation-policy{data-element=Debug1_Byte6, handle-invalid=DONT-INVALIDATE}
      data Debug1_Byte6: implementation-data-type=DataTypes/UInt8, type=DataTypes/UInt8
    if_SR_TxDebug1_Byte7: invalidation-policy{data-element=Debug1_Byte7, handle-invalid=DONT-INVALIDATE}
      data Debug1_Byte7: implementation-data-type=DataTypes/UInt8, type=DataTypes/UInt8
    if_SR_TxDebug2_Byte0: invalidation-policy{data-element=Debug2_Byte0, handle-invalid=DONT-INVALIDATE}
      data Debug2_Byte0: implementation-data-type=DataTypes/UInt8, type=DataTypes/UInt8
    if_SR_TxDebug2_Byte1: invalidation-policy{data-element=Debug2_Byte1, handle-invalid=DONT-INVALIDATE}
      data Debug2_Byte1: implementation-data-type=DataTypes/UInt8, type=DataTypes/UInt8
    if_SR_TxDebug2_Byte2: invalidation-policy{data-element=Debug2_Byte2, handle-invalid=DONT-INVALIDATE}
      data Debug2_Byte2: implementation-data-type=DataTypes/UInt8, type=DataTypes/UInt8
    if_SR_TxDebug2_Byte3: invalidation-policy{data-element=Debug2_Byte3, handle-invalid=DONT-INVALIDATE}
      data Debug2_Byte3: implementation-data-type=DataTypes/UInt8, type=DataTypes/UInt8
    if_SR_TxDebug2_Byte4: invalidation-policy{data-element=Debug2_Byte4, handle-invalid=DONT-INVALIDATE}
      data Debug2_Byte4: implementation-data-type=DataTypes/UInt8, type=DataTypes/UInt8
    if_SR_TxDebug2_Byte5: invalidation-policy{data-element=Debug2_Byte5, handle-invalid=DONT-INVALIDATE}
      data Debug2_Byte5: implementation-data-type=DataTypes/UInt8, type=DataTypes/UInt8
    if_SR_TxDebug2_Byte6: invalidation-policy{data-element=Debug2_Byte6, handle-invalid=DONT-INVALIDATE}
      data Debug2_Byte6: implementation-data-type=DataTypes/UInt8, type=DataTypes/UInt8
    if_SR_TxDebug2_Byte7: invalidation-policy{data-element=Debug2_Byte7, handle-invalid=DONT-INVALIDATE}
      data Debug2_Byte7: implementation-data-type=DataTypes/UInt8, type=DataTypes/UInt8
    if_SR_TxDebug3_Byte0: invalidation-policy{data-element=Debug3_Byte0, handle-invalid=DONT-INVALIDATE}
      data Debug3_Byte0: implementation-data-type=DataTypes/UInt8, type=DataTypes/UInt8
    if_SR_TxDebug3_Byte1: invalidation-policy{data-element=Debug3_Byte1, handle-invalid=DONT-INVALIDATE}
      data Debug3_Byte1: implementation-data-type=DataTypes/UInt8, type=DataTypes/UInt8
    if_SR_TxDebug3_Byte2: invalidation-policy{data-element=Debug3_Byte2, handle-invalid=DONT-INVALIDATE}
      data Debug3_Byte2: implementation-data-type=DataTypes/UInt8, type=DataTypes/UInt8
    if_SR_TxDebug3_Byte3: invalidation-policy{data-element=Debug3_Byte3, handle-invalid=DONT-INVALIDATE}
      data Debug3_Byte3: implementation-data-type=DataTypes/UInt8, type=DataTypes/UInt8
    if_SR_TxDebug3_Byte4: invalidation-policy{data-element=Debug3_Byte4, handle-invalid=DONT-INVALIDATE}
      data Debug3_Byte4: implementation-data-type=DataTypes/UInt8, type=DataTypes/UInt8
    if_SR_TxDebug3_Byte5: invalidation-policy{data-element=Debug3_Byte5, handle-invalid=DONT-INVALIDATE}
      data Debug3_Byte5: implementation-data-type=DataTypes/UInt8, type=DataTypes/UInt8
    if_SR_TxDebug3_Byte6: invalidation-policy{data-element=Debug3_Byte6, handle-invalid=DONT-INVALIDATE}
      data Debug3_Byte6: implementation-data-type=DataTypes/UInt8, type=DataTypes/UInt8
    if_SR_TxDebug3_Byte7: invalidation-policy{data-element=Debug3_Byte7, handle-invalid=DONT-INVALIDATE}
      data Debug3_Byte7: implementation-data-type=DataTypes/UInt8, type=DataTypes/UInt8
    if_SR_TxDebug4_Byte0: invalidation-policy{data-element=Debug4_Byte0, handle-invalid=DONT-INVALIDATE}
      data Debug4_Byte0: implementation-data-type=DataTypes/UInt8, type=DataTypes/UInt8
    if_SR_TxDebug4_Byte1: invalidation-policy{data-element=Debug4_Byte1, handle-invalid=DONT-INVALIDATE}
      data Debug4_Byte1: implementation-data-type=DataTypes/UInt8, type=DataTypes/UInt8
    if_SR_TxDebug4_Byte2: invalidation-policy{data-element=Debug4_Byte2, handle-invalid=DONT-INVALIDATE}
      data Debug4_Byte2: implementation-data-type=DataTypes/UInt8, type=DataTypes/UInt8
    if_SR_TxDebug4_Byte3: invalidation-policy{data-element=Debug4_Byte3, handle-invalid=DONT-INVALIDATE}
      data Debug4_Byte3: implementation-data-type=DataTypes/UInt8, type=DataTypes/UInt8
    if_SR_TxDebug4_Byte4: invalidation-policy{data-element=Debug4_Byte4, handle-invalid=DONT-INVALIDATE}
      data Debug4_Byte4: implementation-data-type=DataTypes/UInt8, type=DataTypes/UInt8
    if_SR_TxDebug4_Byte5: invalidation-policy{data-element=Debug4_Byte5, handle-invalid=DONT-INVALIDATE}
      data Debug4_Byte5: implementation-data-type=DataTypes/UInt8, type=DataTypes/UInt8
    if_SR_TxDebug4_Byte6: invalidation-policy{data-element=Debug4_Byte6, handle-invalid=DONT-INVALIDATE}
      data Debug4_Byte6: implementation-data-type=DataTypes/UInt8, type=DataTypes/UInt8
    if_SR_TxDebug4_Byte7: invalidation-policy{data-element=Debug4_Byte7, handle-invalid=DONT-INVALIDATE}
      data Debug4_Byte7: implementation-data-type=DataTypes/UInt8, type=DataTypes/UInt8
    if_SR_TxDebug5_Byte0: invalidation-policy{data-element=Debug5_Byte0, handle-invalid=DONT-INVALIDATE}
      data Debug5_Byte0: implementation-data-type=DataTypes/UInt8, type=DataTypes/UInt8
    if_SR_TxDebug5_Byte1: invalidation-policy{data-element=Debug5_Byte1, handle-invalid=DONT-INVALIDATE}
      data Debug5_Byte1: implementation-data-type=DataTypes/UInt8, type=DataTypes/UInt8
    if_SR_TxDebug5_Byte2: invalidation-policy{data-element=Debug5_Byte2, handle-invalid=DONT-INVALIDATE}
      data Debug5_Byte2: implementation-data-type=DataTypes/UInt8, type=DataTypes/UInt8
    if_SR_TxDebug5_Byte3: invalidation-policy{data-element=Debug5_Byte3, handle-invalid=DONT-INVALIDATE}
      data Debug5_Byte3: implementation-data-type=DataTypes/UInt8, type=DataTypes/UInt8
    if_SR_TxDebug5_Byte4: invalidation-policy{data-element=Debug5_Byte4, handle-invalid=DONT-INVALIDATE}
      data Debug5_Byte4: implementation-data-type=DataTypes/UInt8, type=DataTypes/UInt8
    if_SR_TxDebug5_Byte5: invalidation-policy{data-element=Debug5_Byte5, handle-invalid=DONT-INVALIDATE}
      data Debug5_Byte5: implementation-data-type=DataTypes/UInt8, type=DataTypes/UInt8
    if_SR_TxDebug5_Byte6: invalidation-policy{data-element=Debug5_Byte6, handle-invalid=DONT-INVALIDATE}
      data Debug5_Byte6: implementation-data-type=DataTypes/UInt8, type=DataTypes/UInt8
    if_SR_TxDebug5_Byte7: invalidation-policy{data-element=Debug5_Byte7, handle-invalid=DONT-INVALIDATE}
      data Debug5_Byte7: implementation-data-type=DataTypes/UInt8, type=DataTypes/UInt8
    if_SR_TxFV_Tx: invalidation-policy{data-element=FV_Tx, handle-invalid=DONT-INVALIDATE}
      data FV_Tx: implementation-data-type=DataTypes/UInt8, type=DataTypes/UInt8
    if_SR_TxIllumination_PWM: invalidation-policy{data-element=Illumination_PWM, handle-invalid=DONT-INVALIDATE}
      data Illumination_PWM: implementation-data-type=DataTypes/UInt8, type=DataTypes/UInt8
    if_SR_TxMAC_Tx: invalidation-policy{data-element=MAC_Tx, handle-invalid=DONT-INVALIDATE}
      data MAC_Tx: implementation-data-type=UInt32, type=UInt32
    if_SR_TxOdometer: invalidation-policy{data-element=Odometer, handle-invalid=DONT-INVALIDATE}
      data Odometer: implementation-data-type=UInt32, type=UInt32
    if_SR_TxSecureTxByte0: invalidation-policy{data-element=SecureTxByte0, handle-invalid=DONT-INVALIDATE}
      data SecureTxByte0: implementation-data-type=DataTypes/UInt8, type=DataTypes/UInt8
    if_SR_TxSecureTxByte1: invalidation-policy{data-element=SecureTxByte1, handle-invalid=DONT-INVALIDATE}
      data SecureTxByte1: implementation-data-type=DataTypes/UInt8, type=DataTypes/UInt8
    if_SR_TxSecureTxByte2: invalidation-policy{data-element=SecureTxByte2, handle-invalid=DONT-INVALIDATE}
      data SecureTxByte2: implementation-data-type=DataTypes/UInt8, type=DataTypes/UInt8
    if_SR_TxSecureTxByte3: invalidation-policy{data-element=SecureTxByte3, handle-invalid=DONT-INVALIDATE}
      data SecureTxByte3: implementation-data-type=DataTypes/UInt8, type=DataTypes/UInt8
    if_SR_TxVehicleSpeedIC: invalidation-policy{data-element=VehicleSpeedIC, handle-invalid=DONT-INVALIDATE}
      data VehicleSpeedIC: implementation-data-type=UInt16, type=UInt16
    if_SR_RxAirbag: invalidation-policy{data-element=Airbag, handle-invalid=DONT-INVALIDATE}
      data Airbag: implementation-data-type=DataTypes/UInt8, type=DataTypes/UInt8
    if_SR_RxAlive_101: invalidation-policy{data-element=Alive_101, handle-invalid=DONT-INVALIDATE}
      data Alive_101: implementation-data-type=DataTypes/UInt8, type=DataTypes/UInt8
    if_SR_RxAmbient_Light_level: invalidation-policy{data-element=Ambient_Light_level, handle-invalid=DONT-INVALIDATE}
      data Ambient_Light_level: implementation-data-type=DataTypes/UInt8, type=DataTypes/UInt8
    if_SR_RxCRC_101: invalidation-policy{data-element=CRC_101, handle-invalid=DONT-INVALIDATE}
      data CRC_101: implementation-data-type=DataTypes/UInt8, type=DataTypes/UInt8
    if_SR_RxDayNightMode: invalidation-policy{data-element=DayNightMode, handle-invalid=DONT-INVALIDATE}
      data DayNightMode: implementation-data-type=DataTypes/UInt8, type=DataTypes/UInt8
    if_SR_RxEngineSpeed: invalidation-policy{data-element=EngineSpeed, handle-invalid=DONT-INVALIDATE}
      data EngineSpeed: implementation-data-type=UInt16, type=UInt16
    if_SR_RxGear: invalidation-policy{data-element=Gear, handle-invalid=DONT-INVALIDATE}
      data Gear: implementation-data-type=DataTypes/UInt8, type=DataTypes/UInt8
    if_SR_RxGearMode: invalidation-policy{data-element=GearMode, handle-invalid=DONT-INVALIDATE}
      data GearMode: implementation-data-type=DataTypes/UInt8, type=DataTypes/UInt8
    if_SR_RxGearRecommendation: invalidation-policy{data-element=GearRecommendation, handle-invalid=DONT-INVALIDATE}
      data GearRecommendation: implementation-data-type=DataTypes/UInt8, type=DataTypes/UInt8
    if_SR_RxGearStatus: invalidation-policy{data-element=GearStatus, handle-invalid=DONT-INVALIDATE}
      data GearStatus: implementation-data-type=DataTypes/UInt8, type=DataTypes/UInt8
    if_SR_RxIllumination_level: invalidation-policy{data-element=Illumination_level, handle-invalid=DONT-INVALIDATE}
      data Illumination_level: implementation-data-type=DataTypes/UInt8, type=DataTypes/UInt8
    if_SR_RxPowerMode: invalidation-policy{data-element=PowerMode, handle-invalid=DONT-INVALIDATE}
      data PowerMode: implementation-data-type=DataTypes/UInt8, type=DataTypes/UInt8
    if_SR_RxTransportMode: invalidation-policy{data-element=TransportMode, handle-invalid=DONT-INVALIDATE}
      data TransportMode: implementation-data-type=DataTypes/UInt8, type=DataTypes/UInt8
    if_SR_RxVehicleSpeedABS: invalidation-policy{data-element=VehicleSpeedABS, handle-invalid=DONT-INVALIDATE}
      data VehicleSpeedABS: implementation-data-type=UInt16, type=UInt16
    if_SR_RxWarning: invalidation-policy{data-element=Warning, handle-invalid=DONT-INVALIDATE}
      data Warning: implementation-data-type=DataTypes/UInt8, type=DataTypes/UInt8
  impl type TTBlinkArray: category=ARRAY
    element ArrayElement: category=VALUE, array-size=16, array-size-semantics=FIXED-SIZE, base-type=uint8
  impl type TTFlashMask: category=VALUE, base-type=uint8, compu {0=NOT_IN_SYNCH, 1=FLASH_180DEG_PHASE_SYNCH, 2=FLASH_360DEG_PHASE_SYNCH, 4=FLASH_OFF_PERIOD_MASK}, range raw 0..4
  sender receiver interface TITelltaleBlinkStatusArray
    data TTBlinkStatusArray: implementation-data-type=TTBlinkArray, type=TTBlinkArray
    data TTdummyDataForTypes: implementation-data-type=TTFlashMask, type=TTFlashMask
    invalidation-policys:
      data-element=TTBlinkStatusArray, handle-invalid=DONT-INVALIDATE
      data-element=TTdummyDataForTypes, handle-invalid=DONT-INVALIDATE
  impl type TT_OP_Type: category=ARRAY
    element ArrayElement: category=VALUE, array-size=92, array-size-semantics=FIXED-SIZE, base-type=uint8
  sender receiver interface TIGetTelltaleStatus: invalidation-policy{data-element=TelltaleFunctionalOpStatus, handle-invalid=DONT-INVALIDATE}
    data TelltaleFunctionalOpStatus: implementation-data-type=TT_OP_Type, type=TT_OP_Type
  sender receiver interface TITelltaleStatusOutput: invalidation-policy{data-element=TelltaleOpArray, handle-invalid=DONT-INVALIDATE}
    data TelltaleOpArray: implementation-data-type=TT_OP_Type, type=TT_OP_Type
  client server interface TI_SafeInit
    operation Init
  impl type BulbTestStatus: category=VALUE, base-type=uint16, compu {0=BulbStatusNotActive, 45020=BulbStatusActive}, range raw 0..45020
  sender receiver interface TI_UiETMEnterBulbTestMode: invalidation-policy{data-element=CurrentBulbTestStatus, handle-invalid=DONT-INVALIDATE}
    data CurrentBulbTestStatus: implementation-data-type=BulbTestStatus, type=BulbTestStatus
  impl type HMIReadySts_Type: category=VALUE, base-type=uint8, compu {0=eHMI_NOT_READY, 1=eHMI_READY}, range raw 0..1
  sender receiver interface TI_SR_HMIReadyStatus: invalidation-policy{data-element=HMI_ReadyStatus, handle-invalid=DONT-INVALIDATE}
    data HMI_ReadyStatus: implementation-data-type=HMIReadySts_Type, type=HMIReadySts_Type
  impl type TFTIgnBlankSts_T: category=VALUE, base-type=uint8, compu {0=TFTExitBlankOut, 1=TFTInBlankOut}, range raw 0..1
  sender receiver interface TI_IgnBlankOutCheck: invalidation-policy{data-element=IgnBlankOutCheck, handle-invalid=DONT-INVALIDATE}
    data IgnBlankOutCheck: implementation-data-type=TFTIgnBlankSts_T, type=TFTIgnBlankSts_T
  impl type IgntionSubstateType: category=VALUE, base-type=uint8, compu {0=IgnOff, 1=IgnOn}, range raw 0..1
  sender receiver interface TI_WSS_IgnitionSubstate: invalidation-policy{data-element=IgnitionSubstate, handle-invalid=DONT-INVALIDATE}
    data IgnitionSubstate: implementation-data-type=IgntionSubstateType, type=IgntionSubstateType
  impl type TT_ENUM_TYPE:
    category=VALUE
    base-type=uint8
    compu {0=TT_ABS_INDEX, 1=TT_AIRBAG_INDEX, 2=TT_BRAKE_RED_INDEX, 3=TT_BRAKE_HOLD_INDEX, 4=TT_BRAKE_YELLOW_INDEX, 5=TT_PARKING_BRAKE_INDEX, 6=TT_TRACTION_CTRL_INDEX, 7=TT_VCS_OFF_INDEX, 8=TT_ABS_INDEX_US, 9=TT_BRAKE_RED_INDEX_US, 10=TT_PARKING_BRAKE_INDEX_US, 11=TT_SAF_RES4_INDEX, 12=TT_SAF_RES5_INDEX, 13=TT_SAF_RES6_INDEX, 14=TT_SAF_RES7_INDEX, 15=TT_SAF_RES8_INDEX, 16=TT_ADAS_INDEX, 17=TT_AUTO_HIGH_BEAM_INDEX, 18=TT_BRAKE_HOLD_STANDBY_INDEX, 19=TT_FUEL_INDEX, 20=TT_FFOG_INDEX, 21=TT_HEAD_INDEX, 22=TT_HIGH_BEAM_INDEX, 23=TT_PCS_OFF_INDEX, 24=TT_READY_INDEX, 25=TT_RFOG_INDEX, 26=TT_SEAT_BELT_INDEX, 27=TT_TAIL_LIGHT_INDEX, 28=TT_TURN_HAZARD_RIGHT_INDEX, 29=TT_TURN_HAZARD_LEFT_INDEX, 30=TT_EWT_INDEX, 31=TT_AAHB_LO_GREEN, 32=TT_AAHB_SHADED_GREEN, 33=TT_AAHB_HI_GREEN, 34=TT_AAHB_HI_WHITE, 35=TT_ITS_INFRA, 36=TT_ITS_VEHICLE, 37=TT_ITS_COMBINATION, 38=TT_SSS_GREEN, 39=TT_SSS_AMBER, 40=TT_LCA_LEFT_WHITE, 41=TT_LCA_LEFT_GRAY, 42=TT_LCA_LEFT_GREEN, 43=TT_LCA_RIGHT_WHITE, 44=TT_LCA_RIGHT_GRAY, 45=TT_LCA_RIGHT_GREEN, 46=TT_LTA_GREEN, 47=TT_LTA_WHITE, 48=TT_LTA_AMBER, 49=TT_CCT_GREEN, 50=TT_CCT_WHITE, 51=TT_CCT_AMBER, 52=TT_RCCT_GREEN, 53=TT_RCCT_WHITE, 54=TT_RCCT_AMBER, 55=TT_ACCDT_WHITE_LV4, 56=TT_ACCDT_WHITE_LV3, 57=TT_ACCDT_WHITE_LV2, 58=TT_ACCDT_WHITE_LV1, 59=TT_ACCDT_GREEN_LV4, 60=TT_ACCDT_GREEN_LV3, 61=TT_ACCDT_GREEN_LV2, 62=TT_ACCDT_GREEN_LV1, 63=TT_SL_GREEN, 64=TT_SL_WHITE, 65=TT_SL_AMBER, 66=TT_AUTO_LSD_AMBER, 67=TT_DRIVEMODE_SPORT, 68=TT_DRIVEMODE_ECO, 69=TT_DRIVEMODE_CUSTOM, 70=TT_DRIVEMODE_RANGE, 71=TT_DRIVEMODE_REARCOMFORT, 72=TT_DRIVEMODE_SNOW, 73=TT_DRIVEMODE_TRACK, 74=TT_LDA_RED, 75=TT_LDA_AMBER, 76=TT_LDA_WHITE, 77=TT_LDA_OFF_AMBER, 78=TT_LDA_OFF_WHITE, 79=TT_ECOLAMP, 80=TT_PS_GREEN, 81=TT_PKBOPER_TXT, 82=TT_PKBOPER_IMG, 83=TT_TPMS_INDEX, 84=TT_EBPWIND_RED_US, 85=TT_EBPWIND_RED, 86=TT_FMSR_AMBER, 87=TT_FMFR_AMBER, 88=TT_MULWL_GREEN, 89=TT_HCS_ACCESS_GREEN, 90=TT_HCS_LIFT_GREEN, 91=TT_HCS_LIFT_AMBER, 92=TT_TOTAL_NUM_OF_TELLTALES}
    range raw 0..92
  impl type TT_OP_STATES:
    category=VALUE
    base-type=uint8
    compu {0=TT_TURN_OFF, 1=TT_TURN_ON, 2=TT_FLASH_QUARTER_HZ, 3=TT_FLASH_HALF_HZ, 4=TT_FLASH_CSNR_HALF_HZ, 5=TT_FLASH_0_83_HZ, 6=TT_FLASH_1HZ, 7=TT_FLASH_1_33_HZ, 8=TT_FLASH_1_66_HZ, 9=TT_FLASH_2HZ, 10=TT_FLASH_2_5_HZ, 11=TT_FLASH_2_66_HZ, 12=TT_FLASH_TRNHZ_Normal, 13=TT_FLASH_TRNHZ_Fast, 14=TT_FLASH_TRNHZ_FHL, 15=TT_FLASH_3HZ, 16=TT_FLASH_4HZ, 17=TT_FLASH_5HZ, 18=TT_FLASH_SYNC_QUARTER_HZ, 19=TT_FLASH_SYNC_HALF_HZ, 20=TT_FLASH_SYNC_CSNR_HALF_HZ, 21=TT_FLASH_SYNC_0_83_HZ, 22=TT_FLASH_SYNC_1HZ, 23=TT_FLASH_SYNC_1_33_HZ, 24=TT_FLASH_SYNC_1_66_HZ, 25=TT_FLASH_SYNC_2HZ, 26=TT_FLASH_SYNC_2_5_HZ, 27=TT_FLASH_SYNC_2_66_HZ, 28=TT_FLASH_TRNHZ_SYNC_Normal, 29=TT_FLASH_TRNHZ_SYNC_Fast, 30=TT_FLASH_TRNHZ_SYNC_FHL, 31=TT_FLASH_SYNC_4HZ, 32=TT_FLASH_SYNC_5HZ, 255=TT_CONFIGURED_OFF}
    range raw 0..255
  sender receiver interface TI_TelltaleIndexStatus
    data TTIndex: implementation-data-type=TT_ENUM_TYPE, type=TT_ENUM_TYPE
    data TTStatus: implementation-data-type=TT_OP_STATES, type=TT_OP_STATES
    invalidation-policys:
      data-element=TTIndex, handle-invalid=DONT-INVALIDATE
      data-element=TTStatus, handle-invalid=DONT-INVALIDATE
  sender receiver interface TIUpdateTelltaleStatus: invalidation-policy{data-element=CurrentTelltaleStatus, handle-invalid=DONT-INVALIDATE}
    data CurrentTelltaleStatus: implementation-data-type=TT_OP_STATES, type=TT_OP_STATES
  impl type ClusterModes: category=VALUE, base-type=uint8, compu {0=CLUSTER_INACTIVE, 1=CLUSTER_ACTIVE}, range raw 0..1
  sender receiver interface TI_WSS_ClusterMode: invalidation-policy{data-element=WSSCurrentClusterMode, handle-invalid=DONT-INVALIDATE}
    data WSSCurrentClusterMode: implementation-data-type=ClusterModes, type=ClusterModes
  impl type ModeStatus: category=VALUE, base-type=uint8, compu {0=STATUS_OFF, 1=STATUS_ON}, range raw 0..1
  6 x sender receiver interface:
    TI_WSS_ACCMode: invalidation-policy{data-element=WSSAccState, handle-invalid=DONT-INVALIDATE}
      data WSSAccState: implementation-data-type=ModeStatus, type=ModeStatus
    TI_WSS_BAMode: invalidation-policy{data-element=WSSBaState, handle-invalid=DONT-INVALIDATE}
      data WSSBaState: implementation-data-type=ModeStatus, type=ModeStatus
    TI_WSS_BAOFMode: invalidation-policy{data-element=WSSBaOfState, handle-invalid=DONT-INVALIDATE}
      data WSSBaOfState: implementation-data-type=ModeStatus, type=ModeStatus
    TI_WSS_IgnitionBuzState: invalidation-policy{data-element=IgnitioBuznstate, handle-invalid=DONT-INVALIDATE}
      data IgnitioBuznstate: implementation-data-type=IgntionSubstateType, type=IgntionSubstateType
    TI_WSS_IGP_CANMode: invalidation-policy{data-element=WSSIGPCANState, handle-invalid=DONT-INVALIDATE}
      data WSSIGPCANState: implementation-data-type=ModeStatus, type=ModeStatus
    TI_WSS_IGPMode: invalidation-policy{data-element=WSSIGPState, handle-invalid=DONT-INVALIDATE}
      data WSSIGPState: implementation-data-type=ModeStatus, type=ModeStatus
  impl type eAppMdl: category=VALUE, base-type=uint8, compu {0=eSWCApp_SmartKey_Bzr, 1=eSWCApp_Warn_MFLID, 2=eSWCApp_Head_TT, 3=eSWCApp_Tail_TT, 4=eSWCApp_Fuel, 5=eSWCApp_Illum, 6=eSWCApp_Buzzer, 7=eSWCApp_NVM, 8=eTFTDisplayOnExceptTurn, 9=eTurnL_Status, 10=eTurnR_Status, 11=eSWCApp_End}, range raw 0..11
  impl type eSleepSt: category=VALUE, base-type=uint8, compu {0=eSleep_Inactive, 1=eISleep_Active}, range raw 0..1
  client server interface TI_WSS_SWCAppSleepStatus
    operation SWCSleepStatus
      arg AppModule: implementation-data-type=eAppMdl, type=eAppMdl, direction=IN
      arg SleepStatus: implementation-data-type=eSleepSt, type=eSleepSt, direction=IN
  client server interface TI_WSS_SWC_EarlyWakeUpHandle
    operation SWCEarlyWakeUpHandle
  impl type ClusterInitModes: category=VALUE, base-type=uint8, compu {0=CLUSTER_INIT, 1=CLUSTER_RUN, 2=CLUSTER_RUN_READALL}, range raw 0..2
  sender receiver interface TI_WSS_Init_ClusterMode: invalidation-policy{data-element=WSSCurrentClusterInitMode, handle-invalid=DONT-INVALIDATE}
    data WSSCurrentClusterInitMode: implementation-data-type=ClusterInitModes, type=ClusterInitModes
  client server interface TI_WSS_SleepOperations
    operation CtrlWSS_CancelSleep: possible-error=TI_WSS_SleepOperations/E_NOT_OK
    operation CtrlWSS_ReadytoSleep: possible-error=TI_WSS_SleepOperations/E_NOT_OK
    operation CtrlWSS_RequestSleep: possible-error=TI_WSS_SleepOperations/E_NOT_OK
    error E_NOT_OK: error-code=1
  impl type SleepType: category=VALUE, base-type=uint8, compu {0=SLEEEP_READY, 1=SLEEP_NOT_READY}, range raw 0..1
  sender receiver interface TI_Sleep_Ready_Status: invalidation-policy{data-element=Sleep_Status, handle-invalid=DONT-INVALIDATE}
    data Sleep_Status: implementation-data-type=SleepType, type=SleepType
  impl type DisplayStatus: category=VALUE, base-type=uint8, compu {0=TFTDisplayOFF, 1=TFTDisplayON}, range raw 0..1
  sender receiver interface TI_TFTDisplayOn: invalidation-policy{data-element=TFTDisplayOn, handle-invalid=DONT-INVALIDATE}
    data TFTDisplayOn: implementation-data-type=DisplayStatus, type=DisplayStatus
  sender receiver interface TI_TFTDisplayOnExTurn: invalidation-policy{data-element=TFTDisplayOnExTurn, handle-invalid=DONT-INVALIDATE}
    data TFTDisplayOnExTurn: implementation-data-type=DisplayStatus, type=DisplayStatus
  client server interface TI_Variant_Status
    operation GetVariant_Status
      arg Variant_Ind: implementation-data-type=DataTypes/UInt8, type=DataTypes/UInt8, direction=IN
      arg Variant_Status: implementation-data-type=DataTypes/UInt8, type=DataTypes/UInt8, direction=OUT
  impl type VehicleActiveModes: category=VALUE, base-type=uint8, compu {0=NETWORK_SLEEP, 1=NETWORK_NORMAL, 2=NETWORK_STANDALONE}, range raw 0..2
  sender receiver interface TI_WSS_VehAppMode: invalidation-policy{data-element=WSSCurrentVehicleState, handle-invalid=DONT-INVALIDATE}
    data WSSCurrentVehicleState: implementation-data-type=VehicleActiveModes, type=VehicleActiveModes
  impl type BOOL_TYPE: category=VALUE, base-type=uint8, compu {0=DBG_TRUE, 1=DBG_FALSE}, range raw 0..1
  4 x sender receiver interface:
    TI_FuelLid_Status: invalidation-policy{data-element=FuelLidStatus, handle-invalid=DONT-INVALIDATE}
      data FuelLidStatus: implementation-data-type=BOOL_TYPE, sw-impl-policy=QUEUED, type=BOOL_TYPE
    TI_Hazard_Status: invalidation-policy{data-element=HazardStatus, handle-invalid=DONT-INVALIDATE}
      data HazardStatus: implementation-data-type=BOOL_TYPE, sw-impl-policy=QUEUED, type=BOOL_TYPE
    if_SR_EcuAppM_phase1readcompleted_dummy: invalidation-policy{data-element=PhasedRead_Status_phase1readcompleted, handle-invalid=DONT-INVALIDATE}
      data PhasedRead_Status_phase1readcompleted: implementation-data-type=Boolean, type=Boolean
    if_SR_EcuAppM_phase2readcompleted_dummy: invalidation-policy{data-element=PhasedRead_Status_phase2readcompleted, handle-invalid=DONT-INVALIDATE}
      data PhasedRead_Status_phase2readcompleted: implementation-data-type=Boolean, type=Boolean
  impl type SMainHMIReadyStatus: category=STRUCTURE
    element status: implementation-data-type=DataTypes/UInt8
  sender receiver interface MainHMIReadyStatus: invalidation-policy{data-element=MainHMIReadyStatusData, handle-invalid=DONT-INVALIDATE}
    data MainHMIReadyStatusData: implementation-data-type=SMainHMIReadyStatus, sw-impl-policy=QUEUED, type=SMainHMIReadyStatus
  client server interface if_CS_MemAbs_NvMWriteStatus
    operation NvmWriteStatus: possible-error=if_CS_MemAbs_NvMWriteStatus/E_NOT_OK
    error E_NOT_OK: error-code=1
  client server interface TI_NvMExt_GetReadAllStatus
    operation NvmExt_GetNvMReadAllStatus
      arg Status: implementation-data-type=Boolean, type=Boolean, direction=OUT
  client server interface TI_NvMExt_SleepOperations
    operation NvMExt_CancelSleep: possible-error=TI_NvMExt_SleepOperations/E_NOT_OK
    operation NvMExt_ReadytoSleep: possible-error=TI_NvMExt_SleepOperations/E_NOT_OK
    operation NvMExt_RequestSleep: possible-error=TI_NvMExt_SleepOperations/E_NOT_OK
    error E_NOT_OK: error-code=1
  impl type HTimer:
    category=VALUE
    base-type=uint8
    compu {0=eWarningMask_Timerhandle, 1=eOWC_Timerhandle, 2=eNWD_Timerhandle, 3=eWarningBulbCheckMask_Timerhandle, 4=eInitWarning_TimerHandle, 5=eInitChimeTimerHandle, 6=eProgrammingTimerHandle, 7=eStubCounter_TimerHanlde, 8=eModeMgrDisplayPowerDownUp, 9=eModeMgrDisplayFaultAction, 10=eModeMgrDomanResetAction, 11=eModeMgrPowerFaultAction, 12=eEtm4SecTimer, 13=eEtm1200msecTimer, 14=eEtm3SecTimer, 15=eCallbackTimerOdoMdl, 16=eThrottleTimerOdoMdl, 17=eChangeupCallbackTimerodoMdl, 18=eTimerVehicleState, 19=eTimerVariantConfig, 20=WARNING_DISPLAY_TIMER_ID, 21=WARNING_HOLD_TIMER_ID, 22=WARNING_CYCLE_TIMER_ID, 23=WARNING_DISPLAYHOLD_TIMER_ID, 24=WARNING_ACK_TIMER_ID, 25=eTimerHandle_Sleep, 26=eInStartCount_TimerHandle, 27=eVehicleModeCount_TimerHandle, 28=e10secTimer, 29=e3secTimer, 30=e30secTimer, 31=e2_6secTimer, 32=eDcmApp5secTimer, 33=eDcmApp1secTimer, 34=eLidopen_OFFTimer, 35=eLidopen_ONTimer, 36=POPUP_DISPLAY_TIMER_ID, 37=POPUP_GRP_TAB_TIMER_ID, 38=eDrvRec5_6Timer, 39=eDrvRec3_6Timer, 40=eIDS_1SecTimer, 41=eIDS3_1SecTimer, 42=eIDS_3SecTimer, 43=ePerDispSet100msTimer, 44=eDrvRec1_2secTimer, 45=eDrvRec0_8secTimer, 46=eHMI_Initial_Blank_timer_ID, 47=eHMI_Fade_in_delay_timer_ID, 48=eKM6secTimer, 49=eKM5_8secTimer, 50=eKM0_6secTimer, 51=eKM0_2secTimer, 52=eIgnCANMode_3SecTimer, 53=eDem2_6secTimer, 54=eDem5secTimer, 55=e2FRheo5secTimer, 56=e2FSTSW5secTimer, 57=eLSTM3_Timer, 58=eLSTM4_Timer, 59=eDem_AFS_5sec_Timer, 60=WARNING_MSGTIMEOUT_1SEC_TIMER_ID, 61=eDCMApp_30Sec_Timer, 62=WRN_ACK_REDISPLAY_TIMER_ID, 63=eMenuScrollStart1sTimer, 64=eType4_6secTimer, 65=eDcmApp_0_35secTimer, 66=eDcmApp_0_35_1secTimer, 67=eRemoteCarFindCtrlStateTimer, 68=eBrake_Red_100msecTimer, 69=eStreeingSw_ReleaseTimer, 70=POPUP_SETTING_TIMER_ID, 71=eMenu100msTimer, 72=eBuzzerMiddleEast_6secs, 73=eBuzzerMiddleEast_6secs_2, 74=eMaxNumof16BitTimers, 75=eSleepMaxTimer, 76=eRentACarTimer, 77=eDoorWarn_Timer, 78=eTimerHandleGdtCdd, 79=eSample32BitTimer, 80=eTimerMax}
    range raw 0..80
  4 x client server interface:
    TI_If_TmExt_Timer_IsElapsed
      operation Timer_IsElapsed
        arg hTimer: implementation-data-type=HTimer, type=HTimer, direction=IN
        arg Timeout: implementation-data-type=UInt32, type=UInt32, direction=IN
        arg IsElapsed: implementation-data-type=Boolean, type=Boolean, direction=OUT
    TI_If_TmExt_Timer_Start
      operation Timer_Start
        arg hTimer: implementation-data-type=HTimer, type=HTimer, direction=IN
    TI_If_TmExt_Timer_IsStarted
      operation Timer_IsStarted
        arg hTimer: implementation-data-type=HTimer, type=HTimer, direction=IN
        arg IsStarted: implementation-data-type=Boolean, type=Boolean, direction=OUT
    TI_If_TmExt_Timer_Stop
      operation Timer_Stop
        arg hTimer: implementation-data-type=HTimer, type=HTimer, direction=IN
  impl type HMI_Odo_Type: category=VALUE, base-type=uint8, compu {0=eODO_TYPE_OFF, 1=eODO_TYPE_BLANK, 2=eODO_TYPE_ODO, 3=eODO_TYPE_TRIPA, 4=eODO_TYPE_TRIPB, 5=eODO_TYPE_OILMIL_DISTANCE, 6=eODO_TYPE_FUEL_OW_ADV_NOTICE, 7=eODO_TYPE_FUEL_OVER_WRITE, 8=eODO_TYPE_POWER_STATUS_ACC, 9=eODO_TYPE_POWER_STATUS_ON, 10=eODO_TYPE_OILMIL_DISTANCE_INT}, range raw 0..10
  sender receiver interface TI_SR_HMI_Odo_Type: invalidation-policy{data-element=HMI_OdoType, handle-invalid=DONT-INVALIDATE}
    data HMI_OdoType: implementation-data-type=HMI_Odo_Type, type=HMI_Odo_Type
  impl type HMI_Screen_Mode: category=VALUE, base-type=uint8, compu {0=eSCREENMODE_OFF, 1=eSCREENMODE_BLANK, 2=eSCREENMODE_NORMAL, 3=eSCREENMODE_DISPLAY_ADJ, 4=eSCREENMODE_WELCOME, 5=eSCREENMODE_IGNOFF_CHR, 6=eSCREENMODE_OPENING, 7=eSCREENMODE_ENDING, 8=eSCREENMODE_ENDING_IGNOFF_CHR, 9=eSCREENMODE_RESERVED}, range raw 0..9
  sender receiver interface TI_SR_HMIScreenMode: invalidation-policy{data-element=HMIScreenMode_Status, handle-invalid=DONT-INVALIDATE}
    data HMIScreenMode_Status: implementation-data-type=HMI_Screen_Mode, type=HMI_Screen_Mode
  sender receiver interface TI_HeadLamp_Status: invalidation-policy{data-element=Head_Lamp_st, handle-invalid=DONT-INVALIDATE}
    data Head_Lamp_st: implementation-data-type=DataTypes/UInt8, type=DataTypes/UInt8
  sender receiver interface TI_DayNightStatus: invalidation-policy{data-element=illumDNStatus, handle-invalid=DONT-INVALIDATE}
    data illumDNStatus: implementation-data-type=DataTypes/UInt8, type=DataTypes/UInt8
  client server interface TI_EcumExtInit
    operation Init
  sender receiver interface TI_SR_PWMOut_TC_Dbc: invalidation-policy{data-element=PWMOut_TC_Dbc, handle-invalid=DONT-INVALIDATE}
    data PWMOut_TC_Dbc: implementation-data-type=DataTypes/UInt8, type=DataTypes/UInt8
  sender receiver interface TI_SR_ShiftPositionDisplay: invalidation-policy{data-element=ShiftPositionDisplay, handle-invalid=DONT-INVALIDATE}
    data ShiftPositionDisplay: implementation-data-type=DataTypes/UInt8, type=DataTypes/UInt8
  sender receiver interface TI_TailLight_Status: invalidation-policy{data-element=Tail_Light_st, handle-invalid=DONT-INVALIDATE}
    data Tail_Light_st: implementation-data-type=DataTypes/UInt8, type=DataTypes/UInt8
  impl type TurnStates: category=VALUE, base-type=uint8, compu {0=TurnOff, 1=TurnOn, 2=TurnBlink}, range raw 0..2
  sender receiver interface TI_SR_TurnHazard_TurnL_Status: invalidation-policy{data-element=LeftIndicatorSts, handle-invalid=DONT-INVALIDATE}
    data LeftIndicatorSts: implementation-data-type=TurnStates, type=TurnStates
  sender receiver interface TI_SR_TurnHazard_TurnR_Status: invalidation-policy{data-element=RightIndicatorSts, handle-invalid=DONT-INVALIDATE}
    data RightIndicatorSts: implementation-data-type=TurnStates, type=TurnStates
  impl type NvM_BlockIdType: category=VALUE, base-type=uint16, range raw 0..65535
  impl type NvM_RequestResultType: category=VALUE, base-type=uint8, range raw 0..255
  6 x client server interface:
    TI_NvMExt_GetErrorStatus
      operation NvMExt_GetErrorStatus: possible-error=TI_NvMExt_GetErrorStatus/E_NOT_OK
        arg NvmBlockId: implementation-data-type=NvM_BlockIdType, type=NvM_BlockIdType, direction=IN
        arg RequestResultPtr: implementation-data-type=NvM_RequestResultType, type=NvM_RequestResultType, direction=INOUT
      error E_NOT_OK: error-code=1
    TI_NvMExt_ReadBlock
      operation NvMExt_ReadBlock: possible-error=TI_NvMExt_ReadBlock/E_NOT_OK
        arg NvmBlockId: implementation-data-type=NvM_BlockIdType, type=NvM_BlockIdType, direction=IN
        arg NvMDstPtr: implementation-data-type=DataTypes/UInt8, type=DataTypes/UInt8, direction=INOUT
      error E_NOT_OK: error-code=1
    TI_NvMExt_RestoreBlockDefaults
      operation NvMExt_RestoreBlockDefaults: possible-error=TI_NvMExt_RestoreBlockDefaults/E_NOT_OK
        arg NvmBlockId: implementation-data-type=NvM_BlockIdType, type=NvM_BlockIdType, direction=IN
        arg NvMDstPtr: implementation-data-type=DataTypes/UInt8, type=DataTypes/UInt8, direction=INOUT
      error E_NOT_OK: error-code=1
    TI_NvMExt_WriteBlock
      operation NvMExt_WriteBlock: possible-error=TI_NvMExt_WriteBlock/E_NOT_OK
        arg NvmBlockId: implementation-data-type=NvM_BlockIdType, type=NvM_BlockIdType, direction=IN
        arg NvM_SrcPtr: implementation-data-type=DataTypes/UInt8, type=DataTypes/UInt8, direction=INOUT
      error E_NOT_OK: error-code=1
    TI_NvmExt_StartNvmReadAll
      operation NvMExt_ReadAll
    TI_NvmExt_GetPendingStatus
      operation NvMExt_GetPendingStatus: possible-error=TI_NvmExt_GetPendingStatus/E_NOT_OK
        arg NvmBlockID: implementation-data-type=DataTypes/UInt8, type=DataTypes/UInt8, direction=IN
        arg Status: implementation-data-type=DataTypes/UInt8, type=DataTypes/UInt8, direction=OUT
      error E_NOT_OK: error-code=1
  sender receiver interface TI_NvMExt_WakeupStatus: invalidation-policy{data-element=WakeupFlag, handle-invalid=DONT-INVALIDATE}
    data WakeupFlag: implementation-data-type=Boolean, type=Boolean
  client server interface TI_If_TmExt_Timer_GetElapsedTime
    operation Timer_GetElapsedTime
      arg hTimer: implementation-data-type=HTimer, type=HTimer, direction=IN
      arg ElapsedTime: implementation-data-type=UInt32, type=UInt32, direction=OUT
