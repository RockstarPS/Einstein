AUTOSAR XML (schema 4-0-3)
package /DaVinci_Project
  module config Com
    ComConfig
      57 x ComSignal:
        Ambient_Light_level_oIllum_control_oCAN00_888fcfad_Rx: ComSignalType=UINT8
        CurrentStateIC_oIC_NMPDU_oCAN00_ffb15989_Tx: ComSignalType=BOOLEAN
        DayNightMode_oIllum_control_oCAN00_6d11bd91_Rx: ComSignalType=BOOLEAN
        Debug1_Byte0_oDebug_Frame1_oCAN00_7a3e08ee_Tx: ComSignalType=UINT8
        Debug1_Byte1_oDebug_Frame1_oCAN00_6d166c2e_Tx: ComSignalType=UINT8
        Debug1_Byte2_oDebug_Frame1_oCAN00_546ec16e_Tx: ComSignalType=UINT8
        Debug1_Byte3_oDebug_Frame1_oCAN00_4346a5ae_Tx: ComSignalType=UINT8
        Debug1_Byte4_oDebug_Frame1_oCAN00_269f9bee_Tx: ComSignalType=UINT8
        Debug1_Byte5_oDebug_Frame1_oCAN00_31b7ff2e_Tx: ComSignalType=UINT8
        Debug1_Byte6_oDebug_Frame1_oCAN00_08cf526e_Tx: ComSignalType=UINT8
        Debug1_Byte7_oDebug_Frame1_oCAN00_1fe736ae_Tx: ComSignalType=UINT8
        Debug2_Byte0_oDebug_Frame2_oCAN00_f66f082a_Tx: ComSignalType=UINT8
        Debug2_Byte1_oDebug_Frame2_oCAN00_e1476cea_Tx: ComSignalType=UINT8
        Debug2_Byte2_oDebug_Frame2_oCAN00_d83fc1aa_Tx: ComSignalType=UINT8
        Debug2_Byte3_oDebug_Frame2_oCAN00_cf17a56a_Tx: ComSignalType=UINT8
        Debug2_Byte4_oDebug_Frame2_oCAN00_aace9b2a_Tx: ComSignalType=UINT8
        Debug2_Byte5_oDebug_Frame2_oCAN00_bde6ffea_Tx: ComSignalType=UINT8
        Debug2_Byte6_oDebug_Frame2_oCAN00_849e52aa_Tx: ComSignalType=UINT8
        Debug2_Byte7_oDebug_Frame2_oCAN00_93b6366a_Tx: ComSignalType=UINT8
        Debug3_Byte0_oDebug_Frame3_oCAN00_3b70f5a9_Tx: ComSignalType=UINT8
        Debug3_Byte1_oDebug_Frame3_oCAN00_2c589169_Tx: ComSignalType=UINT8
        Debug3_Byte2_oDebug_Frame3_oCAN00_15203c29_Tx: ComSignalType=UINT8
        Debug3_Byte3_oDebug_Frame3_oCAN00_020858e9_Tx: ComSignalType=UINT8
        Debug3_Byte4_oDebug_Frame3_oCAN00_67d166a9_Tx: ComSignalType=UINT8
        Debug3_Byte5_oDebug_Frame3_oCAN00_70f90269_Tx: ComSignalType=UINT8
        Debug3_Byte6_oDebug_Frame3_oCAN00_4981af29_Tx: ComSignalType=UINT8
        Debug3_Byte7_oDebug_Frame3_oCAN00_5ea9cbe9_Tx: ComSignalType=UINT8
        Debug4_Byte0_oDebug_Frame4_oCAN00_35bc0fe3_Tx: ComSignalType=UINT8
        Debug4_Byte1_oDebug_Frame4_oCAN00_22946b23_Tx: ComSignalType=UINT8
        Debug4_Byte2_oDebug_Frame4_oCAN00_1becc663_Tx: ComSignalType=UINT8
        Debug4_Byte3_oDebug_Frame4_oCAN00_0cc4a2a3_Tx: ComSignalType=UINT8
        Debug4_Byte4_oDebug_Frame4_oCAN00_691d9ce3_Tx: ComSignalType=UINT8
        Debug4_Byte5_oDebug_Frame4_oCAN00_7e35f823_Tx: ComSignalType=UINT8
        Debug4_Byte6_oDebug_Frame4_oCAN00_474d5563_Tx: ComSignalType=UINT8
        Debug4_Byte7_oDebug_Frame4_oCAN00_506531a3_Tx: ComSignalType=UINT8
        Debug5_Byte0_oDebug_Frame5_oCAN00_f8a3f260_Tx: ComSignalType=UINT8
        Debug5_Byte1_oDebug_Frame5_oCAN00_ef8b96a0_Tx: ComSignalType=UINT8
        Debug5_Byte2_oDebug_Frame5_oCAN00_d6f33be0_Tx: ComSignalType=UINT8
        Debug5_Byte3_oDebug_Frame5_oCAN00_c1db5f20_Tx: ComSignalType=UINT8
        Debug5_Byte4_oDebug_Frame5_oCAN00_a4026160_Tx: ComSignalType=UINT8
        Debug5_Byte5_oDebug_Frame5_oCAN00_b32a05a0_Tx: ComSignalType=UINT8
        Debug5_Byte6_oDebug_Frame5_oCAN00_8a52a8e0_Tx: ComSignalType=UINT8
        Debug5_Byte7_oDebug_Frame5_oCAN00_9d7acc20_Tx: ComSignalType=UINT8
        Diag_Buffer_Tx_USDT_oDiag_Resp_USDT_oCAN00_3c21528d_Tx: ComSignalType=UINT8_N
        Diag_Buffer_Tx_UUDT_oDiag_Resp_UUDT_oCAN00_0ee1ff7b_Tx: ComSignalType=UINT8_N
        EngineSpeed_oVehicleControl_oCAN00_7eb3f445_Rx: ComSignalType=UINT16
        FV_Tx_oCluster_Secure_Tx_oCAN00_f077ac5c_Tx: ComSignalType=UINT8
        GearMode_oVehicleControl_oCAN00_c0b273e8_Rx: ComSignalType=BOOLEAN
        GearRecommendation_oVehicleControl_oCAN00_f980c505_Rx: ComSignalType=UINT8
        GearStatus_oVehicleControl_oCAN00_db10bc53_Rx: ComSignalType=UINT8
        Gear_oVehicleControl_oCAN00_45630abd_Rx: ComSignalType=UINT8
        Illumination_PWM_oCluster_Tx_Reduced_Com_oCAN00_0a670875_Tx: ComSignalType=UINT8
        Illumination_level_oIllum_control_oCAN00_f3b042f8_Rx: ComSignalType=UINT8
        MAC_Tx_oCluster_Secure_Tx_oCAN00_b83a6da7_Tx: ComSignalType=UINT32
        Odometer_oCluster_Tx_Normal_COM_LS_oCAN00_3e00d027_Tx: ComSignalType=UINT32
        PowerMode_oVehicleControl_oCAN00_4caafc19_Rx: ComSignalType=UINT8
        PreviousStateIC_oIC_NMPDU_oCAN00_54068aa2_Tx: ComSignalType=SINT8
      SG_ABS_oABS_oCAN00_6681ad27_Rx (ComSignalGroup): ComNotification=Rte_COMCbk_SG_ABS_oABS_oCAN00_6681ad27_Rx
        4 x ComGroupSignal:
          Airbag_oABS_oCAN00_d379e7a9_Rx: ComSignalType=UINT8
          Alive_101_oABS_oCAN00_a0c1519e_Rx: ComSignalType=UINT8
          CRC_101_oABS_oCAN00_bce9141a_Rx: ComSignalType=UINT8
          VehicleSpeedABS_oABS_oCAN00_94c6f8d1_Rx: ComSignalType=UINT16
      SG_COM_HS_oCluster_Tx_Normal_COM_HS_oCAN00_c9c3ed51_Tx (ComSignalGroup):
        ComErrorNotification = Rte_COMCbkTErr_SG_COM_HS_oCluster_Tx_Normal_COM_HS_oCAN00_c9c3ed51_Tx
        ComNotification = Rte_COMCbkTAck_SG_COM_HS_oCluster_Tx_Normal_COM_HS_oCAN00_c9c3ed51_Tx
        ComTimeoutNotification = Rte_COMCbkTxTOut_SG_COM_HS_oCluster_Tx_Normal_COM_HS_oCAN00_c9c3ed51_Tx
        3 x ComGroupSignal, all with ComSignalType=UINT8:
          Alive_200_oCluster_Tx_Normal_COM_HS_oCAN00_96cf5451_Tx
          Battery_Voltage_oCluster_Tx_Normal_COM_HS_oCAN00_e5088019_Tx
          CRC_200_oCluster_Tx_Normal_COM_HS_oCAN00_b588f3c3_Tx
      13 x ComSignal:
        SecureTxByte0_oCluster_Secure_Tx_oCAN00_659a0722_Tx: ComSignalType=UINT8
        SecureTxByte1_oCluster_Secure_Tx_oCAN00_0b161c63_Tx: ComSignalType=UINT8
        SecureTxByte2_oCluster_Secure_Tx_oCAN00_b88231a0_Tx: ComSignalType=UINT8
        SecureTxByte3_oCluster_Secure_Tx_oCAN00_d60e2ae1_Tx: ComSignalType=UINT8
        TransportMode_oVehicleControl_oCAN00_b498f884_Rx: ComSignalType=BOOLEAN
        Turn_Indicator_Control_oVehicleControl_oCAN00_b06608e9_Rx: ComSignalType=UINT8
        UserData1_IC_oIC_NMPDU_oCAN00_7de7a39d_Tx: ComSignalType=UINT8
        UserData2_IC_oIC_NMPDU_oCAN00_06f9217e_Tx: ComSignalType=UINT8
        UserData3_IC_oIC_NMPDU_oCAN00_9923a2e0_Tx: ComSignalType=UINT8
        UserData4_IC_oIC_NMPDU_oCAN00_f0c424b8_Tx: ComSignalType=UINT8
        UserData5_IC_oIC_NMPDU_oCAN00_6f1ea726_Tx: ComSignalType=UINT8
        VehicleSpeedIC_oCluster_Tx_Normal_COM_MS_oCAN00_1b17fdcc_Tx: ComSignalType=UINT16
        Warning_oVehicleControl_oCAN00_ee369686_Rx: ComSignalType=UINT8
  module config Rte
    13 x RteBswModuleInstance:
      BswM
      Can
        3 x RteBswEventToTaskMapping, all with RteBswUsedOsEventRef=Rte_Ev_Cyclic2_OsTask_SafeBsw_0_10ms, RteBswUsedOsAlarmRef=Os/Rte_Al_TE2_OsTask_SafeBsw_0_10ms:
          Can_MainFunction_BusOffTimingEvent0
          Can_MainFunction_ModeTimingEvent0
          Can_MainFunction_WakeupTimingEvent0
      CanIf
      CanSM
        CanSM_MainFunctionTimingEvent0 (RteBswEventToTaskMapping): RteBswUsedOsEventRef=Rte_Ev_Cyclic2_OsTask_CANFun_0_10ms, RteBswUsedOsAlarmRef=Os/Rte_Al_TE2_OsTask_CANFun_0_10ms
      Com
        Com_MainFunctionRxTimingEvent0 (RteBswEventToTaskMapping): RteBswUsedOsEventRef=Rte_Ev_Cyclic2_OsTask_CANFun_0_10ms, RteBswUsedOsAlarmRef=Os/Rte_Al_TE2_OsTask_CANFun_0_10ms
        Com_MainFunctionTxTimingEvent0 (RteBswEventToTaskMapping): RteBswUsedOsEventRef=Rte_Ev_Cyclic2_OsTask_CANFun_0_10ms, RteBswUsedOsAlarmRef=Os/Rte_Al_TE2_OsTask_CANFun_0_10ms
      ComM
        ComM_MainFunction_0TimingEvent0 (RteBswEventToTaskMapping): RteBswUsedOsEventRef=Rte_Ev_Cyclic2_OsTask_CANFun_0_10ms, RteBswUsedOsAlarmRef=Os/Rte_Al_TE2_OsTask_CANFun_0_10ms
      Dcm
        Dcm_MainFunctionTimingEvent0 (RteBswEventToTaskMapping): RteBswUsedOsEventRef=Rte_Ev_Cyclic2_OsTask_Diagnostics_0_10ms, RteBswUsedOsAlarmRef=Os/Rte_Al_TE2_OsTask_Diagnostics_0_10ms
      Dem
        Dem_MasterMainFunctionTimingEvent0 (RteBswEventToTaskMapping): RteBswUsedOsEventRef=Rte_Ev_Cyclic2_OsTask_Diagnostics_0_10ms, RteBswUsedOsAlarmRef=Os/Rte_Al_TE2_OsTask_Diagnostics_0_10ms
        Dem_SatelliteMainFunctionTimingEvent0 (RteBswEventToTaskMapping): RteBswUsedOsEventRef=Rte_Ev_Cyclic2_OsTask_Diagnostics_0_10ms, RteBswUsedOsAlarmRef=Os/Rte_Al_TE2_OsTask_Diagnostics_0_10ms
      Ea
        Ea_MainFunctionTimingEvent0 (RteBswEventToTaskMapping): RteBswUsedOsEventRef=Rte_Ev_Run_Ea_Ea_MainFunction, RteBswUsedOsAlarmRef=Os/Rte_Al_TE_Ea_Ea_MainFunction
      EcuM
        EcuM_MainFunctionTimingEvent0 (RteBswEventToTaskMapping): RteBswUsedOsEventRef=Rte_Ev_Cyclic2_OsTask_ModeMgt_0_10ms, RteBswUsedOsAlarmRef=Os/Rte_Al_TE2_OsTask_ModeMgt_0_10ms
      Nm
      NvM
        NvM_MainFunctionTimingEvent0 (RteBswEventToTaskMapping): RteBswUsedOsEventRef=Rte_Ev_Cyclic2_OsTask_MemSer_0_10ms, RteBswUsedOsAlarmRef=Os/Rte_Al_TE2_OsTask_MemSer_0_10ms
      PduR
    80 x RteSwComponentInstance:
      CBacklightCdd_EcuSwComposition
        TECBacklightCdd_Impl_MainFunction (RteEventToTaskMapping): RteUsedOsEventRef=Rte_Ev_Cyclic_OsTask_DispFun_0_10ms, RteUsedOsAlarmRef=Os/Rte_Al_TE_OsTask_DispFun_0_10ms
      CCDD_BswFit_EcuSwComposition
        TECCDD_BswFit_Impl_MainFunction (RteEventToTaskMapping): RteUsedOsEventRef=Rte_Ev_Cyclic_OsTask_Diagnostics_0_20ms, RteUsedOsAlarmRef=Os/Rte_Al_TE_OsTask_Diagnostics_0_20ms
      CCDD_EcuBatteryM_EcuSwComposition
        TECCDD_EcuBatteryM_Impl_MainFunction (RteEventToTaskMapping): RteUsedOsEventRef=Rte_Ev_Cyclic_OsTask_SafeBsw_0_10ms, RteUsedOsAlarmRef=Os/Rte_Al_TE_OsTask_SafeBsw_0_10ms
      CCDD_EcuPowerM_EcuSwComposition
        TECCDD_EcuPowerM_Impl_MainFunction (RteEventToTaskMapping): RteUsedOsEventRef=Rte_Ev_Cyclic_OsTask_DispFun_0_5ms, RteUsedOsAlarmRef=Os/Rte_Al_TE_OsTask_DispFun_0_5ms
      CCDD_FitManager_EcuSwComposition
        TECCDD_FitManager_Impl_MainFunction (RteEventToTaskMapping): RteUsedOsEventRef=Rte_Ev_Cyclic_OsTask_Diagnostics_0_20ms, RteUsedOsAlarmRef=Os/Rte_Al_TE_OsTask_Diagnostics_0_20ms
      CCDD_McuFit_EcuSwComposition
        TECCDD_McuFit_Impl_MainFunction (RteEventToTaskMapping): RteUsedOsEventRef=Rte_Ev_Cyclic_OsTask_Diagnostics_0_20ms, RteUsedOsAlarmRef=Os/Rte_Al_TE_OsTask_Diagnostics_0_20ms
      CComAbsCtrl_EcuSwComposition
        TECComAbsCtrl_CmpMain (RteEventToTaskMapping): RteUsedOsEventRef=Rte_Ev_Cyclic_OsTask_CANFun_0_10ms, RteUsedOsAlarmRef=Os/Rte_Al_TE_OsTask_CANFun_0_10ms
        TECComAbsCtrl_Impl_MainFunction (RteEventToTaskMapping): RteUsedOsEventRef=Rte_Ev_Cyclic_OsTask_CANFun_0_10ms, RteUsedOsAlarmRef=Os/Rte_Al_TE_OsTask_CANFun_0_10ms
      CComAbsMdl_EcuSwComposition
        TECComAbsMdl_Impl_RxCanMdlMainFunction (RteEventToTaskMapping): RteUsedOsEventRef=Rte_Ev_Cyclic_OsTask_CANFun_0_10ms, RteUsedOsAlarmRef=Os/Rte_Al_TE_OsTask_CANFun_0_10ms
        TECComAbsMdl_Impl_TxCanMdlMainFunction (RteEventToTaskMapping): RteUsedOsEventRef=Rte_Ev_Cyclic_OsTask_CANFun_0_10ms, RteUsedOsAlarmRef=Os/Rte_Al_TE_OsTask_CANFun_0_10ms
      CComAbsMdlSafe_EcuSwComposition
        TECComAbsMdlSafe_Impl_RxCanMdlSafeMainFunction (RteEventToTaskMapping): RteUsedOsEventRef=Rte_Ev_Cyclic_OsTask_SafeBsw_0_10ms, RteUsedOsAlarmRef=Os/Rte_Al_TE_OsTask_SafeBsw_0_10ms
        TECComAbsMdlSafe_Impl_TxCanMdlSafeMainFunction (RteEventToTaskMapping): RteUsedOsEventRef=Rte_Ev_Cyclic_OsTask_SafeBsw_0_10ms, RteUsedOsAlarmRef=Os/Rte_Al_TE_OsTask_SafeBsw_0_10ms
      CComAbsMdl_stubs_EcuSwComposition
        TMT_CComAbsMdl_stubs_MainFunction (RteEventToTaskMapping): RteUsedOsEventRef=Rte_Ev_Cyclic_OsTask_CANFun_0_10ms, RteUsedOsAlarmRef=Os/Rte_Al_TE_OsTask_CANFun_0_10ms
      CCtrl_Telltale_EcuSwComposition
        TECCtrl_Telltale_Adapter_Task (RteEventToTaskMapping): RteUsedOsAlarmRef=Os/Rte_Al_TE_OsTask_SafeApp_0_30ms
        TECCtrl_Telltale_Impl_MainFunction (RteEventToTaskMapping): RteUsedOsAlarmRef=Os/Rte_Al_TE_OsTask_SafeApp_0_30ms
      CDisplayCdd_EcuSwComposition
        TECDisplayCdd_Impl_MainFunction (RteEventToTaskMapping): RteUsedOsEventRef=Rte_Ev_Cyclic_OsTask_SafeBsw_0_10ms, RteUsedOsAlarmRef=Os/Rte_Al_TE_OsTask_SafeBsw_0_10ms
      CFltM_EcuSwComposition
        TECFltM_Impl_MainFunction (RteEventToTaskMapping): RteUsedOsEventRef=Rte_Ev_Cyclic_OsTask_SafeBsw_0_10ms, RteUsedOsAlarmRef=Os/Rte_Al_TE_OsTask_SafeBsw_0_10ms
      CFltMExt_EcuSwComposition
        TECFltMExt_MainFunction (RteEventToTaskMapping): RteUsedOsEventRef=Rte_Ev_Cyclic_OsTask_SafeBsw_0_10ms, RteUsedOsAlarmRef=Os/Rte_Al_TE_OsTask_SafeBsw_0_10ms
      CIoExp_EcuSwComposition
        TEIoExp_MainFunction (RteEventToTaskMapping): RteUsedOsAlarmRef=Os/Rte_Al_TE_OsTask_Mcal_0_10ms
      CMeetCdd_EcuSwComposition
        TECMeetCdd_Impl_MainFunction (RteEventToTaskMapping): RteUsedOsEventRef=Rte_Ev_Cyclic_OsTask_DispFun_0_10ms, RteUsedOsAlarmRef=Os/Rte_Al_TE_OsTask_DispFun_0_10ms
      CPmicCdd_EcuSwComposition
        TECPmicCdd_Impl_MainFunction (RteEventToTaskMapping): RteUsedOsAlarmRef=Os/Rte_Al_TE_OsTask_WdgMngt_0_10ms
      CRstM_EcuSwComposition
        TECRstM_Impl_MainFunction (RteEventToTaskMapping): RteUsedOsEventRef=Rte_Ev_Cyclic_OsTask_SafeBsw_0_10ms, RteUsedOsAlarmRef=Os/Rte_Al_TE_OsTask_SafeBsw_0_10ms
      CSigCdd_EcuSwComposition
        TECSigCdd_Impl_MainFunction (RteEventToTaskMapping): RteUsedOsEventRef=Rte_Ev_Cyclic_OsTask_LSH_16ms_0_16ms, RteUsedOsAlarmRef=Os/Rte_Al_TE_OsTask_LSH_16ms_0_16ms
      CSwcDispMonSf_EcuSwComposition
        TECSwcDispMonSf_Impl_MainFunction (RteEventToTaskMapping): RteUsedOsEventRef=Rte_Ev_Cyclic_OsTask_SafeBsw_0_10ms, RteUsedOsAlarmRef=Os/Rte_Al_TE_OsTask_SafeBsw_0_10ms
      CUpdateCdd_EcuSwComposition
        TECUpdateCdd_Impl_MainFunction (RteEventToTaskMapping): RteUsedOsEventRef=Rte_Ev_Cyclic_OsTask_DispFun_0_10ms, RteUsedOsAlarmRef=Os/Rte_Al_TE_OsTask_DispFun_0_10ms
        DRECUpdateCdd_OnDre_UpdateResponseTrigByUpdateShortServiceRespData (RteEventToTaskMapping): RteUsedOsEventRef=Rte_Ev_Run_CUpdateCdd_CUpdateCdd_OnDre_UpdateResponse
      CView_Telltale_EcuSwComposition
        TECView_Telltale_Impl_MainFunction (RteEventToTaskMapping): RteUsedOsAlarmRef=Os/Rte_Al_TE_OsTask_SafeApp_0_30ms
      CWarnMsg_Core_Observer_EcuSwComposition
        3 x RteEventToTaskMapping:
          TECWarnMsg_Core_Observer_Impl_MainFunction: RteUsedOsAlarmRef=Os/Rte_Al_TE_OsTask_WarnFun_0_32ms
          DREOnDre_UCL_HudWarnStatusTrigByHudWarningStatusData: RteUsedOsEventRef=Rte_Ev_Run_CWarnMsg_Core_Observer_OnDre_UCL_HudWarnStatus
          DREOnDre_UCL_WarnStatusTrigByWarningStatusData: RteUsedOsEventRef=Rte_Ev_Run_CWarnMsg_Core_Observer_OnDre_UCL_WarnStatus
      ComCallout_EcuSwComposition
        TEComCallout_Impl_MainFunction (RteEventToTaskMapping): RteUsedOsEventRef=Rte_Ev_Cyclic_OsTask_CANFun_0_10ms, RteUsedOsAlarmRef=Os/Rte_Al_TE_OsTask_CANFun_0_10ms
      ComMExt_EcuSwComposition
        TEComMExt_Impl_MainFunction (RteEventToTaskMapping): RteUsedOsEventRef=Rte_Ev_Cyclic_OsTask_CANFun_0_10ms, RteUsedOsAlarmRef=Os/Rte_Al_TE_OsTask_CANFun_0_10ms
      CorTst_EcuSwComposition
        TECorTst_MainFunction (RteEventToTaskMapping): RteUsedOsEventRef=Rte_Ev_Cyclic_OsTask_SafeBsw_0_10ms, RteUsedOsAlarmRef=Os/Rte_Al_TE_OsTask_SafeBsw_0_10ms
      Ctrl_Dim_EcuSwComposition
        TECtrl_Dim_Task (RteEventToTaskMapping): RteUsedOsEventRef=Rte_Ev_Cyclic_OsTask_DispFun_0_10ms, RteUsedOsAlarmRef=Os/Rte_Al_TE_OsTask_DispFun_0_10ms
      Ctrl_Illumination_EcuSwComposition
        TECCtrl_Illumination_Impl_MainFunction (RteEventToTaskMapping): RteUsedOsEventRef=Rte_Ev_Cyclic_OsTask_DispFun_0_10ms, RteUsedOsAlarmRef=Os/Rte_Al_TE_OsTask_DispFun_0_10ms
        TECtrl_Illumination_Task (RteEventToTaskMapping): RteUsedOsEventRef=Rte_Ev_Cyclic_OsTask_DispFun_0_10ms, RteUsedOsAlarmRef=Os/Rte_Al_TE_OsTask_DispFun_0_10ms
      Ctrl_WSS_EcuSwComposition
        TECtrl_WSS_Impl_MainFunction (RteEventToTaskMapping): RteUsedOsEventRef=Rte_Ev_Cyclic_OsTask_ModeMgt_0_10ms, RteUsedOsAlarmRef=Os/Rte_Al_TE_OsTask_ModeMgt_0_10ms
      Ctrl_warning_EcuSwComposition
        TECtrl_warning_Task (RteEventToTaskMapping): RteUsedOsAlarmRef=Os/Rte_Al_TE_OsTask_WarnFun_0_32ms
      DcmApp_EcuSwComposition
        TECDcmApp_Impl_MainFunction (RteEventToTaskMapping): RteUsedOsAlarmRef=Os/Rte_Al_TE_OsTask_AppFun_0_10ms
      DcmExt_EcuSwComposition
        TEDcmExt_MainFunction (RteEventToTaskMapping): RteUsedOsEventRef=Rte_Ev_Cyclic_OsTask_Diagnostics_0_10ms, RteUsedOsAlarmRef=Os/Rte_Al_TE_OsTask_Diagnostics_0_10ms
      DemApp_EcuSwComposition
        TECDemApp_Impl_MainFunction (RteEventToTaskMapping): RteUsedOsAlarmRef=Os/Rte_Al_TE_OsTask_AppFun_0_10ms
      DemExt_EcuSwComposition
        TEDemExt_MainFunction (RteEventToTaskMapping): RteUsedOsEventRef=Rte_Ev_Cyclic_OsTask_Diagnostics_0_10ms, RteUsedOsAlarmRef=Os/Rte_Al_TE_OsTask_Diagnostics_0_10ms
      DemMaster_0_EcuSwComposition
        Timer_Dem_MasterMainFunction (RteEventToTaskMapping): RteUsedOsEventRef=Rte_Ev_Cyclic2_OsTask_Diagnostics_0_10ms, RteUsedOsAlarmRef=Os/Rte_Al_TE2_OsTask_Diagnostics_0_10ms
      DemSatellite_0_EcuSwComposition
        Timer_Dem_SatelliteMainFunction (RteEventToTaskMapping): RteUsedOsEventRef=Rte_Ev_Cyclic2_OsTask_Diagnostics_0_10ms, RteUsedOsAlarmRef=Os/Rte_Al_TE2_OsTask_Diagnostics_0_10ms
      Det_001_EcuSwComposition
        TMT_Det_MainFunction (RteEventToTaskMapping): RteUsedOsEventRef=Rte_Ev_Cyclic_OsTask_Diagnostics_0_10ms, RteUsedOsAlarmRef=Os/Rte_Al_TE_OsTask_Diagnostics_0_10ms
      Dlt_EcuSwComposition
        TEDlt_MainFunction (RteEventToTaskMapping): RteUsedOsEventRef=Rte_Ev_Cyclic_OsTask_Diagnostics_0_100ms, RteUsedOsAlarmRef=Os/Rte_Al_TE_OsTask_Diagnostics_0_100ms
      DltExt_EcuSwComposition
        TEDltExt_MainFunction (RteEventToTaskMapping): RteUsedOsEventRef=Rte_Ev_Cyclic_OsTask_Diagnostics_0_100ms, RteUsedOsAlarmRef=Os/Rte_Al_TE_OsTask_Diagnostics_0_100ms
        DREDltExt_OnDreDLTMessageReadAckDataTrigByDLTMessageReadAckData (RteEventToTaskMapping): RteUsedOsEventRef=Rte_Ev_Run_DltExt_DltExt_OnDreDLTMessageReadAckData
      DmnMgr_EcuSwComposition
        8 x RteEventToTaskMapping:
          TECDmnMgr_Impl_MainFunction: RteUsedOsEventRef=Rte_Ev_Run_DmnMgr_CDmnMgr_Impl_MainFunction, RteUsedOsAlarmRef=Os/Rte_Al_TE_DmnMgr_CDmnMgr_Impl_MainFunction
          DREDmnMgr_MonitorDmnExtendShutdownTimeTrigByPowerExtendShutdownTimeData: RteUsedOsEventRef=Rte_Ev_Run_DmnMgr_DmnMgr_MonitorDmnExtendShutdownTime
          DREDmnMgr_MonitorDmnHealthDumpDataTrigByHealthDumpDataData: RteUsedOsEventRef=Rte_Ev_Run_DmnMgr_DmnMgr_MonitorDmnHealthDumpData
          DREDmnMgr_MonitorDmnHealthDumpHdrInfoTrigByHealthDumpHdrInfoData: RteUsedOsEventRef=Rte_Ev_Run_DmnMgr_DmnMgr_MonitorDmnHealthDumpHdrInfo
          DREDmnMgr_MonitorDmnHealthFatalErrorTrigByHealthDomainFatalErrorData: RteUsedOsEventRef=Rte_Ev_Run_DmnMgr_DmnMgr_MonitorDmnHealthFatalError
          DREDmnMgr_MonitorDmnHeartBeatTrigByHealthDomainHeartbeatData: RteUsedOsEventRef=Rte_Ev_Run_DmnMgr_DmnMgr_MonitorDmnHeartBeat
          DREDmnMgr_MonitorDmnKeepSystemAwakeTrigByPowerKeepSystemAwakeData: RteUsedOsEventRef=Rte_Ev_Run_DmnMgr_DmnMgr_MonitorDmnKeepSystemAwake
          DREDmnMgr_MonitorDmnPowerSystemStateTrigByPowerSystemStateData: RteUsedOsEventRef=Rte_Ev_Run_DmnMgr_DmnMgr_MonitorDmnPowerSystemState
      EcuAppM_EcuSwComposition
        TEEcuAppM_MainFunction (RteEventToTaskMapping): RteUsedOsEventRef=Rte_Ev_Cyclic_OsTask_SafeBsw_0_10ms, RteUsedOsAlarmRef=Os/Rte_Al_TE_OsTask_SafeBsw_0_10ms
      EcuM_EcuSwComposition
        Timer_EcuM_MainFunction (RteEventToTaskMapping): RteUsedOsEventRef=Rte_Ev_Cyclic2_OsTask_ModeMgt_0_10ms, RteUsedOsAlarmRef=Os/Rte_Al_TE2_OsTask_ModeMgt_0_10ms
      EcuMExt_EcuSwComposition
        TEEcuMExt_MainFunction (RteEventToTaskMapping): RteUsedOsAlarmRef=Os/Rte_Al_TE_OsTask_Mcal_0_10ms
      FastGaugeAdapter_EcuSwComposition
        TEFastGaugeAdapter_Task (RteEventToTaskMapping): RteUsedOsAlarmRef=Os/Rte_Al_TE_OsTask_GaugeFun_0_20ms
      FlsTst_EcuSwComposition
        TEFlsTst_MainFunction (RteEventToTaskMapping): RteUsedOsEventRef=Rte_Ev_Cyclic_OsTask_SafeBsw_0_10ms, RteUsedOsAlarmRef=Os/Rte_Al_TE_OsTask_SafeBsw_0_10ms
      GdtCdd_EcuSwComposition
        TECGdtCdd_Impl_MainFunction (RteEventToTaskMapping): RteUsedOsEventRef=Rte_Ev_Cyclic_OsTask_LSH_16ms_0_16ms, RteUsedOsAlarmRef=Os/Rte_Al_TE_OsTask_LSH_16ms_0_16ms
      IoHwAb_EcuSwComposition
        5 x RteEventToTaskMapping:
          TEIoHwAb_MainFunction: RteUsedOsEventRef=Rte_Ev_Cyclic_OsTask_SafeBsw_0_10ms, RteUsedOsAlarmRef=Os/Rte_Al_TE_OsTask_SafeBsw_0_10ms
          TEIoHwAb_OsTask_SafeBsw_Task_10ms: RteUsedOsEventRef=Rte_Ev_Cyclic_OsTask_SafeBsw_0_10ms, RteUsedOsAlarmRef=Os/Rte_Al_TE_OsTask_SafeBsw_0_10ms
          TEIoHwAb_OsTask_SafeBsw_WdgM_CheckPoint_10ms: RteUsedOsAlarmRef=Os/Rte_Al_TE_OsTask_WdgMngt_0_10ms
          TEIoHwAb_OsTask_SafeBsw_WdgM_CheckPoint_20ms: RteUsedOsEventRef=Rte_Ev_Run_IoHwAb_IoHwAb_OsTask_SafeBsw_WdgM_CheckPoint_20ms, RteUsedOsAlarmRef=Os/Rte_Al_TE_IoHwAb_IoHwAb_OsTask_SafeBsw_WdgM_CheckPoint_20ms
          TEIoHwAb_OsTask_SafeBsw_WdgM_CheckPoint_30ms: RteUsedOsAlarmRef=Os/Rte_Al_TE_OsTask_SafeApp_0_30ms
      Mdl_Airbag_EcuSwComposition
        TEMdl_Airbag_Task (RteEventToTaskMapping): RteUsedOsAlarmRef=Os/Rte_Al_TE_OsTask_SafeApp_0_30ms
      Mdl_Dim_EcuSwComposition
        TEMdl_Dim_Task (RteEventToTaskMapping): RteUsedOsEventRef=Rte_Ev_Cyclic_OsTask_DispFun_0_10ms, RteUsedOsAlarmRef=Os/Rte_Al_TE_OsTask_DispFun_0_10ms
      Mdl_Gear_EcuSwComposition
        TEMdl_Gear_Task (RteEventToTaskMapping): RteUsedOsAlarmRef=Os/Rte_Al_TE_OsTask_WarnFun_0_32ms
      Mdl_Linear_Interpolation_EcuSwComposition
        TEMdl_Linear_Interpolation_Task (RteEventToTaskMapping): RteUsedOsAlarmRef=Os/Rte_Al_TE_OsTask_GaugeFun_0_20ms
      Mdl_SafetyAdapter_EcuSwComposition
        5 x RteEventToTaskMapping:
          DREMdl_SafetyAdapter_OnDataRx_B_EBW2TrigByB_EBW2: RteUsedOsEventRef=Rte_Ev_Run_Mdl_SafetyAdapter_Mdl_SafetyAdapter_OnDataRx_B_EBW2
          DREMdl_SafetyAdapter_OnDataRx_B_PKBLPTrigByB_PKBLP: RteUsedOsEventRef=Rte_Ev_Run_Mdl_SafetyAdapter_Mdl_SafetyAdapter_OnDataRx_B_PKBLP
          DREMdl_SafetyAdapter_OnDataRx_SCSBZRTrigBySCSBZR: RteUsedOsEventRef=Rte_Ev_Run_Mdl_SafetyAdapter_Mdl_SafetyAdapter_OnDataRx_SCSBZR
          DREMdl_SafetyAdapter_OnDataRx_VSCOFFTrigByVSCOFF: RteUsedOsEventRef=Rte_Ev_Run_Mdl_SafetyAdapter_Mdl_SafetyAdapter_OnDataRx_VSCOFF
          TEMdl_SafetyAdapter_Task: RteUsedOsEventRef=Rte_Ev_Cyclic_OsTask_SafeBsw_0_10ms, RteUsedOsAlarmRef=Os/Rte_Al_TE_OsTask_SafeBsw_0_10ms
      Mdl_Speed_EcuSwComposition
        TEMdl_Speed_Task (RteEventToTaskMapping): RteUsedOsAlarmRef=Os/Rte_Al_TE_OsTask_GaugeFun_0_20ms
      Mdl_Tacho_EcuSwComposition
        TEMdl_Tacho_Task (RteEventToTaskMapping): RteUsedOsAlarmRef=Os/Rte_Al_TE_OsTask_GaugeFun_0_20ms
      Mdl_TurnHazard_EcuSwComposition
        TEMdl_TurnHazard_Task (RteEventToTaskMapping): RteUsedOsAlarmRef=Os/Rte_Al_TE_OsTask_IndFun_0_30ms
      Mdl_wAirbag_EcuSwComposition
        TEMdl_wAirbag_Task (RteEventToTaskMapping): RteUsedOsAlarmRef=Os/Rte_Al_TE_OsTask_WarnFun_0_32ms
      Mdl_wFuelLidOpen_EcuSwComposition
        TEMdl_wFuelLidOpen_Task (RteEventToTaskMapping): RteUsedOsAlarmRef=Os/Rte_Al_TE_OsTask_WarnFun_0_32ms
      MemAbstractMdl_EcuSwComposition
        TECMemAbstractMdl_Impl_MainFunction (RteEventToTaskMapping): RteUsedOsEventRef=Rte_Ev_Cyclic_OsTask_MemSer_0_10ms, RteUsedOsAlarmRef=Os/Rte_Al_TE_OsTask_MemSer_0_10ms
      MemAbstractStub_EcuSwComposition
        TMT_MemAbstract_MainFunction (RteEventToTaskMapping): RteUsedOsEventRef=Rte_Ev_Cyclic_OsTask_MemSer_0_10ms, RteUsedOsAlarmRef=Os/Rte_Al_TE_OsTask_MemSer_0_10ms
      MemAbstract_Stub_Safe_EcuSwComposition
        TMT_MemAbstract_Stub_Safe (RteEventToTaskMapping): RteUsedOsEventRef=Rte_Ev_Cyclic_OsTask_SafeBsw_0_10ms, RteUsedOsAlarmRef=Os/Rte_Al_TE_OsTask_SafeBsw_0_10ms
      NvM_EcuSwComposition
        Timer_NvM_MainFunction (RteEventToTaskMapping): RteUsedOsEventRef=Rte_Ev_Cyclic2_OsTask_MemSer_0_10ms, RteUsedOsAlarmRef=Os/Rte_Al_TE2_OsTask_MemSer_0_10ms
      NvMExt_EcuSwComposition
        TENvMExt_MainFunction (RteEventToTaskMapping): RteUsedOsEventRef=Rte_Ev_Cyclic_OsTask_MemSer_0_10ms, RteUsedOsAlarmRef=Os/Rte_Al_TE_OsTask_MemSer_0_10ms
        TENvMExt_SpeedupRunnable (RteEventToTaskMapping): RteUsedOsEventRef=Rte_Ev_Run_NvMExt_NvMExt_SpeedupRunnable, RteUsedOsAlarmRef=Os/Rte_Al_TE_NvMExt_NvMExt_SpeedupRunnable
      NvMExtSf_EcuSwComposition
        TECNvMExtSf_MainFunction (RteEventToTaskMapping): RteUsedOsEventRef=Rte_Ev_Cyclic_OsTask_SafeBsw_0_10ms, RteUsedOsAlarmRef=Os/Rte_Al_TE_OsTask_SafeBsw_0_10ms
      Os_OsCore0_swc_EcuSwComposition
      RamTst_EcuSwComposition
        TERamTst_MainFunction (RteEventToTaskMapping): RteUsedOsEventRef=Rte_Ev_Cyclic_OsTask_SafeBsw_0_10ms, RteUsedOsAlarmRef=Os/Rte_Al_TE_OsTask_SafeBsw_0_10ms
      RtcCdd_EcuSwComposition
        TECRtcCdd_Impl_MainFunction (RteEventToTaskMapping): RteUsedOsEventRef=Rte_Ev_Cyclic_OsTask_DispFun_0_10ms, RteUsedOsAlarmRef=Os/Rte_Al_TE_OsTask_DispFun_0_10ms
      SafeBsw_EcuSwComposition
        TMT_Spi_MainFunction_Handling (RteEventToTaskMapping): RteUsedOsEventRef=Rte_Ev_Cyclic_OsTask_SafeBsw_0_10ms, RteUsedOsAlarmRef=Os/Rte_Al_TE_OsTask_SafeBsw_0_10ms
      SafeNvM_EcuSwComposition
        12 x RteEventToTaskMapping:
          TECSafeNvM_Impl_MainFunction: RteUsedOsEventRef=Rte_Ev_Cyclic_OsTask_SafeBsw_0_10ms, RteUsedOsAlarmRef=Os/Rte_Al_TE_OsTask_SafeBsw_0_10ms
          DRT_OnDre_SafeNvM_Illumination_BsConst_BsConst_Illumination_ReservedByte_Value: RteUsedOsEventRef=Rte_Ev_Run_SafeNvM_OnDre_SafeNvM_Illumination
          DRT_OnDre_SafeNvM_Illumination_BsConst_Compensation_Line_Shift_b_Value: RteUsedOsEventRef=Rte_Ev_Run_SafeNvM_OnDre_SafeNvM_Illumination
          DRT_OnDre_SafeNvM_Illumination_BsConst_Compensation_Line_Slope_m_Value: RteUsedOsEventRef=Rte_Ev_Run_SafeNvM_OnDre_SafeNvM_Illumination
          DRT_OnDre_SafeNvM_Illumination_BsConst_Derating_Backlight_Disable_Value: RteUsedOsEventRef=Rte_Ev_Run_SafeNvM_OnDre_SafeNvM_Illumination
          DRT_OnDre_SafeNvM_Illumination_BsConst_Display_Illum_Max_Level_Safe_Value: RteUsedOsEventRef=Rte_Ev_Run_SafeNvM_OnDre_SafeNvM_Illumination
          DRT_OnDre_SafeNvM_Illumination_BsConst_Lookup_Curve_HotSpot_Coef_X_Value: RteUsedOsEventRef=Rte_Ev_Run_SafeNvM_OnDre_SafeNvM_Illumination
          DRT_OnDre_SafeNvM_Illumination_BsConst_Lookup_Curve_HotSpot_Coef_Y_Value: RteUsedOsEventRef=Rte_Ev_Run_SafeNvM_OnDre_SafeNvM_Illumination
          DRT_OnDre_SafeNvM_Illumination_BsConst_PCB_Temperature_Sensor_Conv_Value: RteUsedOsEventRef=Rte_Ev_Run_SafeNvM_OnDre_SafeNvM_Illumination
          DRT_OnDre_SafeNvM_Illumination_BsConst_PWM_boost_bypass_duty_Value: RteUsedOsEventRef=Rte_Ev_Run_SafeNvM_OnDre_SafeNvM_Illumination
          DRT_OnDre_SafeNvM_Illumination_BsConst_Temp_Threshold_Hysteresis_Derating_Value: RteUsedOsEventRef=Rte_Ev_Run_SafeNvM_OnDre_SafeNvM_Illumination
          DRT_OnDre_SafeNvM_Illumination_BsConst_Temperature_Sensor_Conv_Value: RteUsedOsEventRef=Rte_Ev_Run_SafeNvM_OnDre_SafeNvM_Illumination
      SciDrv_EcuSwComposition
        TMT_SciDrv_MainFunction (RteEventToTaskMapping): RteUsedOsAlarmRef=Os/Rte_Al_TE_OsTask_Mcal_0_10ms
      SlowGaugeAdapter_EcuSwComposition
        TESlowGaugeAdapter_Task (RteEventToTaskMapping): RteUsedOsEventRef=Rte_Ev_Run_SlowGaugeAdapter_SlowGaugeAdapter_Task, RteUsedOsAlarmRef=Os/Rte_Al_TE_SlowGaugeAdapter_SlowGaugeAdapter_Task
      SysTst_EcuSwComposition
        TESysTst_MainFunction (RteEventToTaskMapping): RteUsedOsEventRef=Rte_Ev_Cyclic_OsTask_SafeBsw_0_10ms, RteUsedOsAlarmRef=Os/Rte_Al_TE_OsTask_SafeBsw_0_10ms
      Test_Comp_EcuSwComposition
        15 x RteEventToTaskMapping:
          TMT_AppTaskStubRunnable: RteUsedOsAlarmRef=Os/Rte_Al_TE_OsTask_TripFun_0_50ms
          TMT_AudioTaskStubRunnable: RteUsedOsAlarmRef=Os/Rte_Al_TE_Test_Comp_AudioTaskStubRunnable
          TMT_CddTaskStubRunnable: RteUsedOsEventRef=Rte_Ev_Cyclic_OsTask_DispFun_0_5ms, RteUsedOsAlarmRef=Os/Rte_Al_TE_OsTask_DispFun_0_5ms
          TMT_EepDrv_MainFunction: RteUsedOsEventRef=Rte_Ev_Cyclic_OsTask_MemSer_0_10ms, RteUsedOsAlarmRef=Os/Rte_Al_TE_OsTask_MemSer_0_10ms
          TMT_EthIf_MainFunctionState: RteUsedOsAlarmRef=Os/Rte_Al_TE_OsTask_EthFun_0_10ms
          TMT_EthSM_MainFunction: RteUsedOsAlarmRef=Os/Rte_Al_TE_OsTask_EthFun_0_10ms
          TMT_FotaTaskStubRunnable: RteUsedOsAlarmRef=Os/Rte_Al_TE_Test_Comp_FotaTaskStubRunnable
          TMT_GaugeTaskStubRunnable: RteUsedOsAlarmRef=Os/Rte_Al_TE_OsTask_GaugeFun_0_20ms
          TMT_I2c_MainFunction: RteUsedOsAlarmRef=Os/Rte_Al_TE_OsTask_Mcal_0_10ms
          TMT_IndTaskStubRunnable: RteUsedOsAlarmRef=Os/Rte_Al_TE_OsTask_IndFun_0_30ms
          TMT_LinTaskStubRunnable: RteUsedOsAlarmRef=Os/Rte_Al_TE_Test_Comp_LinTaskStubRunnable
          TMT_SoAd_MainFunction: RteUsedOsAlarmRef=Os/Rte_Al_TE_OsTask_EthFun_0_10ms
          TMT_TcpIp_MainFunction: RteUsedOsAlarmRef=Os/Rte_Al_TE_OsTask_EthFun_0_10ms
          TMT_Test_Comp_MainFunction: RteUsedOsEventRef=Rte_Ev_Cyclic_OsTask_Diagnostics_0_10ms, RteUsedOsAlarmRef=Os/Rte_Al_TE_OsTask_Diagnostics_0_10ms
          TMT_TripTaskStubRunnable: RteUsedOsAlarmRef=Os/Rte_Al_TE_OsTask_TripFun_0_50ms
      TmExt_EcuSwComposition
        TETmExt_MainFunction (RteEventToTaskMapping): RteUsedOsEventRef=Rte_Ev_Cyclic_OsTask_ModeMgt_0_10ms, RteUsedOsAlarmRef=Os/Rte_Al_TE_OsTask_ModeMgt_0_10ms
      TrustecSWC_EcuSwComposition
        TMT_TrustedSwc_MainFunction (RteEventToTaskMapping): RteUsedOsAlarmRef=Os/Rte_Al_TE_OsTask_SafeApp_0_30ms
      UclProxyCdd_EcuSwComposition
        23 x RteEventToTaskMapping:
          TECUclProxyCdd_Impl_MainFunction: RteUsedOsEventRef=Rte_Ev_Run_UclProxyCdd_CUclProxyCdd_Impl_MainFunction, RteUsedOsAlarmRef=Os/Rte_Al_TE_UclProxyCdd_CUclProxyCdd_Impl_MainFunction
          DREOnDre_DLTControlMessageReponseTrigByDLTControlMessageReponseData: RteUsedOsEventRef=Rte_Ev_Run_UclProxyCdd_OnDre_DLTControlMessageReponse
          DREOnDre_DLTMessageReadRequestTrigByDLTMessageReadRequestData: RteUsedOsEventRef=Rte_Ev_Run_UclProxyCdd_OnDre_DLTMessageReadRequest
          DREOnDre_DiagDIDRequestTrigByDiagDIDRequestData: RteUsedOsEventRef=Rte_Ev_Run_UclProxyCdd_OnDre_DiagDIDRequest
          DREOnDre_DiagIOCtrlRequestTrigByDiagIOCtrlRequestData: RteUsedOsEventRef=Rte_Ev_Run_UclProxyCdd_OnDre_DiagIOCtrlRequest
          DREOnDre_DiagRoutineRequestTrigByDiagRoutineRequestData: RteUsedOsEventRef=Rte_Ev_Run_UclProxyCdd_OnDre_DiagRoutineRequest
          DREOnDre_DisplaySetPowerTrigByDisplaySetPowerData: RteUsedOsEventRef=Rte_Ev_Run_UclProxyCdd_OnDre_DisplaySetPower
          DREOnDre_FRTT_StatusTrigByFRTT_StatusData: RteUsedOsEventRef=Rte_Ev_Run_UclProxyCdd_OnDre_FRTT_Status
          DREOnDre_FastGaugeInfoTrigByFastGaugeInfoData: RteUsedOsEventRef=Rte_Ev_Run_UclProxyCdd_OnDre_FastGaugeInfo
          DREOnDre_HealthDumpGetDataTrigByHealthDumpGetDataData: RteUsedOsEventRef=Rte_Ev_Run_UclProxyCdd_OnDre_HealthDumpGetData
          DREOnDre_HealthDumpGetHdrTrigByHealthDumpGetHdrData: RteUsedOsEventRef=Rte_Ev_Run_UclProxyCdd_OnDre_HealthDumpGetHdr
          DREOnDre_IlluminationDataTrigByIlluminationDataData: RteUsedOsEventRef=Rte_Ev_Run_UclProxyCdd_OnDre_IlluminationData
          DREOnDre_PowerSystemStateReqChangeTrigByPowerSystemStateReqChangeData: RteUsedOsEventRef=Rte_Ev_Run_UclProxyCdd_OnDre_PowerSystemStateReqChange
          DREOnDre_RTT_IconTrigByRTT_IconData: RteUsedOsEventRef=Rte_Ev_Run_UclProxyCdd_OnDre_RTT_Icon
          DREOnDre_RTT_StatusTrigByRTT_StatusData: RteUsedOsEventRef=Rte_Ev_Run_UclProxyCdd_OnDre_RTT_Status
          DREOnDre_RTT_ToggleTrigByRTT_ToggleData: RteUsedOsEventRef=Rte_Ev_Run_UclProxyCdd_OnDre_RTT_Toggle
          DREOnDre_ShiftPosIndStatusTrigByShiftPosIndStatusData: RteUsedOsEventRef=Rte_Ev_Run_UclProxyCdd_OnDre_ShiftPosIndStatus
          DREOnDre_SlowGaugeInfoTrigBySlowGaugeInfoData: RteUsedOsEventRef=Rte_Ev_Run_UclProxyCdd_OnDre_SlowGaugeInfo
          DREOnDre_TT_StatusTrigByTT_StatusData: RteUsedOsEventRef=Rte_Ev_Run_UclProxyCdd_OnDre_TT_Status
          DREOnDre_UpdateLongServiceReqTrigByUpdateLongServiceReqData: RteUsedOsEventRef=Rte_Ev_Run_UclProxyCdd_OnDre_UpdateLongServiceReq
          DREOnDre_UpdateShortServiceReqTrigByUpdateShortServiceReqData: RteUsedOsEventRef=Rte_Ev_Run_UclProxyCdd_OnDre_UpdateShortServiceReq
          DREOnDre_WarningDisplayTrigByWarningDisplayData: RteUsedOsEventRef=Rte_Ev_Run_UclProxyCdd_OnDre_WarningDisplay
          DREOnDre_WarningExtDisplayTrigByWarningExtDisplayData: RteUsedOsEventRef=Rte_Ev_Run_UclProxyCdd_OnDre_WarningExtDisplay
      View_Illumination_EcuSwComposition
        TECView_Illumination_Impl_MainFunction (RteEventToTaskMapping): RteUsedOsEventRef=Rte_Ev_Cyclic_OsTask_DispFun_0_10ms, RteUsedOsAlarmRef=Os/Rte_Al_TE_OsTask_DispFun_0_10ms
        TEView_Illumination_Task (RteEventToTaskMapping): RteUsedOsEventRef=Rte_Ev_Cyclic_OsTask_DispFun_0_10ms, RteUsedOsAlarmRef=Os/Rte_Al_TE_OsTask_DispFun_0_10ms
      View_Speed_EcuSwComposition
        TEView_Speed_Task (RteEventToTaskMapping): RteUsedOsAlarmRef=Os/Rte_Al_TE_OsTask_GaugeFun_0_20ms
      WarnMsg_Core_TmrSupport_EcuSwComposition
        TEWarnMsg_Core_TmrSupport_Task (RteEventToTaskMapping): RteUsedOsAlarmRef=Os/Rte_Al_TE_OsTask_WarnFun_0_32ms
      WdgM_EcuSwComposition
        3 x RteEventToTaskMapping:
          TMT_GraphicsTaskStubRunnable: RteUsedOsAlarmRef=Os/Rte_Al_TE_OsTask_SafeApp_0_30ms
          TMT_TxRxIpcMessage: RteUsedOsAlarmRef=Os/Rte_Al_TE_OsTask_SafeApp_0_30ms
          TMT_WdgM_MainFunction: RteUsedOsAlarmRef=Os/Rte_Al_TE_OsTask_WdgMngt_0_10ms
      NvBlockSwComponentType_EcuSwComposition
        54 x RteNvRamAllocation:
          NvmBlock_NvBlockSwComponentType_NVNeed_NVBlockDescriptor_055: RteNvmRomBlockLocationSymbol=Rte_NvBlockSwComponentType_NVBlockDescriptor_BsConst_Audio_ROM_NVBlockDescriptor_BsConst_Audio, RteNvmBlockRef=NvBlockSwComponentTypeNVBlockDescriptor_BsConst_Audio
          NvmBlock_NvBlockSwComponentType_NVNeed_NVBlockDescriptor_029: RteNvmRomBlockLocationSymbol=Rte_NvBlockSwComponentType_NVBlockDescriptor_BsConst_Communication_ROM_NVBlockDescriptor_BsConst_Communication, RteNvmBlockRef=NvBlockSwComponentTypeNVBlockDescriptor_BsConst_Communication
          NvmBlock_NvBlockSwComponentType_NVNeed_NVBlockDescriptor_038: RteNvmRomBlockLocationSymbol=Rte_NvBlockSwComponentType_NVBlockDescriptor_BsConst_EngOffTimer_ROM_NVBlockDescriptor_BsConst_EngOffTimer, RteNvmBlockRef=NvBlockSwComponentTypeNVBlockDescriptor_BsConst_EngOffTimer
          NvmBlock_NvBlockSwComponentType_NVNeed_NVBlockDescriptor_048: RteNvmRomBlockLocationSymbol=Rte_NvBlockSwComponentType_NVBlockDescriptor_BsConst_FuelGauge_ROM_NVBlockDescriptor_BsConst_FuelGauge, RteNvmBlockRef=NvBlockSwComponentTypeNVBlockDescriptor_BsConst_FuelGauge
          NvmBlock_NvBlockSwComponentType_NVNeed_NVBlockDescriptor_001: RteNvmRomBlockLocationSymbol=Rte_NvBlockSwComponentType_NVBlockDescriptor_BsConst_Illumination_ROM_NVBlockDescriptor_BsConst_Illumination, RteNvmBlockRef=NvBlockSwComponentTypeNVBlockDescriptor_BsConst_Illumination
          NvmBlock_NvBlockSwComponentType_NVNeed_NVBlockDescriptor: RteNvmRomBlockLocationSymbol=Rte_NvBlockSwComponentType_NVBlockDescriptor_BsConst_Illumination_Copy1_ROM_NVBlockDescriptor_BsConst_Illumination_Copy1, RteNvmBlockRef=NvBlockSwComponentTypeNVBlockDescriptor_BsConst_Illumination_Copy1
          NvmBlock_NvBlockSwComponentType_NVNeed_NVBlockDescriptor_010: RteNvmRomBlockLocationSymbol=Rte_NvBlockSwComponentType_NVBlockDescriptor_BsConst_Illumination_Copy2_ROM_NVBlockDescriptor_BsConst_Illumination_Copy2, RteNvmBlockRef=NvBlockSwComponentTypeNVBlockDescriptor_BsConst_Illumination_Copy2
          NvmBlock_NvBlockSwComponentType_NVNeed_NVBlockDescriptor_037: RteNvmRomBlockLocationSymbol=Rte_NvBlockSwComponentType_NVBlockDescriptor_BsConst_OilGauge_ROM_NVBlockDescriptor_BsConst_OilGauge, RteNvmBlockRef=NvBlockSwComponentTypeNVBlockDescriptor_BsConst_OilGauge
          NvmBlock_NvBlockSwComponentType_NVNeed_NVBlockDescriptor_030: RteNvmRomBlockLocationSymbol=Rte_NvBlockSwComponentType_NVBlockDescriptor_BsConst_Power_ROM_NVBlockDescriptor_BsConst_Power, RteNvmBlockRef=NvBlockSwComponentTypeNVBlockDescriptor_BsConst_Power
          NvmBlock_NvBlockSwComponentType_NVNeed_NVBlockDescriptor_036: RteNvmRomBlockLocationSymbol=Rte_NvBlockSwComponentType_NVBlockDescriptor_BsConst_PowerGauge_ROM_NVBlockDescriptor_BsConst_PowerGauge, RteNvmBlockRef=NvBlockSwComponentTypeNVBlockDescriptor_BsConst_PowerGauge
          NvmBlock_NvBlockSwComponentType_NVNeed_NVBlockDescriptor_034: RteNvmRomBlockLocationSymbol=Rte_NvBlockSwComponentType_NVBlockDescriptor_BsConst_RealTimeClock_ROM_NVBlockDescriptor_BsConst_RealTimeClock, RteNvmBlockRef=NvBlockSwComponentTypeNVBlockDescriptor_BsConst_RealTimeClock
          NvmBlock_NvBlockSwComponentType_NVNeed_NVBlockDescriptor_009: RteNvmRomBlockLocationSymbol=Rte_NvBlockSwComponentType_NVBlockDescriptor_BsConst_ServiceReminder_ROM_NVBlockDescriptor_BsConst_ServiceReminder, RteNvmBlockRef=NvBlockSwComponentTypeNVBlockDescriptor_BsConst_ServiceReminder
          NvmBlock_NvBlockSwComponentType_NVNeed_NVBlockDescriptor_027: RteNvmRomBlockLocationSymbol=Rte_NvBlockSwComponentType_NVBlockDescriptor_BsConst_SpeedoGauge_ROM_NVBlockDescriptor_BsConst_SpeedoGauge, RteNvmBlockRef=NvBlockSwComponentTypeNVBlockDescriptor_BsConst_SpeedoGauge
          NvmBlock_NvBlockSwComponentType_NVNeed_NVBlockDescriptor_023: RteNvmRomBlockLocationSymbol=Rte_NvBlockSwComponentType_NVBlockDescriptor_BsConst_TachoGauge_ROM_NVBlockDescriptor_BsConst_TachoGauge, RteNvmBlockRef=NvBlockSwComponentTypeNVBlockDescriptor_BsConst_TachoGauge
          NvmBlock_NvBlockSwComponentType_NVNeed_NVBlockDescriptor_047: RteNvmRomBlockLocationSymbol=Rte_NvBlockSwComponentType_NVBlockDescriptor_BsConst_TempGauge_ROM_NVBlockDescriptor_BsConst_TempGauge, RteNvmBlockRef=NvBlockSwComponentTypeNVBlockDescriptor_BsConst_TempGauge
          NvmBlock_NvBlockSwComponentType_NVNeed_NVBlockDescriptor_016: RteNvmRomBlockLocationSymbol=Rte_NvBlockSwComponentType_NVBlockDescriptor_BsConst_TripComputer_ROM_NVBlockDescriptor_BsConst_TripComputer, RteNvmBlockRef=NvBlockSwComponentTypeNVBlockDescriptor_BsConst_TripComputer
          NvmBlock_NvBlockSwComponentType_NVNeed_NVBlockDescriptor_033: RteNvmRomBlockLocationSymbol=Rte_NvBlockSwComponentType_NVBlockDescriptor_BsConst_Warning_ROM_NVBlockDescriptor_BsConst_Warning, RteNvmBlockRef=NvBlockSwComponentTypeNVBlockDescriptor_BsConst_Warning
          NvmBlock_NvBlockSwComponentType_NVNeed_NVBlockDescriptor_022: RteNvmRomBlockLocationSymbol=Rte_NvBlockSwComponentType_NVBlockDescriptor_BsCys_Certicificate_ROM_NVBlockDescriptor_BsCys_Certicificate, RteNvmBlockRef=NvBlockSwComponentTypeNVBlockDescriptor_BsCys_Certicificate
          NvmBlock_NvBlockSwComponentType_NVNeed_NVBlockDescriptor_039: RteNvmRomBlockLocationSymbol=Rte_NvBlockSwComponentType_NVBlockDescriptor_BsDiag_Dtc_ROM_NVBlockDescriptor_BsDiag_Dtc, RteNvmBlockRef=NvBlockSwComponentTypeNVBlockDescriptor_BsDiag_Dtc
          NvmBlock_NvBlockSwComponentType_NVNeed_NVBlockDescriptor_045: RteNvmRomBlockLocationSymbol=Rte_NvBlockSwComponentType_NVBlockDescriptor_BsDiag_ErrorRecord_ROM_NVBlockDescriptor_BsDiag_ErrorRecord, RteNvmBlockRef=NvBlockSwComponentTypeNVBlockDescriptor_BsDiag_ErrorRecord
          NvmBlock_NvBlockSwComponentType_NVNeed_NVBlockDescriptor_044: RteNvmRomBlockLocationSymbol=Rte_NvBlockSwComponentType_NVBlockDescriptor_BsReten_Audio_ROM_NVBlockDescriptor_BsReten_Audio, RteNvmBlockRef=NvBlockSwComponentTypeNVBlockDescriptor_BsReten_Audio
          NvmBlock_NvBlockSwComponentType_NVNeed_NVBlockDescriptor_041: RteNvmRomBlockLocationSymbol=Rte_NvBlockSwComponentType_NVBlockDescriptor_BsReten_Communication_ROM_NVBlockDescriptor_BsReten_Communication, RteNvmBlockRef=NvBlockSwComponentTypeNVBlockDescriptor_BsReten_Communication
          NvmBlock_NvBlockSwComponentType_NVNeed_NVBlockDescriptor_018: RteNvmRomBlockLocationSymbol=Rte_NvBlockSwComponentType_NVBlockDescriptor_BsReten_Display_ROM_NVBlockDescriptor_BsReten_Display, RteNvmBlockRef=NvBlockSwComponentTypeNVBlockDescriptor_BsReten_Display
          NvmBlock_NvBlockSwComponentType_NVNeed_NVBlockDescriptor_004: RteNvmRomBlockLocationSymbol=Rte_NvBlockSwComponentType_NVBlockDescriptor_BsReten_Gauges_ROM_NVBlockDescriptor_BsReten_Gauges, RteNvmBlockRef=NvBlockSwComponentTypeNVBlockDescriptor_BsReten_Gauges
          NvmBlock_NvBlockSwComponentType_NVNeed_NVBlockDescriptor_049: RteNvmRomBlockLocationSymbol=Rte_NvBlockSwComponentType_NVBlockDescriptor_BsReten_Illumination_ROM_NVBlockDescriptor_BsReten_Illumination, RteNvmBlockRef=NvBlockSwComponentTypeNVBlockDescriptor_BsReten_Illumination
          NvmBlock_NvBlockSwComponentType_NVNeed_NVBlockDescriptor_028: RteNvmRomBlockLocationSymbol=Rte_NvBlockSwComponentType_NVBlockDescriptor_BsReten_Odometer_ROM_NVBlockDescriptor_BsReten_Odometer, RteNvmBlockRef=NvBlockSwComponentTypeNVBlockDescriptor_BsReten_Odometer
          NvmBlock_NvBlockSwComponentType_NVNeed_NVBlockDescriptor_002: RteNvmRomBlockLocationSymbol=Rte_NvBlockSwComponentType_NVBlockDescriptor_BsReten_Personalization_ROM_NVBlockDescriptor_BsReten_Personalization, RteNvmBlockRef=NvBlockSwComponentTypeNVBlockDescriptor_BsReten_Personalization
          NvmBlock_NvBlockSwComponentType_NVNeed_NVBlockDescriptor_014: RteNvmRomBlockLocationSymbol=Rte_NvBlockSwComponentType_NVBlockDescriptor_BsReten_Power_ROM_NVBlockDescriptor_BsReten_Power, RteNvmBlockRef=NvBlockSwComponentTypeNVBlockDescriptor_BsReten_Power
          NvmBlock_NvBlockSwComponentType_NVNeed_NVBlockDescriptor_058: RteNvmRomBlockLocationSymbol=Rte_NvBlockSwComponentType_NVBlockDescriptor_BsReten_RealTimeClock_ROM_NVBlockDescriptor_BsReten_RealTimeClock, RteNvmBlockRef=NvBlockSwComponentTypeNVBlockDescriptor_BsReten_RealTimeClock
          NvmBlock_NvBlockSwComponentType_NVNeed_NVBlockDescriptor_057: RteNvmRomBlockLocationSymbol=Rte_NvBlockSwComponentType_NVBlockDescriptor_BsReten_Tripcomputer_ROM_NVBlockDescriptor_BsReten_Tripcomputer, RteNvmBlockRef=NvBlockSwComponentTypeNVBlockDescriptor_BsReten_Tripcomputer
          NvmBlock_NvBlockSwComponentType_NVNeed_NVBlockDescriptor_053: RteNvmRomBlockLocationSymbol=Rte_NvBlockSwComponentType_NVBlockDescriptor_BsReten_Warning_ROM_NVBlockDescriptor_BsReten_Warning, RteNvmBlockRef=NvBlockSwComponentTypeNVBlockDescriptor_BsReten_Warning
          NvmBlock_NvBlockSwComponentType_NVNeed_NVBlockDescriptor_046: RteNvmRomBlockLocationSymbol=Rte_NvBlockSwComponentType_NVBlockDescriptor_BsRt_CusDlt_ROM_NVBlockDescriptor_BsRt_CusDlt, RteNvmBlockRef=NvBlockSwComponentTypeNVBlockDescriptor_BsRt_CusDlt
          NvmBlock_NvBlockSwComponentType_NVNeed_NVBlockDescriptor_008: RteNvmRomBlockLocationSymbol=Rte_NvBlockSwComponentType_NVBlockDescriptor_BsRt_FuelGauge_ROM_NVBlockDescriptor_BsRt_FuelGauge, RteNvmBlockRef=NvBlockSwComponentTypeNVBlockDescriptor_BsRt_FuelGauge
          NvmBlock_NvBlockSwComponentType_NVNeed_NVBlockDescriptor_005: RteNvmRomBlockLocationSymbol=Rte_NvBlockSwComponentType_NVBlockDescriptor_BsRt_Illumination_ROM_NVBlockDescriptor_BsRt_Illumination, RteNvmBlockRef=NvBlockSwComponentTypeNVBlockDescriptor_BsRt_Illumination
          NvmBlock_NvBlockSwComponentType_NVNeed_NVBlockDescriptor_012: RteNvmRomBlockLocationSymbol=Rte_NvBlockSwComponentType_NVBlockDescriptor_BsRt_Odometer_ROM_NVBlockDescriptor_BsRt_Odometer, RteNvmBlockRef=NvBlockSwComponentTypeNVBlockDescriptor_BsRt_Odometer
          NvmBlock_NvBlockSwComponentType_NVNeed_NVBlockDescriptor_003: RteNvmRomBlockLocationSymbol=Rte_NvBlockSwComponentType_NVBlockDescriptor_BsRt_OilGauge_ROM_NVBlockDescriptor_BsRt_OilGauge, RteNvmBlockRef=NvBlockSwComponentTypeNVBlockDescriptor_BsRt_OilGauge
          NvmBlock_NvBlockSwComponentType_NVNeed_NVBlockDescriptor_043: RteNvmRomBlockLocationSymbol=Rte_NvBlockSwComponentType_NVBlockDescriptor_BsRt_Personalization_ROM_NVBlockDescriptor_BsRt_Personalization, RteNvmBlockRef=NvBlockSwComponentTypeNVBlockDescriptor_BsRt_Personalization
          NvmBlock_NvBlockSwComponentType_NVNeed_NVBlockDescriptor_015: RteNvmRomBlockLocationSymbol=Rte_NvBlockSwComponentType_NVBlockDescriptor_BsRt_PowerGauge_ROM_NVBlockDescriptor_BsRt_PowerGauge, RteNvmBlockRef=NvBlockSwComponentTypeNVBlockDescriptor_BsRt_PowerGauge
          NvmBlock_NvBlockSwComponentType_NVNeed_NVBlockDescriptor_059: RteNvmRomBlockLocationSymbol=Rte_NvBlockSwComponentType_NVBlockDescriptor_BsRt_RealTimeClock_ROM_NVBlockDescriptor_BsRt_RealTimeClock, RteNvmBlockRef=NvBlockSwComponentTypeNVBlockDescriptor_BsRt_RealTimeClock
          NvmBlock_NvBlockSwComponentType_NVNeed_NVBlockDescriptor_042: RteNvmRomBlockLocationSymbol=Rte_NvBlockSwComponentType_NVBlockDescriptor_BsRt_SpeedoGauge_ROM_NVBlockDescriptor_BsRt_SpeedoGauge, RteNvmBlockRef=NvBlockSwComponentTypeNVBlockDescriptor_BsRt_SpeedoGauge
          NvmBlock_NvBlockSwComponentType_NVNeed_NVBlockDescriptor_006: RteNvmRomBlockLocationSymbol=Rte_NvBlockSwComponentType_NVBlockDescriptor_BsRt_TachoGauge_ROM_NVBlockDescriptor_BsRt_TachoGauge, RteNvmBlockRef=NvBlockSwComponentTypeNVBlockDescriptor_BsRt_TachoGauge
          NvmBlock_NvBlockSwComponentType_NVNeed_NVBlockDescriptor_024: RteNvmRomBlockLocationSymbol=Rte_NvBlockSwComponentType_NVBlockDescriptor_BsRt_TempGauge_ROM_NVBlockDescriptor_BsRt_TempGauge, RteNvmBlockRef=NvBlockSwComponentTypeNVBlockDescriptor_BsRt_TempGauge
          NvmBlock_NvBlockSwComponentType_NVNeed_NVBlockDescriptor_035: RteNvmRomBlockLocationSymbol=Rte_NvBlockSwComponentType_NVBlockDescriptor_BsRt_TripComputer_ROM_NVBlockDescriptor_BsRt_TripComputer, RteNvmBlockRef=NvBlockSwComponentTypeNVBlockDescriptor_BsRt_TripComputer
          NvmBlock_NvBlockSwComponentType_NVNeed_NVBlockDescriptor_020: RteNvmRomBlockLocationSymbol=Rte_NvBlockSwComponentType_NVBlockDescriptor_BsRt_Warning_ROM_NVBlockDescriptor_BsRt_Warning, RteNvmBlockRef=NvBlockSwComponentTypeNVBlockDescriptor_BsRt_Warning
          NvmBlock_NvBlockSwComponentType_NVNeed_NVBlockDescriptor_007: RteNvmRomBlockLocationSymbol=Rte_NvBlockSwComponentType_NVBlockDescriptor_BsShare_EcuPartNumber_ROM_NVBlockDescriptor_BsShare_EcuPartNumber, RteNvmBlockRef=NvBlockSwComponentTypeNVBlockDescriptor_BsShare_EcuPartNumber
          NvmBlock_NvBlockSwComponentType_NVNeed_NVBlockDescriptor_056: RteNvmRomBlockLocationSymbol=Rte_NvBlockSwComponentType_NVBlockDescriptor_BsShare_SwUpdFotaFinPrint_ROM_NVBlockDescriptor_BsShare_SwUpdFotaFinPrint, RteNvmBlockRef=NvBlockSwComponentTypeNVBlockDescriptor_BsShare_SwUpdFotaFinPrint
          NvmBlock_NvBlockSwComponentType_NVNeed_NVBlockDescriptor_032: RteNvmRomBlockLocationSymbol=Rte_NvBlockSwComponentType_NVBlockDescriptor_BsShare_SwUpdFotaMode_ROM_NVBlockDescriptor_BsShare_SwUpdFotaMode, RteNvmBlockRef=NvBlockSwComponentTypeNVBlockDescriptor_BsShare_SwUpdFotaMode
          NvmBlock_NvBlockSwComponentType_NVNeed_NVBlockDescriptor_054: RteNvmRomBlockLocationSymbol=Rte_NvBlockSwComponentType_NVBlockDescriptor_BsShare_SwUpdFotaStatus_ROM_NVBlockDescriptor_BsShare_SwUpdFotaStatus, RteNvmBlockRef=NvBlockSwComponentTypeNVBlockDescriptor_BsShare_SwUpdFotaStatus
          NvmBlock_NvBlockSwComponentType_NVNeed_NVBlockDescriptor_021: RteNvmRomBlockLocationSymbol=Rte_NvBlockSwComponentType_NVBlockDescriptor_BsShare_SwUpdFotadecrypt_ROM_NVBlockDescriptor_BsShare_SwUpdFotadecrypt, RteNvmBlockRef=NvBlockSwComponentTypeNVBlockDescriptor_BsShare_SwUpdFotadecrypt
          NvmBlock_NvBlockSwComponentType_NVNeed_NVBlockDescriptor_060: RteNvmRomBlockLocationSymbol=Rte_NvBlockSwComponentType_NVBlockDescriptor_BsShare_SwUpdReflash_ROM_NVBlockDescriptor_BsShare_SwUpdReflash, RteNvmBlockRef=NvBlockSwComponentTypeNVBlockDescriptor_BsShare_SwUpdReflash
          NvmBlock_NvBlockSwComponentType_NVNeed_NVBlockDescriptor_050: RteNvmRomBlockLocationSymbol=Rte_NvBlockSwComponentType_NVBlockDescriptor_BsShare_VehicleConfig_ROM_NVBlockDescriptor_BsShare_VehicleConfig, RteNvmBlockRef=NvBlockSwComponentTypeNVBlockDescriptor_BsShare_VehicleConfig
          NvmBlock_NvBlockSwComponentType_NVNeed_NVBlockDescriptor_040: RteNvmRomBlockLocationSymbol=Rte_NvBlockSwComponentType_NVBlockDescriptor_BsShare_VisMeet_ROM_NVBlockDescriptor_BsShare_VisMeet, RteNvmBlockRef=NvBlockSwComponentTypeNVBlockDescriptor_BsShare_VisMeet
          NvmBlock_NvBlockSwComponentType_NVNeed_NVBlockDescriptor_025: RteNvmRomBlockLocationSymbol=Rte_NvBlockSwComponentType_NVBlockDescriptor_RefCys_Certicificate_ROM_NVBlockDescriptor_RefCys_Certicificate, RteNvmBlockRef=NvBlockSwComponentTypeNVBlockDescriptor_RefCys_Certicificate
          NvmBlock_NvBlockSwComponentType_NVNeed_NVBlockDescriptor_061: RteNvmRomBlockLocationSymbol=Rte_NvBlockSwComponentType_NVBlockDescriptor_RefCys_Certicificate1_ROM_NVBlockDescriptor_RefCys_Certicificate1, RteNvmBlockRef=NvBlockSwComponentTypeNVBlockDescriptor_RefCys_Certicificate1
    RteOsInteraction
      33 x RteUsedOsActivation, all with RteExpectedActivationOffset=0:
        Rte_Al_TE_OsTask_AppFun_0_10ms: RteActivationOsAlarmRef=Os/Rte_Al_TE_OsTask_AppFun_0_10ms, RteActivationOsTaskRef=OsTask_AppFun
        Rte_Al_TE_Test_Comp_AudioTaskStubRunnable: RteActivationOsAlarmRef=Os/Rte_Al_TE_Test_Comp_AudioTaskStubRunnable, RteActivationOsTaskRef=OsTask_AudioFun
        Rte_Al_TE2_OsTask_CANFun_0_10ms: RteActivationOsAlarmRef=Os/Rte_Al_TE2_OsTask_CANFun_0_10ms, RteActivationOsTaskRef=OsTask_CANFun
        Rte_Al_TE_OsTask_CANFun_0_10ms: RteActivationOsAlarmRef=Os/Rte_Al_TE_OsTask_CANFun_0_10ms, RteActivationOsTaskRef=OsTask_CANFun
        Rte_Al_TE2_OsTask_Diagnostics_0_10ms: RteActivationOsAlarmRef=Os/Rte_Al_TE2_OsTask_Diagnostics_0_10ms, RteActivationOsTaskRef=OsTask_Diagnostics
        Rte_Al_TE_OsTask_Diagnostics_0_100ms: RteActivationOsAlarmRef=Os/Rte_Al_TE_OsTask_Diagnostics_0_100ms, RteActivationOsTaskRef=OsTask_Diagnostics
        Rte_Al_TE_OsTask_Diagnostics_0_10ms: RteActivationOsAlarmRef=Os/Rte_Al_TE_OsTask_Diagnostics_0_10ms, RteActivationOsTaskRef=OsTask_Diagnostics
        Rte_Al_TE_OsTask_Diagnostics_0_20ms: RteActivationOsAlarmRef=Os/Rte_Al_TE_OsTask_Diagnostics_0_20ms, RteActivationOsTaskRef=OsTask_Diagnostics
        Rte_Al_TE_OsTask_DispFun_0_10ms: RteActivationOsAlarmRef=Os/Rte_Al_TE_OsTask_DispFun_0_10ms, RteActivationOsTaskRef=OsTask_DispFun
        Rte_Al_TE_OsTask_DispFun_0_5ms: RteActivationOsAlarmRef=Os/Rte_Al_TE_OsTask_DispFun_0_5ms, RteActivationOsTaskRef=OsTask_DispFun
        Rte_Al_TE_SlowGaugeAdapter_SlowGaugeAdapter_Task: RteActivationOsAlarmRef=Os/Rte_Al_TE_SlowGaugeAdapter_SlowGaugeAdapter_Task, RteActivationOsTaskRef=OsTask_DispFun
        Rte_Al_TE_OsTask_EthFun_0_10ms: RteActivationOsAlarmRef=Os/Rte_Al_TE_OsTask_EthFun_0_10ms, RteActivationOsTaskRef=OsTask_EthFun
        Rte_Al_TE_Test_Comp_FotaTaskStubRunnable: RteActivationOsAlarmRef=Os/Rte_Al_TE_Test_Comp_FotaTaskStubRunnable, RteActivationOsTaskRef=OsTask_FotaFun
        Rte_Al_TE_OsTask_GaugeFun_0_20ms: RteActivationOsAlarmRef=Os/Rte_Al_TE_OsTask_GaugeFun_0_20ms, RteActivationOsTaskRef=OsTask_GaugeFun
        Rte_Al_TE_OsTask_IndFun_0_30ms: RteActivationOsAlarmRef=Os/Rte_Al_TE_OsTask_IndFun_0_30ms, RteActivationOsTaskRef=OsTask_IndFun
        Rte_Al_TE_DmnMgr_CDmnMgr_Impl_MainFunction: RteActivationOsAlarmRef=Os/Rte_Al_TE_DmnMgr_CDmnMgr_Impl_MainFunction, RteActivationOsTaskRef=OsTask_IpcUclEv
        Rte_Al_TE_UclProxyCdd_CUclProxyCdd_Impl_MainFunction: RteActivationOsAlarmRef=Os/Rte_Al_TE_UclProxyCdd_CUclProxyCdd_Impl_MainFunction, RteActivationOsTaskRef=OsTask_IpcUclEv
        Rte_Al_TE_OsTask_LSH_16ms_0_16ms: RteActivationOsAlarmRef=Os/Rte_Al_TE_OsTask_LSH_16ms_0_16ms, RteActivationOsTaskRef=OsTask_LSH_16ms
        Rte_Al_TE_Test_Comp_LinTaskStubRunnable: RteActivationOsAlarmRef=Os/Rte_Al_TE_Test_Comp_LinTaskStubRunnable, RteActivationOsTaskRef=OsTask_LinFun
        Rte_Al_TE_OsTask_Mcal_0_10ms: RteActivationOsAlarmRef=Os/Rte_Al_TE_OsTask_Mcal_0_10ms, RteActivationOsTaskRef=OsTask_Mcal
        Rte_Al_TE2_OsTask_MemSer_0_10ms: RteActivationOsAlarmRef=Os/Rte_Al_TE2_OsTask_MemSer_0_10ms, RteActivationOsTaskRef=OsTask_MemSer
        Rte_Al_TE_Ea_Ea_MainFunction: RteActivationOsAlarmRef=Os/Rte_Al_TE_Ea_Ea_MainFunction, RteActivationOsTaskRef=OsTask_MemSer
        Rte_Al_TE_OsTask_MemSer_0_10ms: RteActivationOsAlarmRef=Os/Rte_Al_TE_OsTask_MemSer_0_10ms, RteActivationOsTaskRef=OsTask_MemSer
        Rte_Al_TE2_OsTask_ModeMgt_0_10ms: RteActivationOsAlarmRef=Os/Rte_Al_TE2_OsTask_ModeMgt_0_10ms, RteActivationOsTaskRef=OsTask_ModeMgt
        Rte_Al_TE_OsTask_ModeMgt_0_10ms: RteActivationOsAlarmRef=Os/Rte_Al_TE_OsTask_ModeMgt_0_10ms, RteActivationOsTaskRef=OsTask_ModeMgt
        Rte_Al_TE_NvMExt_NvMExt_SpeedupRunnable: RteActivationOsAlarmRef=Os/Rte_Al_TE_NvMExt_NvMExt_SpeedupRunnable, RteActivationOsTaskRef=OsTask_NvmSpeedup
        Rte_Al_TE_OsTask_SafeApp_0_30ms: RteActivationOsAlarmRef=Os/Rte_Al_TE_OsTask_SafeApp_0_30ms, RteActivationOsTaskRef=OsTask_SafeApp
        Rte_Al_TE2_OsTask_SafeBsw_0_10ms: RteActivationOsAlarmRef=Os/Rte_Al_TE2_OsTask_SafeBsw_0_10ms, RteActivationOsTaskRef=OsTask_SafeBsw
        Rte_Al_TE_IoHwAb_IoHwAb_OsTask_SafeBsw_WdgM_CheckPoint_20ms: RteActivationOsAlarmRef=Os/Rte_Al_TE_IoHwAb_IoHwAb_OsTask_SafeBsw_WdgM_CheckPoint_20ms, RteActivationOsTaskRef=OsTask_SafeBsw
        Rte_Al_TE_OsTask_SafeBsw_0_10ms: RteActivationOsAlarmRef=Os/Rte_Al_TE_OsTask_SafeBsw_0_10ms, RteActivationOsTaskRef=OsTask_SafeBsw
        Rte_Al_TE_OsTask_TripFun_0_50ms: RteActivationOsAlarmRef=Os/Rte_Al_TE_OsTask_TripFun_0_50ms, RteActivationOsTaskRef=OsTask_TripFun
        Rte_Al_TE_OsTask_WarnFun_0_32ms: RteActivationOsAlarmRef=Os/Rte_Al_TE_OsTask_WarnFun_0_32ms, RteActivationOsTaskRef=OsTask_WarnFun
        Rte_Al_TE_OsTask_WdgMngt_0_10ms: RteActivationOsAlarmRef=Os/Rte_Al_TE_OsTask_WdgMngt_0_10ms, RteActivationOsTaskRef=OsTask_WdgMngt
  module config NvM
    NvMCommonVendorParams: NvMCfgCbkIncludeList=Rte_Cbk.h
    54 x NvMBlockDescriptor, all with NvMBlockUseSyncMechanism=true, NvMSingleBlockCallback=NULL_PTR, NvMInitBlockCallback=NULL_PTR, NvMUseServicePorts=true:
      NvBlockSwComponentTypeNVBlockDescriptor_BsConst_Audio: NvMNvBlockLength=128, NvMRomBlockDataAddress=Rte_NvBlockSwComponentType_NVBlockDescriptor_BsConst_Audio_ROM_NVBlockDescriptor_BsConst_Audio, NvMWriteRamBlockToNvCallback=Rte_GetMirror_NvBlockSwComponentType_NVBlockDescriptor_BsConst_Audio, NvMReadRamBlockFromNvCallback=Rte_SetMirror_NvBlockSwComponentType_NVBlockDescriptor_BsConst_Audio
      NvBlockSwComponentTypeNVBlockDescriptor_BsConst_Communication: NvMNvBlockLength=64, NvMRomBlockDataAddress=Rte_NvBlockSwComponentType_NVBlockDescriptor_BsConst_Communication_ROM_NVBlockDescriptor_BsConst_Communication, NvMWriteRamBlockToNvCallback=Rte_GetMirror_NvBlockSwComponentType_NVBlockDescriptor_BsConst_Communication, NvMReadRamBlockFromNvCallback=Rte_SetMirror_NvBlockSwComponentType_NVBlockDescriptor_BsConst_Communication
      NvBlockSwComponentTypeNVBlockDescriptor_BsConst_EngOffTimer: NvMNvBlockLength=32, NvMRomBlockDataAddress=Rte_NvBlockSwComponentType_NVBlockDescriptor_BsConst_EngOffTimer_ROM_NVBlockDescriptor_BsConst_EngOffTimer, NvMWriteRamBlockToNvCallback=Rte_GetMirror_NvBlockSwComponentType_NVBlockDescriptor_BsConst_EngOffTimer, NvMReadRamBlockFromNvCallback=Rte_SetMirror_NvBlockSwComponentType_NVBlockDescriptor_BsConst_EngOffTimer
      NvBlockSwComponentTypeNVBlockDescriptor_BsConst_FuelGauge: NvMNvBlockLength=128, NvMRomBlockDataAddress=Rte_NvBlockSwComponentType_NVBlockDescriptor_BsConst_FuelGauge_ROM_NVBlockDescriptor_BsConst_FuelGauge, NvMWriteRamBlockToNvCallback=Rte_GetMirror_NvBlockSwComponentType_NVBlockDescriptor_BsConst_FuelGauge, NvMReadRamBlockFromNvCallback=Rte_SetMirror_NvBlockSwComponentType_NVBlockDescriptor_BsConst_FuelGauge
      NvBlockSwComponentTypeNVBlockDescriptor_BsConst_Illumination: NvMNvBlockLength=88, NvMRomBlockDataAddress=Rte_NvBlockSwComponentType_NVBlockDescriptor_BsConst_Illumination_ROM_NVBlockDescriptor_BsConst_Illumination, NvMWriteRamBlockToNvCallback=Rte_GetMirror_NvBlockSwComponentType_NVBlockDescriptor_BsConst_Illumination, NvMReadRamBlockFromNvCallback=Rte_SetMirror_NvBlockSwComponentType_NVBlockDescriptor_BsConst_Illumination
      NvBlockSwComponentTypeNVBlockDescriptor_BsConst_Illumination_Copy1: NvMNvBlockLength=88, NvMRomBlockDataAddress=Rte_NvBlockSwComponentType_NVBlockDescriptor_BsConst_Illumination_Copy1_ROM_NVBlockDescriptor_BsConst_Illumination_Copy1, NvMWriteRamBlockToNvCallback=Rte_GetMirror_NvBlockSwComponentType_NVBlockDescriptor_BsConst_Illumination_Copy1, NvMReadRamBlockFromNvCallback=Rte_SetMirror_NvBlockSwComponentType_NVBlockDescriptor_BsConst_Illumination_Copy1
      NvBlockSwComponentTypeNVBlockDescriptor_BsConst_Illumination_Copy2: NvMNvBlockLength=88, NvMRomBlockDataAddress=Rte_NvBlockSwComponentType_NVBlockDescriptor_BsConst_Illumination_Copy2_ROM_NVBlockDescriptor_BsConst_Illumination_Copy2, NvMWriteRamBlockToNvCallback=Rte_GetMirror_NvBlockSwComponentType_NVBlockDescriptor_BsConst_Illumination_Copy2, NvMReadRamBlockFromNvCallback=Rte_SetMirror_NvBlockSwComponentType_NVBlockDescriptor_BsConst_Illumination_Copy2
      NvBlockSwComponentTypeNVBlockDescriptor_BsConst_OilGauge: NvMNvBlockLength=64, NvMRomBlockDataAddress=Rte_NvBlockSwComponentType_NVBlockDescriptor_BsConst_OilGauge_ROM_NVBlockDescriptor_BsConst_OilGauge, NvMWriteRamBlockToNvCallback=Rte_GetMirror_NvBlockSwComponentType_NVBlockDescriptor_BsConst_OilGauge, NvMReadRamBlockFromNvCallback=Rte_SetMirror_NvBlockSwComponentType_NVBlockDescriptor_BsConst_OilGauge
      NvBlockSwComponentTypeNVBlockDescriptor_BsConst_Power: NvMNvBlockLength=32, NvMRomBlockDataAddress=Rte_NvBlockSwComponentType_NVBlockDescriptor_BsConst_Power_ROM_NVBlockDescriptor_BsConst_Power, NvMWriteRamBlockToNvCallback=Rte_GetMirror_NvBlockSwComponentType_NVBlockDescriptor_BsConst_Power, NvMReadRamBlockFromNvCallback=Rte_SetMirror_NvBlockSwComponentType_NVBlockDescriptor_BsConst_Power
      NvBlockSwComponentTypeNVBlockDescriptor_BsConst_PowerGauge: NvMNvBlockLength=64, NvMRomBlockDataAddress=Rte_NvBlockSwComponentType_NVBlockDescriptor_BsConst_PowerGauge_ROM_NVBlockDescriptor_BsConst_PowerGauge, NvMWriteRamBlockToNvCallback=Rte_GetMirror_NvBlockSwComponentType_NVBlockDescriptor_BsConst_PowerGauge, NvMReadRamBlockFromNvCallback=Rte_SetMirror_NvBlockSwComponentType_NVBlockDescriptor_BsConst_PowerGauge
      NvBlockSwComponentTypeNVBlockDescriptor_BsConst_RealTimeClock: NvMNvBlockLength=48, NvMRomBlockDataAddress=Rte_NvBlockSwComponentType_NVBlockDescriptor_BsConst_RealTimeClock_ROM_NVBlockDescriptor_BsConst_RealTimeClock, NvMWriteRamBlockToNvCallback=Rte_GetMirror_NvBlockSwComponentType_NVBlockDescriptor_BsConst_RealTimeClock, NvMReadRamBlockFromNvCallback=Rte_SetMirror_NvBlockSwComponentType_NVBlockDescriptor_BsConst_RealTimeClock
      NvBlockSwComponentTypeNVBlockDescriptor_BsConst_ServiceReminder: NvMNvBlockLength=48, NvMRomBlockDataAddress=Rte_NvBlockSwComponentType_NVBlockDescriptor_BsConst_ServiceReminder_ROM_NVBlockDescriptor_BsConst_ServiceReminder, NvMWriteRamBlockToNvCallback=Rte_GetMirror_NvBlockSwComponentType_NVBlockDescriptor_BsConst_ServiceReminder, NvMReadRamBlockFromNvCallback=Rte_SetMirror_NvBlockSwComponentType_NVBlockDescriptor_BsConst_ServiceReminder
      NvBlockSwComponentTypeNVBlockDescriptor_BsConst_SpeedoGauge: NvMNvBlockLength=64, NvMRomBlockDataAddress=Rte_NvBlockSwComponentType_NVBlockDescriptor_BsConst_SpeedoGauge_ROM_NVBlockDescriptor_BsConst_SpeedoGauge, NvMWriteRamBlockToNvCallback=Rte_GetMirror_NvBlockSwComponentType_NVBlockDescriptor_BsConst_SpeedoGauge, NvMReadRamBlockFromNvCallback=Rte_SetMirror_NvBlockSwComponentType_NVBlockDescriptor_BsConst_SpeedoGauge
      NvBlockSwComponentTypeNVBlockDescriptor_BsConst_TachoGauge: NvMNvBlockLength=64, NvMRomBlockDataAddress=Rte_NvBlockSwComponentType_NVBlockDescriptor_BsConst_TachoGauge_ROM_NVBlockDescriptor_BsConst_TachoGauge, NvMWriteRamBlockToNvCallback=Rte_GetMirror_NvBlockSwComponentType_NVBlockDescriptor_BsConst_TachoGauge, NvMReadRamBlockFromNvCallback=Rte_SetMirror_NvBlockSwComponentType_NVBlockDescriptor_BsConst_TachoGauge
      NvBlockSwComponentTypeNVBlockDescriptor_BsConst_TempGauge: NvMNvBlockLength=64, NvMRomBlockDataAddress=Rte_NvBlockSwComponentType_NVBlockDescriptor_BsConst_TempGauge_ROM_NVBlockDescriptor_BsConst_TempGauge, NvMWriteRamBlockToNvCallback=Rte_GetMirror_NvBlockSwComponentType_NVBlockDescriptor_BsConst_TempGauge, NvMReadRamBlockFromNvCallback=Rte_SetMirror_NvBlockSwComponentType_NVBlockDescriptor_BsConst_TempGauge
      NvBlockSwComponentTypeNVBlockDescriptor_BsConst_TripComputer: NvMNvBlockLength=64, NvMRomBlockDataAddress=Rte_NvBlockSwComponentType_NVBlockDescriptor_BsConst_TripComputer_ROM_NVBlockDescriptor_BsConst_TripComputer, NvMWriteRamBlockToNvCallback=Rte_GetMirror_NvBlockSwComponentType_NVBlockDescriptor_BsConst_TripComputer, NvMReadRamBlockFromNvCallback=Rte_SetMirror_NvBlockSwComponentType_NVBlockDescriptor_BsConst_TripComputer
      NvBlockSwComponentTypeNVBlockDescriptor_BsConst_Warning: NvMNvBlockLength=64, NvMRomBlockDataAddress=Rte_NvBlockSwComponentType_NVBlockDescriptor_BsConst_Warning_ROM_NVBlockDescriptor_BsConst_Warning, NvMWriteRamBlockToNvCallback=Rte_GetMirror_NvBlockSwComponentType_NVBlockDescriptor_BsConst_Warning, NvMReadRamBlockFromNvCallback=Rte_SetMirror_NvBlockSwComponentType_NVBlockDescriptor_BsConst_Warning
      NvBlockSwComponentTypeNVBlockDescriptor_BsCys_Certicificate: NvMNvBlockLength=64, NvMRomBlockDataAddress=Rte_NvBlockSwComponentType_NVBlockDescriptor_BsCys_Certicificate_ROM_NVBlockDescriptor_BsCys_Certicificate, NvMWriteRamBlockToNvCallback=Rte_GetMirror_NvBlockSwComponentType_NVBlockDescriptor_BsCys_Certicificate, NvMReadRamBlockFromNvCallback=Rte_SetMirror_NvBlockSwComponentType_NVBlockDescriptor_BsCys_Certicificate
      NvBlockSwComponentTypeNVBlockDescriptor_BsDiag_Dtc: NvMNvBlockLength=2048, NvMRomBlockDataAddress=Rte_NvBlockSwComponentType_NVBlockDescriptor_BsDiag_Dtc_ROM_NVBlockDescriptor_BsDiag_Dtc, NvMWriteRamBlockToNvCallback=Rte_GetMirror_NvBlockSwComponentType_NVBlockDescriptor_BsDiag_Dtc, NvMReadRamBlockFromNvCallback=Rte_SetMirror_NvBlockSwComponentType_NVBlockDescriptor_BsDiag_Dtc
      NvBlockSwComponentTypeNVBlockDescriptor_BsDiag_ErrorRecord: NvMNvBlockLength=1024, NvMRomBlockDataAddress=Rte_NvBlockSwComponentType_NVBlockDescriptor_BsDiag_ErrorRecord_ROM_NVBlockDescriptor_BsDiag_ErrorRecord, NvMWriteRamBlockToNvCallback=Rte_GetMirror_NvBlockSwComponentType_NVBlockDescriptor_BsDiag_ErrorRecord, NvMReadRamBlockFromNvCallback=Rte_SetMirror_NvBlockSwComponentType_NVBlockDescriptor_BsDiag_ErrorRecord
      NvBlockSwComponentTypeNVBlockDescriptor_BsReten_Audio: NvMNvBlockLength=100, NvMRomBlockDataAddress=Rte_NvBlockSwComponentType_NVBlockDescriptor_BsReten_Audio_ROM_NVBlockDescriptor_BsReten_Audio, NvMWriteRamBlockToNvCallback=Rte_GetMirror_NvBlockSwComponentType_NVBlockDescriptor_BsReten_Audio, NvMReadRamBlockFromNvCallback=Rte_SetMirror_NvBlockSwComponentType_NVBlockDescriptor_BsReten_Audio
      NvBlockSwComponentTypeNVBlockDescriptor_BsReten_Communication: NvMNvBlockLength=100, NvMRomBlockDataAddress=Rte_NvBlockSwComponentType_NVBlockDescriptor_BsReten_Communication_ROM_NVBlockDescriptor_BsReten_Communication, NvMWriteRamBlockToNvCallback=Rte_GetMirror_NvBlockSwComponentType_NVBlockDescriptor_BsReten_Communication, NvMReadRamBlockFromNvCallback=Rte_SetMirror_NvBlockSwComponentType_NVBlockDescriptor_BsReten_Communication
      NvBlockSwComponentTypeNVBlockDescriptor_BsReten_Display: NvMNvBlockLength=100, NvMRomBlockDataAddress=Rte_NvBlockSwComponentType_NVBlockDescriptor_BsReten_Display_ROM_NVBlockDescriptor_BsReten_Display, NvMWriteRamBlockToNvCallback=Rte_GetMirror_NvBlockSwComponentType_NVBlockDescriptor_BsReten_Display, NvMReadRamBlockFromNvCallback=Rte_SetMirror_NvBlockSwComponentType_NVBlockDescriptor_BsReten_Display
      NvBlockSwComponentTypeNVBlockDescriptor_BsReten_Gauges: NvMNvBlockLength=100, NvMRomBlockDataAddress=Rte_NvBlockSwComponentType_NVBlockDescriptor_BsReten_Gauges_ROM_NVBlockDescriptor_BsReten_Gauges, NvMWriteRamBlockToNvCallback=Rte_GetMirror_NvBlockSwComponentType_NVBlockDescriptor_BsReten_Gauges, NvMReadRamBlockFromNvCallback=Rte_SetMirror_NvBlockSwComponentType_NVBlockDescriptor_BsReten_Gauges
      NvBlockSwComponentTypeNVBlockDescriptor_BsReten_Illumination: NvMNvBlockLength=100, NvMRomBlockDataAddress=Rte_NvBlockSwComponentType_NVBlockDescriptor_BsReten_Illumination_ROM_NVBlockDescriptor_BsReten_Illumination, NvMWriteRamBlockToNvCallback=Rte_GetMirror_NvBlockSwComponentType_NVBlockDescriptor_BsReten_Illumination, NvMReadRamBlockFromNvCallback=Rte_SetMirror_NvBlockSwComponentType_NVBlockDescriptor_BsReten_Illumination
      NvBlockSwComponentTypeNVBlockDescriptor_BsReten_Odometer: NvMNvBlockLength=100, NvMRomBlockDataAddress=Rte_NvBlockSwComponentType_NVBlockDescriptor_BsReten_Odometer_ROM_NVBlockDescriptor_BsReten_Odometer, NvMWriteRamBlockToNvCallback=Rte_GetMirror_NvBlockSwComponentType_NVBlockDescriptor_BsReten_Odometer, NvMReadRamBlockFromNvCallback=Rte_SetMirror_NvBlockSwComponentType_NVBlockDescriptor_BsReten_Odometer
      NvBlockSwComponentTypeNVBlockDescriptor_BsReten_Personalization: NvMNvBlockLength=100, NvMRomBlockDataAddress=Rte_NvBlockSwComponentType_NVBlockDescriptor_BsReten_Personalization_ROM_NVBlockDescriptor_BsReten_Personalization, NvMWriteRamBlockToNvCallback=Rte_GetMirror_NvBlockSwComponentType_NVBlockDescriptor_BsReten_Personalization, NvMReadRamBlockFromNvCallback=Rte_SetMirror_NvBlockSwComponentType_NVBlockDescriptor_BsReten_Personalization
      NvBlockSwComponentTypeNVBlockDescriptor_BsReten_Power: NvMNvBlockLength=100, NvMRomBlockDataAddress=Rte_NvBlockSwComponentType_NVBlockDescriptor_BsReten_Power_ROM_NVBlockDescriptor_BsReten_Power, NvMWriteRamBlockToNvCallback=Rte_GetMirror_NvBlockSwComponentType_NVBlockDescriptor_BsReten_Power, NvMReadRamBlockFromNvCallback=Rte_SetMirror_NvBlockSwComponentType_NVBlockDescriptor_BsReten_Power
      NvBlockSwComponentTypeNVBlockDescriptor_BsReten_RealTimeClock: NvMNvBlockLength=100, NvMRomBlockDataAddress=Rte_NvBlockSwComponentType_NVBlockDescriptor_BsReten_RealTimeClock_ROM_NVBlockDescriptor_BsReten_RealTimeClock, NvMWriteRamBlockToNvCallback=Rte_GetMirror_NvBlockSwComponentType_NVBlockDescriptor_BsReten_RealTimeClock, NvMReadRamBlockFromNvCallback=Rte_SetMirror_NvBlockSwComponentType_NVBlockDescriptor_BsReten_RealTimeClock
      NvBlockSwComponentTypeNVBlockDescriptor_BsReten_Tripcomputer: NvMNvBlockLength=100, NvMRomBlockDataAddress=Rte_NvBlockSwComponentType_NVBlockDescriptor_BsReten_Tripcomputer_ROM_NVBlockDescriptor_BsReten_Tripcomputer, NvMWriteRamBlockToNvCallback=Rte_GetMirror_NvBlockSwComponentType_NVBlockDescriptor_BsReten_Tripcomputer, NvMReadRamBlockFromNvCallback=Rte_SetMirror_NvBlockSwComponentType_NVBlockDescriptor_BsReten_Tripcomputer
      NvBlockSwComponentTypeNVBlockDescriptor_BsReten_Warning: NvMNvBlockLength=100, NvMRomBlockDataAddress=Rte_NvBlockSwComponentType_NVBlockDescriptor_BsReten_Warning_ROM_NVBlockDescriptor_BsReten_Warning, NvMWriteRamBlockToNvCallback=Rte_GetMirror_NvBlockSwComponentType_NVBlockDescriptor_BsReten_Warning, NvMReadRamBlockFromNvCallback=Rte_SetMirror_NvBlockSwComponentType_NVBlockDescriptor_BsReten_Warning
      NvBlockSwComponentTypeNVBlockDescriptor_BsRt_CusDlt: NvMNvBlockLength=128, NvMRomBlockDataAddress=Rte_NvBlockSwComponentType_NVBlockDescriptor_BsRt_CusDlt_ROM_NVBlockDescriptor_BsRt_CusDlt, NvMWriteRamBlockToNvCallback=Rte_GetMirror_NvBlockSwComponentType_NVBlockDescriptor_BsRt_CusDlt, NvMReadRamBlockFromNvCallback=Rte_SetMirror_NvBlockSwComponentType_NVBlockDescriptor_BsRt_CusDlt
      NvBlockSwComponentTypeNVBlockDescriptor_BsRt_FuelGauge: NvMNvBlockLength=32, NvMRomBlockDataAddress=Rte_NvBlockSwComponentType_NVBlockDescriptor_BsRt_FuelGauge_ROM_NVBlockDescriptor_BsRt_FuelGauge, NvMWriteRamBlockToNvCallback=Rte_GetMirror_NvBlockSwComponentType_NVBlockDescriptor_BsRt_FuelGauge, NvMReadRamBlockFromNvCallback=Rte_SetMirror_NvBlockSwComponentType_NVBlockDescriptor_BsRt_FuelGauge
      NvBlockSwComponentTypeNVBlockDescriptor_BsRt_Illumination: NvMNvBlockLength=100, NvMRomBlockDataAddress=Rte_NvBlockSwComponentType_NVBlockDescriptor_BsRt_Illumination_ROM_NVBlockDescriptor_BsRt_Illumination, NvMWriteRamBlockToNvCallback=Rte_GetMirror_NvBlockSwComponentType_NVBlockDescriptor_BsRt_Illumination, NvMReadRamBlockFromNvCallback=Rte_SetMirror_NvBlockSwComponentType_NVBlockDescriptor_BsRt_Illumination
      NvBlockSwComponentTypeNVBlockDescriptor_BsRt_Odometer: NvMNvBlockLength=128, NvMRomBlockDataAddress=Rte_NvBlockSwComponentType_NVBlockDescriptor_BsRt_Odometer_ROM_NVBlockDescriptor_BsRt_Odometer, NvMWriteRamBlockToNvCallback=Rte_GetMirror_NvBlockSwComponentType_NVBlockDescriptor_BsRt_Odometer, NvMReadRamBlockFromNvCallback=Rte_SetMirror_NvBlockSwComponentType_NVBlockDescriptor_BsRt_Odometer
      NvBlockSwComponentTypeNVBlockDescriptor_BsRt_OilGauge: NvMNvBlockLength=8, NvMRomBlockDataAddress=Rte_NvBlockSwComponentType_NVBlockDescriptor_BsRt_OilGauge_ROM_NVBlockDescriptor_BsRt_OilGauge, NvMWriteRamBlockToNvCallback=Rte_GetMirror_NvBlockSwComponentType_NVBlockDescriptor_BsRt_OilGauge, NvMReadRamBlockFromNvCallback=Rte_SetMirror_NvBlockSwComponentType_NVBlockDescriptor_BsRt_OilGauge
      NvBlockSwComponentTypeNVBlockDescriptor_BsRt_Personalization: NvMNvBlockLength=128, NvMRomBlockDataAddress=Rte_NvBlockSwComponentType_NVBlockDescriptor_BsRt_Personalization_ROM_NVBlockDescriptor_BsRt_Personalization, NvMWriteRamBlockToNvCallback=Rte_GetMirror_NvBlockSwComponentType_NVBlockDescriptor_BsRt_Personalization, NvMReadRamBlockFromNvCallback=Rte_SetMirror_NvBlockSwComponentType_NVBlockDescriptor_BsRt_Personalization
      NvBlockSwComponentTypeNVBlockDescriptor_BsRt_PowerGauge: NvMNvBlockLength=32, NvMRomBlockDataAddress=Rte_NvBlockSwComponentType_NVBlockDescriptor_BsRt_PowerGauge_ROM_NVBlockDescriptor_BsRt_PowerGauge, NvMWriteRamBlockToNvCallback=Rte_GetMirror_NvBlockSwComponentType_NVBlockDescriptor_BsRt_PowerGauge, NvMReadRamBlockFromNvCallback=Rte_SetMirror_NvBlockSwComponentType_NVBlockDescriptor_BsRt_PowerGauge
      NvBlockSwComponentTypeNVBlockDescriptor_BsRt_RealTimeClock: NvMNvBlockLength=48, NvMRomBlockDataAddress=Rte_NvBlockSwComponentType_NVBlockDescriptor_BsRt_RealTimeClock_ROM_NVBlockDescriptor_BsRt_RealTimeClock, NvMWriteRamBlockToNvCallback=Rte_GetMirror_NvBlockSwComponentType_NVBlockDescriptor_BsRt_RealTimeClock, NvMReadRamBlockFromNvCallback=Rte_SetMirror_NvBlockSwComponentType_NVBlockDescriptor_BsRt_RealTimeClock
      NvBlockSwComponentTypeNVBlockDescriptor_BsRt_SpeedoGauge: NvMNvBlockLength=8, NvMRomBlockDataAddress=Rte_NvBlockSwComponentType_NVBlockDescriptor_BsRt_SpeedoGauge_ROM_NVBlockDescriptor_BsRt_SpeedoGauge, NvMWriteRamBlockToNvCallback=Rte_GetMirror_NvBlockSwComponentType_NVBlockDescriptor_BsRt_SpeedoGauge, NvMReadRamBlockFromNvCallback=Rte_SetMirror_NvBlockSwComponentType_NVBlockDescriptor_BsRt_SpeedoGauge
      NvBlockSwComponentTypeNVBlockDescriptor_BsRt_TachoGauge: NvMNvBlockLength=16, NvMRomBlockDataAddress=Rte_NvBlockSwComponentType_NVBlockDescriptor_BsRt_TachoGauge_ROM_NVBlockDescriptor_BsRt_TachoGauge, NvMWriteRamBlockToNvCallback=Rte_GetMirror_NvBlockSwComponentType_NVBlockDescriptor_BsRt_TachoGauge, NvMReadRamBlockFromNvCallback=Rte_SetMirror_NvBlockSwComponentType_NVBlockDescriptor_BsRt_TachoGauge
      NvBlockSwComponentTypeNVBlockDescriptor_BsRt_TempGauge: NvMNvBlockLength=32, NvMRomBlockDataAddress=Rte_NvBlockSwComponentType_NVBlockDescriptor_BsRt_TempGauge_ROM_NVBlockDescriptor_BsRt_TempGauge, NvMWriteRamBlockToNvCallback=Rte_GetMirror_NvBlockSwComponentType_NVBlockDescriptor_BsRt_TempGauge, NvMReadRamBlockFromNvCallback=Rte_SetMirror_NvBlockSwComponentType_NVBlockDescriptor_BsRt_TempGauge
      NvBlockSwComponentTypeNVBlockDescriptor_BsRt_TripComputer: NvMNvBlockLength=64, NvMRomBlockDataAddress=Rte_NvBlockSwComponentType_NVBlockDescriptor_BsRt_TripComputer_ROM_NVBlockDescriptor_BsRt_TripComputer, NvMWriteRamBlockToNvCallback=Rte_GetMirror_NvBlockSwComponentType_NVBlockDescriptor_BsRt_TripComputer, NvMReadRamBlockFromNvCallback=Rte_SetMirror_NvBlockSwComponentType_NVBlockDescriptor_BsRt_TripComputer
      NvBlockSwComponentTypeNVBlockDescriptor_BsRt_Warning: NvMNvBlockLength=32, NvMRomBlockDataAddress=Rte_NvBlockSwComponentType_NVBlockDescriptor_BsRt_Warning_ROM_NVBlockDescriptor_BsRt_Warning, NvMWriteRamBlockToNvCallback=Rte_GetMirror_NvBlockSwComponentType_NVBlockDescriptor_BsRt_Warning, NvMReadRamBlockFromNvCallback=Rte_SetMirror_NvBlockSwComponentType_NVBlockDescriptor_BsRt_Warning
      NvBlockSwComponentTypeNVBlockDescriptor_BsShare_EcuPartNumber: NvMNvBlockLength=128, NvMRomBlockDataAddress=Rte_NvBlockSwComponentType_NVBlockDescriptor_BsShare_EcuPartNumber_ROM_NVBlockDescriptor_BsShare_EcuPartNumber, NvMWriteRamBlockToNvCallback=Rte_GetMirror_NvBlockSwComponentType_NVBlockDescriptor_BsShare_EcuPartNumber, NvMReadRamBlockFromNvCallback=Rte_SetMirror_NvBlockSwComponentType_NVBlockDescriptor_BsShare_EcuPartNumber
      NvBlockSwComponentTypeNVBlockDescriptor_BsShare_SwUpdFotaFinPrint: NvMNvBlockLength=32, NvMRomBlockDataAddress=Rte_NvBlockSwComponentType_NVBlockDescriptor_BsShare_SwUpdFotaFinPrint_ROM_NVBlockDescriptor_BsShare_SwUpdFotaFinPrint, NvMWriteRamBlockToNvCallback=Rte_GetMirror_NvBlockSwComponentType_NVBlockDescriptor_BsShare_SwUpdFotaFinPrint, NvMReadRamBlockFromNvCallback=Rte_SetMirror_NvBlockSwComponentType_NVBlockDescriptor_BsShare_SwUpdFotaFinPrint
      NvBlockSwComponentTypeNVBlockDescriptor_BsShare_SwUpdFotaMode: NvMNvBlockLength=16, NvMRomBlockDataAddress=Rte_NvBlockSwComponentType_NVBlockDescriptor_BsShare_SwUpdFotaMode_ROM_NVBlockDescriptor_BsShare_SwUpdFotaMode, NvMWriteRamBlockToNvCallback=Rte_GetMirror_NvBlockSwComponentType_NVBlockDescriptor_BsShare_SwUpdFotaMode, NvMReadRamBlockFromNvCallback=Rte_SetMirror_NvBlockSwComponentType_NVBlockDescriptor_BsShare_SwUpdFotaMode
      NvBlockSwComponentTypeNVBlockDescriptor_BsShare_SwUpdFotaStatus: NvMNvBlockLength=48, NvMRomBlockDataAddress=Rte_NvBlockSwComponentType_NVBlockDescriptor_BsShare_SwUpdFotaStatus_ROM_NVBlockDescriptor_BsShare_SwUpdFotaStatus, NvMWriteRamBlockToNvCallback=Rte_GetMirror_NvBlockSwComponentType_NVBlockDescriptor_BsShare_SwUpdFotaStatus, NvMReadRamBlockFromNvCallback=Rte_SetMirror_NvBlockSwComponentType_NVBlockDescriptor_BsShare_SwUpdFotaStatus
      NvBlockSwComponentTypeNVBlockDescriptor_BsShare_SwUpdFotadecrypt: NvMNvBlockLength=64, NvMRomBlockDataAddress=Rte_NvBlockSwComponentType_NVBlockDescriptor_BsShare_SwUpdFotadecrypt_ROM_NVBlockDescriptor_BsShare_SwUpdFotadecrypt, NvMWriteRamBlockToNvCallback=Rte_GetMirror_NvBlockSwComponentType_NVBlockDescriptor_BsShare_SwUpdFotadecrypt, NvMReadRamBlockFromNvCallback=Rte_SetMirror_NvBlockSwComponentType_NVBlockDescriptor_BsShare_SwUpdFotadecrypt
      NvBlockSwComponentTypeNVBlockDescriptor_BsShare_SwUpdReflash: NvMNvBlockLength=8, NvMRomBlockDataAddress=Rte_NvBlockSwComponentType_NVBlockDescriptor_BsShare_SwUpdReflash_ROM_NVBlockDescriptor_BsShare_SwUpdReflash, NvMWriteRamBlockToNvCallback=Rte_GetMirror_NvBlockSwComponentType_NVBlockDescriptor_BsShare_SwUpdReflash, NvMReadRamBlockFromNvCallback=Rte_SetMirror_NvBlockSwComponentType_NVBlockDescriptor_BsShare_SwUpdReflash
      NvBlockSwComponentTypeNVBlockDescriptor_BsShare_VehicleConfig: NvMNvBlockLength=256, NvMRomBlockDataAddress=Rte_NvBlockSwComponentType_NVBlockDescriptor_BsShare_VehicleConfig_ROM_NVBlockDescriptor_BsShare_VehicleConfig, NvMWriteRamBlockToNvCallback=Rte_GetMirror_NvBlockSwComponentType_NVBlockDescriptor_BsShare_VehicleConfig, NvMReadRamBlockFromNvCallback=Rte_SetMirror_NvBlockSwComponentType_NVBlockDescriptor_BsShare_VehicleConfig
      NvBlockSwComponentTypeNVBlockDescriptor_BsShare_VisMeet: NvMNvBlockLength=48, NvMRomBlockDataAddress=Rte_NvBlockSwComponentType_NVBlockDescriptor_BsShare_VisMeet_ROM_NVBlockDescriptor_BsShare_VisMeet, NvMWriteRamBlockToNvCallback=Rte_GetMirror_NvBlockSwComponentType_NVBlockDescriptor_BsShare_VisMeet, NvMReadRamBlockFromNvCallback=Rte_SetMirror_NvBlockSwComponentType_NVBlockDescriptor_BsShare_VisMeet
      NvBlockSwComponentTypeNVBlockDescriptor_RefCys_Certicificate: NvMNvBlockLength=64, NvMRomBlockDataAddress=Rte_NvBlockSwComponentType_NVBlockDescriptor_RefCys_Certicificate_ROM_NVBlockDescriptor_RefCys_Certicificate, NvMWriteRamBlockToNvCallback=Rte_GetMirror_NvBlockSwComponentType_NVBlockDescriptor_RefCys_Certicificate, NvMReadRamBlockFromNvCallback=Rte_SetMirror_NvBlockSwComponentType_NVBlockDescriptor_RefCys_Certicificate
      NvBlockSwComponentTypeNVBlockDescriptor_RefCys_Certicificate1: NvMNvBlockLength=64, NvMRomBlockDataAddress=Rte_NvBlockSwComponentType_NVBlockDescriptor_RefCys_Certicificate1_ROM_NVBlockDescriptor_RefCys_Certicificate1, NvMWriteRamBlockToNvCallback=Rte_GetMirror_NvBlockSwComponentType_NVBlockDescriptor_RefCys_Certicificate1, NvMReadRamBlockFromNvCallback=Rte_SetMirror_NvBlockSwComponentType_NVBlockDescriptor_RefCys_Certicificate1
  module config Os
    OsTask_AppFun (OsTask): OsTaskActivation=1, OsTaskPriority=5, OsTaskSchedule=NON, OsTaskAccessingApplication=OsApplication_Trusted
    Rte_Al_TE_OsTask_AppFun_0_10ms (OsAlarm): OsAlarmCounterRef=SystemTimer, OsAlarmAccessingApplication=OsApplication_Trusted
      OsAlarmAction
        OsAlarmActivateTask: OsAlarmActivateTaskRef=OsTask_AppFun
    OsTask_AudioFun (OsTask): OsTaskActivation=1, OsTaskPriority=11, OsTaskSchedule=NON, OsTaskAccessingApplication=OsApplication_Trusted
    Rte_Al_TE_Test_Comp_AudioTaskStubRunnable (OsAlarm): OsAlarmCounterRef=SystemTimer, OsAlarmAccessingApplication=OsApplication_Trusted
      OsAlarmAction
        OsAlarmActivateTask: OsAlarmActivateTaskRef=OsTask_AudioFun
    OsTask_CANFun (OsTask):
      OsTaskActivation = 1
      OsTaskPriority = 2
      OsTaskSchedule = NON
      OsTaskEventRef = Rte_Ev_Cyclic2_OsTask_CANFun_0_10ms
      OsTaskEventRef = Rte_Ev_Cyclic_OsTask_CANFun_0_10ms
      OsTaskAccessingApplication = OsApplication_Trusted
    Rte_Al_TE2_OsTask_CANFun_0_10ms (OsAlarm): OsAlarmCounterRef=SystemTimer, OsAlarmAccessingApplication=OsApplication_Trusted
      OsAlarmAction
        OsAlarmSetEvent: OsAlarmSetEventRef=Rte_Ev_Cyclic2_OsTask_CANFun_0_10ms, OsAlarmSetEventTaskRef=OsTask_CANFun
    Rte_Al_TE_OsTask_CANFun_0_10ms (OsAlarm): OsAlarmCounterRef=SystemTimer, OsAlarmAccessingApplication=OsApplication_Trusted
      OsAlarmAction
        OsAlarmSetEvent: OsAlarmSetEventRef=Rte_Ev_Cyclic_OsTask_CANFun_0_10ms, OsAlarmSetEventTaskRef=OsTask_CANFun
    OsTask_Diagnostics (OsTask):
      OsTaskActivation = 1
      OsTaskPriority = 12
      OsTaskSchedule = NON
      OsTaskEventRef = Rte_Ev_Cyclic2_OsTask_Diagnostics_0_10ms
      OsTaskEventRef = Rte_Ev_Cyclic_OsTask_Diagnostics_0_100ms
      OsTaskEventRef = Rte_Ev_Cyclic_OsTask_Diagnostics_0_10ms
      OsTaskEventRef = Rte_Ev_Cyclic_OsTask_Diagnostics_0_20ms
      OsTaskAccessingApplication = OsApplication_Trusted
    4 x OsAlarm, all with OsAlarmCounterRef=SystemTimer, OsAlarmAccessingApplication=OsApplication_Trusted:
      Rte_Al_TE2_OsTask_Diagnostics_0_10ms
        OsAlarmAction
          OsAlarmSetEvent: OsAlarmSetEventRef=Rte_Ev_Cyclic2_OsTask_Diagnostics_0_10ms, OsAlarmSetEventTaskRef=OsTask_Diagnostics
      Rte_Al_TE_OsTask_Diagnostics_0_100ms
        OsAlarmAction
          OsAlarmSetEvent: OsAlarmSetEventRef=Rte_Ev_Cyclic_OsTask_Diagnostics_0_100ms, OsAlarmSetEventTaskRef=OsTask_Diagnostics
      Rte_Al_TE_OsTask_Diagnostics_0_10ms
        OsAlarmAction
          OsAlarmSetEvent: OsAlarmSetEventRef=Rte_Ev_Cyclic_OsTask_Diagnostics_0_10ms, OsAlarmSetEventTaskRef=OsTask_Diagnostics
      Rte_Al_TE_OsTask_Diagnostics_0_20ms
        OsAlarmAction
          OsAlarmSetEvent: OsAlarmSetEventRef=Rte_Ev_Cyclic_OsTask_Diagnostics_0_20ms, OsAlarmSetEventTaskRef=OsTask_Diagnostics
    OsTask_DispFun (OsTask):
      OsTaskActivation = 1
      OsTaskPriority = 24
      OsTaskSchedule = NON
      OsTaskEventRef = Rte_Ev_Cyclic_OsTask_DispFun_0_10ms
      OsTaskEventRef = Rte_Ev_Cyclic_OsTask_DispFun_0_5ms
      OsTaskEventRef = Rte_Ev_Run_SlowGaugeAdapter_SlowGaugeAdapter_Task
      OsTaskAccessingApplication = OsApplication_Trusted
    3 x OsAlarm, all with OsAlarmCounterRef=SystemTimer, OsAlarmAccessingApplication=OsApplication_Trusted:
      Rte_Al_TE_OsTask_DispFun_0_10ms
        OsAlarmAction
          OsAlarmSetEvent: OsAlarmSetEventRef=Rte_Ev_Cyclic_OsTask_DispFun_0_10ms, OsAlarmSetEventTaskRef=OsTask_DispFun
      Rte_Al_TE_OsTask_DispFun_0_5ms
        OsAlarmAction
          OsAlarmSetEvent: OsAlarmSetEventRef=Rte_Ev_Cyclic_OsTask_DispFun_0_5ms, OsAlarmSetEventTaskRef=OsTask_DispFun
      Rte_Al_TE_SlowGaugeAdapter_SlowGaugeAdapter_Task
        OsAlarmAction
          OsAlarmSetEvent: OsAlarmSetEventRef=Rte_Ev_Run_SlowGaugeAdapter_SlowGaugeAdapter_Task, OsAlarmSetEventTaskRef=OsTask_DispFun
    OsTask_EthFun (OsTask): OsTaskActivation=1, OsTaskPriority=17, OsTaskSchedule=NON, OsTaskAccessingApplication=OsApplication_Trusted
    Rte_Al_TE_OsTask_EthFun_0_10ms (OsAlarm): OsAlarmCounterRef=SystemTimer, OsAlarmAccessingApplication=OsApplication_Trusted
      OsAlarmAction
        OsAlarmActivateTask: OsAlarmActivateTaskRef=OsTask_EthFun
    OsTask_FotaFun (OsTask): OsTaskActivation=1, OsTaskPriority=4, OsTaskSchedule=FULL, OsTaskAccessingApplication=OsApplication_Trusted
    Rte_Al_TE_Test_Comp_FotaTaskStubRunnable (OsAlarm): OsAlarmCounterRef=SystemTimer, OsAlarmAccessingApplication=OsApplication_Trusted
      OsAlarmAction
        OsAlarmActivateTask: OsAlarmActivateTaskRef=OsTask_FotaFun
    OsTask_GaugeFun (OsTask): OsTaskActivation=1, OsTaskPriority=14, OsTaskSchedule=NON, OsTaskAccessingApplication=OsApplication_Trusted
    Rte_Al_TE_OsTask_GaugeFun_0_20ms (OsAlarm): OsAlarmCounterRef=SystemTimer, OsAlarmAccessingApplication=OsApplication_Trusted
      OsAlarmAction
        OsAlarmActivateTask: OsAlarmActivateTaskRef=OsTask_GaugeFun
    OsTask_IndFun (OsTask): OsTaskActivation=1, OsTaskPriority=10, OsTaskSchedule=NON, OsTaskAccessingApplication=OsApplication_Trusted
    Rte_Al_TE_OsTask_IndFun_0_30ms (OsAlarm): OsAlarmCounterRef=SystemTimer, OsAlarmAccessingApplication=OsApplication_Trusted
      OsAlarmAction
        OsAlarmActivateTask: OsAlarmActivateTaskRef=OsTask_IndFun
    OsTask_IpcUclEv (OsTask):
      OsTaskActivation = 1
      OsTaskPriority = 8
      OsTaskSchedule = NON
      OsTaskEventRef = Rte_Ev_Run_CUpdateCdd_CUpdateCdd_OnDre_UpdateResponse
      OsTaskEventRef = Rte_Ev_Run_CWarnMsg_Core_Observer_OnDre_UCL_HudWarnStatus
      OsTaskEventRef = Rte_Ev_Run_CWarnMsg_Core_Observer_OnDre_UCL_WarnStatus
      OsTaskEventRef = Rte_Ev_Run_DltExt_DltExt_OnDreDLTMessageReadAckData
      OsTaskEventRef = Rte_Ev_Run_DmnMgr_CDmnMgr_Impl_MainFunction
      OsTaskEventRef = Rte_Ev_Run_DmnMgr_DmnMgr_MonitorDmnExtendShutdownTime
      OsTaskEventRef = Rte_Ev_Run_DmnMgr_DmnMgr_MonitorDmnHealthDumpData
      OsTaskEventRef = Rte_Ev_Run_DmnMgr_DmnMgr_MonitorDmnHealthDumpHdrInfo
      OsTaskEventRef = Rte_Ev_Run_DmnMgr_DmnMgr_MonitorDmnHealthFatalError
      OsTaskEventRef = Rte_Ev_Run_DmnMgr_DmnMgr_MonitorDmnHeartBeat
      OsTaskEventRef = Rte_Ev_Run_DmnMgr_DmnMgr_MonitorDmnKeepSystemAwake
      OsTaskEventRef = Rte_Ev_Run_DmnMgr_DmnMgr_MonitorDmnPowerSystemState
      OsTaskEventRef = Rte_Ev_Run_UclProxyCdd_CUclProxyCdd_Impl_MainFunction
      OsTaskEventRef = Rte_Ev_Run_UclProxyCdd_OnDre_DLTControlMessageReponse
      OsTaskEventRef = Rte_Ev_Run_UclProxyCdd_OnDre_DLTMessageReadRequest
      OsTaskEventRef = Rte_Ev_Run_UclProxyCdd_OnDre_DiagDIDRequest
      OsTaskEventRef = Rte_Ev_Run_UclProxyCdd_OnDre_DiagIOCtrlRequest
      OsTaskEventRef = Rte_Ev_Run_UclProxyCdd_OnDre_DiagRoutineRequest
      OsTaskEventRef = Rte_Ev_Run_UclProxyCdd_OnDre_DisplaySetPower
      OsTaskEventRef = Rte_Ev_Run_UclProxyCdd_OnDre_FRTT_Status
      OsTaskEventRef = Rte_Ev_Run_UclProxyCdd_OnDre_FastGaugeInfo
      OsTaskEventRef = Rte_Ev_Run_UclProxyCdd_OnDre_HealthDumpGetData
      OsTaskEventRef = Rte_Ev_Run_UclProxyCdd_OnDre_HealthDumpGetHdr
      OsTaskEventRef = Rte_Ev_Run_UclProxyCdd_OnDre_IlluminationData
      OsTaskEventRef = Rte_Ev_Run_UclProxyCdd_OnDre_PowerSystemStateReqChange
      OsTaskEventRef = Rte_Ev_Run_UclProxyCdd_OnDre_RTT_Icon
      OsTaskEventRef = Rte_Ev_Run_UclProxyCdd_OnDre_RTT_Status
      OsTaskEventRef = Rte_Ev_Run_UclProxyCdd_OnDre_RTT_Toggle
      OsTaskEventRef = Rte_Ev_Run_UclProxyCdd_OnDre_ShiftPosIndStatus
      OsTaskEventRef = Rte_Ev_Run_UclProxyCdd_OnDre_SlowGaugeInfo
      OsTaskEventRef = Rte_Ev_Run_UclProxyCdd_OnDre_TT_Status
      OsTaskEventRef = Rte_Ev_Run_UclProxyCdd_OnDre_UpdateLongServiceReq
      OsTaskEventRef = Rte_Ev_Run_UclProxyCdd_OnDre_UpdateShortServiceReq
      OsTaskEventRef = Rte_Ev_Run_UclProxyCdd_OnDre_WarningDisplay
      OsTaskEventRef = Rte_Ev_Run_UclProxyCdd_OnDre_WarningExtDisplay
      OsTaskAccessingApplication = OsApplication_Trusted
    Rte_Al_TE_DmnMgr_CDmnMgr_Impl_MainFunction (OsAlarm): OsAlarmCounterRef=SystemTimer, OsAlarmAccessingApplication=OsApplication_Trusted
      OsAlarmAction
        OsAlarmSetEvent: OsAlarmSetEventRef=Rte_Ev_Run_DmnMgr_CDmnMgr_Impl_MainFunction, OsAlarmSetEventTaskRef=OsTask_IpcUclEv
    Rte_Al_TE_UclProxyCdd_CUclProxyCdd_Impl_MainFunction (OsAlarm): OsAlarmCounterRef=SystemTimer, OsAlarmAccessingApplication=OsApplication_Trusted
      OsAlarmAction
        OsAlarmSetEvent: OsAlarmSetEventRef=Rte_Ev_Run_UclProxyCdd_CUclProxyCdd_Impl_MainFunction, OsAlarmSetEventTaskRef=OsTask_IpcUclEv
    OsTask_LSH_16ms (OsTask):
      OsTaskActivation = 1
      OsTaskPriority = 20
      OsTaskSchedule = NON
      OsTaskEventRef = Rte_Ev_Cyclic_OsTask_LSH_16ms_0_16ms
      OsTaskAccessingApplication = OsApplication_Trusted
    Rte_Al_TE_OsTask_LSH_16ms_0_16ms (OsAlarm): OsAlarmCounterRef=SystemTimer, OsAlarmAccessingApplication=OsApplication_Trusted
      OsAlarmAction
        OsAlarmSetEvent: OsAlarmSetEventRef=Rte_Ev_Cyclic_OsTask_LSH_16ms_0_16ms, OsAlarmSetEventTaskRef=OsTask_LSH_16ms
    OsTask_LinFun (OsTask): OsTaskActivation=1, OsTaskPriority=13, OsTaskSchedule=NON, OsTaskAccessingApplication=OsApplication_Trusted
    Rte_Al_TE_Test_Comp_LinTaskStubRunnable (OsAlarm): OsAlarmCounterRef=SystemTimer, OsAlarmAccessingApplication=OsApplication_Trusted
      OsAlarmAction
        OsAlarmActivateTask: OsAlarmActivateTaskRef=OsTask_LinFun
    OsTask_Mcal (OsTask): OsTaskActivation=1, OsTaskPriority=21, OsTaskSchedule=NON, OsTaskAccessingApplication=OsApplication_Trusted
    Rte_Al_TE_OsTask_Mcal_0_10ms (OsAlarm): OsAlarmCounterRef=SystemTimer, OsAlarmAccessingApplication=OsApplication_Trusted
      OsAlarmAction
        OsAlarmActivateTask: OsAlarmActivateTaskRef=OsTask_Mcal
    OsTask_MemSer (OsTask):
      OsTaskActivation = 1
      OsTaskPriority = 22
      OsTaskSchedule = NON
      OsTaskEventRef = Rte_Ev_Cyclic2_OsTask_MemSer_0_10ms
      OsTaskEventRef = Rte_Ev_Cyclic_OsTask_MemSer_0_10ms
      OsTaskEventRef = Rte_Ev_Run_Ea_Ea_MainFunction
      OsTaskEventRef = Rte_Ev_Run_NvBlockSwComponentType_NvBlockSwComponentTypeRunnable
      OsTaskAccessingApplication = OsApplication_Trusted
    3 x OsAlarm, all with OsAlarmCounterRef=SystemTimer, OsAlarmAccessingApplication=OsApplication_Trusted:
      Rte_Al_TE2_OsTask_MemSer_0_10ms
        OsAlarmAction
          OsAlarmSetEvent: OsAlarmSetEventRef=Rte_Ev_Cyclic2_OsTask_MemSer_0_10ms, OsAlarmSetEventTaskRef=OsTask_MemSer
      Rte_Al_TE_Ea_Ea_MainFunction
        OsAlarmAction
          OsAlarmSetEvent: OsAlarmSetEventRef=Rte_Ev_Run_Ea_Ea_MainFunction, OsAlarmSetEventTaskRef=OsTask_MemSer
      Rte_Al_TE_OsTask_MemSer_0_10ms
        OsAlarmAction
          OsAlarmSetEvent: OsAlarmSetEventRef=Rte_Ev_Cyclic_OsTask_MemSer_0_10ms, OsAlarmSetEventTaskRef=OsTask_MemSer
    OsTask_ModeMgt (OsTask):
      OsTaskActivation = 1
      OsTaskPriority = 25
      OsTaskSchedule = NON
      OsTaskEventRef = Rte_Ev_Cyclic2_OsTask_ModeMgt_0_10ms
      OsTaskEventRef = Rte_Ev_Cyclic_OsTask_ModeMgt_0_10ms
      OsTaskAccessingApplication = OsApplication_Trusted
    Rte_Al_TE2_OsTask_ModeMgt_0_10ms (OsAlarm): OsAlarmCounterRef=SystemTimer, OsAlarmAccessingApplication=OsApplication_Trusted
      OsAlarmAction
        OsAlarmSetEvent: OsAlarmSetEventRef=Rte_Ev_Cyclic2_OsTask_ModeMgt_0_10ms, OsAlarmSetEventTaskRef=OsTask_ModeMgt
    Rte_Al_TE_OsTask_ModeMgt_0_10ms (OsAlarm): OsAlarmCounterRef=SystemTimer, OsAlarmAccessingApplication=OsApplication_Trusted
      OsAlarmAction
        OsAlarmSetEvent: OsAlarmSetEventRef=Rte_Ev_Cyclic_OsTask_ModeMgt_0_10ms, OsAlarmSetEventTaskRef=OsTask_ModeMgt
    OsTask_NvmSpeedup (OsTask):
      OsTaskActivation = 1
      OsTaskPriority = 7
      OsTaskSchedule = FULL
      OsTaskEventRef = Rte_Ev_Run_NvMExt_NvMExt_SpeedupRunnable
      OsTaskAccessingApplication = OsApplication_Trusted
    Rte_Al_TE_NvMExt_NvMExt_SpeedupRunnable (OsAlarm): OsAlarmCounterRef=SystemTimer, OsAlarmAccessingApplication=OsApplication_Trusted
      OsAlarmAction
        OsAlarmSetEvent: OsAlarmSetEventRef=Rte_Ev_Run_NvMExt_NvMExt_SpeedupRunnable, OsAlarmSetEventTaskRef=OsTask_NvmSpeedup
    OsTask_SafeApp (OsTask): OsTaskActivation=1, OsTaskPriority=15, OsTaskSchedule=NON, OsTaskAccessingApplication=OsApplication_NonTrusted
    Rte_Al_TE_OsTask_SafeApp_0_30ms (OsAlarm): OsAlarmCounterRef=SystemTimer, OsAlarmAccessingApplication=OsApplication_NonTrusted
      OsAlarmAction
        OsAlarmActivateTask: OsAlarmActivateTaskRef=OsTask_SafeApp
    OsTask_SafeBsw (OsTask):
      OsTaskActivation = 1
      OsTaskPriority = 16
      OsTaskSchedule = NON
      OsTaskEventRef = Rte_Ev_Cyclic2_OsTask_SafeBsw_0_10ms
      OsTaskEventRef = Rte_Ev_Cyclic_OsTask_SafeBsw_0_10ms
      OsTaskEventRef = Rte_Ev_Run_IoHwAb_IoHwAb_OsTask_SafeBsw_WdgM_CheckPoint_20ms
      OsTaskEventRef = Rte_Ev_Run_Mdl_SafetyAdapter_Mdl_SafetyAdapter_OnDataRx_B_EBW2
      OsTaskEventRef = Rte_Ev_Run_Mdl_SafetyAdapter_Mdl_SafetyAdapter_OnDataRx_B_PKBLP
      OsTaskEventRef = Rte_Ev_Run_Mdl_SafetyAdapter_Mdl_SafetyAdapter_OnDataRx_SCSBZR
      OsTaskEventRef = Rte_Ev_Run_Mdl_SafetyAdapter_Mdl_SafetyAdapter_OnDataRx_VSCOFF
      OsTaskEventRef = Rte_Ev_Run_SafeNvM_OnDre_SafeNvM_Illumination
      OsTaskAccessingApplication = OsApplication_NonTrusted
    3 x OsAlarm, all with OsAlarmCounterRef=SystemTimer, OsAlarmAccessingApplication=OsApplication_NonTrusted:
      Rte_Al_TE2_OsTask_SafeBsw_0_10ms
        OsAlarmAction
          OsAlarmSetEvent: OsAlarmSetEventRef=Rte_Ev_Cyclic2_OsTask_SafeBsw_0_10ms, OsAlarmSetEventTaskRef=OsTask_SafeBsw
      Rte_Al_TE_IoHwAb_IoHwAb_OsTask_SafeBsw_WdgM_CheckPoint_20ms
        OsAlarmAction
          OsAlarmSetEvent: OsAlarmSetEventRef=Rte_Ev_Run_IoHwAb_IoHwAb_OsTask_SafeBsw_WdgM_CheckPoint_20ms, OsAlarmSetEventTaskRef=OsTask_SafeBsw
      Rte_Al_TE_OsTask_SafeBsw_0_10ms
        OsAlarmAction
          OsAlarmSetEvent: OsAlarmSetEventRef=Rte_Ev_Cyclic_OsTask_SafeBsw_0_10ms, OsAlarmSetEventTaskRef=OsTask_SafeBsw
    OsTask_TripFun (OsTask): OsTaskActivation=1, OsTaskPriority=6, OsTaskSchedule=NON, OsTaskAccessingApplication=OsApplication_Trusted
    Rte_Al_TE_OsTask_TripFun_0_50ms (OsAlarm): OsAlarmCounterRef=SystemTimer, OsAlarmAccessingApplication=OsApplication_Trusted
      OsAlarmAction
        OsAlarmActivateTask: OsAlarmActivateTaskRef=OsTask_TripFun
    OsTask_WarnFun (OsTask): OsTaskActivation=1, OsTaskPriority=9, OsTaskSchedule=NON, OsTaskAccessingApplication=OsApplication_Trusted
    Rte_Al_TE_OsTask_WarnFun_0_32ms (OsAlarm): OsAlarmCounterRef=SystemTimer, OsAlarmAccessingApplication=OsApplication_Trusted
      OsAlarmAction
        OsAlarmActivateTask: OsAlarmActivateTaskRef=OsTask_WarnFun
    OsTask_WdgMngt (OsTask): OsTaskActivation=1, OsTaskPriority=23, OsTaskSchedule=NON, OsTaskAccessingApplication=OsApplication_NonTrusted
    Rte_Al_TE_OsTask_WdgMngt_0_10ms (OsAlarm): OsAlarmCounterRef=SystemTimer, OsAlarmAccessingApplication=OsApplication_NonTrusted
      OsAlarmAction
        OsAlarmActivateTask: OsAlarmActivateTaskRef=OsTask_WdgMngt
    60 x OsEvent:
      Rte_Ev_Cyclic2_OsTask_CANFun_0_10ms
      Rte_Ev_Cyclic2_OsTask_Diagnostics_0_10ms
      Rte_Ev_Cyclic2_OsTask_MemSer_0_10ms
      Rte_Ev_Cyclic2_OsTask_ModeMgt_0_10ms
      Rte_Ev_Cyclic2_OsTask_SafeBsw_0_10ms
      Rte_Ev_Cyclic_OsTask_CANFun_0_10ms
      Rte_Ev_Cyclic_OsTask_Diagnostics_0_100ms
      Rte_Ev_Cyclic_OsTask_Diagnostics_0_10ms
      Rte_Ev_Cyclic_OsTask_Diagnostics_0_20ms
      Rte_Ev_Cyclic_OsTask_DispFun_0_10ms
      Rte_Ev_Cyclic_OsTask_DispFun_0_5ms
      Rte_Ev_Cyclic_OsTask_LSH_16ms_0_16ms
      Rte_Ev_Cyclic_OsTask_MemSer_0_10ms
      Rte_Ev_Cyclic_OsTask_ModeMgt_0_10ms
      Rte_Ev_Cyclic_OsTask_SafeBsw_0_10ms
      Rte_Ev_Run_CUpdateCdd_CUpdateCdd_OnDre_UpdateResponse
      Rte_Ev_Run_CWarnMsg_Core_Observer_OnDre_UCL_HudWarnStatus
      Rte_Ev_Run_CWarnMsg_Core_Observer_OnDre_UCL_WarnStatus
      Rte_Ev_Run_DltExt_DltExt_OnDreDLTMessageReadAckData
      Rte_Ev_Run_DmnMgr_CDmnMgr_Impl_MainFunction
      Rte_Ev_Run_DmnMgr_DmnMgr_MonitorDmnExtendShutdownTime
      Rte_Ev_Run_DmnMgr_DmnMgr_MonitorDmnHealthDumpData
      Rte_Ev_Run_DmnMgr_DmnMgr_MonitorDmnHealthDumpHdrInfo
      Rte_Ev_Run_DmnMgr_DmnMgr_MonitorDmnHealthFatalError
      Rte_Ev_Run_DmnMgr_DmnMgr_MonitorDmnHeartBeat
      Rte_Ev_Run_DmnMgr_DmnMgr_MonitorDmnKeepSystemAwake
      Rte_Ev_Run_DmnMgr_DmnMgr_MonitorDmnPowerSystemState
      Rte_Ev_Run_Ea_Ea_MainFunction
      Rte_Ev_Run_IoHwAb_IoHwAb_OsTask_SafeBsw_WdgM_CheckPoint_20ms
      Rte_Ev_Run_Mdl_SafetyAdapter_Mdl_SafetyAdapter_OnDataRx_B_EBW2
      Rte_Ev_Run_Mdl_SafetyAdapter_Mdl_SafetyAdapter_OnDataRx_B_PKBLP
      Rte_Ev_Run_Mdl_SafetyAdapter_Mdl_SafetyAdapter_OnDataRx_SCSBZR
      Rte_Ev_Run_Mdl_SafetyAdapter_Mdl_SafetyAdapter_OnDataRx_VSCOFF
      Rte_Ev_Run_NvBlockSwComponentType_NvBlockSwComponentTypeRunnable
      Rte_Ev_Run_NvMExt_NvMExt_SpeedupRunnable
      Rte_Ev_Run_SafeNvM_OnDre_SafeNvM_Illumination
      Rte_Ev_Run_SlowGaugeAdapter_SlowGaugeAdapter_Task
      Rte_Ev_Run_UclProxyCdd_CUclProxyCdd_Impl_MainFunction
      Rte_Ev_Run_UclProxyCdd_OnDre_DLTControlMessageReponse
      Rte_Ev_Run_UclProxyCdd_OnDre_DLTMessageReadRequest
      Rte_Ev_Run_UclProxyCdd_OnDre_DiagDIDRequest
      Rte_Ev_Run_UclProxyCdd_OnDre_DiagIOCtrlRequest
      Rte_Ev_Run_UclProxyCdd_OnDre_DiagRoutineRequest
      Rte_Ev_Run_UclProxyCdd_OnDre_DisplaySetPower
      Rte_Ev_Run_UclProxyCdd_OnDre_FRTT_Status
      Rte_Ev_Run_UclProxyCdd_OnDre_FastGaugeInfo
      Rte_Ev_Run_UclProxyCdd_OnDre_HealthDumpGetData
      Rte_Ev_Run_UclProxyCdd_OnDre_HealthDumpGetHdr
      Rte_Ev_Run_UclProxyCdd_OnDre_IlluminationData
      Rte_Ev_Run_UclProxyCdd_OnDre_PowerSystemStateReqChange
      Rte_Ev_Run_UclProxyCdd_OnDre_RTT_Icon
      Rte_Ev_Run_UclProxyCdd_OnDre_RTT_Status
      Rte_Ev_Run_UclProxyCdd_OnDre_RTT_Toggle
      Rte_Ev_Run_UclProxyCdd_OnDre_ShiftPosIndStatus
      Rte_Ev_Run_UclProxyCdd_OnDre_SlowGaugeInfo
      Rte_Ev_Run_UclProxyCdd_OnDre_TT_Status
      Rte_Ev_Run_UclProxyCdd_OnDre_UpdateLongServiceReq
      Rte_Ev_Run_UclProxyCdd_OnDre_UpdateShortServiceReq
      Rte_Ev_Run_UclProxyCdd_OnDre_WarningDisplay
      Rte_Ev_Run_UclProxyCdd_OnDre_WarningExtDisplay
    OsApplication_NonTrusted (OsApplication):
      OsTrusted = false
      OsAppTaskRef = OsTask_AppFun
      OsAppAlarmRef = Os/Rte_Al_TE_OsTask_AppFun_0_10ms
      OsAppTaskRef = OsTask_AudioFun
      OsAppAlarmRef = Os/Rte_Al_TE_Test_Comp_AudioTaskStubRunnable
      OsAppTaskRef = OsTask_CANFun
      OsAppAlarmRef = Os/Rte_Al_TE2_OsTask_CANFun_0_10ms
      OsAppAlarmRef = Os/Rte_Al_TE_OsTask_CANFun_0_10ms
      OsAppTaskRef = OsTask_Diagnostics
      OsAppAlarmRef = Os/Rte_Al_TE2_OsTask_Diagnostics_0_10ms
      OsAppAlarmRef = Os/Rte_Al_TE_OsTask_Diagnostics_0_100ms
      OsAppAlarmRef = Os/Rte_Al_TE_OsTask_Diagnostics_0_10ms
      OsAppAlarmRef = Os/Rte_Al_TE_OsTask_Diagnostics_0_20ms
      OsAppTaskRef = OsTask_DispFun
      OsAppAlarmRef = Os/Rte_Al_TE_OsTask_DispFun_0_10ms
      OsAppAlarmRef = Os/Rte_Al_TE_OsTask_DispFun_0_5ms
      OsAppAlarmRef = Os/Rte_Al_TE_SlowGaugeAdapter_SlowGaugeAdapter_Task
      OsAppTaskRef = OsTask_EthFun
      OsAppAlarmRef = Os/Rte_Al_TE_OsTask_EthFun_0_10ms
      OsAppTaskRef = OsTask_FotaFun
      OsAppAlarmRef = Os/Rte_Al_TE_Test_Comp_FotaTaskStubRunnable
      OsAppTaskRef = OsTask_GaugeFun
      OsAppAlarmRef = Os/Rte_Al_TE_OsTask_GaugeFun_0_20ms
      OsAppTaskRef = OsTask_IndFun
      OsAppAlarmRef = Os/Rte_Al_TE_OsTask_IndFun_0_30ms
      OsAppTaskRef = OsTask_IpcUclEv
      OsAppAlarmRef = Os/Rte_Al_TE_DmnMgr_CDmnMgr_Impl_MainFunction
      OsAppAlarmRef = Os/Rte_Al_TE_UclProxyCdd_CUclProxyCdd_Impl_MainFunction
      OsAppTaskRef = OsTask_LSH_16ms
      OsAppAlarmRef = Os/Rte_Al_TE_OsTask_LSH_16ms_0_16ms
      OsAppTaskRef = OsTask_LinFun
      OsAppAlarmRef = Os/Rte_Al_TE_Test_Comp_LinTaskStubRunnable
      OsAppTaskRef = OsTask_Mcal
      OsAppAlarmRef = Os/Rte_Al_TE_OsTask_Mcal_0_10ms
      OsAppTaskRef = OsTask_MemSer
      OsAppAlarmRef = Os/Rte_Al_TE2_OsTask_MemSer_0_10ms
      OsAppAlarmRef = Os/Rte_Al_TE_Ea_Ea_MainFunction
      OsAppAlarmRef = Os/Rte_Al_TE_OsTask_MemSer_0_10ms
      OsAppTaskRef = OsTask_ModeMgt
      OsAppAlarmRef = Os/Rte_Al_TE2_OsTask_ModeMgt_0_10ms
      OsAppAlarmRef = Os/Rte_Al_TE_OsTask_ModeMgt_0_10ms
      OsAppTaskRef = OsTask_NvmSpeedup
      OsAppAlarmRef = Os/Rte_Al_TE_NvMExt_NvMExt_SpeedupRunnable
      OsAppTaskRef = OsTask_TripFun
      OsAppAlarmRef = Os/Rte_Al_TE_OsTask_TripFun_0_50ms
      OsAppTaskRef = OsTask_WarnFun
      OsAppAlarmRef = Os/Rte_Al_TE_OsTask_WarnFun_0_32ms
    OsApplication_Trusted (OsApplication):
      OsTrusted = true
      OsAppTaskRef = OsTask_SafeApp
      OsAppAlarmRef = Os/Rte_Al_TE_OsTask_SafeApp_0_30ms
      OsAppTaskRef = OsTask_SafeBsw
      OsAppAlarmRef = Os/Rte_Al_TE2_OsTask_SafeBsw_0_10ms
      OsAppAlarmRef = Os/Rte_Al_TE_IoHwAb_IoHwAb_OsTask_SafeBsw_WdgM_CheckPoint_20ms
      OsAppAlarmRef = Os/Rte_Al_TE_OsTask_SafeBsw_0_10ms
      OsAppTaskRef = OsTask_WdgMngt
      OsAppAlarmRef = Os/Rte_Al_TE_OsTask_WdgMngt_0_10ms
  module config EcuC
  ecuc value collection DaVinci_Project: ecuc-values=[Com, Rte, Os, EcuC, NvM]
