AUTOSAR XML (schema 4-2-1)
package /ActiveEcuC
  module config Fee: implementation-config-variant=VARIANT-PRE-COMPILE, module-description=Fee_Impl
    FeeBlock_Template (FeeBlockConfiguration):
      FeeBlockIdFixed = false
      FeeBlockIsCritical = false
      FeeImmediateData = true
      FeeNumberOfChunkInstances = 1
      FeeBlockNumber = 1
      FeeBlockSize = 1
      FeeNumberOfWriteCycles = 10000
      FeeNumberOfDatasets = 1
      FeeBlockId = 1
      FeePartition = FeePartitionConfiguration
      FeeDeviceIndex = FlsGeneral
    FeeConfigBlock (FeeBlockConfiguration):
      FeeBlockIdFixed = false
      FeeBlockIsCritical = false
      FeeImmediateData = false
      FeeNumberOfChunkInstances = 1
      FeeBlockNumber = 42
      FeeBlockSize = 4
      FeeNumberOfWriteCycles = 10000
      FeeNumberOfDatasets = 2
      FeeBlockId = 2
      FeePartition = FeePartitionConfiguration_DIAG
      FeeDeviceIndex = FlsGeneral
    FeeGeneral:
      FeeDevErrorDetect = true
      FeeVersionInfoApi = false
      FeePollingMode = false
      FeeSetModeSupported = true
      FeeIndex = 0
      FeeNvmJobEndNotification = NvM_JobEndNotification
      FeeNvmJobErrorNotification = NvM_JobErrorNotification
      FeeInternalBufferSize = 64
      FeeMainFunctionPeriod = 0.01
      FeeNvmCbkIncludeFile = NvM_Cbk.h
      FeeMainFunctionTriggering = FixedCycleTime
      FeeDevErrorChecks: FeeDebugReporting=true, FeeDetErrorhook=Det_ReportError, FeeDetIncludeFile=Det.h
      FeeFlsApi:
        FeeFlsIncludeFile = NvMExt_Stubs.h
        FeeFlsSetMode = Fls_SetMode
        FeeFlsRead = NvmExt_Stubs_FlsRead
        FeeFlsWrite = NvmExt_Stubs_FlsWrite
        FeeFlsCancel = Fls_Cancel
        FeeFlsGetStatus = Fls_GetStatus
        FeeFlsGetJobResult = Fls_GetJobResult
        FeeFlsErase = Fls_Erase
        FeeFlsCompare = Fls_Compare
        FeeFlsDeviceIndex = FlsGeneral
    4 x FeePartitionConfiguration, all with FeeBssThresholdReserved=3072, FeeFssThresholdReserved=1024, FeeAddressAlignment=8, FeeWriteAlignment=8, FeeUpperSectorSize=8192, FeeLowerSectorSize=8192, FeePartitionDevice=FlsConfigSet_0:
      FeePartitionConfiguration_DIAG: FeeLowerSectorAddress=8192, FeeUpperSectorAddress=65536
      FeePartitionConfiguration_ODO: FeeLowerSectorAddress=24576, FeeUpperSectorAddress=81920
      FeePartitionConfiguration_SIGMA_FEE_BLK_1: FeeLowerSectorAddress=32768, FeeUpperSectorAddress=90112
      FeePartitionConfiguration_SIGMA_FEE_BLK_2: FeeLowerSectorAddress=49152, FeeUpperSectorAddress=106496
    FeePublishedInformation: FeeBlockOverhead=2, FeeMaximumBlockingTime=1, FeePageOverhead=0, FeeChunkHeader=16, FeeChunkLink=8, FeeSectorHeader=8
    FeeSpecificFeatures:
      FeeApplErrorCallbackFunction = Appl_FeeCriticalErrorCallback
      FeeApplErrorCallbackIncludeFile = ApplMain.h
      FeeGetEraseCycleApi = false
      FeeGetWriteCycleApi = false
      FeeUseApplErrorCallback = false
      FeeUseJobCache = false
      FeeForceSectorSwitchApi = false
      FeeDataConversionApi = false
      FeeFblConfig = false
      FeeMaxLinkTableSize = 4095
      FeeFssControlApi = false
    60 x FeeBlockConfiguration, all with FeeBlockIdFixed=false, FeeBlockIsCritical=false, FeeImmediateData=true, FeeNumberOfChunkInstances=1, FeeBlockSize=, FeeNumberOfDatasets=1, FeePartition=FeePartitionConfiguration_CALIB, FeeDeviceIndex=FlsGeneral:
      Fee_BsConst_Audio: FeeBlockNumber=17, FeeNumberOfWriteCycles=10000, FeeBlockId=17
      Fee_BsConst_Communication: FeeBlockNumber=20, FeeNumberOfWriteCycles=10000, FeeBlockId=20
      Fee_BsConst_EngOffTimer: FeeBlockNumber=23, FeeNumberOfWriteCycles=10000, FeeBlockId=23
      Fee_BsConst_FuelGauge: FeeBlockNumber=11, FeeNumberOfWriteCycles=10000, FeeBlockId=11
      Fee_BsConst_Illumination: FeeBlockNumber=16, FeeNumberOfWriteCycles=10000, FeeBlockId=16
      Fee_BsConst_OilGauge: FeeBlockNumber=14, FeeNumberOfWriteCycles=10000, FeeBlockId=14
      Fee_BsConst_Power: FeeBlockNumber=21, FeeNumberOfWriteCycles=10000, FeeBlockId=21
      Fee_BsConst_PowerGauge: FeeBlockNumber=13, FeeNumberOfWriteCycles=10000, FeeBlockId=13
      Fee_BsConst_RealTimeClock: FeeBlockNumber=19, FeeNumberOfWriteCycles=10000, FeeBlockId=19
      Fee_BsConst_ServiceReminder: FeeBlockNumber=22, FeeNumberOfWriteCycles=10000, FeeBlockId=22
      Fee_BsConst_SpeedoGauge: FeeBlockNumber=9, FeeNumberOfWriteCycles=10000, FeeBlockId=9
      Fee_BsConst_TachoGauge: FeeBlockNumber=10, FeeNumberOfWriteCycles=10000, FeeBlockId=10
      Fee_BsConst_TempGauge: FeeBlockNumber=12, FeeNumberOfWriteCycles=10000, FeeBlockId=12
      Fee_BsConst_TripComputer: FeeBlockNumber=15, FeeNumberOfWriteCycles=10000, FeeBlockId=15
      Fee_BsConst_Warning: FeeBlockNumber=18, FeeNumberOfWriteCycles=10000, FeeBlockId=18
      Fee_BsCys_Certicificate: FeeBlockNumber=31, FeeNumberOfWriteCycles=10000, FeeBlockId=31
      Fee_BsDiag_Dtc: FeeBlockNumber=60, FeeNumberOfWriteCycles=10000, FeeBlockId=60
      Fee_BsDiag_ErrorRecord: FeeBlockNumber=59, FeeNumberOfWriteCycles=10000, FeeBlockId=59
      Fee_BsFuSa_Audio: FeeBlockNumber=27, FeeNumberOfWriteCycles=10000, FeeBlockId=27
      Fee_BsFuSa_Communication: FeeBlockNumber=28, FeeNumberOfWriteCycles=10000, FeeBlockId=28
      Fee_BsFuSa_Config: FeeBlockNumber=30, FeeNumberOfWriteCycles=10000, FeeBlockId=30
      Fee_BsFuSa_Display: FeeBlockNumber=26, FeeNumberOfWriteCycles=10000, FeeBlockId=26
      Fee_BsFuSa_Power: FeeBlockNumber=25, FeeNumberOfWriteCycles=10000, FeeBlockId=25
      Fee_BsFuSa_Warning: FeeBlockNumber=24, FeeNumberOfWriteCycles=10000, FeeBlockId=24
      Fee_BsFusa_Fota: FeeBlockNumber=29, FeeNumberOfWriteCycles=10000, FeeBlockId=29
      Fee_BsReten_Audio: FeeBlockNumber=51, FeeNumberOfWriteCycles=10000, FeeBlockId=51
      Fee_BsReten_Communication: FeeBlockNumber=54, FeeNumberOfWriteCycles=10000, FeeBlockId=54
      Fee_BsReten_Display: FeeBlockNumber=58, FeeNumberOfWriteCycles=10000, FeeBlockId=58
      Fee_BsReten_Gauges: FeeBlockNumber=48, FeeNumberOfWriteCycles=10000, FeeBlockId=48
      Fee_BsReten_Illumination: FeeBlockNumber=50, FeeNumberOfWriteCycles=10000, FeeBlockId=50
      Fee_BsReten_Odometer: FeeBlockNumber=47, FeeNumberOfWriteCycles=10000, FeeBlockId=47
      Fee_BsReten_Personalization: FeeBlockNumber=55, FeeNumberOfWriteCycles=10000, FeeBlockId=55
      Fee_BsReten_Power: FeeBlockNumber=57, FeeNumberOfWriteCycles=10000, FeeBlockId=57
      Fee_BsReten_RealTimeClock: FeeBlockNumber=53, FeeNumberOfWriteCycles=10000, FeeBlockId=53
      Fee_BsReten_Tripcomputer: FeeBlockNumber=49, FeeNumberOfWriteCycles=10000, FeeBlockId=49
      Fee_BsReten_VisDlt: FeeBlockNumber=56, FeeNumberOfWriteCycles=10000, FeeBlockId=56
      Fee_BsReten_Warning: FeeBlockNumber=52, FeeNumberOfWriteCycles=10000, FeeBlockId=52
      Fee_BsRt_CusDlt: FeeBlockNumber=46, FeeNumberOfWriteCycles=10000, FeeBlockId=46
      Fee_BsRt_FuelGauge: FeeBlockNumber=37, FeeNumberOfWriteCycles=10000, FeeBlockId=37
      Fee_BsRt_Illumination: FeeBlockNumber=45, FeeNumberOfWriteCycles=10000, FeeBlockId=45
      Fee_BsRt_Odometer: FeeBlockNumber=34, FeeNumberOfWriteCycles=1000000, FeeBlockId=34
      Fee_BsRt_OilGauge: FeeBlockNumber=40, FeeNumberOfWriteCycles=10000, FeeBlockId=40
      Fee_BsRt_Personalization: FeeBlockNumber=44, FeeNumberOfWriteCycles=10000, FeeBlockId=44
      Fee_BsRt_PowerGauge: FeeBlockNumber=39, FeeNumberOfWriteCycles=10000, FeeBlockId=39
      Fee_BsRt_RealTimeClock: FeeBlockNumber=43, FeeNumberOfWriteCycles=10000, FeeBlockId=43
      Fee_BsRt_SpeedoGauge: FeeBlockNumber=35, FeeNumberOfWriteCycles=10000, FeeBlockId=35
      Fee_BsRt_TachoGauge: FeeBlockNumber=36, FeeNumberOfWriteCycles=10000, FeeBlockId=36
      Fee_BsRt_TempGauge: FeeBlockNumber=38, FeeNumberOfWriteCycles=10000, FeeBlockId=38
      Fee_BsRt_TripComputer: FeeBlockNumber=41, FeeNumberOfWriteCycles=10000, FeeBlockId=41
      Fee_BsRt_Warning: FeeBlockNumber=42, FeeNumberOfWriteCycles=10000, FeeBlockId=42
      Fee_BsShare_EcuPartNumber: FeeBlockNumber=6, FeeNumberOfWriteCycles=20000, FeeBlockId=6
      Fee_BsShare_SwUpdFotaFinPrint: FeeBlockNumber=3, FeeNumberOfWriteCycles=20000, FeeBlockId=3
      Fee_BsShare_SwUpdFotaMode: FeeBlockNumber=2, FeeNumberOfWriteCycles=10000, FeeBlockId=2
      Fee_BsShare_SwUpdFotaStatus: FeeBlockNumber=4, FeeNumberOfWriteCycles=20000, FeeBlockId=4
      Fee_BsShare_SwUpdFotadecrypt: FeeBlockNumber=5, FeeNumberOfWriteCycles=20000, FeeBlockId=5
      Fee_BsShare_SwUpdReflash: FeeBlockNumber=1, FeeNumberOfWriteCycles=10000, FeeBlockId=1
      Fee_BsShare_VehicleConfig: FeeBlockNumber=8, FeeNumberOfWriteCycles=10000, FeeBlockId=8
      Fee_BsShare_VisMeet: FeeBlockNumber=7, FeeNumberOfWriteCycles=10000, FeeBlockId=7
      Fee_RefCys_Certicificate: FeeBlockNumber=32, FeeNumberOfWriteCycles=10000, FeeBlockId=32
      Fee_RefCys_Certicificate1: FeeBlockNumber=33, FeeNumberOfWriteCycles=10000, FeeBlockId=33
  module config NvM: implementation-config-variant=VARIANT-PRE-COMPILE, module-description=NvM_Impl
    61 x NvMBlockDescriptor, all with NvMBlockCrcType=NVM_CRC16, NvMInitBlockCallback=NULL_PTR, NvMResistantToChangedSw=true, NvMSelectBlockForReadAll=true, NvMUseInitCallback=false, NvMBswMBlockStatusInformation=false, NvMCalcRamBlockCrc=false, NvMNvBlockNum=2, NvMBlockWriteProt=false, NvMRamBlockDataAddress=NULL_PTR, NvMWriteBlockOnce=false, NvMAutomaticBlockLength=false, NvMBlockLengthCheckType=true:
      NvBlockSwComponentTypeNVBlockDescriptor_BsConst_Audio: NvMBlockManagementType=NVM_BLOCK_NATIVE, NvMSelectBlockForWriteAll=false, NvMUseJobendCallback=true, NvMSingleBlockCallback=BsConst_Audio_NvM_JobFinished, NvMBlockUseCrc=, NvMBlockUseSyncMechanism=true, NvMUseServicePorts=true, NvMNvramBlockIdentifier=17, NvMNvBlockLength=128, NvMRomBlockDataAddress=Rte_NvBlockSwComponentType_NVBlockDescriptor_ClusterSettings_ROM_NVBlockDescriptor_BsConst_Audio, NvMBlockJobPriority=1, NvMReadRamBlockFromNvCallback=Rte_SetMirror_NvBlockSwComponentType_NVBlockDescriptor_BsConst_Audio, NvMWriteRamBlockToNvCallback=Rte_GetMirror_NvBlockSwComponentType_NVBlockDescriptor_BsConst_Audio, NvMBlockLengthCheck=true
        NvMTargetBlockReference
          NvMFeeRef: NvMNameOfFeeBlock=Fee_BsConst_Audio
      NvBlockSwComponentTypeNVBlockDescriptor_BsConst_Communication: NvMBlockManagementType=NVM_BLOCK_NATIVE, NvMSelectBlockForWriteAll=false, NvMUseJobendCallback=true, NvMSingleBlockCallback=BsConst_Communication_NvM_JobFinished, NvMBlockUseCrc=, NvMBlockUseSyncMechanism=true, NvMUseServicePorts=true, NvMNvramBlockIdentifier=20, NvMNvBlockLength=64, NvMRomBlockDataAddress=Rte_NvBlockSwComponentType_NVBlockDescriptor_ClusterSettings_ROM_NVBlockDescriptor_BsConst_Communication, NvMBlockJobPriority=1, NvMReadRamBlockFromNvCallback=Rte_SetMirror_NvBlockSwComponentType_NVBlockDescriptor_BsConst_Communication, NvMWriteRamBlockToNvCallback=Rte_GetMirror_NvBlockSwComponentType_NVBlockDescriptor_BsConst_Communication, NvMBlockLengthCheck=true
        NvMTargetBlockReference
          NvMFeeRef: NvMNameOfFeeBlock=Fee_BsConst_Communication
      NvBlockSwComponentTypeNVBlockDescriptor_BsConst_EngOffTimer: NvMBlockManagementType=NVM_BLOCK_NATIVE, NvMSelectBlockForWriteAll=false, NvMUseJobendCallback=true, NvMSingleBlockCallback=BsConst_EngOffTimer_NvM_JobFinished, NvMBlockUseCrc=, NvMBlockUseSyncMechanism=true, NvMUseServicePorts=true, NvMNvramBlockIdentifier=23, NvMNvBlockLength=32, NvMRomBlockDataAddress=Rte_NvBlockSwComponentType_NVBlockDescriptor_ClusterSettings_ROM_NVBlockDescriptor_BsConst_EngOffTimer, NvMBlockJobPriority=1, NvMReadRamBlockFromNvCallback=Rte_SetMirror_NvBlockSwComponentType_NVBlockDescriptor_BsConst_EngOffTimer, NvMWriteRamBlockToNvCallback=Rte_GetMirror_NvBlockSwComponentType_NVBlockDescriptor_BsConst_EngOffTimer, NvMBlockLengthCheck=true
        NvMTargetBlockReference
          NvMFeeRef: NvMNameOfFeeBlock=Fee_BsConst_EngOffTimer
      NvBlockSwComponentTypeNVBlockDescriptor_BsConst_FuelGauge: NvMBlockManagementType=NVM_BLOCK_NATIVE, NvMSelectBlockForWriteAll=false, NvMUseJobendCallback=true, NvMSingleBlockCallback=BsConst_FuelGauge_NvM_JobFinished, NvMBlockUseCrc=, NvMBlockUseSyncMechanism=true, NvMUseServicePorts=true, NvMNvramBlockIdentifier=11, NvMNvBlockLength=128, NvMRomBlockDataAddress=Rte_NvBlockSwComponentType_NVBlockDescriptor_ClusterSettings_ROM_NVBlockDescriptor_BsConst_FuelGauge, NvMBlockJobPriority=1, NvMReadRamBlockFromNvCallback=Rte_SetMirror_NvBlockSwComponentType_NVBlockDescriptor_BsConst_FuelGauge, NvMWriteRamBlockToNvCallback=Rte_GetMirror_NvBlockSwComponentType_NVBlockDescriptor_BsConst_FuelGauge, NvMBlockLengthCheck=true
        NvMTargetBlockReference
          NvMFeeRef: NvMNameOfFeeBlock=Fee_BsConst_FuelGauge
      NvBlockSwComponentTypeNVBlockDescriptor_BsConst_Illumination: NvMBlockManagementType=NVM_BLOCK_NATIVE, NvMSelectBlockForWriteAll=false, NvMUseJobendCallback=true, NvMSingleBlockCallback=BsConst_Illumination_NvM_JobFinished, NvMBlockUseCrc=, NvMBlockUseSyncMechanism=true, NvMUseServicePorts=true, NvMNvramBlockIdentifier=16, NvMNvBlockLength=128, NvMRomBlockDataAddress=Rte_NvBlockSwComponentType_NVBlockDescriptor_ClusterSettings_ROM_NVBlockDescriptor_BsConst_Illumination, NvMBlockJobPriority=1, NvMReadRamBlockFromNvCallback=Rte_SetMirror_NvBlockSwComponentType_NVBlockDescriptor_BsConst_Illumination, NvMWriteRamBlockToNvCallback=Rte_GetMirror_NvBlockSwComponentType_NVBlockDescriptor_BsConst_Illumination, NvMBlockLengthCheck=true
        NvMTargetBlockReference
          NvMFeeRef: NvMNameOfFeeBlock=Fee_BsConst_Illumination
      NvBlockSwComponentTypeNVBlockDescriptor_BsConst_OilGauge: NvMBlockManagementType=NVM_BLOCK_NATIVE, NvMSelectBlockForWriteAll=false, NvMUseJobendCallback=true, NvMSingleBlockCallback=BsConst_OilGauge_NvM_JobFinished, NvMBlockUseCrc=, NvMBlockUseSyncMechanism=true, NvMUseServicePorts=true, NvMNvramBlockIdentifier=14, NvMNvBlockLength=64, NvMRomBlockDataAddress=Rte_NvBlockSwComponentType_NVBlockDescriptor_ClusterSettings_ROM_NVBlockDescriptor_BsConst_OilGauge, NvMBlockJobPriority=1, NvMReadRamBlockFromNvCallback=Rte_SetMirror_NvBlockSwComponentType_NVBlockDescriptor_BsConst_OilGauge, NvMWriteRamBlockToNvCallback=Rte_GetMirror_NvBlockSwComponentType_NVBlockDescriptor_BsConst_OilGauge, NvMBlockLengthCheck=true
        NvMTargetBlockReference
          NvMFeeRef: NvMNameOfFeeBlock=Fee_BsConst_OilGauge
      NvBlockSwComponentTypeNVBlockDescriptor_BsConst_Power: NvMBlockManagementType=NVM_BLOCK_NATIVE, NvMSelectBlockForWriteAll=false, NvMUseJobendCallback=true, NvMSingleBlockCallback=BsConst_Power_NvM_JobFinished, NvMBlockUseCrc=, NvMBlockUseSyncMechanism=true, NvMUseServicePorts=true, NvMNvramBlockIdentifier=21, NvMNvBlockLength=32, NvMRomBlockDataAddress=Rte_NvBlockSwComponentType_NVBlockDescriptor_ClusterSettings_ROM_NVBlockDescriptor_BsConst_Power, NvMBlockJobPriority=1, NvMReadRamBlockFromNvCallback=Rte_SetMirror_NvBlockSwComponentType_NVBlockDescriptor_BsConst_Power, NvMWriteRamBlockToNvCallback=Rte_GetMirror_NvBlockSwComponentType_NVBlockDescriptor_BsConst_Power, NvMBlockLengthCheck=true
        NvMTargetBlockReference
          NvMFeeRef: NvMNameOfFeeBlock=Fee_BsConst_Power
      NvBlockSwComponentTypeNVBlockDescriptor_BsConst_PowerGauge: NvMBlockManagementType=NVM_BLOCK_NATIVE, NvMSelectBlockForWriteAll=false, NvMUseJobendCallback=true, NvMSingleBlockCallback=BsConst_PowerGauge_NvM_JobFinished, NvMBlockUseCrc=, NvMBlockUseSyncMechanism=true, NvMUseServicePorts=true, NvMNvramBlockIdentifier=13, NvMNvBlockLength=64, NvMRomBlockDataAddress=Rte_NvBlockSwComponentType_NVBlockDescriptor_ClusterSettings_ROM_NVBlockDescriptor_BsConst_PowerGauge, NvMBlockJobPriority=1, NvMReadRamBlockFromNvCallback=Rte_SetMirror_NvBlockSwComponentType_NVBlockDescriptor_BsConst_PowerGauge, NvMWriteRamBlockToNvCallback=Rte_GetMirror_NvBlockSwComponentType_NVBlockDescriptor_BsConst_PowerGauge, NvMBlockLengthCheck=true
        NvMTargetBlockReference
          NvMFeeRef: NvMNameOfFeeBlock=Fee_BsConst_PowerGauge
      NvBlockSwComponentTypeNVBlockDescriptor_BsConst_RealTimeClock: NvMBlockManagementType=NVM_BLOCK_NATIVE, NvMSelectBlockForWriteAll=false, NvMUseJobendCallback=true, NvMSingleBlockCallback=BsConst_RealTimeClock_NvM_JobFinished, NvMBlockUseCrc=, NvMBlockUseSyncMechanism=true, NvMUseServicePorts=true, NvMNvramBlockIdentifier=19, NvMNvBlockLength=48, NvMRomBlockDataAddress=Rte_NvBlockSwComponentType_NVBlockDescriptor_ClusterSettings_ROM_NVBlockDescriptor_BsConst_RealTimeClock, NvMBlockJobPriority=1, NvMReadRamBlockFromNvCallback=Rte_SetMirror_NvBlockSwComponentType_NVBlockDescriptor_BsConst_RealTimeClock, NvMWriteRamBlockToNvCallback=Rte_GetMirror_NvBlockSwComponentType_NVBlockDescriptor_BsConst_RealTimeClock, NvMBlockLengthCheck=true
        NvMTargetBlockReference
          NvMFeeRef: NvMNameOfFeeBlock=Fee_BsConst_RealTimeClock
      NvBlockSwComponentTypeNVBlockDescriptor_BsConst_ServiceReminder: NvMBlockManagementType=NVM_BLOCK_NATIVE, NvMSelectBlockForWriteAll=false, NvMUseJobendCallback=true, NvMSingleBlockCallback=BsConst_ServiceReminder_NvM_JobFinished, NvMBlockUseCrc=, NvMBlockUseSyncMechanism=true, NvMUseServicePorts=true, NvMNvramBlockIdentifier=22, NvMNvBlockLength=48, NvMRomBlockDataAddress=Rte_NvBlockSwComponentType_NVBlockDescriptor_ClusterSettings_ROM_NVBlockDescriptor_BsConst_ServiceReminder, NvMBlockJobPriority=1, NvMReadRamBlockFromNvCallback=Rte_SetMirror_NvBlockSwComponentType_NVBlockDescriptor_BsConst_ServiceReminder, NvMWriteRamBlockToNvCallback=Rte_GetMirror_NvBlockSwComponentType_NVBlockDescriptor_BsConst_ServiceReminder, NvMBlockLengthCheck=true
        NvMTargetBlockReference
          NvMFeeRef: NvMNameOfFeeBlock=Fee_BsConst_ServiceReminder
      NvBlockSwComponentTypeNVBlockDescriptor_BsConst_SpeedoGauge: NvMBlockManagementType=NVM_BLOCK_NATIVE, NvMSelectBlockForWriteAll=false, NvMUseJobendCallback=true, NvMSingleBlockCallback=BsConst_SpeedoGauge_NvM_JobFinished, NvMBlockUseCrc=, NvMBlockUseSyncMechanism=true, NvMUseServicePorts=true, NvMNvramBlockIdentifier=9, NvMNvBlockLength=64, NvMRomBlockDataAddress=Rte_NvBlockSwComponentType_NVBlockDescriptor_ClusterSettings_ROM_NVBlockDescriptor_BsConst_SpeedoGauge, NvMBlockJobPriority=1, NvMReadRamBlockFromNvCallback=Rte_SetMirror_NvBlockSwComponentType_NVBlockDescriptor_BsConst_SpeedoGauge, NvMWriteRamBlockToNvCallback=Rte_GetMirror_NvBlockSwComponentType_NVBlockDescriptor_BsConst_SpeedoGauge, NvMBlockLengthCheck=true
        NvMTargetBlockReference
          NvMFeeRef: NvMNameOfFeeBlock=Fee_BsConst_SpeedoGauge
      NvBlockSwComponentTypeNVBlockDescriptor_BsConst_TachoGauge: NvMBlockManagementType=NVM_BLOCK_NATIVE, NvMSelectBlockForWriteAll=false, NvMUseJobendCallback=true, NvMSingleBlockCallback=BsConst_TachoGauge_NvM_JobFinished, NvMBlockUseCrc=, NvMBlockUseSyncMechanism=true, NvMUseServicePorts=true, NvMNvramBlockIdentifier=10, NvMNvBlockLength=64, NvMRomBlockDataAddress=Rte_NvBlockSwComponentType_NVBlockDescriptor_ClusterSettings_ROM_NVBlockDescriptor_BsConst_TachoGauge, NvMBlockJobPriority=1, NvMReadRamBlockFromNvCallback=Rte_SetMirror_NvBlockSwComponentType_NVBlockDescriptor_BsConst_TachoGauge, NvMWriteRamBlockToNvCallback=Rte_GetMirror_NvBlockSwComponentType_NVBlockDescriptor_BsConst_TachoGauge, NvMBlockLengthCheck=true
        NvMTargetBlockReference
          NvMFeeRef: NvMNameOfFeeBlock=Fee_BsConst_TachoGauge
      NvBlockSwComponentTypeNVBlockDescriptor_BsConst_TempGauge: NvMBlockManagementType=NVM_BLOCK_NATIVE, NvMSelectBlockForWriteAll=false, NvMUseJobendCallback=true, NvMSingleBlockCallback=BsConst_TempGauge_NvM_JobFinished, NvMBlockUseCrc=, NvMBlockUseSyncMechanism=true, NvMUseServicePorts=true, NvMNvramBlockIdentifier=12, NvMNvBlockLength=64, NvMRomBlockDataAddress=Rte_NvBlockSwComponentType_NVBlockDescriptor_ClusterSettings_ROM_NVBlockDescriptor_BsConst_TempGauge, NvMBlockJobPriority=1, NvMReadRamBlockFromNvCallback=Rte_SetMirror_NvBlockSwComponentType_NVBlockDescriptor_BsConst_TempGauge, NvMWriteRamBlockToNvCallback=Rte_GetMirror_NvBlockSwComponentType_NVBlockDescriptor_BsConst_TempGauge, NvMBlockLengthCheck=true
        NvMTargetBlockReference
          NvMFeeRef: NvMNameOfFeeBlock=Fee_BsConst_TempGauge
      NvBlockSwComponentTypeNVBlockDescriptor_BsConst_TripComputer: NvMBlockManagementType=NVM_BLOCK_NATIVE, NvMSelectBlockForWriteAll=false, NvMUseJobendCallback=true, NvMSingleBlockCallback=BsConst_TripComputer_NvM_JobFinished, NvMBlockUseCrc=, NvMBlockUseSyncMechanism=true, NvMUseServicePorts=true, NvMNvramBlockIdentifier=15, NvMNvBlockLength=64, NvMRomBlockDataAddress=Rte_NvBlockSwComponentType_NVBlockDescriptor_ClusterSettings_ROM_NVBlockDescriptor_BsConst_TripComputer, NvMBlockJobPriority=1, NvMReadRamBlockFromNvCallback=Rte_SetMirror_NvBlockSwComponentType_NVBlockDescriptor_BsConst_TripComputer, NvMWriteRamBlockToNvCallback=Rte_GetMirror_NvBlockSwComponentType_NVBlockDescriptor_BsConst_TripComputer, NvMBlockLengthCheck=true
        NvMTargetBlockReference
          NvMFeeRef: NvMNameOfFeeBlock=Fee_BsConst_TripComputer
      NvBlockSwComponentTypeNVBlockDescriptor_BsConst_Warning: NvMBlockManagementType=NVM_BLOCK_NATIVE, NvMSelectBlockForWriteAll=false, NvMUseJobendCallback=true, NvMSingleBlockCallback=BsConst_Warning_NvM_JobFinished, NvMBlockUseCrc=, NvMBlockUseSyncMechanism=true, NvMUseServicePorts=true, NvMNvramBlockIdentifier=18, NvMNvBlockLength=64, NvMRomBlockDataAddress=Rte_NvBlockSwComponentType_NVBlockDescriptor_ClusterSettings_ROM_NVBlockDescriptor_BsConst_Warning, NvMBlockJobPriority=1, NvMReadRamBlockFromNvCallback=Rte_SetMirror_NvBlockSwComponentType_NVBlockDescriptor_BsConst_Warning, NvMWriteRamBlockToNvCallback=Rte_GetMirror_NvBlockSwComponentType_NVBlockDescriptor_BsConst_Warning, NvMBlockLengthCheck=true
        NvMTargetBlockReference
          NvMFeeRef: NvMNameOfFeeBlock=Fee_BsConst_Warning
      NvBlockSwComponentTypeNVBlockDescriptor_BsCys_Certicificate: NvMBlockManagementType=NVM_BLOCK_REDUNDANT, NvMSelectBlockForWriteAll=false, NvMUseJobendCallback=true, NvMSingleBlockCallback=BsCys_Certicificate_NvM_JobFinished, NvMBlockUseCrc=, NvMBlockUseSyncMechanism=true, NvMUseServicePorts=true, NvMNvramBlockIdentifier=31, NvMNvBlockLength=64, NvMRomBlockDataAddress=Rte_NvBlockSwComponentType_NVBlockDescriptor_ClusterSettings_ROM_NVBlockDescriptor_BsCys_Certicificate, NvMBlockJobPriority=1, NvMReadRamBlockFromNvCallback=Rte_SetMirror_NvBlockSwComponentType_NVBlockDescriptor_BsCys_Certicificate, NvMWriteRamBlockToNvCallback=Rte_GetMirror_NvBlockSwComponentType_NVBlockDescriptor_BsCys_Certicificate, NvMBlockLengthCheck=true
        NvMTargetBlockReference
          NvMFeeRef: NvMNameOfFeeBlock=Fee_BsCys_Certicificate
      NvBlockSwComponentTypeNVBlockDescriptor_BsDiag_Dtc: NvMBlockManagementType=NVM_BLOCK_REDUNDANT, NvMSelectBlockForWriteAll=false, NvMUseJobendCallback=true, NvMSingleBlockCallback=BsDiag_Dtc_NvM_JobFinished, NvMBlockUseCrc=, NvMBlockUseSyncMechanism=true, NvMUseServicePorts=true, NvMNvramBlockIdentifier=60, NvMNvBlockLength=2048, NvMRomBlockDataAddress=Rte_NvBlockSwComponentType_NVBlockDescriptor_ClusterSettings_ROM_NVBlockDescriptor_BsDiag_Dtc, NvMBlockJobPriority=1, NvMReadRamBlockFromNvCallback=Rte_SetMirror_NvBlockSwComponentType_NVBlockDescriptor_BsDiag_Dtc, NvMWriteRamBlockToNvCallback=Rte_GetMirror_NvBlockSwComponentType_NVBlockDescriptor_BsDiag_Dtc, NvMBlockLengthCheck=true
        NvMTargetBlockReference
          NvMFeeRef: NvMNameOfFeeBlock=Fee_BsDiag_Dtc
      NvBlockSwComponentTypeNVBlockDescriptor_BsDiag_ErrorRecord: NvMBlockManagementType=NVM_BLOCK_REDUNDANT, NvMSelectBlockForWriteAll=false, NvMUseJobendCallback=true, NvMSingleBlockCallback=BsDiag_ErrorRecord_NvM_JobFinished, NvMBlockUseCrc=, NvMBlockUseSyncMechanism=true, NvMUseServicePorts=true, NvMNvramBlockIdentifier=59, NvMNvBlockLength=1024, NvMRomBlockDataAddress=Rte_NvBlockSwComponentType_NVBlockDescriptor_ClusterSettings_ROM_NVBlockDescriptor_BsDiag_ErrorRecord, NvMBlockJobPriority=1, NvMReadRamBlockFromNvCallback=Rte_SetMirror_NvBlockSwComponentType_NVBlockDescriptor_BsDiag_ErrorRecord, NvMWriteRamBlockToNvCallback=Rte_GetMirror_NvBlockSwComponentType_NVBlockDescriptor_BsDiag_ErrorRecord, NvMBlockLengthCheck=true
        NvMTargetBlockReference
          NvMFeeRef: NvMNameOfFeeBlock=Fee_BsDiag_ErrorRecord
      NvBlockSwComponentTypeNVBlockDescriptor_BsFuSa_Audio: NvMBlockManagementType=NVM_BLOCK_REDUNDANT, NvMSelectBlockForWriteAll=false, NvMUseJobendCallback=true, NvMSingleBlockCallback=BsFuSa_Audio_NvM_JobFinished, NvMBlockUseCrc=, NvMBlockUseSyncMechanism=true, NvMUseServicePorts=true, NvMNvramBlockIdentifier=27, NvMNvBlockLength=32, NvMRomBlockDataAddress=Rte_NvBlockSwComponentType_NVBlockDescriptor_ClusterSettings_ROM_NVBlockDescriptor_BsFuSa_Audio, NvMBlockJobPriority=1, NvMReadRamBlockFromNvCallback=Rte_SetMirror_NvBlockSwComponentType_NVBlockDescriptor_BsFuSa_Audio, NvMWriteRamBlockToNvCallback=Rte_GetMirror_NvBlockSwComponentType_NVBlockDescriptor_BsFuSa_Audio, NvMBlockLengthCheck=true
        NvMTargetBlockReference
          NvMFeeRef: NvMNameOfFeeBlock=Fee_BsFuSa_Audio
      NvBlockSwComponentTypeNVBlockDescriptor_BsFuSa_Communication: NvMBlockManagementType=NVM_BLOCK_REDUNDANT, NvMSelectBlockForWriteAll=false, NvMUseJobendCallback=true, NvMSingleBlockCallback=BsFuSa_Communication_NvM_JobFinished, NvMBlockUseCrc=, NvMBlockUseSyncMechanism=true, NvMUseServicePorts=true, NvMNvramBlockIdentifier=28, NvMNvBlockLength=16, NvMRomBlockDataAddress=Rte_NvBlockSwComponentType_NVBlockDescriptor_ClusterSettings_ROM_NVBlockDescriptor_BsFuSa_Communication, NvMBlockJobPriority=1, NvMReadRamBlockFromNvCallback=Rte_SetMirror_NvBlockSwComponentType_NVBlockDescriptor_BsFuSa_Communication, NvMWriteRamBlockToNvCallback=Rte_GetMirror_NvBlockSwComponentType_NVBlockDescriptor_BsFuSa_Communication, NvMBlockLengthCheck=true
        NvMTargetBlockReference
          NvMFeeRef: NvMNameOfFeeBlock=Fee_BsFuSa_Communication
      NvBlockSwComponentTypeNVBlockDescriptor_BsFuSa_Config: NvMBlockManagementType=NVM_BLOCK_REDUNDANT, NvMSelectBlockForWriteAll=false, NvMUseJobendCallback=true, NvMSingleBlockCallback=BsFuSa_Config_NvM_JobFinished, NvMBlockUseCrc=, NvMBlockUseSyncMechanism=true, NvMUseServicePorts=true, NvMNvramBlockIdentifier=30, NvMNvBlockLength=16, NvMRomBlockDataAddress=Rte_NvBlockSwComponentType_NVBlockDescriptor_ClusterSettings_ROM_NVBlockDescriptor_BsFuSa_Config, NvMBlockJobPriority=1, NvMReadRamBlockFromNvCallback=Rte_SetMirror_NvBlockSwComponentType_NVBlockDescriptor_BsFuSa_Config, NvMWriteRamBlockToNvCallback=Rte_GetMirror_NvBlockSwComponentType_NVBlockDescriptor_BsFuSa_Config, NvMBlockLengthCheck=true
        NvMTargetBlockReference
          NvMFeeRef: NvMNameOfFeeBlock=Fee_BsFuSa_Config
      NvBlockSwComponentTypeNVBlockDescriptor_BsFuSa_Display: NvMBlockManagementType=NVM_BLOCK_REDUNDANT, NvMSelectBlockForWriteAll=false, NvMUseJobendCallback=true, NvMSingleBlockCallback=BsFuSa_Display_NvM_JobFinished, NvMBlockUseCrc=, NvMBlockUseSyncMechanism=true, NvMUseServicePorts=true, NvMNvramBlockIdentifier=26, NvMNvBlockLength=64, NvMRomBlockDataAddress=Rte_NvBlockSwComponentType_NVBlockDescriptor_ClusterSettings_ROM_NVBlockDescriptor_BsFuSa_Display, NvMBlockJobPriority=1, NvMReadRamBlockFromNvCallback=Rte_SetMirror_NvBlockSwComponentType_NVBlockDescriptor_BsFuSa_Display, NvMWriteRamBlockToNvCallback=Rte_GetMirror_NvBlockSwComponentType_NVBlockDescriptor_BsFuSa_Display, NvMBlockLengthCheck=true
        NvMTargetBlockReference
          NvMFeeRef: NvMNameOfFeeBlock=Fee_BsFuSa_Display
      NvBlockSwComponentTypeNVBlockDescriptor_BsFuSa_Power: NvMBlockManagementType=NVM_BLOCK_REDUNDANT, NvMSelectBlockForWriteAll=false, NvMUseJobendCallback=true, NvMSingleBlockCallback=BsFuSa_Power_NvM_JobFinished, NvMBlockUseCrc=, NvMBlockUseSyncMechanism=true, NvMUseServicePorts=true, NvMNvramBlockIdentifier=25, NvMNvBlockLength=48, NvMRomBlockDataAddress=Rte_NvBlockSwComponentType_NVBlockDescriptor_ClusterSettings_ROM_NVBlockDescriptor_BsFuSa_Power, NvMBlockJobPriority=1, NvMReadRamBlockFromNvCallback=Rte_SetMirror_NvBlockSwComponentType_NVBlockDescriptor_BsFuSa_Power, NvMWriteRamBlockToNvCallback=Rte_GetMirror_NvBlockSwComponentType_NVBlockDescriptor_BsFuSa_Power, NvMBlockLengthCheck=true
        NvMTargetBlockReference
          NvMFeeRef: NvMNameOfFeeBlock=Fee_BsFuSa_Power
      NvBlockSwComponentTypeNVBlockDescriptor_BsFuSa_Warning: NvMBlockManagementType=NVM_BLOCK_REDUNDANT, NvMSelectBlockForWriteAll=false, NvMUseJobendCallback=true, NvMSingleBlockCallback=BsFuSa_Warning_NvM_JobFinished, NvMBlockUseCrc=, NvMBlockUseSyncMechanism=true, NvMUseServicePorts=true, NvMNvramBlockIdentifier=24, NvMNvBlockLength=32, NvMRomBlockDataAddress=Rte_NvBlockSwComponentType_NVBlockDescriptor_ClusterSettings_ROM_NVBlockDescriptor_BsFuSa_Warning, NvMBlockJobPriority=1, NvMReadRamBlockFromNvCallback=Rte_SetMirror_NvBlockSwComponentType_NVBlockDescriptor_BsFuSa_Warning, NvMWriteRamBlockToNvCallback=Rte_GetMirror_NvBlockSwComponentType_NVBlockDescriptor_BsFuSa_Warning, NvMBlockLengthCheck=true
        NvMTargetBlockReference
          NvMFeeRef: NvMNameOfFeeBlock=Fee_BsFuSa_Warning
      NvBlockSwComponentTypeNVBlockDescriptor_BsFusa_Fota: NvMBlockManagementType=NVM_BLOCK_REDUNDANT, NvMSelectBlockForWriteAll=false, NvMUseJobendCallback=true, NvMSingleBlockCallback=BsFusa_Fota_NvM_JobFinished, NvMBlockUseCrc=, NvMBlockUseSyncMechanism=true, NvMUseServicePorts=true, NvMNvramBlockIdentifier=29, NvMNvBlockLength=32, NvMRomBlockDataAddress=Rte_NvBlockSwComponentType_NVBlockDescriptor_ClusterSettings_ROM_NVBlockDescriptor_BsFusa_Fota, NvMBlockJobPriority=1, NvMReadRamBlockFromNvCallback=Rte_SetMirror_NvBlockSwComponentType_NVBlockDescriptor_BsFusa_Fota, NvMWriteRamBlockToNvCallback=Rte_GetMirror_NvBlockSwComponentType_NVBlockDescriptor_BsFusa_Fota, NvMBlockLengthCheck=true
        NvMTargetBlockReference
          NvMFeeRef: NvMNameOfFeeBlock=Fee_BsFusa_Fota
      NvBlockSwComponentTypeNVBlockDescriptor_BsReten_Audio: NvMBlockManagementType=NVM_BLOCK_REDUNDANT, NvMSelectBlockForWriteAll=false, NvMUseJobendCallback=true, NvMSingleBlockCallback=BsReten_Audio_NvM_JobFinished, NvMBlockUseCrc=, NvMBlockUseSyncMechanism=true, NvMUseServicePorts=true, NvMNvramBlockIdentifier=51, NvMNvBlockLength=100, NvMRomBlockDataAddress=Rte_NvBlockSwComponentType_NVBlockDescriptor_ClusterSettings_ROM_NVBlockDescriptor_BsReten_Audio, NvMBlockJobPriority=1, NvMReadRamBlockFromNvCallback=Rte_SetMirror_NvBlockSwComponentType_NVBlockDescriptor_BsReten_Audio, NvMWriteRamBlockToNvCallback=Rte_GetMirror_NvBlockSwComponentType_NVBlockDescriptor_BsReten_Audio, NvMBlockLengthCheck=true
        NvMTargetBlockReference
          NvMFeeRef: NvMNameOfFeeBlock=Fee_BsReten_Audio
      NvBlockSwComponentTypeNVBlockDescriptor_BsReten_Communication: NvMBlockManagementType=NVM_BLOCK_REDUNDANT, NvMSelectBlockForWriteAll=false, NvMUseJobendCallback=true, NvMSingleBlockCallback=BsReten_Communication_NvM_JobFinished, NvMBlockUseCrc=, NvMBlockUseSyncMechanism=true, NvMUseServicePorts=true, NvMNvramBlockIdentifier=54, NvMNvBlockLength=100, NvMRomBlockDataAddress=Rte_NvBlockSwComponentType_NVBlockDescriptor_ClusterSettings_ROM_NVBlockDescriptor_BsReten_Communication, NvMBlockJobPriority=1, NvMReadRamBlockFromNvCallback=Rte_SetMirror_NvBlockSwComponentType_NVBlockDescriptor_BsReten_Communication, NvMWriteRamBlockToNvCallback=Rte_GetMirror_NvBlockSwComponentType_NVBlockDescriptor_BsReten_Communication, NvMBlockLengthCheck=true
        NvMTargetBlockReference
          NvMFeeRef: NvMNameOfFeeBlock=Fee_BsReten_Communication
      NvBlockSwComponentTypeNVBlockDescriptor_BsReten_Display: NvMBlockManagementType=NVM_BLOCK_REDUNDANT, NvMSelectBlockForWriteAll=false, NvMUseJobendCallback=true, NvMSingleBlockCallback=BsReten_Display_NvM_JobFinished, NvMBlockUseCrc=, NvMBlockUseSyncMechanism=true, NvMUseServicePorts=true, NvMNvramBlockIdentifier=58, NvMNvBlockLength=100, NvMRomBlockDataAddress=Rte_NvBlockSwComponentType_NVBlockDescriptor_ClusterSettings_ROM_NVBlockDescriptor_BsReten_Display, NvMBlockJobPriority=1, NvMReadRamBlockFromNvCallback=Rte_SetMirror_NvBlockSwComponentType_NVBlockDescriptor_BsReten_Display, NvMWriteRamBlockToNvCallback=Rte_GetMirror_NvBlockSwComponentType_NVBlockDescriptor_BsReten_Display, NvMBlockLengthCheck=true
        NvMTargetBlockReference
          NvMFeeRef: NvMNameOfFeeBlock=Fee_BsReten_Display
      NvBlockSwComponentTypeNVBlockDescriptor_BsReten_Gauges: NvMBlockManagementType=NVM_BLOCK_REDUNDANT, NvMSelectBlockForWriteAll=false, NvMUseJobendCallback=true, NvMSingleBlockCallback=BsReten_Gauges_NvM_JobFinished, NvMBlockUseCrc=, NvMBlockUseSyncMechanism=true, NvMUseServicePorts=true, NvMNvramBlockIdentifier=48, NvMNvBlockLength=100, NvMRomBlockDataAddress=Rte_NvBlockSwComponentType_NVBlockDescriptor_ClusterSettings_ROM_NVBlockDescriptor_BsReten_Gauges, NvMBlockJobPriority=1, NvMReadRamBlockFromNvCallback=Rte_SetMirror_NvBlockSwComponentType_NVBlockDescriptor_BsReten_Gauges, NvMWriteRamBlockToNvCallback=Rte_GetMirror_NvBlockSwComponentType_NVBlockDescriptor_BsReten_Gauges, NvMBlockLengthCheck=true
        NvMTargetBlockReference
          NvMFeeRef: NvMNameOfFeeBlock=Fee_BsReten_Gauges
      NvBlockSwComponentTypeNVBlockDescriptor_BsReten_Illumination: NvMBlockManagementType=NVM_BLOCK_REDUNDANT, NvMSelectBlockForWriteAll=false, NvMUseJobendCallback=true, NvMSingleBlockCallback=BsReten_Illumination_NvM_JobFinished, NvMBlockUseCrc=, NvMBlockUseSyncMechanism=true, NvMUseServicePorts=true, NvMNvramBlockIdentifier=50, NvMNvBlockLength=100, NvMRomBlockDataAddress=Rte_NvBlockSwComponentType_NVBlockDescriptor_ClusterSettings_ROM_NVBlockDescriptor_BsReten_Illumination, NvMBlockJobPriority=1, NvMReadRamBlockFromNvCallback=Rte_SetMirror_NvBlockSwComponentType_NVBlockDescriptor_BsReten_Illumination, NvMWriteRamBlockToNvCallback=Rte_GetMirror_NvBlockSwComponentType_NVBlockDescriptor_BsReten_Illumination, NvMBlockLengthCheck=true
        NvMTargetBlockReference
          NvMFeeRef: NvMNameOfFeeBlock=Fee_BsReten_Illumination
      NvBlockSwComponentTypeNVBlockDescriptor_BsReten_Odometer: NvMBlockManagementType=NVM_BLOCK_REDUNDANT, NvMSelectBlockForWriteAll=false, NvMUseJobendCallback=true, NvMSingleBlockCallback=BsReten_Odometer_NvM_JobFinished, NvMBlockUseCrc=, NvMBlockUseSyncMechanism=true, NvMUseServicePorts=true, NvMNvramBlockIdentifier=47, NvMNvBlockLength=100, NvMRomBlockDataAddress=Rte_NvBlockSwComponentType_NVBlockDescriptor_ClusterSettings_ROM_NVBlockDescriptor_BsReten_Odometer, NvMBlockJobPriority=1, NvMReadRamBlockFromNvCallback=Rte_SetMirror_NvBlockSwComponentType_NVBlockDescriptor_BsReten_Odometer, NvMWriteRamBlockToNvCallback=Rte_GetMirror_NvBlockSwComponentType_NVBlockDescriptor_BsReten_Odometer, NvMBlockLengthCheck=true
        NvMTargetBlockReference
          NvMFeeRef: NvMNameOfFeeBlock=Fee_BsReten_Odometer
      NvBlockSwComponentTypeNVBlockDescriptor_BsReten_Personalization: NvMBlockManagementType=NVM_BLOCK_REDUNDANT, NvMSelectBlockForWriteAll=false, NvMUseJobendCallback=true, NvMSingleBlockCallback=BsReten_Personalization_NvM_JobFinished, NvMBlockUseCrc=, NvMBlockUseSyncMechanism=true, NvMUseServicePorts=true, NvMNvramBlockIdentifier=55, NvMNvBlockLength=100, NvMRomBlockDataAddress=Rte_NvBlockSwComponentType_NVBlockDescriptor_ClusterSettings_ROM_NVBlockDescriptor_BsReten_Personalization, NvMBlockJobPriority=1, NvMReadRamBlockFromNvCallback=Rte_SetMirror_NvBlockSwComponentType_NVBlockDescriptor_BsReten_Personalization, NvMWriteRamBlockToNvCallback=Rte_GetMirror_NvBlockSwComponentType_NVBlockDescriptor_BsReten_Personalization, NvMBlockLengthCheck=true
        NvMTargetBlockReference
          NvMFeeRef: NvMNameOfFeeBlock=Fee_BsReten_Personalization
      NvBlockSwComponentTypeNVBlockDescriptor_BsReten_Power: NvMBlockManagementType=NVM_BLOCK_REDUNDANT, NvMSelectBlockForWriteAll=false, NvMUseJobendCallback=true, NvMSingleBlockCallback=BsReten_Power_NvM_JobFinished, NvMBlockUseCrc=, NvMBlockUseSyncMechanism=true, NvMUseServicePorts=true, NvMNvramBlockIdentifier=57, NvMNvBlockLength=100, NvMRomBlockDataAddress=Rte_NvBlockSwComponentType_NVBlockDescriptor_ClusterSettings_ROM_NVBlockDescriptor_BsReten_Power, NvMBlockJobPriority=1, NvMReadRamBlockFromNvCallback=Rte_SetMirror_NvBlockSwComponentType_NVBlockDescriptor_BsReten_Power, NvMWriteRamBlockToNvCallback=Rte_GetMirror_NvBlockSwComponentType_NVBlockDescriptor_BsReten_Power, NvMBlockLengthCheck=true
        NvMTargetBlockReference
          NvMFeeRef: NvMNameOfFeeBlock=Fee_BsReten_Power
      NvBlockSwComponentTypeNVBlockDescriptor_BsReten_RealTimeClock: NvMBlockManagementType=NVM_BLOCK_REDUNDANT, NvMSelectBlockForWriteAll=false, NvMUseJobendCallback=true, NvMSingleBlockCallback=BsReten_RealTimeClock_NvM_JobFinished, NvMBlockUseCrc=, NvMBlockUseSyncMechanism=true, NvMUseServicePorts=true, NvMNvramBlockIdentifier=53, NvMNvBlockLength=100, NvMRomBlockDataAddress=Rte_NvBlockSwComponentType_NVBlockDescriptor_ClusterSettings_ROM_NVBlockDescriptor_BsReten_RealTimeClock, NvMBlockJobPriority=1, NvMReadRamBlockFromNvCallback=Rte_SetMirror_NvBlockSwComponentType_NVBlockDescriptor_BsReten_RealTimeClock, NvMWriteRamBlockToNvCallback=Rte_GetMirror_NvBlockSwComponentType_NVBlockDescriptor_BsReten_RealTimeClock, NvMBlockLengthCheck=true
        NvMTargetBlockReference
          NvMFeeRef: NvMNameOfFeeBlock=Fee_BsReten_RealTimeClock
      NvBlockSwComponentTypeNVBlockDescriptor_BsReten_Tripcomputer: NvMBlockManagementType=NVM_BLOCK_REDUNDANT, NvMSelectBlockForWriteAll=false, NvMUseJobendCallback=true, NvMSingleBlockCallback=BsReten_Tripcomputer_NvM_JobFinished, NvMBlockUseCrc=, NvMBlockUseSyncMechanism=true, NvMUseServicePorts=true, NvMNvramBlockIdentifier=49, NvMNvBlockLength=100, NvMRomBlockDataAddress=Rte_NvBlockSwComponentType_NVBlockDescriptor_ClusterSettings_ROM_NVBlockDescriptor_BsReten_Tripcomputer, NvMBlockJobPriority=1, NvMReadRamBlockFromNvCallback=Rte_SetMirror_NvBlockSwComponentType_NVBlockDescriptor_BsReten_Tripcomputer, NvMWriteRamBlockToNvCallback=Rte_GetMirror_NvBlockSwComponentType_NVBlockDescriptor_BsReten_Tripcomputer, NvMBlockLengthCheck=true
        NvMTargetBlockReference
          NvMFeeRef: NvMNameOfFeeBlock=Fee_BsReten_Tripcomputer
      NvBlockSwComponentTypeNVBlockDescriptor_BsReten_VisDlt: NvMBlockManagementType=NVM_BLOCK_REDUNDANT, NvMSelectBlockForWriteAll=false, NvMUseJobendCallback=true, NvMSingleBlockCallback=BsReten_VisDlt_NvM_JobFinished, NvMBlockUseCrc=, NvMBlockUseSyncMechanism=true, NvMUseServicePorts=true, NvMNvramBlockIdentifier=56, NvMNvBlockLength=256, NvMRomBlockDataAddress=Rte_NvBlockSwComponentType_NVBlockDescriptor_ClusterSettings_ROM_NVBlockDescriptor_BsReten_VisDlt, NvMBlockJobPriority=1, NvMReadRamBlockFromNvCallback=Rte_SetMirror_NvBlockSwComponentType_NVBlockDescriptor_BsReten_VisDlt, NvMWriteRamBlockToNvCallback=Rte_GetMirror_NvBlockSwComponentType_NVBlockDescriptor_BsReten_VisDlt, NvMBlockLengthCheck=true
        NvMTargetBlockReference
          NvMFeeRef: NvMNameOfFeeBlock=Fee_BsReten_VisDlt
      NvBlockSwComponentTypeNVBlockDescriptor_BsReten_Warning: NvMBlockManagementType=NVM_BLOCK_REDUNDANT, NvMSelectBlockForWriteAll=false, NvMUseJobendCallback=true, NvMSingleBlockCallback=BsReten_Warning_NvM_JobFinished, NvMBlockUseCrc=, NvMBlockUseSyncMechanism=true, NvMUseServicePorts=true, NvMNvramBlockIdentifier=52, NvMNvBlockLength=100, NvMRomBlockDataAddress=Rte_NvBlockSwComponentType_NVBlockDescriptor_ClusterSettings_ROM_NVBlockDescriptor_BsReten_Warning, NvMBlockJobPriority=1, NvMReadRamBlockFromNvCallback=Rte_SetMirror_NvBlockSwComponentType_NVBlockDescriptor_BsReten_Warning, NvMWriteRamBlockToNvCallback=Rte_GetMirror_NvBlockSwComponentType_NVBlockDescriptor_BsReten_Warning, NvMBlockLengthCheck=true
        NvMTargetBlockReference
          NvMFeeRef: NvMNameOfFeeBlock=Fee_BsReten_Warning
      NvBlockSwComponentTypeNVBlockDescriptor_BsRt_CusDlt: NvMBlockManagementType=NVM_BLOCK_REDUNDANT, NvMSelectBlockForWriteAll=false, NvMUseJobendCallback=true, NvMSingleBlockCallback=BsRt_CusDlt_NvM_JobFinished, NvMBlockUseCrc=, NvMBlockUseSyncMechanism=true, NvMUseServicePorts=true, NvMNvramBlockIdentifier=46, NvMNvBlockLength=128, NvMRomBlockDataAddress=Rte_NvBlockSwComponentType_NVBlockDescriptor_ClusterSettings_ROM_NVBlockDescriptor_BsRt_CusDlt, NvMBlockJobPriority=1, NvMReadRamBlockFromNvCallback=Rte_SetMirror_NvBlockSwComponentType_NVBlockDescriptor_BsRt_CusDlt, NvMWriteRamBlockToNvCallback=Rte_GetMirror_NvBlockSwComponentType_NVBlockDescriptor_BsRt_CusDlt, NvMBlockLengthCheck=true
        NvMTargetBlockReference
          NvMFeeRef: NvMNameOfFeeBlock=Fee_BsRt_CusDlt
      NvBlockSwComponentTypeNVBlockDescriptor_BsRt_FuelGauge: NvMBlockManagementType=NVM_BLOCK_REDUNDANT, NvMSelectBlockForWriteAll=false, NvMUseJobendCallback=true, NvMSingleBlockCallback=BsRt_FuelGauge_NvM_JobFinished, NvMBlockUseCrc=, NvMBlockUseSyncMechanism=true, NvMUseServicePorts=true, NvMNvramBlockIdentifier=37, NvMNvBlockLength=32, NvMRomBlockDataAddress=Rte_NvBlockSwComponentType_NVBlockDescriptor_ClusterSettings_ROM_NVBlockDescriptor_BsRt_FuelGauge, NvMBlockJobPriority=1, NvMReadRamBlockFromNvCallback=Rte_SetMirror_NvBlockSwComponentType_NVBlockDescriptor_BsRt_FuelGauge, NvMWriteRamBlockToNvCallback=Rte_GetMirror_NvBlockSwComponentType_NVBlockDescriptor_BsRt_FuelGauge, NvMBlockLengthCheck=true
        NvMTargetBlockReference
          NvMFeeRef: NvMNameOfFeeBlock=Fee_BsRt_FuelGauge
      NvBlockSwComponentTypeNVBlockDescriptor_BsRt_Illumination: NvMBlockManagementType=NVM_BLOCK_REDUNDANT, NvMSelectBlockForWriteAll=false, NvMUseJobendCallback=true, NvMSingleBlockCallback=BsRt_Illumination_NvM_JobFinished, NvMBlockUseCrc=, NvMBlockUseSyncMechanism=true, NvMUseServicePorts=true, NvMNvramBlockIdentifier=45, NvMNvBlockLength=100, NvMRomBlockDataAddress=Rte_NvBlockSwComponentType_NVBlockDescriptor_ClusterSettings_ROM_NVBlockDescriptor_BsRt_Illumination, NvMBlockJobPriority=1, NvMReadRamBlockFromNvCallback=Rte_SetMirror_NvBlockSwComponentType_NVBlockDescriptor_BsRt_Illumination, NvMWriteRamBlockToNvCallback=Rte_GetMirror_NvBlockSwComponentType_NVBlockDescriptor_BsRt_Illumination, NvMBlockLengthCheck=true
        NvMTargetBlockReference
          NvMFeeRef: NvMNameOfFeeBlock=Fee_BsRt_Illumination
      NvBlockSwComponentTypeNVBlockDescriptor_BsRt_Odometer: NvMBlockManagementType=NVM_BLOCK_REDUNDANT, NvMSelectBlockForWriteAll=false, NvMUseJobendCallback=true, NvMSingleBlockCallback=BsRt_Odometer_NvM_JobFinished, NvMBlockUseCrc=, NvMBlockUseSyncMechanism=true, NvMUseServicePorts=true, NvMNvramBlockIdentifier=34, NvMNvBlockLength=128, NvMRomBlockDataAddress=Rte_NvBlockSwComponentType_NVBlockDescriptor_ClusterSettings_ROM_NVBlockDescriptor_BsRt_Odometer, NvMBlockJobPriority=1, NvMReadRamBlockFromNvCallback=Rte_SetMirror_NvBlockSwComponentType_NVBlockDescriptor_BsRt_Odometer, NvMWriteRamBlockToNvCallback=Rte_GetMirror_NvBlockSwComponentType_NVBlockDescriptor_BsRt_Odometer, NvMBlockLengthCheck=true
        NvMTargetBlockReference
          NvMFeeRef: NvMNameOfFeeBlock=Fee_BsRt_Odometer
      NvBlockSwComponentTypeNVBlockDescriptor_BsRt_OilGauge: NvMBlockManagementType=NVM_BLOCK_REDUNDANT, NvMSelectBlockForWriteAll=false, NvMUseJobendCallback=true, NvMSingleBlockCallback=BsRt_OilGauge_NvM_JobFinished, NvMBlockUseCrc=, NvMBlockUseSyncMechanism=true, NvMUseServicePorts=true, NvMNvramBlockIdentifier=40, NvMNvBlockLength=8, NvMRomBlockDataAddress=Rte_NvBlockSwComponentType_NVBlockDescriptor_ClusterSettings_ROM_NVBlockDescriptor_BsRt_OilGauge, NvMBlockJobPriority=1, NvMReadRamBlockFromNvCallback=Rte_SetMirror_NvBlockSwComponentType_NVBlockDescriptor_BsRt_OilGauge, NvMWriteRamBlockToNvCallback=Rte_GetMirror_NvBlockSwComponentType_NVBlockDescriptor_BsRt_OilGauge, NvMBlockLengthCheck=true
        NvMTargetBlockReference
          NvMFeeRef: NvMNameOfFeeBlock=Fee_BsRt_OilGauge
      NvBlockSwComponentTypeNVBlockDescriptor_BsRt_Personalization: NvMBlockManagementType=NVM_BLOCK_REDUNDANT, NvMSelectBlockForWriteAll=false, NvMUseJobendCallback=true, NvMSingleBlockCallback=BsRt_Personalization_NvM_JobFinished, NvMBlockUseCrc=, NvMBlockUseSyncMechanism=true, NvMUseServicePorts=true, NvMNvramBlockIdentifier=44, NvMNvBlockLength=128, NvMRomBlockDataAddress=Rte_NvBlockSwComponentType_NVBlockDescriptor_ClusterSettings_ROM_NVBlockDescriptor_BsRt_Personalization, NvMBlockJobPriority=1, NvMReadRamBlockFromNvCallback=Rte_SetMirror_NvBlockSwComponentType_NVBlockDescriptor_BsRt_Personalization, NvMWriteRamBlockToNvCallback=Rte_GetMirror_NvBlockSwComponentType_NVBlockDescriptor_BsRt_Personalization, NvMBlockLengthCheck=true
        NvMTargetBlockReference
          NvMFeeRef: NvMNameOfFeeBlock=Fee_BsRt_Personalization
      NvBlockSwComponentTypeNVBlockDescriptor_BsRt_PowerGauge: NvMBlockManagementType=NVM_BLOCK_REDUNDANT, NvMSelectBlockForWriteAll=false, NvMUseJobendCallback=true, NvMSingleBlockCallback=BsRt_PowerGauge_NvM_JobFinished, NvMBlockUseCrc=, NvMBlockUseSyncMechanism=true, NvMUseServicePorts=true, NvMNvramBlockIdentifier=39, NvMNvBlockLength=32, NvMRomBlockDataAddress=Rte_NvBlockSwComponentType_NVBlockDescriptor_ClusterSettings_ROM_NVBlockDescriptor_BsRt_PowerGauge, NvMBlockJobPriority=1, NvMReadRamBlockFromNvCallback=Rte_SetMirror_NvBlockSwComponentType_NVBlockDescriptor_BsRt_PowerGauge, NvMWriteRamBlockToNvCallback=Rte_GetMirror_NvBlockSwComponentType_NVBlockDescriptor_BsRt_PowerGauge, NvMBlockLengthCheck=true
        NvMTargetBlockReference
          NvMFeeRef: NvMNameOfFeeBlock=Fee_BsRt_PowerGauge
      NvBlockSwComponentTypeNVBlockDescriptor_BsRt_RealTimeClock: NvMBlockManagementType=NVM_BLOCK_REDUNDANT, NvMSelectBlockForWriteAll=false, NvMUseJobendCallback=true, NvMSingleBlockCallback=BsRt_RealTimeClock_NvM_JobFinished, NvMBlockUseCrc=, NvMBlockUseSyncMechanism=true, NvMUseServicePorts=true, NvMNvramBlockIdentifier=43, NvMNvBlockLength=48, NvMRomBlockDataAddress=Rte_NvBlockSwComponentType_NVBlockDescriptor_ClusterSettings_ROM_NVBlockDescriptor_BsRt_RealTimeClock, NvMBlockJobPriority=1, NvMReadRamBlockFromNvCallback=Rte_SetMirror_NvBlockSwComponentType_NVBlockDescriptor_BsRt_RealTimeClock, NvMWriteRamBlockToNvCallback=Rte_GetMirror_NvBlockSwComponentType_NVBlockDescriptor_BsRt_RealTimeClock, NvMBlockLengthCheck=true
        NvMTargetBlockReference
          NvMFeeRef: NvMNameOfFeeBlock=Fee_BsRt_RealTimeClock
      NvBlockSwComponentTypeNVBlockDescriptor_BsRt_SpeedoGauge: NvMBlockManagementType=NVM_BLOCK_REDUNDANT, NvMSelectBlockForWriteAll=false, NvMUseJobendCallback=true, NvMSingleBlockCallback=BsRt_SpeedoGauge_NvM_JobFinished, NvMBlockUseCrc=, NvMBlockUseSyncMechanism=true, NvMUseServicePorts=true, NvMNvramBlockIdentifier=35, NvMNvBlockLength=8, NvMRomBlockDataAddress=Rte_NvBlockSwComponentType_NVBlockDescriptor_ClusterSettings_ROM_NVBlockDescriptor_BsRt_SpeedoGauge, NvMBlockJobPriority=1, NvMReadRamBlockFromNvCallback=Rte_SetMirror_NvBlockSwComponentType_NVBlockDescriptor_BsRt_SpeedoGauge, NvMWriteRamBlockToNvCallback=Rte_GetMirror_NvBlockSwComponentType_NVBlockDescriptor_BsRt_SpeedoGauge, NvMBlockLengthCheck=true
        NvMTargetBlockReference
          NvMFeeRef: NvMNameOfFeeBlock=Fee_BsRt_SpeedoGauge
      NvBlockSwComponentTypeNVBlockDescriptor_BsRt_TachoGauge: NvMBlockManagementType=NVM_BLOCK_REDUNDANT, NvMSelectBlockForWriteAll=false, NvMUseJobendCallback=true, NvMSingleBlockCallback=BsRt_TachoGauge_NvM_JobFinished, NvMBlockUseCrc=, NvMBlockUseSyncMechanism=true, NvMUseServicePorts=true, NvMNvramBlockIdentifier=36, NvMNvBlockLength=16, NvMRomBlockDataAddress=Rte_NvBlockSwComponentType_NVBlockDescriptor_ClusterSettings_ROM_NVBlockDescriptor_BsRt_TachoGauge, NvMBlockJobPriority=1, NvMReadRamBlockFromNvCallback=Rte_SetMirror_NvBlockSwComponentType_NVBlockDescriptor_BsRt_TachoGauge, NvMWriteRamBlockToNvCallback=Rte_GetMirror_NvBlockSwComponentType_NVBlockDescriptor_BsRt_TachoGauge, NvMBlockLengthCheck=true
        NvMTargetBlockReference
          NvMFeeRef: NvMNameOfFeeBlock=Fee_BsRt_TachoGauge
      NvBlockSwComponentTypeNVBlockDescriptor_BsRt_TempGauge: NvMBlockManagementType=NVM_BLOCK_REDUNDANT, NvMSelectBlockForWriteAll=false, NvMUseJobendCallback=true, NvMSingleBlockCallback=BsRt_TempGauge_NvM_JobFinished, NvMBlockUseCrc=, NvMBlockUseSyncMechanism=true, NvMUseServicePorts=true, NvMNvramBlockIdentifier=38, NvMNvBlockLength=32, NvMRomBlockDataAddress=Rte_NvBlockSwComponentType_NVBlockDescriptor_ClusterSettings_ROM_NVBlockDescriptor_BsRt_TempGauge, NvMBlockJobPriority=1, NvMReadRamBlockFromNvCallback=Rte_SetMirror_NvBlockSwComponentType_NVBlockDescriptor_BsRt_TempGauge, NvMWriteRamBlockToNvCallback=Rte_GetMirror_NvBlockSwComponentType_NVBlockDescriptor_BsRt_TempGauge, NvMBlockLengthCheck=true
        NvMTargetBlockReference
          NvMFeeRef: NvMNameOfFeeBlock=Fee_BsRt_TempGauge
      NvBlockSwComponentTypeNVBlockDescriptor_BsRt_TripComputer: NvMBlockManagementType=NVM_BLOCK_REDUNDANT, NvMSelectBlockForWriteAll=false, NvMUseJobendCallback=true, NvMSingleBlockCallback=BsRt_TripComputer_NvM_JobFinished, NvMBlockUseCrc=, NvMBlockUseSyncMechanism=true, NvMUseServicePorts=true, NvMNvramBlockIdentifier=41, NvMNvBlockLength=64, NvMRomBlockDataAddress=Rte_NvBlockSwComponentType_NVBlockDescriptor_ClusterSettings_ROM_NVBlockDescriptor_BsRt_TripComputer, NvMBlockJobPriority=1, NvMReadRamBlockFromNvCallback=Rte_SetMirror_NvBlockSwComponentType_NVBlockDescriptor_BsRt_TripComputer, NvMWriteRamBlockToNvCallback=Rte_GetMirror_NvBlockSwComponentType_NVBlockDescriptor_BsRt_TripComputer, NvMBlockLengthCheck=true
        NvMTargetBlockReference
          NvMFeeRef: NvMNameOfFeeBlock=Fee_BsRt_TripComputer
      NvBlockSwComponentTypeNVBlockDescriptor_BsRt_Warning: NvMBlockManagementType=NVM_BLOCK_REDUNDANT, NvMSelectBlockForWriteAll=false, NvMUseJobendCallback=true, NvMSingleBlockCallback=BsRt_Warning_NvM_JobFinished, NvMBlockUseCrc=, NvMBlockUseSyncMechanism=true, NvMUseServicePorts=true, NvMNvramBlockIdentifier=42, NvMNvBlockLength=32, NvMRomBlockDataAddress=Rte_NvBlockSwComponentType_NVBlockDescriptor_ClusterSettings_ROM_NVBlockDescriptor_BsRt_Warning, NvMBlockJobPriority=1, NvMReadRamBlockFromNvCallback=Rte_SetMirror_NvBlockSwComponentType_NVBlockDescriptor_BsRt_Warning, NvMWriteRamBlockToNvCallback=Rte_GetMirror_NvBlockSwComponentType_NVBlockDescriptor_BsRt_Warning, NvMBlockLengthCheck=true
        NvMTargetBlockReference
          NvMFeeRef: NvMNameOfFeeBlock=Fee_BsRt_Warning
      NvBlockSwComponentTypeNVBlockDescriptor_BsShare_EcuPartNumber: NvMBlockManagementType=NVM_BLOCK_NATIVE, NvMSelectBlockForWriteAll=false, NvMUseJobendCallback=true, NvMSingleBlockCallback=BsShare_EcuPartNumber_NvM_JobFinished, NvMBlockUseCrc=, NvMBlockUseSyncMechanism=true, NvMUseServicePorts=true, NvMNvramBlockIdentifier=6, NvMNvBlockLength=128, NvMRomBlockDataAddress=Rte_NvBlockSwComponentType_NVBlockDescriptor_ClusterSettings_ROM_NVBlockDescriptor_BsShare_EcuPartNumber, NvMBlockJobPriority=1, NvMReadRamBlockFromNvCallback=Rte_SetMirror_NvBlockSwComponentType_NVBlockDescriptor_BsShare_EcuPartNumber, NvMWriteRamBlockToNvCallback=Rte_GetMirror_NvBlockSwComponentType_NVBlockDescriptor_BsShare_EcuPartNumber, NvMBlockLengthCheck=true
        NvMTargetBlockReference
          NvMFeeRef: NvMNameOfFeeBlock=Fee_BsShare_EcuPartNumber
      NvBlockSwComponentTypeNVBlockDescriptor_BsShare_SwUpdFotaFinPrint: NvMBlockManagementType=NVM_BLOCK_NATIVE, NvMSelectBlockForWriteAll=false, NvMUseJobendCallback=true, NvMSingleBlockCallback=BsShare_SwUpdFotaFinPrint_NvM_JobFinished, NvMBlockUseCrc=, NvMBlockUseSyncMechanism=true, NvMUseServicePorts=true, NvMNvramBlockIdentifier=3, NvMNvBlockLength=32, NvMRomBlockDataAddress=Rte_NvBlockSwComponentType_NVBlockDescriptor_ClusterSettings_ROM_NVBlockDescriptor_BsShare_SwUpdFotaFinPrint, NvMBlockJobPriority=1, NvMReadRamBlockFromNvCallback=Rte_SetMirror_NvBlockSwComponentType_NVBlockDescriptor_BsShare_SwUpdFotaFinPrint, NvMWriteRamBlockToNvCallback=Rte_GetMirror_NvBlockSwComponentType_NVBlockDescriptor_BsShare_SwUpdFotaFinPrint, NvMBlockLengthCheck=true
        NvMTargetBlockReference
          NvMFeeRef: NvMNameOfFeeBlock=Fee_BsShare_SwUpdFotaFinPrint
      NvBlockSwComponentTypeNVBlockDescriptor_BsShare_SwUpdFotaMode: NvMBlockManagementType=NVM_BLOCK_NATIVE, NvMSelectBlockForWriteAll=false, NvMUseJobendCallback=true, NvMSingleBlockCallback=BsShare_SwUpdFotaMode_NvM_JobFinished, NvMBlockUseCrc=, NvMBlockUseSyncMechanism=true, NvMUseServicePorts=true, NvMNvramBlockIdentifier=2, NvMNvBlockLength=16, NvMRomBlockDataAddress=Rte_NvBlockSwComponentType_NVBlockDescriptor_ClusterSettings_ROM_NVBlockDescriptor_BsShare_SwUpdFotaMode, NvMBlockJobPriority=1, NvMReadRamBlockFromNvCallback=Rte_SetMirror_NvBlockSwComponentType_NVBlockDescriptor_BsShare_SwUpdFotaMode, NvMWriteRamBlockToNvCallback=Rte_GetMirror_NvBlockSwComponentType_NVBlockDescriptor_BsShare_SwUpdFotaMode, NvMBlockLengthCheck=true
        NvMTargetBlockReference
          NvMFeeRef: NvMNameOfFeeBlock=Fee_BsShare_SwUpdFotaMode
      NvBlockSwComponentTypeNVBlockDescriptor_BsShare_SwUpdFotaStatus: NvMBlockManagementType=NVM_BLOCK_NATIVE, NvMSelectBlockForWriteAll=false, NvMUseJobendCallback=true, NvMSingleBlockCallback=BsShare_SwUpdFotaStatus_NvM_JobFinished, NvMBlockUseCrc=, NvMBlockUseSyncMechanism=true, NvMUseServicePorts=true, NvMNvramBlockIdentifier=4, NvMNvBlockLength=48, NvMRomBlockDataAddress=Rte_NvBlockSwComponentType_NVBlockDescriptor_ClusterSettings_ROM_NVBlockDescriptor_BsShare_SwUpdFotaStatus, NvMBlockJobPriority=1, NvMReadRamBlockFromNvCallback=Rte_SetMirror_NvBlockSwComponentType_NVBlockDescriptor_BsShare_SwUpdFotaStatus, NvMWriteRamBlockToNvCallback=Rte_GetMirror_NvBlockSwComponentType_NVBlockDescriptor_BsShare_SwUpdFotaStatus, NvMBlockLengthCheck=true
        NvMTargetBlockReference
          NvMFeeRef: NvMNameOfFeeBlock=Fee_BsShare_SwUpdFotaStatus
      NvBlockSwComponentTypeNVBlockDescriptor_BsShare_SwUpdFotadecrypt: NvMBlockManagementType=NVM_BLOCK_NATIVE, NvMSelectBlockForWriteAll=false, NvMUseJobendCallback=true, NvMSingleBlockCallback=BsShare_SwUpdFotadecrypt_NvM_JobFinished, NvMBlockUseCrc=, NvMBlockUseSyncMechanism=true, NvMUseServicePorts=true, NvMNvramBlockIdentifier=5, NvMNvBlockLength=64, NvMRomBlockDataAddress=Rte_NvBlockSwComponentType_NVBlockDescriptor_ClusterSettings_ROM_NVBlockDescriptor_BsShare_SwUpdFotadecrypt, NvMBlockJobPriority=1, NvMReadRamBlockFromNvCallback=Rte_SetMirror_NvBlockSwComponentType_NVBlockDescriptor_BsShare_SwUpdFotadecrypt, NvMWriteRamBlockToNvCallback=Rte_GetMirror_NvBlockSwComponentType_NVBlockDescriptor_BsShare_SwUpdFotadecrypt, NvMBlockLengthCheck=true
        NvMTargetBlockReference
          NvMFeeRef: NvMNameOfFeeBlock=Fee_BsShare_SwUpdFotadecrypt
      NvBlockSwComponentTypeNVBlockDescriptor_BsShare_SwUpdReflash: NvMBlockManagementType=NVM_BLOCK_NATIVE, NvMSelectBlockForWriteAll=false, NvMUseJobendCallback=true, NvMSingleBlockCallback=BsShare_SwUpdReflash_NvM_JobFinished, NvMBlockUseCrc=, NvMBlockUseSyncMechanism=true, NvMUseServicePorts=true, NvMNvramBlockIdentifier=1, NvMNvBlockLength=8, NvMRomBlockDataAddress=Rte_NvBlockSwComponentType_NVBlockDescriptor_ClusterSettings_ROM_NVBlockDescriptor_BsShare_SwUpdReflash, NvMBlockJobPriority=1, NvMReadRamBlockFromNvCallback=Rte_SetMirror_NvBlockSwComponentType_NVBlockDescriptor_BsShare_SwUpdReflash, NvMWriteRamBlockToNvCallback=Rte_GetMirror_NvBlockSwComponentType_NVBlockDescriptor_BsShare_SwUpdReflash, NvMBlockLengthCheck=true
        NvMTargetBlockReference
          NvMFeeRef: NvMNameOfFeeBlock=Fee_BsShare_SwUpdReflash
      NvBlockSwComponentTypeNVBlockDescriptor_BsShare_VehicleConfig: NvMBlockManagementType=NVM_BLOCK_NATIVE, NvMSelectBlockForWriteAll=false, NvMUseJobendCallback=true, NvMSingleBlockCallback=BsShare_VehicleConfig_NvM_JobFinished, NvMBlockUseCrc=, NvMBlockUseSyncMechanism=true, NvMUseServicePorts=true, NvMNvramBlockIdentifier=8, NvMNvBlockLength=256, NvMRomBlockDataAddress=Rte_NvBlockSwComponentType_NVBlockDescriptor_ClusterSettings_ROM_NVBlockDescriptor_BsShare_VehicleConfig, NvMBlockJobPriority=1, NvMReadRamBlockFromNvCallback=Rte_SetMirror_NvBlockSwComponentType_NVBlockDescriptor_BsShare_VehicleConfig, NvMWriteRamBlockToNvCallback=Rte_GetMirror_NvBlockSwComponentType_NVBlockDescriptor_BsShare_VehicleConfig, NvMBlockLengthCheck=true
        NvMTargetBlockReference
          NvMFeeRef: NvMNameOfFeeBlock=Fee_BsShare_VehicleConfig
      NvBlockSwComponentTypeNVBlockDescriptor_BsShare_VisMeet: NvMBlockManagementType=NVM_BLOCK_NATIVE, NvMSelectBlockForWriteAll=false, NvMUseJobendCallback=true, NvMSingleBlockCallback=BsShare_VisMeet_NvM_JobFinished, NvMBlockUseCrc=, NvMBlockUseSyncMechanism=true, NvMUseServicePorts=true, NvMNvramBlockIdentifier=7, NvMNvBlockLength=48, NvMRomBlockDataAddress=Rte_NvBlockSwComponentType_NVBlockDescriptor_ClusterSettings_ROM_NVBlockDescriptor_BsShare_VisMeet, NvMBlockJobPriority=1, NvMReadRamBlockFromNvCallback=Rte_SetMirror_NvBlockSwComponentType_NVBlockDescriptor_BsShare_VisMeet, NvMWriteRamBlockToNvCallback=Rte_GetMirror_NvBlockSwComponentType_NVBlockDescriptor_BsShare_VisMeet, NvMBlockLengthCheck=true
        NvMTargetBlockReference
          NvMFeeRef: NvMNameOfFeeBlock=Fee_BsShare_VisMeet
      NvBlockSwComponentTypeNVBlockDescriptor_RefCys_Certicificate: NvMBlockManagementType=NVM_BLOCK_REDUNDANT, NvMSelectBlockForWriteAll=false, NvMUseJobendCallback=true, NvMSingleBlockCallback=RefCys_Certicificate_NvM_JobFinished, NvMBlockUseCrc=, NvMBlockUseSyncMechanism=true, NvMUseServicePorts=true, NvMNvramBlockIdentifier=32, NvMNvBlockLength=64, NvMRomBlockDataAddress=Rte_NvBlockSwComponentType_NVBlockDescriptor_ClusterSettings_ROM_NVBlockDescriptor_RefCys_Certicificate, NvMBlockJobPriority=1, NvMReadRamBlockFromNvCallback=Rte_SetMirror_NvBlockSwComponentType_NVBlockDescriptor_RefCys_Certicificate, NvMWriteRamBlockToNvCallback=Rte_GetMirror_NvBlockSwComponentType_NVBlockDescriptor_RefCys_Certicificate, NvMBlockLengthCheck=true
        NvMTargetBlockReference
          NvMFeeRef: NvMNameOfFeeBlock=Fee_RefCys_Certicificate
      NvBlockSwComponentTypeNVBlockDescriptor_RefCys_Certicificate1: NvMBlockManagementType=NVM_BLOCK_REDUNDANT, NvMSelectBlockForWriteAll=false, NvMUseJobendCallback=true, NvMSingleBlockCallback=RefCys_Certicificate1_NvM_JobFinished, NvMBlockUseCrc=, NvMBlockUseSyncMechanism=true, NvMUseServicePorts=true, NvMNvramBlockIdentifier=33, NvMNvBlockLength=64, NvMRomBlockDataAddress=Rte_NvBlockSwComponentType_NVBlockDescriptor_ClusterSettings_ROM_NVBlockDescriptor_RefCys_Certicificate1, NvMBlockJobPriority=1, NvMReadRamBlockFromNvCallback=Rte_SetMirror_NvBlockSwComponentType_NVBlockDescriptor_RefCys_Certicificate1, NvMWriteRamBlockToNvCallback=Rte_GetMirror_NvBlockSwComponentType_NVBlockDescriptor_RefCys_Certicificate1, NvMBlockLengthCheck=true
        NvMTargetBlockReference
          NvMFeeRef: NvMNameOfFeeBlock=Fee_RefCys_Certicificate1
      NvBlock_Template: NvMBlockManagementType=NVM_BLOCK_REDUNDANT, NvMSelectBlockForWriteAll=true, NvMUseJobendCallback=false, NvMSingleBlockCallback=NULL_PTR, NvMBlockUseCrc=true, NvMBlockUseSyncMechanism=false, NvMUseServicePorts=false, NvMNvramBlockIdentifier=1, NvMNvBlockLength=2, NvMRomBlockDataAddress=NULL_PTR, NvMBlockJobPriority=127, NvMReadRamBlockFromNvCallback=NULL_PTR, NvMWriteRamBlockToNvCallback=NULL_PTR, NvMBlockLengthCheck=false
        NvMTargetBlockReference
          NvMFeeRef: NvMNameOfFeeBlock=XXX
    NvMCommon:
      NvMDevErrorDetect = true
      NvMVersionInfoApi = false
      NvMApiConfigClass = NVM_API_CONFIG_CLASS_3
      NvMBswMMultiBlockJobStatusInformation = false
      NvMCompiledConfigId = 1
      NvMCrcNumOfBytes = 64
      NvMDatasetSelectionBits = 1
      NvMDrvModeSwitch = flase
      NvMDynamicConfiguration = false
      NvMJobPrioritization = false
      NvMMultiBlockCallback = NvM_MultiBlockJobEndNotification
      NvMPollingMode = false
      NvMSetRamBlockStatusApi = true
      NvMSizeStandardJobQueue = 4
      NvMMaxNoOfWriteRetries = 1
      NvMMainFunctionPeriod = 0.01
      NvMRepairRedundantBlocksApi = true
      NvMUseBlockIdCheck = true
    NvMCommonVendorParams:
      NvMCfgIncludeDem = Dem.h
      NvMSeterror = Dem_ReportErrorStatus
      NvMMultiblockId = MultiBlockRequest
      NvMCrcIntBuffer = true
      NvMKillWriteAllApi = true
      NvMCfgCbkIncludeList = Rte_Cbk.h
      NvMCfgCbkIncludeList = EcuMExt.h
      NvMCfgCbkIncludeList = Rte_Cbk.h
      NvMCfgCbkIncludeList = Dem_Cbk.h
      NvMDevErrorChecks: NvMCfgIncludeDet=Det.h, NvMErrorhook=Det_ReportError, NvMDebugReporting=true
    NvMConfigBlock (NvMBlockDescriptor):
      NvMBlockCrcType = NVM_CRC16
      NvMBlockManagementType = NVM_BLOCK_REDUNDANT
      NvMInitBlockCallback = NULL_PTR
      NvMResistantToChangedSw = true
      NvMSelectBlockForReadAll = true
      NvMSelectBlockForWriteAll = true
      NvMUseInitCallback = false
      NvMUseJobendCallback = false
      NvMSingleBlockCallback = NULL_PTR
      NvMBswMBlockStatusInformation = false
      NvMBlockUseCrc = true
      NvMBlockUseSyncMechanism = false
      NvMCalcRamBlockCrc = false
      NvMUseServicePorts = false
      NvMNvramBlockIdentifier = 1
      NvMNvBlockNum = 2
      NvMNvBlockLength = 2
      NvMRomBlockDataAddress = NULL_PTR
      NvMBlockJobPriority = 127
      NvMBlockWriteProt = false
      NvMRamBlockDataAddress = NULL_PTR
      NvMReadRamBlockFromNvCallback = NULL_PTR
      NvMWriteBlockOnce = false
      NvMWriteRamBlockToNvCallback = NULL_PTR
      NvMAutomaticBlockLength = false
      NvMBlockLengthCheck = false
      NvMBlockLengthCheckType = true
      NvMTargetBlockReference
        NvMFeeRef: NvMNameOfFeeBlock=FeeConfigBlock
    NvmDemEventParameterRefs:
      NVM_E_INTEGRITY_FAILED = NVM_E_INTEGRITY_FAILED
      NVM_E_LOSS_OF_REDUNDANCY = NVM_E_LOSS_OF_REDUNDANCY
      NVM_E_QUEUE_OVERFLOW = NVM_E_QUEUE_OVERFLOW
      NVM_E_REQ_FAILED = NVM_E_REQ_FAILED
      NVM_E_VERIFY_FAILED = NVM_E_VERIFY_FAILED
      NVM_E_WRITE_PROTECTED = NVM_E_WRITE_PROTECTED
      NVM_E_WRONG_BLOCK_ID = NVM_E_WRONG_BLOCK_ID
