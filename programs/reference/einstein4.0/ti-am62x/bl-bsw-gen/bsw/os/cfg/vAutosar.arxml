AUTOSAR XML (schema 00050)
standard types defined: boolean, uint8, uint16, uint32, uint64, sint8, sint16, sint32, sint64, float32, float64
package /ActiveEcuC
  module config Os
    3 x OsAlarm, all with OsAlarmCounterRef=SystemTimer:
      Rte_Al_TE2_OsTask_Diagnostics_0_10ms
        OsAlarmAction
          OsAlarmSetEvent: OsAlarmSetEventRef=Rte_Ev_Cyclic2_OsTask_Diagnostics_0_10ms, OsAlarmSetEventTaskRef=OsTask_Diagnostics
      Rte_Al_TE2_OsTask_Ucl_0_4ms
        OsAlarmAction
          OsAlarmSetEvent: OsAlarmSetEventRef=Rte_Ev_Cyclic2_OsTask_Ucl_0_4ms, OsAlarmSetEventTaskRef=OsTask_Ucl
      Rte_Al_TE2_OsTask_CANFun_0_10ms
        OsAlarmAction
          OsAlarmSetEvent: OsAlarmSetEventRef=Rte_Ev_Cyclic2_OsTask_CANFun_0_10ms, OsAlarmSetEventTaskRef=OsTask_CANFun
    OsMpu_TrustedSystem (OsMpu)
      7 x OsMpuRegion, all with OsMpuSubRegion=0:
        OsMpuRegion: OsMpuRegionAccess=S_RW_U_R, OsMpuRegionBaseAddress=0x00000000, OsMpuRegionMemoryOrder=CACHEABLE_WRITEBACK_ALLOCATE, OsMpuRegionNumber=6, OsMpuRegionPermission=EXECUTE_ALLOWED, OsMpuRegionSize=32768
        OsMpuRegion1: OsMpuRegionAccess=S_R_U_R, OsMpuRegionBaseAddress=0x41010400, OsMpuRegionMemoryOrder=CACHEABLE_WRITEBACK_ALLOCATE, OsMpuRegionNumber=5, OsMpuRegionPermission=EXECUTE_ALLOWED, OsMpuRegionSize=32768
        OsMpuRegion2: OsMpuRegionAccess=S_RW_U_RW, OsMpuRegionBaseAddress=0x79120000, OsMpuRegionMemoryOrder=CACHEABLE_WRITEBACK_ALLOCATE, OsMpuRegionNumber=3, OsMpuRegionPermission=EXECUTE_FORBIDDEN, OsMpuRegionSize=131072
        OsMpuRegion3: OsMpuRegionAccess=S_RW_U_R, OsMpuRegionBaseAddress=0x79140000, OsMpuRegionMemoryOrder=CACHEABLE_WRITEBACK_ALLOCATE, OsMpuRegionNumber=10, OsMpuRegionPermission=EXECUTE_FORBIDDEN, OsMpuRegionSize=32768
        OsMpuRegion4: OsMpuRegionAccess=S_R_U_R, OsMpuRegionBaseAddress=0x79120000, OsMpuRegionMemoryOrder=CACHEABLE_WRITEBACK_ALLOCATE, OsMpuRegionNumber=11, OsMpuRegionPermission=EXECUTE_FORBIDDEN, OsMpuRegionSize=65536
        OsMpuRegion5: OsMpuRegionAccess=S_RW_U_RW, OsMpuRegionBaseAddress=0x04000000, OsMpuRegionMemoryOrder=STRONGLY_ORDERED, OsMpuRegionNumber=13, OsMpuRegionPermission=EXECUTE_FORBIDDEN, OsMpuRegionSize=67108864
        OsMpuRegion6: OsMpuRegionAccess=S_RW_U_R, OsMpuRegionBaseAddress=0x07FF0000, OsMpuRegionMemoryOrder=STRONGLY_ORDERED, OsMpuRegionNumber=14, OsMpuRegionPermission=EXECUTE_ALLOWED, OsMpuRegionSize=16384
    TrustedSystem (OsApplication):
      OsTrustedApplicationWithProtection = false
      OsApplicationIsPrivileged = true
      OsAppMpuConfigRef = OsMpu_TrustedSystem
      OsAppTaskRef = OsTask_CANFun
      OsAppTaskRef = OsTask_IdleTask
      OsAppTaskRef = OsTask_Diagnostics
      OsAppCoreConfigRef = OsCoreAsr0
      OsAppIsrRef = McuOsGptIsr
      OsAppIsrRef = McuCan0RxTxIsr
      OsAppIsrRef = McuCan1RxTxIsr
      OsAppIsrRef = McuI2c3IoIsr
      OsAppIsrRef = McuI2c0PmicIsr
      OsAppIsrRef = Gpt_Ch3Isr
      OsAppIsrRef = Gpt_Ch4Isr
      OsAppIsrRef = PmicCdd_nINTGpioInterrupt
      OsAppIsrRef = Cdd_IpcIrqMbxFromWKUP_R5FSS0_0
      OsAppTaskRef = InitTask
      OsAppTaskRef = OsTask_Ucl
      OsAppTaskRef = OsTask_WdgMngt
      OsApplicationHooks: OsAppErrorHook=false, OsAppShutdownHook=false, OsAppStartupHook=false
    OsOS:
      OsStackMonitoring = false
      OsStatus = EXTENDED
      OsUseGetServiceId = false
      OsUseParameterAccess = false
      OsUseResScheduler = false
      OsScalabilityClass = SC3
      OsNumberOfCores = 1
      OsFpuSupport = true
      OsHooks:
        OsErrorHook = true
        OsPostTaskHook = false
        OsPreTaskHook = false
        OsShutdownHook = true
        OsStartupHook = false
        OsPreIsrHookFunc = UserPreISRHook(x)
        OsPostIsrHookFunc = UserPostISRHook(x)
        OsPostTaskHookFunc = UserPostTaskHook()
        OsPreTaskHookFunc = UserPreTaskHook()
    OsCounter_0 (OsCounter): OsCounterMaxAllowedValue=65535, OsCounterType=HARDWARE, OsSecondsPerTick=0.001, OsCounterTicksPerBase=1, OsCounterMinValue=0, OsCounterMinCycle=1
      OsDriver
    OSDEFAULTAPPMODE (OsAppMode)
    6 x OsTask, all with OsTaskStackSharing=false, OsTaskMpuPermission=EXECUTE_FORBIDDEN, OsTaskMpuMemoryOrder=CACHEABLE_WRITEBACK_ALLOCATE, OsTaskAccessingApplication=TrustedSystem:
      InitTask: OsTaskActivation=5, OsTaskPriority=5, OsTaskSchedule=NON, OsTaskStackSize=512, OsTaskType=BASIC, OsTaskIsAutostart=true
      OsTask_Ucl: OsTaskActivation=1, OsTaskPriority=4, OsTaskSchedule=NON, OsTaskStackSize=2048, OsTaskType=EXTENDED, OsTaskEventRef=Rte_Ev_Cyclic2_OsTask_Ucl_0_4ms
      OsTask_Diagnostics: OsTaskActivation=1, OsTaskPriority=3, OsTaskSchedule=NON, OsTaskStackSize=2048, OsTaskType=EXTENDED, OsTaskEventRef=Rte_Ev_Cyclic2_OsTask_Diagnostics_0_10ms
      OsTask_CANFun: OsTaskActivation=1, OsTaskPriority=2, OsTaskSchedule=NON, OsTaskStackSize=2048, OsTaskType=EXTENDED, OsTaskEventRef=Rte_Ev_Cyclic2_OsTask_CANFun_0_10ms
      OsTask_WdgMngt: OsTaskActivation=1, OsTaskPriority=1, OsTaskSchedule=NON, OsTaskStackSize=2048, OsTaskType=EXTENDED, OsTaskEventRef=Rte_Ev_Cyclic2_OsTask_WdgMngt_0_500ms
      OsTask_IdleTask: OsTaskActivation=1, OsTaskPriority=0, OsTaskSchedule=FULL, OsTaskStackSize=1024, OsTaskType=BASIC, OsTaskIsAutostart=true
    9 x OsIsr, all with OsIsrCategory=CATEGORY_2, OsIsrEnableNesting=false, OsIsrEnableSource=false, OsIsrMpuMemoryOrder=CACHEABLE_WRITEBACK_ALLOCATE, OsIsrMpuPermission=EXECUTE_FORBIDDEN, OsIsrStackSize=2048:
      McuOsGptIsr: OsIsrApplicationApi=osTimerInterruptfunc, OsIsrInterruptSource=28, OsIsrPriority=0
      McuCan0RxTxIsr: OsIsrApplicationApi=Can_0_Int0ISRfunc, OsIsrInterruptSource=43, OsIsrPriority=1
      McuCan1RxTxIsr: OsIsrApplicationApi=Can_1_Int0ISRfunc, OsIsrInterruptSource=46, OsIsrPriority=2
      McuI2c3IoIsr: OsIsrApplicationApi=McuI2c3IoIsrfunc, OsIsrInterruptSource=196, OsIsrPriority=12
      McuI2c0PmicIsr: OsIsrApplicationApi=McuI2c0PmicIsrfunc, OsIsrInterruptSource=197, OsIsrPriority=13
      Gpt_Ch3Isr: OsIsrApplicationApi=Gpt_Ch3Isrfunc, OsIsrInterruptSource=138, OsIsrPriority=14
      Gpt_Ch4Isr: OsIsrApplicationApi=Gpt_Ch4Isrfunc, OsIsrInterruptSource=139, OsIsrPriority=16
      PmicCdd_nINTGpioInterrupt: OsIsrApplicationApi=PmicCdd_nINTGpioInterruptfunc, OsIsrInterruptSource=106, OsIsrPriority=15
      Cdd_IpcIrqMbxFromWKUP_R5FSS0_0: OsIsrApplicationApi=Cdd_IpcIrqMbxFromWKUP_R5FSS0_0, OsIsrInterruptSource=242, OsIsrPriority=11
    OsCoreAsr0 (OsCore):
      OsCoreIsAutosar = true
      OsSystemStackMpuMemoryOrder = CACHEABLE_WRITEBACK_ALLOCATE
      OsSystemStackMpuPermission = EXECUTE_ALLOWED
      OsSystemStackSize = 4096
      OsCoreOwnAppRef = TrustedSystem
      OsCoreOwnHookRef = OsHooks
      OsHookConfigList_Core0 (OsCoreHooks)
    OsDerivative: OsTimerReloadValue=4294942294, OsDerivativeIncludeHeader=
      OsCpuCore
        ARMCortexR5: OSCpuCoreDerivative=TIAM62P, OsTimerSelection=MCU_TIMER0
    OsGeneral:
      ExtendedConformanceClassType = ECC1
      MosUseScheduleLog = false
      MosVersionInfoApi = true
      OsCompilerSetttings = CLANG
      OsMpuBackroundRegionRegister = false
      OsMpuSetting = OSAPPLICATIONS_PROTECTION
      OsMpuStackRegionNumber = 12
      OsTestingLocal = false
      OsHooksIncludeHeader = Stubs.h
      OsHooksIncludeHeader = OsError.h
      OsHooksIncludeHeader = OsPrvTypes.h
      OsHooksIncludeHeader = Det.h
      OsTrustedServiceIncludeHeader = Rte_Type.h
    SystemTimer (OsCounter): OsCounterMaxAllowedValue=65535, OsCounterMinValue=0, OsCounterTicksPerBase=1, OsCounterType=HARDWARE, OsSecondsPerTick=0.001, OsCounterMinCycle=1
    OsMpu_QMSystem (OsMpu)
      7 x OsMpuRegion, all with OsMpuSubRegion=0:
        OsMpuRegion: OsMpuRegionAccess=S_RW_U_R, OsMpuRegionBaseAddress=0x00000000, OsMpuRegionMemoryOrder=CACHEABLE_WRITEBACK_ALLOCATE, OsMpuRegionNumber=6, OsMpuRegionPermission=EXECUTE_ALLOWED, OsMpuRegionSize=32768
        OsMpuRegion1: OsMpuRegionAccess=S_R_U_R, OsMpuRegionBaseAddress=0x41010400, OsMpuRegionMemoryOrder=CACHEABLE_WRITEBACK_ALLOCATE, OsMpuRegionNumber=5, OsMpuRegionPermission=EXECUTE_ALLOWED, OsMpuRegionSize=32768
        OsMpuRegion2: OsMpuRegionAccess=S_RW_U_RW, OsMpuRegionBaseAddress=0x79120000, OsMpuRegionMemoryOrder=CACHEABLE_WRITEBACK_ALLOCATE, OsMpuRegionNumber=3, OsMpuRegionPermission=EXECUTE_FORBIDDEN, OsMpuRegionSize=131072
        OsMpuRegion3: OsMpuRegionAccess=S_RW_U_R, OsMpuRegionBaseAddress=0x79140000, OsMpuRegionMemoryOrder=CACHEABLE_WRITEBACK_ALLOCATE, OsMpuRegionNumber=10, OsMpuRegionPermission=EXECUTE_FORBIDDEN, OsMpuRegionSize=32768
        OsMpuRegion4: OsMpuRegionAccess=S_R_U_R, OsMpuRegionBaseAddress=0x79120000, OsMpuRegionMemoryOrder=CACHEABLE_WRITEBACK_ALLOCATE, OsMpuRegionNumber=11, OsMpuRegionPermission=EXECUTE_FORBIDDEN, OsMpuRegionSize=65536
        OsMpuRegion5: OsMpuRegionAccess=S_RW_U_RW, OsMpuRegionBaseAddress=0x04000000, OsMpuRegionMemoryOrder=STRONGLY_ORDERED, OsMpuRegionNumber=13, OsMpuRegionPermission=EXECUTE_FORBIDDEN, OsMpuRegionSize=67108864
        OsMpuRegion6: OsMpuRegionAccess=S_RW_U_R, OsMpuRegionBaseAddress=0x07FF0000, OsMpuRegionMemoryOrder=STRONGLY_ORDERED, OsMpuRegionNumber=14, OsMpuRegionPermission=EXECUTE_ALLOWED, OsMpuRegionSize=16384
    4 x OsEvent:
      Rte_Ev_Cyclic2_OsTask_WdgMngt_0_500ms: OsEventMask=1
      Rte_Ev_Cyclic2_OsTask_Diagnostics_0_10ms: OsEventMask=2
      Rte_Ev_Cyclic2_OsTask_Ucl_0_4ms: OsEventMask=4
      Rte_Ev_Cyclic2_OsTask_CANFun_0_10ms: OsEventMask=8
    Rte_Al_TE2_OsTask_WdgMngt_0_500ms (OsAlarm): OsAlarmCounterRef=SystemTimer
      OsAlarmAction
        OsAlarmSetEvent: OsAlarmSetEventRef=Rte_Ev_Cyclic2_OsTask_WdgMngt_0_500ms, OsAlarmSetEventTaskRef=OsTask_WdgMngt
package /PlatformTypes/BaseTypes
  16 x impl type:
    osuint8: category=VALUE, base-type=uint8
    osuint16: category=VALUE, base-type=uint16
    osuint32: category=VALUE, base-type=uint32
    osuint64: category=VALUE, base-type=uint64
    osint8: category=VALUE, base-type=sint8
    osint16: category=VALUE, base-type=sint16
    osint32: category=VALUE, base-type=sint32
    osint64: category=VALUE, base-type=sint64
    osbool: implementation-data-type=osuint8
    osfloat32: category=VALUE, base-type=float32
    osfloat64: category=VALUE, base-type=float64
    osCpuStackType: implementation-data-type=osuint32
    osCpuTaskAddressType: implementation-data-type=osuint32
    osCpuTaskPriorityBitType: implementation-data-type=osuint32
    osCpuIntGlobalType: implementation-data-type=osuint32
    osCpuMemoryAddressType: implementation-data-type=osuint32
