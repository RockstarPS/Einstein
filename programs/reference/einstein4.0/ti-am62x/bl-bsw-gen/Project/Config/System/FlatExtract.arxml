AUTOSAR XML (schema 00044)
package /COM/VECTOR/CFG/WORKFLOW/SYSDESC/SYNC
  system SYSTEM: category=ECU_EXTRACT
    system mapping MAPPINGS
    root-software-compositions:
      root sw composition prototype COMPOSITIONTYPE: flat-map=FLATMAP, software-composition=COMPOSITIONTYPE
  composition sw component type COMPOSITIONTYPE  # UB:Derived from original system description
    26 x component:
      UclProxyCdd: type=UclProxyCdd
      Test_Comp: type=Test_Comp
      Os_OsCore0_swc: type=Os_OsCore0_swc
      DemMaster_0: type=DemMaster_0
      DemSatellite_0: type=DemSatellite_0
      NvBlockSwComponentType: type=NvBlockSwComponentType
      NvM: type=NvM
      NvMExt: type=NvMExt
      EcuMExt: type=EcuMExt
      TmExt: type=TmExt
      IoHwAb: type=IoHwAb
      MemAbstractStub: type=MemAbstractStub
      EcuAppM: type=EcuAppM
      ComM: type=ComM
      EcuM: type=EcuM
      MemAbstractMdl: type=MemAbstractMdl
      DmnMgr: type=DmnMgr
      SciDrv: type=SciDrv
      CSleepManager: type=CSleepManager
      CBacklightCdd: type=CBacklightCdd
      CDisplayCdd: type=CDisplayCdd
      CBattMdl: type=CBattMdl
      CCDD_EcuPowerM: type=CCDD_EcuPowerM
      Dlt: type=Dlt
      DltExt: type=DltExt
      RtcCdd: type=RtcCdd
    connect MemAbstractStub.NvMSampleBlock1_NvMNotifyJobFinished_1 -> NvM.NvM_RpNotifyJobEnd_NvBlockSwComponentTypeNVBlockDescriptor_NvMSampleBlock1
    connect MemAbstractStub.SampleBlock2_NvMNotifyJobFinished_1 -> NvM.NvM_RpNotifyJobEnd_NvBlockSwComponentTypeNVBlockDescriptor_SampleBlock2
    connect MemAbstractStub.NvMSampleBlock1_NvMNotifyJobFinished -> NvM.NvM_RpNotifyJobEnd_NvBlockSwComponentTypeNVBlockDescriptor_NvMSampleBlock1
    connect MemAbstractStub.SampleBlock2_NvMNotifyJobFinished -> NvM.NvM_RpNotifyJobEnd_NvBlockSwComponentTypeNVBlockDescriptor_SampleBlock2
    connect EcuAppM.ppCS_EcuAppM -> EcuMExt.rpCS_EcuAppM  # UB:Derived from original system description
    connect MemAbstractStub.BsConst_Audio_NvMNotifyJobFinished -> NvM.NvM_RpNotifyJobEnd_NvBlockSwComponentTypeNVBlockDescriptor_BsConst_Audio
    connect MemAbstractStub.BsConst_Communication_NvMNotifyJobFinished -> NvM.NvM_RpNotifyJobEnd_NvBlockSwComponentTypeNVBlockDescriptor_BsConst_Communication
    connect MemAbstractStub.BsConst_EngOffTimer_NvMNotifyJobFinished -> NvM.NvM_RpNotifyJobEnd_NvBlockSwComponentTypeNVBlockDescriptor_BsConst_EngOffTimer
    connect MemAbstractStub.BsConst_FuelGauge_NvMNotifyJobFinished -> NvM.NvM_RpNotifyJobEnd_NvBlockSwComponentTypeNVBlockDescriptor_BsConst_FuelGauge
    connect MemAbstractStub.BsConst_Illumination_NvMNotifyJobFinished -> NvM.NvM_RpNotifyJobEnd_NvBlockSwComponentTypeNVBlockDescriptor_BsConst_Illumination
    connect MemAbstractStub.BsConst_OilGauge_NvMNotifyJobFinished -> NvM.NvM_RpNotifyJobEnd_NvBlockSwComponentTypeNVBlockDescriptor_BsConst_OilGauge
    connect MemAbstractStub.BsConst_PowerGauge_NvMNotifyJobFinished -> NvM.NvM_RpNotifyJobEnd_NvBlockSwComponentTypeNVBlockDescriptor_BsConst_PowerGauge
    connect MemAbstractStub.BsConst_Power_NvMNotifyJobFinished -> NvM.NvM_RpNotifyJobEnd_NvBlockSwComponentTypeNVBlockDescriptor_BsConst_Power
    connect MemAbstractStub.BsConst_RealTimeClock_NvMNotifyJobFinished -> NvM.NvM_RpNotifyJobEnd_NvBlockSwComponentTypeNVBlockDescriptor_BsConst_RealTimeClock
    connect MemAbstractStub.BsConst_ServiceReminder_NvMNotifyJobFinished -> NvM.NvM_RpNotifyJobEnd_NvBlockSwComponentTypeNVBlockDescriptor_BsConst_ServiceReminder
    connect MemAbstractStub.BsConst_SpeedoGauge_NvMNotifyJobFinished -> NvM.NvM_RpNotifyJobEnd_NvBlockSwComponentTypeNVBlockDescriptor_BsConst_SpeedoGauge
    connect MemAbstractStub.BsConst_TachoGauge_NvMNotifyJobFinished -> NvM.NvM_RpNotifyJobEnd_NvBlockSwComponentTypeNVBlockDescriptor_BsConst_TachoGauge
    connect MemAbstractStub.BsConst_TempGauge_NvMNotifyJobFinished -> NvM.NvM_RpNotifyJobEnd_NvBlockSwComponentTypeNVBlockDescriptor_BsConst_TempGauge
    connect MemAbstractStub.BsConst_TripComputer_NvMNotifyJobFinished -> NvM.NvM_RpNotifyJobEnd_NvBlockSwComponentTypeNVBlockDescriptor_BsConst_TripComputer
    connect MemAbstractStub.BsConst_Warning_NvMNotifyJobFinished -> NvM.NvM_RpNotifyJobEnd_NvBlockSwComponentTypeNVBlockDescriptor_BsConst_Warning
    connect MemAbstractStub.BsCys_Certicificate_NvMNotifyJobFinished -> NvM.NvM_RpNotifyJobEnd_NvBlockSwComponentTypeNVBlockDescriptor_BsCys_Certicificate
    connect MemAbstractStub.BsDiag_ErrorRecord_NvMNotifyJobFinished -> NvM.NvM_RpNotifyJobEnd_NvBlockSwComponentTypeNVBlockDescriptor_BsDiag_ErrorRecord
    connect MemAbstractStub.BsFuSa_Audio_NvMNotifyJobFinished -> NvM.NvM_RpNotifyJobEnd_NvBlockSwComponentTypeNVBlockDescriptor_BsFuSa_Audio
    connect MemAbstractStub.BsFuSa_Communication_NvMNotifyJobFinished -> NvM.NvM_RpNotifyJobEnd_NvBlockSwComponentTypeNVBlockDescriptor_BsFuSa_Communication
    connect MemAbstractStub.BsFuSa_Config_NvMNotifyJobFinished -> NvM.NvM_RpNotifyJobEnd_NvBlockSwComponentTypeNVBlockDescriptor_BsFuSa_Config
    connect MemAbstractStub.BsFuSa_Display_NvMNotifyJobFinished -> NvM.NvM_RpNotifyJobEnd_NvBlockSwComponentTypeNVBlockDescriptor_BsFuSa_Display
    connect MemAbstractStub.BsFuSa_Power_NvMNotifyJobFinished -> NvM.NvM_RpNotifyJobEnd_NvBlockSwComponentTypeNVBlockDescriptor_BsFuSa_Power
    connect MemAbstractStub.BsFuSa_Warning_NvMNotifyJobFinished -> NvM.NvM_RpNotifyJobEnd_NvBlockSwComponentTypeNVBlockDescriptor_BsFuSa_Warning
    connect MemAbstractStub.BsFusa_Fota_NvMNotifyJobFinished -> NvM.NvM_RpNotifyJobEnd_NvBlockSwComponentTypeNVBlockDescriptor_BsFusa_Fota
    connect MemAbstractStub.BsReten_Audio_NvMNotifyJobFinished -> NvM.NvM_RpNotifyJobEnd_NvBlockSwComponentTypeNVBlockDescriptor_BsReten_Audio
    connect MemAbstractStub.BsReten_Communication_NvMNotifyJobFinished -> NvM.NvM_RpNotifyJobEnd_NvBlockSwComponentTypeNVBlockDescriptor_BsReten_Communication
    connect MemAbstractStub.BsReten_Display_NvMNotifyJobFinished -> NvM.NvM_RpNotifyJobEnd_NvBlockSwComponentTypeNVBlockDescriptor_BsReten_Display
    connect MemAbstractStub.BsReten_Gauges_NvMNotifyJobFinished -> NvM.NvM_RpNotifyJobEnd_NvBlockSwComponentTypeNVBlockDescriptor_BsReten_Gauges
    connect MemAbstractStub.BsReten_Illumination_NvMNotifyJobFinished -> NvM.NvM_RpNotifyJobEnd_NvBlockSwComponentTypeNVBlockDescriptor_BsReten_Illumination
    connect MemAbstractStub.BsReten_Odometer_NvMNotifyJobFinished -> NvM.NvM_RpNotifyJobEnd_NvBlockSwComponentTypeNVBlockDescriptor_BsReten_Odometer
    connect MemAbstractStub.BsReten_Personalization_NvMNotifyJobFinished -> NvM.NvM_RpNotifyJobEnd_NvBlockSwComponentTypeNVBlockDescriptor_BsReten_Personalization
    connect MemAbstractStub.BsReten_Power_NvMNotifyJobFinished -> NvM.NvM_RpNotifyJobEnd_NvBlockSwComponentTypeNVBlockDescriptor_BsReten_Power
    connect MemAbstractStub.BsReten_RealTimeClock_NvMNotifyJobFinished -> NvM.NvM_RpNotifyJobEnd_NvBlockSwComponentTypeNVBlockDescriptor_BsReten_RealTimeClock
    connect MemAbstractStub.BsReten_Tripcomputer_NvMNotifyJobFinished -> NvM.NvM_RpNotifyJobEnd_NvBlockSwComponentTypeNVBlockDescriptor_BsReten_Tripcomputer
    connect MemAbstractStub.BsReten_VisDlt_NvMNotifyJobFinished -> NvM.NvM_RpNotifyJobEnd_NvBlockSwComponentTypeNVBlockDescriptor_BsReten_VisDlt
    connect MemAbstractStub.BsReten_Warning_NvMNotifyJobFinished -> NvM.NvM_RpNotifyJobEnd_NvBlockSwComponentTypeNVBlockDescriptor_BsReten_Warning
    connect MemAbstractStub.BsRt_CusDlt_NvMNotifyJobFinished -> NvM.NvM_RpNotifyJobEnd_NvBlockSwComponentTypeNVBlockDescriptor_BsRt_CusDlt
    connect MemAbstractStub.BsRt_FuelGauge_NvMNotifyJobFinished -> NvM.NvM_RpNotifyJobEnd_NvBlockSwComponentTypeNVBlockDescriptor_BsRt_FuelGauge
    connect MemAbstractStub.BsRt_Illumination_NvMNotifyJobFinished -> NvM.NvM_RpNotifyJobEnd_NvBlockSwComponentTypeNVBlockDescriptor_BsRt_Illumination
    connect MemAbstractStub.BsRt_Odometer_NvMNotifyJobFinished -> NvM.NvM_RpNotifyJobEnd_NvBlockSwComponentTypeNVBlockDescriptor_BsRt_Odometer
    connect MemAbstractStub.BsRt_OilGauge_NvMNotifyJobFinished -> NvM.NvM_RpNotifyJobEnd_NvBlockSwComponentTypeNVBlockDescriptor_BsRt_OilGauge
    connect MemAbstractStub.BsRt_Personalization_NvMNotifyJobFinished -> NvM.NvM_RpNotifyJobEnd_NvBlockSwComponentTypeNVBlockDescriptor_BsRt_Personalization
    connect MemAbstractStub.BsRt_PowerGauge_NvMNotifyJobFinished -> NvM.NvM_RpNotifyJobEnd_NvBlockSwComponentTypeNVBlockDescriptor_BsRt_PowerGauge
    connect MemAbstractStub.BsRt_RealTimeClock_NvMNotifyJobFinished -> NvM.NvM_RpNotifyJobEnd_NvBlockSwComponentTypeNVBlockDescriptor_BsRt_RealTimeClock
    connect MemAbstractStub.BsRt_SpeedoGauge_NvMNotifyJobFinished -> NvM.NvM_RpNotifyJobEnd_NvBlockSwComponentTypeNVBlockDescriptor_BsRt_SpeedoGauge
    connect MemAbstractStub.BsRt_TachoGauge_NvMNotifyJobFinished -> NvM.NvM_RpNotifyJobEnd_NvBlockSwComponentTypeNVBlockDescriptor_BsRt_TachoGauge
    connect MemAbstractStub.BsRt_TempGauge_NvMNotifyJobFinished -> NvM.NvM_RpNotifyJobEnd_NvBlockSwComponentTypeNVBlockDescriptor_BsRt_TempGauge
    connect MemAbstractStub.BsRt_TripComputer_NvMNotifyJobFinished -> NvM.NvM_RpNotifyJobEnd_NvBlockSwComponentTypeNVBlockDescriptor_BsRt_TripComputer
    connect MemAbstractStub.BsRt_Warning_NvMNotifyJobFinished -> NvM.NvM_RpNotifyJobEnd_NvBlockSwComponentTypeNVBlockDescriptor_BsRt_Warning
    connect MemAbstractStub.BsShare_EcuPartNumber_NvMNotifyJobFinished -> NvM.NvM_RpNotifyJobEnd_NvBlockSwComponentTypeNVBlockDescriptor_BsShare_EcuPartNumber
    connect MemAbstractStub.BsShare_SwUpdFotaFinPrint_NvMNotifyJobFinished -> NvM.NvM_RpNotifyJobEnd_NvBlockSwComponentTypeNVBlockDescriptor_BsShare_SwUpdFotaFinPrint
    connect MemAbstractStub.BsShare_SwUpdFotaMode_NvMNotifyJobFinished -> NvM.NvM_RpNotifyJobEnd_NvBlockSwComponentTypeNVBlockDescriptor_BsShare_SwUpdFotaMode
    connect MemAbstractStub.BsShare_SwUpdFotaStatus_NvMNotifyJobFinished -> NvM.NvM_RpNotifyJobEnd_NvBlockSwComponentTypeNVBlockDescriptor_BsShare_SwUpdFotaStatus
    connect MemAbstractStub.BsShare_SwUpdFotadecrypt_NvMNotifyJobFinished -> NvM.NvM_RpNotifyJobEnd_NvBlockSwComponentTypeNVBlockDescriptor_BsShare_SwUpdFotadecrypt
    connect MemAbstractStub.BsShare_SwUpdReflash_NvMNotifyJobFinished -> NvM.NvM_RpNotifyJobEnd_NvBlockSwComponentTypeNVBlockDescriptor_BsShare_SwUpdReflash
    connect MemAbstractStub.BsShare_VehicleConfig_NvMNotifyJobFinished -> NvM.NvM_RpNotifyJobEnd_NvBlockSwComponentTypeNVBlockDescriptor_BsShare_VehicleConfig
    connect MemAbstractStub.BsShare_VisMeet_NvMNotifyJobFinished -> NvM.NvM_RpNotifyJobEnd_NvBlockSwComponentTypeNVBlockDescriptor_BsShare_VisMeet
    connect MemAbstractStub.RefCys_Certicificate1_NvMNotifyJobFinished -> NvM.NvM_RpNotifyJobEnd_NvBlockSwComponentTypeNVBlockDescriptor_RefCys_Certicificate1
    connect NvBlockSwComponentType.BsConst_PowerGauge_Element -> MemAbstractStub.BsConst_PowerGauge_Element  # UB:Derived from original system description
    connect NvBlockSwComponentType.BsFuSa_Audio_Element -> MemAbstractStub.BsFuSa_Audio_Element  # UB:Derived from original system description
    connect NvBlockSwComponentType.BsReten_Odometer_Element -> MemAbstractStub.BsReten_Odometer_Element  # UB:Derived from original system description
    connect NvBlockSwComponentType.BsDiag_ErrorRecord_Element -> MemAbstractStub.BsDiag_ErrorRecord_Element  # UB:Derived from original system description
    connect NvBlockSwComponentType.BsConst_Audio_Element -> MemAbstractStub.BsConst_Audio_Element  # UB:Derived from original system description
    connect NvBlockSwComponentType.BsConst_TempGauge_Element -> MemAbstractStub.BsConst_TempGauge_Element  # UB:Derived from original system description
    connect NvBlockSwComponentType.BsFuSa_Communication_Element -> MemAbstractStub.BsFuSa_Communication_Element  # UB:Derived from original system description
    connect NvBlockSwComponentType.BsRt_CusDlt_Element -> MemAbstractStub.BsRt_CusDlt_Element  # UB:Derived from original system description
    connect NvBlockSwComponentType.BsShare_SwUpdFotaFinPrint_Element -> MemAbstractStub.BsShare_SwUpdFotaFinPrint_Element  # UB:Derived from original system description
    connect NvBlockSwComponentType.BsConst_Power_Element -> MemAbstractStub.BsConst_Power_Element  # UB:Derived from original system description
    connect NvBlockSwComponentType.BsRt_Illumination_Element -> MemAbstractStub.BsRt_Illumination_Element  # UB:Derived from original system description
    connect NvBlockSwComponentType.BsReten_Gauges_Element -> MemAbstractStub.BsReten_Gauges_Element  # UB:Derived from original system description
    connect NvBlockSwComponentType.BsCys_Certicificate_Element -> MemAbstractStub.BsCys_Certicificate_Element  # UB:Derived from original system description
    connect NvBlockSwComponentType.BsConst_Communication_Element -> MemAbstractStub.BsConst_Communication_Element  # UB:Derived from original system description
    connect NvBlockSwComponentType.BsShare_EcuPartNumber_Element -> MemAbstractStub.BsShare_EcuPartNumber_Element  # UB:Derived from original system description
    connect NvBlockSwComponentType.BsShare_SwUpdFotaStatus_Element -> MemAbstractStub.BsShare_SwUpdFotaStatus_Element  # UB:Derived from original system description
    connect NvBlockSwComponentType.RefCys_Certicificate_Element -> MemAbstractStub.RefCys_Certicificate_Element  # UB:Derived from original system description
    connect NvBlockSwComponentType.BsReten_Audio_Element -> MemAbstractStub.BsReten_Audio_Element  # UB:Derived from original system description
    connect NvBlockSwComponentType.BsConst_OilGauge_Element -> MemAbstractStub.BsConst_OilGauge_Element  # UB:Derived from original system description
    connect NvBlockSwComponentType.BsConst_TripComputer_Element -> MemAbstractStub.BsConst_TripComputer_Element  # UB:Derived from original system description
    connect NvBlockSwComponentType.BsConst_FuelGauge_Element -> MemAbstractStub.BsConst_FuelGauge_Element  # UB:Derived from original system description
    connect NvBlockSwComponentType.BsFusa_Fota_Element -> MemAbstractStub.BsFusa_Fota_Element  # UB:Derived from original system description
    connect NvBlockSwComponentType.BsReten_Illumination_Element -> MemAbstractStub.BsReten_Illumination_Element  # UB:Derived from original system description
    connect NvBlockSwComponentType.BsRt_PowerGauge_Element -> MemAbstractStub.BsRt_PowerGauge_Element  # UB:Derived from original system description
    connect NvBlockSwComponentType.BsReten_Tripcomputer_Element -> MemAbstractStub.BsReten_Tripcomputer_Element  # UB:Derived from original system description
    connect NvBlockSwComponentType.BsFuSa_Display_Element -> MemAbstractStub.BsFuSa_Display_Element  # UB:Derived from original system description
    connect NvBlockSwComponentType.BsReten_Power_Element -> MemAbstractStub.BsReten_Power_Element  # UB:Derived from original system description
    connect NvBlockSwComponentType.BsShare_SwUpdReflash_Element -> MemAbstractStub.BsShare_SwUpdReflash_Element  # UB:Derived from original system description
    connect NvBlockSwComponentType.BsRt_Odometer_Element -> MemAbstractStub.BsRt_Odometer_Element  # UB:Derived from original system description
    connect NvBlockSwComponentType.BsShare_SwUpdFotadecrypt_Element -> MemAbstractStub.BsShare_SwUpdFotadecrypt_Element  # UB:Derived from original system description
    connect NvBlockSwComponentType.BsConst_EngOffTimer_Element -> MemAbstractStub.BsConst_EngOffTimer_Element  # UB:Derived from original system description
    connect NvBlockSwComponentType.BsReten_RealTimeClock_Element -> MemAbstractStub.BsReten_RealTimeClock_Element  # UB:Derived from original system description
    connect NvBlockSwComponentType.BsRt_SpeedoGauge_Element -> MemAbstractStub.BsRt_SpeedoGauge_Element  # UB:Derived from original system description
    connect NvBlockSwComponentType.BsReten_Display_Element -> MemAbstractStub.BsReten_Display_Element  # UB:Derived from original system description
    connect NvBlockSwComponentType.BsConst_RealTimeClock_Element -> MemAbstractStub.BsConst_RealTimeClock_Element  # UB:Derived from original system description
    connect NvBlockSwComponentType.BsReten_VisDlt_Element -> MemAbstractStub.BsReten_VisDlt_Element  # UB:Derived from original system description
    connect NvBlockSwComponentType.BsRt_Warning_Element -> MemAbstractStub.BsRt_Warning_Element  # UB:Derived from original system description
    connect NvBlockSwComponentType.BsRt_TripComputer_Element -> MemAbstractStub.BsRt_TripComputer_Element  # UB:Derived from original system description
    connect NvBlockSwComponentType.BsDiag_Dtc_Element -> MemAbstractStub.BsDiag_Dtc_Element  # UB:Derived from original system description
    connect NvBlockSwComponentType.BsConst_Illumination_Element -> MemAbstractStub.BsConst_Illumination_Element  # UB:Derived from original system description
    connect NvBlockSwComponentType.BsShare_VehicleConfig_Element -> MemAbstractStub.BsShare_VehicleConfig_Element  # UB:Derived from original system description
    connect NvBlockSwComponentType.BsRt_Personalization_Element -> MemAbstractStub.BsRt_Personalization_Element  # UB:Derived from original system description
    connect NvBlockSwComponentType.BsFuSa_Config_Element -> MemAbstractStub.BsFuSa_Config_Element  # UB:Derived from original system description
    connect NvBlockSwComponentType.BsRt_TachoGauge_Element -> MemAbstractStub.BsRt_TachoGauge_Element  # UB:Derived from original system description
    connect NvBlockSwComponentType.RefCys_Certicificate1_Element -> MemAbstractStub.RefCys_Certicificate1_Element  # UB:Derived from original system description
    connect NvBlockSwComponentType.BsShare_VisMeet_Element -> MemAbstractStub.BsShare_VisMeet_Element  # UB:Derived from original system description
    connect NvBlockSwComponentType.BsReten_Communication_Element -> MemAbstractStub.BsReten_Communication_Element  # UB:Derived from original system description
    connect NvBlockSwComponentType.BsRt_FuelGauge_Element -> MemAbstractStub.BsRt_FuelGauge_Element  # UB:Derived from original system description
    connect NvBlockSwComponentType.BsConst_Warning_Element -> MemAbstractStub.BsConst_Warning_Element  # UB:Derived from original system description
    connect NvBlockSwComponentType.BsConst_SpeedoGauge_Element -> MemAbstractStub.BsConst_SpeedoGauge_Element  # UB:Derived from original system description
    connect NvBlockSwComponentType.BsReten_Personalization_Element -> MemAbstractStub.BsReten_Personalization_Element  # UB:Derived from original system description
    connect NvBlockSwComponentType.BsRt_RealTimeClock_Element -> MemAbstractStub.BsRt_RealTimeClock_Element  # UB:Derived from original system description
    connect NvBlockSwComponentType.BsConst_TachoGauge_Element -> MemAbstractStub.BsConst_TachoGauge_Element  # UB:Derived from original system description
    connect NvBlockSwComponentType.BsRt_OilGauge_Element -> MemAbstractStub.BsRt_OilGauge_Element  # UB:Derived from original system description
    connect NvBlockSwComponentType.BsConst_ServiceReminder_Element -> MemAbstractStub.BsConst_ServiceReminder_Element  # UB:Derived from original system description
    connect NvBlockSwComponentType.BsFuSa_Power_Element -> MemAbstractStub.BsFuSa_Power_Element  # UB:Derived from original system description
    connect NvBlockSwComponentType.BsFuSa_Warning_Element -> MemAbstractStub.BsFuSa_Warning_Element  # UB:Derived from original system description
    connect NvBlockSwComponentType.BsRt_TempGauge_Element -> MemAbstractStub.BsRt_TempGauge_Element  # UB:Derived from original system description
    connect NvBlockSwComponentType.BsShare_SwUpdFotaMode_Element -> MemAbstractStub.BsShare_SwUpdFotaMode_Element  # UB:Derived from original system description
    connect NvBlockSwComponentType.BsReten_Warning_Element -> MemAbstractStub.BsReten_Warning_Element  # UB:Derived from original system description
    connect MemAbstractStub.BsDiag_Dtc_NvMNotifyJobFinished -> NvM.NvM_RpNotifyJobEnd_NvBlockSwComponentTypeNVBlockDescriptor_BsDiag_Dtc
    connect MemAbstractStub.RefCys_Certicificate_NvMNotifyJobFinished -> NvM.NvM_RpNotifyJobEnd_NvBlockSwComponentTypeNVBlockDescriptor_RefCys_Certicificate
    connect DmnMgr.pp_CmpLibCmd_CDmnMgr -> EcuAppM.rp_CmpLibCmd_rp_CmpLibCmd_CDmnMgr  # UB:Derived from original system description
    connect UclProxyCdd.pSR_HealthDomainFatalError -> DmnMgr.rSR_HealthDomainFatalError
    connect UclProxyCdd.pSR_HealthDomainHeartbeat -> DmnMgr.rSR_HealthDomainHeartbeat
    connect UclProxyCdd.pSR_HealthDumpHdrInfo -> DmnMgr.rSR_HealthDumpHdrInfo
    connect UclProxyCdd.pSR_PowerExtendShutdownTime -> DmnMgr.rSR_PowerExtendShutdownTime
    connect UclProxyCdd.pSR_PowerSystemState -> DmnMgr.rSR_PowerSystemState
    connect CSleepManager.ppSR_SleepStatus -> EcuAppM.rpSR_SleepStatus  # UB:Derived from original system description
    connect UclProxyCdd.pSR_HealthDumpData -> DmnMgr.rSR_HealthDumpData  # UB:Derived from original system description
    connect UclProxyCdd.pSR_PowerKeepSystemAwake -> DmnMgr.rSR_PowerKeepSystemAwake  # UB:Derived from original system description
    connect UclProxyCdd.ppCS_UclInitShutdown -> DmnMgr.rpCS_UclInitShutdown  # UB:Derived from original system description
    connect DmnMgr.pp_CmpLibCmd_CDmnMgr -> EcuAppM.rp_CmpLibCmd_rp_CmpLibCmd_CDisplayCdd
    connect UclProxyCdd.pp_CmpLibCmd_CUclProxyCdd -> EcuAppM.rp_CmpLibCmd_rp_CmpLibCmd_CUclProxyCdd  # UB:Derived from original system description
    connect UclProxyCdd.pSR_HealthDomainFatalError -> Test_Comp.pSR_HealthDomainFatalError
    connect UclProxyCdd.pSR_HealthDomainHeartbeat -> Test_Comp.pSR_HealthDomainHeartbeat
    connect UclProxyCdd.pSR_HealthDumpHdrInfo -> Test_Comp.pSR_HealthDumpHdrInfo
    connect UclProxyCdd.pSR_HealthEventRecord -> Test_Comp.pSR_HealthEventRecord
    connect UclProxyCdd.pSR_PowerExtendShutdownTime -> Test_Comp.pSR_PowerExtendShutdownTime
    connect UclProxyCdd.pSR_PowerSystemState -> Test_Comp.pSR_PowerSystemState
    connect Test_Comp.rSR_HealthDumpGetData -> UclProxyCdd.rSR_HealthDumpGetData
    connect Test_Comp.rSR_HealthDumpGetHdr -> UclProxyCdd.rSR_HealthDumpGetHdr
    connect Test_Comp.rSR_IgnState -> UclProxyCdd.rSR_IgnState
    connect Test_Comp.rSR_PowerSystemStateReqChange -> UclProxyCdd.rSR_PowerSystemStateReqChange
    connect CSleepManager.ppSR_SleepStatus -> DmnMgr.rpSR_SleepStatus  # UB:Derived from original system description
    connect CSleepManager.pp_CmpLibCmd -> EcuAppM.rp_CmpLibCmd_rp_CmpLibCmd_CSleepManager  # UB:Derived from original system description
    connect DmnMgr.pSR_HealthDumpGetData -> UclProxyCdd.rSR_HealthDumpGetData  # UB:Derived from original system description
    connect DmnMgr.pSR_HealthDumpGetHdr -> UclProxyCdd.rSR_HealthDumpGetHdr  # UB:Derived from original system description
    connect DmnMgr.pSR_PowerSystemStateReqChange -> UclProxyCdd.rSR_PowerSystemStateReqChange  # UB:Derived from original system description
    connect DmnMgr.ppCS_UclSystemCallbacks -> UclProxyCdd.rCS_UclSystemCallbacks  # UB:Derived from original system description
    connect DmnMgr.ppSR_DmnInfo -> DmnMgr.rpSR_DmnInfo  # UB:Derived from original system description
    connect UclProxyCdd.pSR_HealthDomainFatalError -> DmnMgr.rSR_HealthDomainFatalError  # UB:Derived from original system description
    connect UclProxyCdd.pSR_HealthDomainHeartbeat -> DmnMgr.rSR_HealthDomainHeartbeat  # UB:Derived from original system description
    connect UclProxyCdd.pSR_HealthDumpHdrInfo -> DmnMgr.rSR_HealthDumpHdrInfo  # UB:Derived from original system description
    connect UclProxyCdd.pSR_PowerExtendShutdownTime -> DmnMgr.rSR_PowerExtendShutdownTime  # UB:Derived from original system description
    connect IoHwAb.ppIoHwAb_DOut -> CCDD_EcuPowerM.rpIoHwAb_DOut  # UB:Derived from original system description
    connect IoHwAb.ppIoHwAb_Din -> CCDD_EcuPowerM.rpIoHwAb_Din  # UB:Derived from original system description
    connect IoHwAb.ppIoHwAb_PWM -> CCDD_EcuPowerM.rpIoHwAb_PWM  # UB:Derived from original system description
    connect IoHwAb.ppIoHwAb_DOut -> CBattMdl.rpIoHwAb_DOut  # UB:Derived from original system description
    connect IoHwAb.ppIoHwAb_Din -> CBattMdl.rpIoHwAb_Din  # UB:Derived from original system description
    connect IoHwAb.ppIoHwAb_PWM -> CBattMdl.rpIoHwAb_PWM
    connect IoHwAb.ppIoHwAb_ADC -> CBattMdl.rpIoHwAb_ADC  # UB:Derived from original system description
    connect IoHwAb.ppIoHwAb_ADC -> CCDD_EcuPowerM.rpIoHwAb_ADC  # UB:Derived from original system description
    connect MemAbstractMdl.pp_CS_MemAbsGet -> DltExt.rp_CS_MemAbsGet  # UB:Derived from original system description
    connect MemAbstractMdl.pp_CS_MemAbsSet -> DltExt.rp_CS_MemAbsSet  # UB:Derived from original system description
    connect MemAbstractMdl.pp_CS_MemAbs_NvMWriteStatus -> DltExt.rp_CS_MemAbs_NvMWriteStatus  # UB:Derived from original system description
    connect UclProxyCdd.pSR_PowerSystemState -> DmnMgr.rSR_PowerSystemState  # UB:Derived from original system description
    connect CBacklightCdd.pp_CS_Backlight_Notify -> CDisplayCdd.rp_CS_Backlight_Notify
    connect CBacklightCdd.pp_CS_Backlight_Status -> CDisplayCdd.rp_CS_Backlight_Status
    connect CBacklightCdd.pp_CS_Backlight_service -> EcuAppM.rp_CS_Backlight_service
    connect CBacklightCdd.pp_CmpLibCmd_CBacklightCdd -> EcuAppM.rp_CmpLibCmd_rp_CmpLibCmd_CBacklightCdd
    connect IoHwAb.ppIoHwAb_DOut -> CBacklightCdd.rpIoHwAb_DOut
    connect IoHwAb.ppIoHwAb_Din -> CBacklightCdd.rpIoHwAb_Din
    connect IoHwAb.ppIoHwAb_PWM -> CBacklightCdd.rpIoHwAb_PWM
    connect IoHwAb.ppIoHwAb_DOut -> CDisplayCdd.rpIoHwAb_SetDout
    connect CRtcCdd.pp_CmpLibCmd_CRTCCdd -> EcuAppM.rp_CmpLibCmd_rp_CmpLibCmd_CRTCCdd
    connect IoHwAb.ppIoHwAb_ADC -> CRtcCdd.rp_CS_IoHwAb_ADC
    connect IoHwAb.ppIoHwAb_DOut -> CRtcCdd.rp_IoHwAb_DOut
    connect IoHwAb.ppIoHwAb_Din -> CRtcCdd.rp_IoHwAb_Din
    connect CBattMdl.pp_CmpLibCmd_CBattMdl -> EcuAppM.rp_CmpLibCmd_rp_CmpLibCmd_CBattMdl
    connect CCDD_EcuPowerM.pp_CmpLibCmd -> EcuAppM.rp_CmpLibCmd_rp_CmpLibCmd_CCDD_EcuPowerM
    connect CCDD_EcuPowerM.ppCS_RequestPower -> EcuAppM.rpCS_RequestPower
    connect CCDD_EcuPowerM.pp_CmpLibCmd_CCDD_EcuPowerM -> EcuAppM.rp_CmpLibCmd_rp_CmpLibCmd_CCDD_EcuPowerM
    connect CDisplayCdd.pp_CmpLibCmd_CDisplayCdd -> EcuAppM.rp_CmpLibCmd_rp_CmpLibCmd_CSndCdd
    connect EcuMExt.ppCS_EcumExt_ReleaseRUN -> EcuAppM.rpCS_EcumExt_ReleaseRUN
    connect EcuMExt.ppCS_EcumExt_RequestRUN -> EcuAppM.rpCS_EcumExt_RequestRUN
    connect NvMExt.pp_CS_NvMExt_GetNvMExtReadAllStatus -> EcuAppM.rp_CS_NvMExt_GetNvMExtReadAllStatus
    connect NvMExt.pp_CS_NvMExt_SleepOperations -> EcuAppM.rp_CS_NvMExt_SleepOperations
    connect NvMExt.pp_CS_NvmExtStartReadAll -> EcuAppM.rp_CS_NvmExtStartReadAll
    connect RtcCdd.pp_CmpLibCmd_CRTCCdd -> EcuAppM.rp_CmpLibCmd_rp_CmpLibCmd_CRTCCdd
    connect IoHwAb.ppIoHwAb_ADC -> RtcCdd.rp_CS_IoHwAb_ADC
    connect IoHwAb.ppIoHwAb_DOut -> RtcCdd.rp_IoHwAb_DOut
    connect IoHwAb.ppIoHwAb_Din -> RtcCdd.rp_IoHwAb_Din
  end to end protection set E2EPROTECTIONSET
  port interface mapping set PORTINTERFACEMAPPINGSET
