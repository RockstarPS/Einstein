AUTOSAR XML (schema 4-0-3)
package /COM/VECTOR/CFG/WORKFLOW/SYSDESC/SYNC
  flat map FLATMAP
    80 x flat instance descriptor:
      UclProxyCdd: upstream-reference=SoftwareArchitecture.UclProxyCdd, ecu-extract-reference=COMPOSITIONTYPE.UclProxyCdd
      Test_Comp: upstream-reference=SoftwareArchitecture.Test_Comp, ecu-extract-reference=COMPOSITIONTYPE.Test_Comp
      NvBlockSwComponentType: upstream-reference=SoftwareArchitecture.NvBlockSwComponentType, ecu-extract-reference=COMPOSITIONTYPE.NvBlockSwComponentType
      NvMExt: upstream-reference=SoftwareArchitecture.NvMExt, ecu-extract-reference=COMPOSITIONTYPE.NvMExt
      EcuMExt: upstream-reference=SoftwareArchitecture.EcuMExt, ecu-extract-reference=COMPOSITIONTYPE.EcuMExt
      TmExt: upstream-reference=SoftwareArchitecture.TmExt, ecu-extract-reference=COMPOSITIONTYPE.TmExt
      IoHwAb: upstream-reference=SoftwareArchitecture.IoHwAb, ecu-extract-reference=COMPOSITIONTYPE.IoHwAb
      MemAbstractStub: upstream-reference=SoftwareArchitecture.MemAbstractStub, ecu-extract-reference=COMPOSITIONTYPE.MemAbstractStub
      EcuAppM: upstream-reference=SoftwareArchitecture.EcuAppM, ecu-extract-reference=COMPOSITIONTYPE.EcuAppM
      NvBlockSwComponentTypeNVBlockDescriptor_BsConst_Audio: upstream-reference=COMPOSITIONTYPE.NvBlockSwComponentType.NVBlockDescriptor_BsConst_Audio
      NvBlockSwComponentTypeNVBlockDescriptor_BsConst_Communication: upstream-reference=COMPOSITIONTYPE.NvBlockSwComponentType.NVBlockDescriptor_BsConst_Communication
      NvBlockSwComponentTypeNVBlockDescriptor_BsConst_EngOffTimer: upstream-reference=COMPOSITIONTYPE.NvBlockSwComponentType.NVBlockDescriptor_BsConst_EngOffTimer
      NvBlockSwComponentTypeNVBlockDescriptor_BsConst_FuelGauge: upstream-reference=COMPOSITIONTYPE.NvBlockSwComponentType.NVBlockDescriptor_BsConst_FuelGauge
      NvBlockSwComponentTypeNVBlockDescriptor_BsConst_Illumination: upstream-reference=COMPOSITIONTYPE.NvBlockSwComponentType.NVBlockDescriptor_BsConst_Illumination
      NvBlockSwComponentTypeNVBlockDescriptor_BsConst_OilGauge: upstream-reference=COMPOSITIONTYPE.NvBlockSwComponentType.NVBlockDescriptor_BsConst_OilGauge
      NvBlockSwComponentTypeNVBlockDescriptor_BsConst_Power: upstream-reference=COMPOSITIONTYPE.NvBlockSwComponentType.NVBlockDescriptor_BsConst_Power
      NvBlockSwComponentTypeNVBlockDescriptor_BsConst_PowerGauge: upstream-reference=COMPOSITIONTYPE.NvBlockSwComponentType.NVBlockDescriptor_BsConst_PowerGauge
      NvBlockSwComponentTypeNVBlockDescriptor_BsConst_RealTimeClock: upstream-reference=COMPOSITIONTYPE.NvBlockSwComponentType.NVBlockDescriptor_BsConst_RealTimeClock
      NvBlockSwComponentTypeNVBlockDescriptor_BsConst_ServiceReminder: upstream-reference=COMPOSITIONTYPE.NvBlockSwComponentType.NVBlockDescriptor_BsConst_ServiceReminder
      NvBlockSwComponentTypeNVBlockDescriptor_BsConst_SpeedoGauge: upstream-reference=COMPOSITIONTYPE.NvBlockSwComponentType.NVBlockDescriptor_BsConst_SpeedoGauge
      NvBlockSwComponentTypeNVBlockDescriptor_BsConst_TachoGauge: upstream-reference=COMPOSITIONTYPE.NvBlockSwComponentType.NVBlockDescriptor_BsConst_TachoGauge
      NvBlockSwComponentTypeNVBlockDescriptor_BsConst_TempGauge: upstream-reference=COMPOSITIONTYPE.NvBlockSwComponentType.NVBlockDescriptor_BsConst_TempGauge
      NvBlockSwComponentTypeNVBlockDescriptor_BsConst_TripComputer: upstream-reference=COMPOSITIONTYPE.NvBlockSwComponentType.NVBlockDescriptor_BsConst_TripComputer
      NvBlockSwComponentTypeNVBlockDescriptor_BsConst_Warning: upstream-reference=COMPOSITIONTYPE.NvBlockSwComponentType.NVBlockDescriptor_BsConst_Warning
      NvBlockSwComponentTypeNVBlockDescriptor_BsCys_Certicificate: upstream-reference=COMPOSITIONTYPE.NvBlockSwComponentType.NVBlockDescriptor_BsCys_Certicificate
      NvBlockSwComponentTypeNVBlockDescriptor_BsDiag_Dtc: upstream-reference=COMPOSITIONTYPE.NvBlockSwComponentType.NVBlockDescriptor_BsDiag_Dtc
      NvBlockSwComponentTypeNVBlockDescriptor_BsDiag_ErrorRecord: upstream-reference=COMPOSITIONTYPE.NvBlockSwComponentType.NVBlockDescriptor_BsDiag_ErrorRecord
      NvBlockSwComponentTypeNVBlockDescriptor_BsFuSa_Audio: upstream-reference=COMPOSITIONTYPE.NvBlockSwComponentType.NVBlockDescriptor_BsFuSa_Audio
      NvBlockSwComponentTypeNVBlockDescriptor_BsFuSa_Communication: upstream-reference=COMPOSITIONTYPE.NvBlockSwComponentType.NVBlockDescriptor_BsFuSa_Communication
      NvBlockSwComponentTypeNVBlockDescriptor_BsFuSa_Config: upstream-reference=COMPOSITIONTYPE.NvBlockSwComponentType.NVBlockDescriptor_BsFuSa_Config
      NvBlockSwComponentTypeNVBlockDescriptor_BsFuSa_Display: upstream-reference=COMPOSITIONTYPE.NvBlockSwComponentType.NVBlockDescriptor_BsFuSa_Display
      NvBlockSwComponentTypeNVBlockDescriptor_BsFuSa_Power: upstream-reference=COMPOSITIONTYPE.NvBlockSwComponentType.NVBlockDescriptor_BsFuSa_Power
      NvBlockSwComponentTypeNVBlockDescriptor_BsFuSa_Warning: upstream-reference=COMPOSITIONTYPE.NvBlockSwComponentType.NVBlockDescriptor_BsFuSa_Warning
      NvBlockSwComponentTypeNVBlockDescriptor_BsFusa_Fota: upstream-reference=COMPOSITIONTYPE.NvBlockSwComponentType.NVBlockDescriptor_BsFusa_Fota
      NvBlockSwComponentTypeNVBlockDescriptor_BsReten_Audio: upstream-reference=COMPOSITIONTYPE.NvBlockSwComponentType.NVBlockDescriptor_BsReten_Audio
      NvBlockSwComponentTypeNVBlockDescriptor_BsReten_Communication: upstream-reference=COMPOSITIONTYPE.NvBlockSwComponentType.NVBlockDescriptor_BsReten_Communication
      NvBlockSwComponentTypeNVBlockDescriptor_BsReten_Display: upstream-reference=COMPOSITIONTYPE.NvBlockSwComponentType.NVBlockDescriptor_BsReten_Display
      NvBlockSwComponentTypeNVBlockDescriptor_BsReten_Gauges: upstream-reference=COMPOSITIONTYPE.NvBlockSwComponentType.NVBlockDescriptor_BsReten_Gauges
      NvBlockSwComponentTypeNVBlockDescriptor_BsReten_Illumination: upstream-reference=COMPOSITIONTYPE.NvBlockSwComponentType.NVBlockDescriptor_BsReten_Illumination
      NvBlockSwComponentTypeNVBlockDescriptor_BsReten_Odometer: upstream-reference=COMPOSITIONTYPE.NvBlockSwComponentType.NVBlockDescriptor_BsReten_Odometer
      NvBlockSwComponentTypeNVBlockDescriptor_BsReten_Personalization: upstream-reference=COMPOSITIONTYPE.NvBlockSwComponentType.NVBlockDescriptor_BsReten_Personalization
      NvBlockSwComponentTypeNVBlockDescriptor_BsReten_Power: upstream-reference=COMPOSITIONTYPE.NvBlockSwComponentType.NVBlockDescriptor_BsReten_Power
      NvBlockSwComponentTypeNVBlockDescriptor_BsReten_RealTimeClock: upstream-reference=COMPOSITIONTYPE.NvBlockSwComponentType.NVBlockDescriptor_BsReten_RealTimeClock
      NvBlockSwComponentTypeNVBlockDescriptor_BsReten_Tripcomputer: upstream-reference=COMPOSITIONTYPE.NvBlockSwComponentType.NVBlockDescriptor_BsReten_Tripcomputer
      NvBlockSwComponentTypeNVBlockDescriptor_BsReten_VisDlt: upstream-reference=COMPOSITIONTYPE.NvBlockSwComponentType.NVBlockDescriptor_BsReten_VisDlt
      NvBlockSwComponentTypeNVBlockDescriptor_BsReten_Warning: upstream-reference=COMPOSITIONTYPE.NvBlockSwComponentType.NVBlockDescriptor_BsReten_Warning
      NvBlockSwComponentTypeNVBlockDescriptor_BsRt_CusDlt: upstream-reference=COMPOSITIONTYPE.NvBlockSwComponentType.NVBlockDescriptor_BsRt_CusDlt
      NvBlockSwComponentTypeNVBlockDescriptor_BsRt_FuelGauge: upstream-reference=COMPOSITIONTYPE.NvBlockSwComponentType.NVBlockDescriptor_BsRt_FuelGauge
      NvBlockSwComponentTypeNVBlockDescriptor_BsRt_Illumination: upstream-reference=COMPOSITIONTYPE.NvBlockSwComponentType.NVBlockDescriptor_BsRt_Illumination
      NvBlockSwComponentTypeNVBlockDescriptor_BsRt_Odometer: upstream-reference=COMPOSITIONTYPE.NvBlockSwComponentType.NVBlockDescriptor_BsRt_Odometer
      NvBlockSwComponentTypeNVBlockDescriptor_BsRt_OilGauge: upstream-reference=COMPOSITIONTYPE.NvBlockSwComponentType.NVBlockDescriptor_BsRt_OilGauge
      NvBlockSwComponentTypeNVBlockDescriptor_BsRt_Personalization: upstream-reference=COMPOSITIONTYPE.NvBlockSwComponentType.NVBlockDescriptor_BsRt_Personalization
      NvBlockSwComponentTypeNVBlockDescriptor_BsRt_PowerGauge: upstream-reference=COMPOSITIONTYPE.NvBlockSwComponentType.NVBlockDescriptor_BsRt_PowerGauge
      NvBlockSwComponentTypeNVBlockDescriptor_BsRt_RealTimeClock: upstream-reference=COMPOSITIONTYPE.NvBlockSwComponentType.NVBlockDescriptor_BsRt_RealTimeClock
      NvBlockSwComponentTypeNVBlockDescriptor_BsRt_SpeedoGauge: upstream-reference=COMPOSITIONTYPE.NvBlockSwComponentType.NVBlockDescriptor_BsRt_SpeedoGauge
      NvBlockSwComponentTypeNVBlockDescriptor_BsRt_TachoGauge: upstream-reference=COMPOSITIONTYPE.NvBlockSwComponentType.NVBlockDescriptor_BsRt_TachoGauge
      NvBlockSwComponentTypeNVBlockDescriptor_BsRt_TempGauge: upstream-reference=COMPOSITIONTYPE.NvBlockSwComponentType.NVBlockDescriptor_BsRt_TempGauge
      NvBlockSwComponentTypeNVBlockDescriptor_BsRt_TripComputer: upstream-reference=COMPOSITIONTYPE.NvBlockSwComponentType.NVBlockDescriptor_BsRt_TripComputer
      NvBlockSwComponentTypeNVBlockDescriptor_BsRt_Warning: upstream-reference=COMPOSITIONTYPE.NvBlockSwComponentType.NVBlockDescriptor_BsRt_Warning
      NvBlockSwComponentTypeNVBlockDescriptor_BsShare_EcuPartNumber: upstream-reference=COMPOSITIONTYPE.NvBlockSwComponentType.NVBlockDescriptor_BsShare_EcuPartNumber
      NvBlockSwComponentTypeNVBlockDescriptor_BsShare_SwUpdFotaFinPrint: upstream-reference=COMPOSITIONTYPE.NvBlockSwComponentType.NVBlockDescriptor_BsShare_SwUpdFotaFinPrint
      NvBlockSwComponentTypeNVBlockDescriptor_BsShare_SwUpdFotaMode: upstream-reference=COMPOSITIONTYPE.NvBlockSwComponentType.NVBlockDescriptor_BsShare_SwUpdFotaMode
      NvBlockSwComponentTypeNVBlockDescriptor_BsShare_SwUpdFotaStatus: upstream-reference=COMPOSITIONTYPE.NvBlockSwComponentType.NVBlockDescriptor_BsShare_SwUpdFotaStatus
      NvBlockSwComponentTypeNVBlockDescriptor_BsShare_SwUpdFotadecrypt: upstream-reference=COMPOSITIONTYPE.NvBlockSwComponentType.NVBlockDescriptor_BsShare_SwUpdFotadecrypt
      NvBlockSwComponentTypeNVBlockDescriptor_BsShare_SwUpdReflash: upstream-reference=COMPOSITIONTYPE.NvBlockSwComponentType.NVBlockDescriptor_BsShare_SwUpdReflash
      NvBlockSwComponentTypeNVBlockDescriptor_BsShare_VehicleConfig: upstream-reference=COMPOSITIONTYPE.NvBlockSwComponentType.NVBlockDescriptor_BsShare_VehicleConfig
      NvBlockSwComponentTypeNVBlockDescriptor_BsShare_VisMeet: upstream-reference=COMPOSITIONTYPE.NvBlockSwComponentType.NVBlockDescriptor_BsShare_VisMeet
      NvBlockSwComponentTypeNVBlockDescriptor_RefCys_Certicificate: upstream-reference=COMPOSITIONTYPE.NvBlockSwComponentType.NVBlockDescriptor_RefCys_Certicificate
      NvBlockSwComponentTypeNVBlockDescriptor_RefCys_Certicificate1: upstream-reference=COMPOSITIONTYPE.NvBlockSwComponentType.NVBlockDescriptor_RefCys_Certicificate1
      MemAbstractMdl: upstream-reference=SoftwareArchitecture.MemAbstractMdl, ecu-extract-reference=COMPOSITIONTYPE.MemAbstractMdl
      DmnMgr: upstream-reference=SoftwareArchitecture.DmnMgr, ecu-extract-reference=COMPOSITIONTYPE.DmnMgr
      SciDrv: upstream-reference=SoftwareArchitecture.SciDrv, ecu-extract-reference=COMPOSITIONTYPE.SciDrv
      CSleepManager: upstream-reference=SoftwareArchitecture.CSleepManager, ecu-extract-reference=COMPOSITIONTYPE.CSleepManager
      CBacklightCdd: upstream-reference=SoftwareArchitecture.CBacklightCdd, ecu-extract-reference=COMPOSITIONTYPE.CBacklightCdd
      CDisplayCdd: upstream-reference=SoftwareArchitecture.CDisplayCdd, ecu-extract-reference=COMPOSITIONTYPE.CDisplayCdd
      CBattMdl: upstream-reference=SoftwareArchitecture.CBattMdl, ecu-extract-reference=COMPOSITIONTYPE.CBattMdl
      CCDD_EcuPowerM: upstream-reference=SoftwareArchitecture.CCDD_EcuPowerM, ecu-extract-reference=COMPOSITIONTYPE.CCDD_EcuPowerM
      Dlt: upstream-reference=SoftwareArchitecture.Dlt, ecu-extract-reference=COMPOSITIONTYPE.Dlt
      DltExt: upstream-reference=SoftwareArchitecture.DltExt, ecu-extract-reference=COMPOSITIONTYPE.DltExt
      RtcCdd: upstream-reference=SoftwareArchitecture.RtcCdd, ecu-extract-reference=COMPOSITIONTYPE.RtcCdd
