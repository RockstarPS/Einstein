AUTOSAR XML (schema 00044)
package /InitialEcuC
  ecuc value collection InitialEcuC
