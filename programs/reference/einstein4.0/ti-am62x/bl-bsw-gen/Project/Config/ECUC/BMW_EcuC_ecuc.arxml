AUTOSAR XML (schema 00044)
package /ActiveEcuC
  module config EcuC: implementation-config-variant=VARIANT-PRE-COMPILE, module-description=EcuC_Impl
    EcucGeneral:
      DummyFunction = false
      DummyStatement = true
      StructAlignment = Auto
      ArrayAlignment = Auto
      StructInArrayAlignment = Auto
      SizeOfEnum = Size32Bit
      SizeOfROMPointer = Size32Bit
      SizeOfRAMPointer = Size32Bit
      DummyStatementKind = SelfAssignment
      AtomicBitAccessInBitfield = false
      AtomicVariableAccess = Atomic32BitAccess
      CPUType = CPU32Bit
      SizeOfInt = Size32Bit
      ByteOrder = LITTLE_ENDIAN
      BitOrder = LSB_to_MSB
      BitFieldDataType = INT
      EcuCSafeBswChecks = false
      ConditionalGenerating = true
      EcucBswImplementationCodeType = EcuCSourceCode
      EcuCUseStdReturnTypeForRte = false
      BswInitialization
        9 x InitFunction:
          SchM_Init: Header=Rte_Main.h, InitPhase=NO_INIT, ModuleRef=Rte
          Rte_InitMemory: Header=Rte_Main.h, InitPhase=INIT_MEMORY, ModuleRef=Rte
          Dcm_InitMemory: Header=Dcm.h, InitPhase=INIT_MEMORY, ModuleRef=Dcm
          Dcm_Init: Header=Dcm.h, InitPhase=INIT_TWO_POST_NVMREADALL, ConfigType=Dcm_ConfigType, ConfigPtrName=NULL_PTR, ConfigPtrClass=DCM_CONST, ModuleRef=Dcm
          Dem_PreInit: Header=Dem.h, InitPhase=INIT_ZERO, ConfigType=Dem_ConfigType, ConfigPtrName=Dem_Config_Ptr, ConfigPtrClass=DEM_INIT_DATA, ModuleRef=Dem
          Dem_Init: Header=Dem.h, InitPhase=INIT_TWO_POST_NVMREADALL, ConfigType=Dem_ConfigType, ConfigPtrName=Dem_Config_Ptr, ConfigPtrClass=DEM_INIT_DATA, ModuleRef=Dem
          Dem_InitMemory: Header=Dem.h, InitPhase=INIT_MEMORY, ModuleRef=Dem
          NvM_Init: Header=NvM.h, InitPhase=INIT_TWO_SYS, ModuleRef=NvM
          Ea_Init: Header=Ea.h, InitPhase=INIT_TWO_IF, ModuleRef=Ea
    EcucHardware
      EcucCoreDefinition: EcucCoreId=0
