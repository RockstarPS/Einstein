AUTOSAR XML (schema 00044)
package /ActiveEcuC
  module config Os: implementation-config-variant=VARIANT-PRE-COMPILE, module-description=Os_Impl
    SystemTimer (OsCounter):
      OsCounterMaxAllowedValue = 2147483647
      OsCounterMinCycle = 1
      OsCounterType = HARDWARE
      OsSecondsPerTick = 0.001
      OsCounterTicksPerBase = 1
      OsCounterAccessingApplication = SystemApplication_OsCore0
      OsDriver: OsDriverHighResolution=false, OsDriverIsrRef=OsIsr, OsDriverHardwareTimerChannelRef=FRT_1_Ch0
    OsOS:
      OsScalabilityClass = SC3
      OsGenerateMemMapForNearAddressing = false
      OsStackMonitoring = true
      OsStatus = EXTENDED
      OsUseGetServiceId = false
      OsUseParameterAccess = false
      OsUseResScheduler = false
      OsForcibleTermination = false
      OsGenerateCalloutStubs = true
      OsGenerateMemMap = COMPLETE
      OsGenerateMemMapForThreads = false
      OsServiceProtection = false
      OsStackUsageMeasurement = false
      OsUseXSignalAsyncApiCalls = false
      OsFpuUsage = NONE
      OsNumberOfCores = 1
      OsSystemTimer = SystemTimer
      OsMasterCore = OsCore0
      OsHooks: OsErrorHook=true, OsPostTaskHook=false, OsPreTaskHook=false, OsShutdownHook=false, OsStartupHook=false
      OsStackSummary
        24 x OsStack, all with OsStackSize=1024, OsStackCore=OsCore0:
          OsCore0_Error: OsStackType=CORE_ERROR_STACK, OsStackUser=OsCore0
          OsCore0_Init: OsStackType=CORE_INIT_STACK, OsStackUser=OsCore0
          OsCore0_Kernel: OsStackType=CORE_KERNEL_STACK, OsStackUser=OsCore0
          OsCore0_Task_Prio4294967295: OsStackType=TASK_SHARED_PRIORITY_STACK, OsStackUser=IdleTask_OsCore0
          OsCore0_Isr_Core: OsStackType=ISR_SHARED_CORE_STACK, OsStackUser=OsIsr
          OsCore0_Task_Prio1: OsStackType=TASK_SHARED_PRIORITY_STACK, OsStackUser=OsTask_ModeMgt
          OsTask_CddFun: OsStackType=TASK_SHARED_PRIORITY_STACK, OsStackUser=Os/OsTask_CddFun
          OsCore0_Task_Prio3: OsStackType=TASK_SHARED_PRIORITY_STACK, OsStackUser=OsTask_WdgMngt
          OsTask_MemSer: OsStackType=TASK_SHARED_PRIORITY_STACK, OsStackUser=Os/OsTask_MemSer
          OsCore0_Task_Prio5: OsStackType=TASK_SHARED_PRIORITY_STACK, OsStackUser=OsTask_Mcal
          OsTask_NvmSpeedup: OsStackType=TASK_SHARED_PRIORITY_STACK, OsStackUser=Os/OsTask_NvmSpeedup
          OsCore0_Task_Prio7: OsStackType=TASK_SHARED_PRIORITY_STACK, OsStackUser=OsTask_EthFun
          OsCore0_Task_Prio8: OsStackType=TASK_SHARED_PRIORITY_STACK, OsStackUser=OsTask_SafeFun
          OsCore0_Task_Prio9: OsStackType=TASK_SHARED_PRIORITY_STACK, OsStackUser=OsTask_GaugeFun
          OsCore0_Task_Prio10: OsStackType=TASK_SHARED_PRIORITY_STACK, OsStackUser=OsTask_LinFun
          OsCore0_Task_Prio11: OsStackType=TASK_SHARED_PRIORITY_STACK, OsStackUser=OsTask_AudioFun
          OsCore0_Task_Prio12: OsStackType=TASK_SHARED_PRIORITY_STACK, OsStackUser=OsTask_IndFun
          OsCore0_Task_Prio13: OsStackType=TASK_SHARED_PRIORITY_STACK, OsStackUser=OsTask_WarnFun
          OsCore0_Task_Prio14: OsStackType=TASK_SHARED_PRIORITY_STACK, OsStackUser=OsTask_TripFun
          OsCore0_Task_Prio15: OsStackType=TASK_SHARED_PRIORITY_STACK, OsStackUser=OsTask_AppFun
          OsCore0_Task_Prio16: OsStackType=TASK_SHARED_PRIORITY_STACK, OsStackUser=OsTask_FotaFun
          OsTask_Graphics: OsStackType=TASK_SHARED_PRIORITY_STACK, OsStackUser=Os/OsTask_Graphics
          OsTask_Diagnostics: OsStackType=TASK_SHARED_PRIORITY_STACK, OsStackUser=Os/OsTask_Diagnostics
          OsCore0_Task_Prio0: OsStackType=TASK_SHARED_PRIORITY_STACK, OsStackUser=OsTask_CANFun, OsStackUser=OsTask_OsTask1, OsStackUser=OsTask_OsTask2
    OsMemoryProtection
      3 x OsMemoryRegion, all with OsMemoryRegionProtectionUnit=Core0_MPU, OsMemoryRegionFlags=TYPE_CACHEABLE_WRITEBACK_ALLOCATE:
        Core0_FullAccessSupervisor: OsMemoryRegionStartAddress=0, OsMemoryRegionEndAddress=0x100000000, OsMemoryRegionProtectionUnitSlot=0, OsMemoryRegionAccessRights=SUPERVISOR_RWX, OsMemoryRegionAccessRights=USER_RX
        Core0_StackProtection: OsMemoryRegionStartAddress=_OS_CORE0_STACKS_START, OsMemoryRegionProtectionUnitSlot=1, OsMemoryRegionEndAddress=1024, OsMemoryRegionAccessRights=SUPERVISOR_R, OsMemoryRegionAccessRights=USER_R
        MemoryRegion_App_SystemApplication_OsCore0: OsMemoryRegionStartAddress=_OS_SystemApplication_OsCore0_VAR_ALL_START, OsMemoryRegionEndAddress=1024, OsMemoryRegionIdentifier=1, OsMemoryRegionProtectionUnitSlot=14, OsMemoryRegionAccessRights=SUPERVISOR_RW, OsMemoryRegionOwner=SystemApplication_OsCore0, OsMemoryRegionAccessRights=USER_R
    OSDEFAULTAPPMODE (OsAppMode)
    OS_APPMODE_ANY (OsAppMode)
    OsPublishedInformation: OsKernelVersion=7, OsPlatformName=Arm
      S6J32xx (OsDerivativeInformation):
        OsMpuAlignment = SIZE
        OsStackAlignment = 0
        OsExceptionVectorTableAlignment = 0
        OsInterruptVectorTableAlignment = 0
        OsHardwareManuals = ARM Architecture Reference Manual ARMv7-A and ARMv7-R edition: ARM DDI 0406C.c (ID051414), 20 May 2014 Spansion Traveo Family Hardware Manual Platform Part: Doc. No. 002-04854 Rev. *A, 26 July 2015 S6J3200 Series Spansion Traveo Family Hardware Manual: Doc. No. 002-04852 Rev. *A, 13 October 2015
        Core0 (OsPhysicalCore):
          OsPhysicalCoreId = 0
          OsPhysicalCoreType = Cortex-R_Traveo
          OsPhysicalCoreExceptionSources = 8
          OsPhysicalCoreIsAutostart = true
          OsPhysicalCoreMasterStartAllowed = true
          OsPhysicalCorePrivelegedHwAccess = true
          OsPhysicalCoreStackProtectionUnit = Core0_MPU
          Core0_MPU (OsPhysicalCoreMpu): OsPhysicalCoreMpuMaxRegions=16, OsPhysicalCoreMpuId=0, OsPhysicalCoreMpuType=CoreMpu
        FRT_1 (OsHardwareTimer): OsHardwareTimerSize=32, OsHardwareTimerUnit=FRT, OsHardwareTimerBaseAddress=3028418564, OsHardwareTimerId=0, OsHardwareTimerType=FRT
          8 x OsHardwareTimerChannel:
            FRT_1_Ch0: OsHardwareTimerChannelOffset=0, OsHardwareTimerChannelIntSource=208, OsHardwareTimerChannelId=0
            FRT_1_Ch1: OsHardwareTimerChannelOffset=1024, OsHardwareTimerChannelIntSource=209, OsHardwareTimerChannelId=1
            FRT_1_Ch2: OsHardwareTimerChannelOffset=2048, OsHardwareTimerChannelIntSource=210, OsHardwareTimerChannelId=2
            FRT_1_Ch3: OsHardwareTimerChannelOffset=3072, OsHardwareTimerChannelIntSource=211, OsHardwareTimerChannelId=3
            FRT_1_Ch4: OsHardwareTimerChannelOffset=4096, OsHardwareTimerChannelIntSource=212, OsHardwareTimerChannelId=4
            FRT_1_Ch5: OsHardwareTimerChannelOffset=5120, OsHardwareTimerChannelIntSource=213, OsHardwareTimerChannelId=5
            FRT_1_Ch6: OsHardwareTimerChannelOffset=6144, OsHardwareTimerChannelIntSource=214, OsHardwareTimerChannelId=6
            FRT_1_Ch7: OsHardwareTimerChannelOffset=7168, OsHardwareTimerChannelIntSource=215, OsHardwareTimerChannelId=7
          FRTCompareBaseAddress (OsHardwareTimerAddress): OsHardwareTimerAddressValue=3028484096
        INTC (OsSystemIntCtrl):
          OsSystemIntCtrlMaxPrios = 32
          OsSystemIntCtrlMaxSources = 512
          OsSystemIntCtrlPrioOrder = DESC
          OsSystemIntCtrlBaseAddress = 2956984320
          OsSystemIntCtrlType = Traveo
        FRT_2 (OsHardwareTimer): OsHardwareTimerSize=32, OsHardwareTimerUnit=FRT, OsHardwareTimerBaseAddress=3028942852, OsHardwareTimerId=0, OsHardwareTimerType=FRT
          4 x OsHardwareTimerChannel:
            FRT_2_Ch8: OsHardwareTimerChannelOffset=0, OsHardwareTimerChannelIntSource=216, OsHardwareTimerChannelId=8
            FRT_2_Ch9: OsHardwareTimerChannelOffset=1024, OsHardwareTimerChannelIntSource=217, OsHardwareTimerChannelId=9
            FRT_2_Ch10: OsHardwareTimerChannelOffset=2048, OsHardwareTimerChannelIntSource=218, OsHardwareTimerChannelId=10
            FRT_2_Ch11: OsHardwareTimerChannelOffset=3072, OsHardwareTimerChannelIntSource=219, OsHardwareTimerChannelId=11
          FRTCompareBaseAddress (OsHardwareTimerAddress): OsHardwareTimerAddressValue=3029008384
        OsMemoryRegionSpecifics
          10 x OsMemoryRegionAccess:
            SUPERVISOR_R: OsMemoryRegionAccessRights=R, OsMemoryRegionAccessType=SUPERVISOR
            SUPERVISOR_RW: OsMemoryRegionAccessRights=RW, OsMemoryRegionAccessType=SUPERVISOR
            USER_R: OsMemoryRegionAccessRights=R, OsMemoryRegionAccessType=USER
            USER_RW: OsMemoryRegionAccessRights=RW, OsMemoryRegionAccessType=USER
            SUPERVISOR_NONE: OsMemoryRegionAccessRights=NONE, OsMemoryRegionAccessType=SUPERVISOR
            USER_NONE: OsMemoryRegionAccessRights=NONE, OsMemoryRegionAccessType=USER
            SUPERVISOR_RX: OsMemoryRegionAccessRights=RX, OsMemoryRegionAccessType=SUPERVISOR
            SUPERVISOR_RWX: OsMemoryRegionAccessRights=RWX, OsMemoryRegionAccessType=SUPERVISOR
            USER_RX: OsMemoryRegionAccessRights=RX, OsMemoryRegionAccessType=USER
            USER_RWX: OsMemoryRegionAccessRights=RWX, OsMemoryRegionAccessType=USER
          8 x OsMemoryRegionFlag:
            SHAREABLE
            TYPE_STRONGLY_ORDERED
            TYPE_NON_CACHEABLE
            TYPE_CACHEABLE_WRITEBACK_ALLOCATE
            TYPE_SHAREABLE_DEVICE
            TYPE_NON_SHAREABLE_DEVICE
            TYPE_CACHEABLE_WRITETHROUGH_NO_ALLOCATE
            TYPE_CACHEABLE_WRITEBACK_NO_ALLOCATE
        ReloadTimer_1 (OsHardwareTimer): OsHardwareTimerUnit=PIT, OsHardwareTimerSize=32, OsHardwareTimerBaseAddress=3028353024, OsHardwareTimerId=0, OsHardwareTimerType=ReloadTimer
          4 x OsHardwareTimerChannel:
            ReloadTimer_1_Ch0: OsHardwareTimerChannelIntSource=152, OsHardwareTimerChannelOffset=0, OsHardwareTimerChannelId=0
            ReloadTimer_1_Ch1: OsHardwareTimerChannelIntSource=153, OsHardwareTimerChannelOffset=1024, OsHardwareTimerChannelId=1
            ReloadTimer_1_Ch2: OsHardwareTimerChannelIntSource=154, OsHardwareTimerChannelOffset=2048, OsHardwareTimerChannelId=2
            ReloadTimer_1_Ch3: OsHardwareTimerChannelIntSource=155, OsHardwareTimerChannelOffset=3072, OsHardwareTimerChannelId=3
        OsMemoryRegionDefaults_AppT (OsMemoryRegionDefaults):
          OsMemoryRegionDefIdentifier = 1
          OsMemoryRegionDefType = APPLICATION_TRUSTED
          OsMemoryRegionDefProtectionUnitSlot = 14
          OsMemoryRegionDefAccessRights = SUPERVISOR_RW
          OsMemoryRegionDefAccessRights = USER_R
          OsMemoryRegionDefFlags = TYPE_CACHEABLE_WRITEBACK_ALLOCATE
        OsMemoryRegionDefaults_AppNT (OsMemoryRegionDefaults):
          OsMemoryRegionDefIdentifier = 1
          OsMemoryRegionDefType = APPLICATION_NONTRUSTED
          OsMemoryRegionDefProtectionUnitSlot = 14
          OsMemoryRegionDefAccessRights = SUPERVISOR_RW
          OsMemoryRegionDefAccessRights = USER_RW
          OsMemoryRegionDefFlags = TYPE_CACHEABLE_WRITEBACK_ALLOCATE
        FIQ (OsInterruptSupportedType): OsInterruptSupportedTypeSeparateSources=true
        DEFAULT (OsInterruptSupportedType): OsInterruptSupportedTypeSeparateSources=true
    OsCore0 (OsCore):
      OsCoreIsAutostart = true
      OsCoreIsAutosar = true
      OsCorePhysicalCoreRef = Core0
      OsCoreIdleTask = IdleTask_OsCore0
      OsCoreSystemApplication = SystemApplication_OsCore0
      OsCoreEcucCoreRef = EcucCoreDefinition
      OsCoreStacks:
        OsCoreKernelStackSize = 1024
        OsCoreStartupStackSize = 1024
        OsCoreShutdownStackSize = 1024
        OsCoreErrorStackSize = 1024
        OsCoreProtectionStackSize = 1024
        OsCoreInitStackSize = 1024
    IdleTask_OsCore0 (OsTask):
      OsTaskActivation = 1
      OsTaskPriority = 4294967295
      OsTaskSchedule = FULL
      OsTaskStackSharing = false
      OsTaskStackSize = 1024
      OsTaskType = AUTO
      OsTaskUsesFpu = false
      OsTaskAccessingApplication = SystemApplication_OsCore0
      OsTaskAutostart: OsTaskAppModeRef=OS_APPMODE_ANY
    SystemApplication_OsCore0 (OsApplication):
      OsTrusted = true
      OsTrustedApplicationDelayTimingViolationCall = false
      OsTrustedApplicationWithProtection = false
      OsApplicationIsPrivileged = true
      OsAppUseTrustedFunctionStubs = false
      OsAppTaskRef = IdleTask_OsCore0
      OsApplicationCoreRef = EcucCoreDefinition
      OsAppIsrRef = OsIsr
      OsAppCounterRef = SystemTimer
      OsAppTaskRef = OsTask_OsTask1
      OsAppTaskRef = OsTask_OsTask2
      OsAppAlarmRef = Rte_Al_TE_UclProxyCdd_CUclProxyCdd_Impl_MainFunction
      OsAppAlarmRef = Rte_Al_TE_Ea_Ea_MainFunction
      OsAppTaskRef = OsTask_ModeMgt
      OsAppTaskRef = Os/OsTask_CddFun
      OsAppTaskRef = OsTask_WdgMngt
      OsAppTaskRef = Os/OsTask_MemSer
      OsAppTaskRef = OsTask_Mcal
      OsAppTaskRef = OsTask_CANFun
      OsAppTaskRef = OsTask_EthFun
      OsAppTaskRef = OsTask_SafeFun
      OsAppTaskRef = OsTask_GaugeFun
      OsAppTaskRef = OsTask_LinFun
      OsAppTaskRef = OsTask_AudioFun
      OsAppTaskRef = OsTask_IndFun
      OsAppTaskRef = OsTask_WarnFun
      OsAppTaskRef = OsTask_TripFun
      OsAppTaskRef = OsTask_AppFun
      OsAppTaskRef = OsTask_FotaFun
      OsAppTaskRef = Os/OsTask_Graphics
      OsAppTaskRef = Os/OsTask_Diagnostics
      OsAppAlarmRef = Rte_Al_TE2_OsTask_ModeMgt_5msLP_0_5ms
      OsAppAlarmRef = Rte_Al_TE2_OsTask_Mcal_10msLP_0_10ms
      OsAppAlarmRef = Rte_Al_TE2_OsTask_SafeFun_10msLP_0_10ms
      OsAppAlarmRef = Rte_Al_TE2_MemSer_10msLP_0_10ms
      OsAppAlarmRef = Rte_Al_TE2_OsTask_Graphics_130msLP_0_130ms
      OsAppAlarmRef = Rte_Al_TE_OsTask_Mcal_0_10ms
      OsAppAlarmRef = Rte_Al_TE2_OsTask_MemSer_0_10ms
      OsAppAlarmRef = Rte_Al_TE_OsTask_MemSer_0_10ms
      OsAppAlarmRef = Rte_Al_TE_Test_Comp_TxRxIpcMessage
      OsAppTaskRef = Os/OsTask_NvmSpeedup
      OsAppAlarmRef = Rte_Al_TE_Test_Comp_AppTaskStubRunnable
      OsAppAlarmRef = Rte_Al_TE_Test_Comp_AudioTaskStubRunnable
      OsAppAlarmRef = Rte_Al_TE_OsTask_CANFun_0_10ms
      OsAppAlarmRef = Rte_Al_TE_OsTask_EthFun_0_10ms
      OsAppAlarmRef = Rte_Al_TE_Test_Comp_FotaTaskStubRunnable
      OsAppAlarmRef = Rte_Al_TE_Test_Comp_GaugeTaskStubRunnable
      OsAppAlarmRef = Rte_Al_TE_Test_Comp_GraphicsTaskStubRunnable
      OsAppAlarmRef = Rte_Al_TE_Test_Comp_IndTaskStubRunnable
      OsAppAlarmRef = Rte_Al_TE_Test_Comp_LinTaskStubRunnable
      OsAppAlarmRef = Rte_Al_TE_Test_Comp_IoExp_MainFunction
      OsAppAlarmRef = Rte_Al_TE_Test_Comp_TripTaskStubRunnable
      OsAppAlarmRef = Rte_Al_TE_Test_Comp_WarnTaskStubRunnable
      OsAppAlarmRef = Rte_Al_TE_Test_Comp_WdgMgntTaskStubRunnable
      OsAppAlarmRef = Rte_Al_TE_NvMExt_NvMExt_SpeedupRunnable
      OsAppAlarmRef = Rte_Al_TE_OsTask_CddFun_0_10ms
      OsAppAlarmRef = Rte_Al_TE_OsTask_CddFun_0_5ms
      OsAppAlarmRef = Rte_Al_TE2_OsTask_Diagnostics_0_10ms
      OsAppAlarmRef = Rte_Al_TE_OsTask_Diagnostics_0_100ms
      OsApplicationHooks: OsAppErrorHook=false, OsAppShutdownHook=false, OsAppStartupHook=false
    OsApplication:
      OsTrusted = true
      OsTrustedApplicationDelayTimingViolationCall = false
      OsTrustedApplicationWithProtection = false
      OsApplicationIsPrivileged = false
      OsAppUseTrustedFunctionStubs = false
      OsApplicationCoreRef = EcucCoreDefinition
      OsApplicationHooks: OsAppErrorHook=false, OsAppShutdownHook=false, OsAppStartupHook=false
    OsIsr:
      OsIsrCategory = CATEGORY_2
      OsIsrInterruptType = EXTERNAL
      OsIsrInterruptSource = 208
      OsIsrInterruptPriority = 0
      OsIsrStackSize = 1024
      OsIsrEnableNesting = false
      OsIsrUsesFpu = false
      OsIsrInitialEnableInterruptSource = false
      OsIsrSpecialFunctionName = Os_TimerPfrtIsr
      OsIsrInterruptMapping = DEFAULT
    OsTask_OsTask1 (OsTask):
      OsTaskActivation = 1
      OsTaskPriority = 0
      OsTaskSchedule = FULL
      OsTaskStackSharing = false
      OsTaskStackSize = 1024
      OsTaskType = AUTO
      OsTaskUsesFpu = false
      OsTaskAccessingApplication = SystemApplication_OsCore0
    OsTask_OsTask2 (OsTask):
      OsTaskActivation = 1
      OsTaskPriority = 0
      OsTaskSchedule = FULL
      OsTaskStackSharing = false
      OsTaskStackSize = 1024
      OsTaskType = AUTO
      OsTaskUsesFpu = false
      OsTaskAccessingApplication = SystemApplication_OsCore0
    Rte_Al_TE_UclProxyCdd_CUclProxyCdd_Impl_MainFunction (OsAlarm): OsAlarmCounterRef=SystemTimer, OsAlarmAccessingApplication=SystemApplication_OsCore0
      OsAlarmAction
        OsAlarmSetEvent: OsAlarmSetEventRef=Rte_Ev_Run_UclProxyCdd_CUclProxyCdd_Impl_MainFunction, OsAlarmSetEventTaskRef=Os/OsTask_MemSer
    4 x OsEvent:
      Rte_Ev_Run_UclProxyCdd_CUclProxyCdd_Impl_MainFunction
      Rte_Ev_Run_UclProxyCdd_OnDre_HealthDumpGetData
      Rte_Ev_Run_UclProxyCdd_OnDre_HealthDumpGetHdr
      Rte_Ev_Run_UclProxyCdd_OnDre_PowerSystemStateReqChange
    Rte_Al_TE_Ea_Ea_MainFunction (OsAlarm): OsAlarmCounterRef=SystemTimer, OsAlarmAccessingApplication=SystemApplication_OsCore0
      OsAlarmAction
        OsAlarmSetEvent: OsAlarmSetEventRef=Rte_Ev_Run_Ea_Ea_MainFunction, OsAlarmSetEventTaskRef=Os/OsTask_MemSer
    4 x OsEvent:
      Rte_Ev_Run_Ea_Ea_MainFunction
      Rte_Ev_Run_NvBlockSwComponentType_NvBlockSwComponentTypeRunnable
      Rte_Ev_Cyclic_OsTask_Graphics_130msLP_0_130ms
      Rte_Ev_Cyclic_MemSer_10msLP_0_10ms
    18 x OsTask, all with OsTaskActivation=1, OsTaskStackSharing=false, OsTaskStackSize=1024, OsTaskUsesFpu=false, OsTaskAccessingApplication=SystemApplication_OsCore0:
      OsTask_ModeMgt: OsTaskPriority=1, OsTaskSchedule=NON, OsTaskType=BASIC
      OsTask_CddFun: OsTaskPriority=2, OsTaskSchedule=NON, OsTaskType=EXTENDED, OsTaskEventRef=Rte_Ev_Cyclic_OsTask_CddFun_0_10ms, OsTaskEventRef=Rte_Ev_Cyclic_OsTask_CddFun_0_5ms
      OsTask_WdgMngt: OsTaskPriority=3, OsTaskSchedule=NON, OsTaskType=BASIC
      OsTask_MemSer: OsTaskPriority=4, OsTaskSchedule=NON, OsTaskType=EXTENDED, OsTaskEventRef=Rte_Ev_Cyclic_MemSer_10msLP_0_10ms, OsTaskEventRef=Rte_Ev_Cyclic2_OsTask_MemSer_0_10ms, OsTaskEventRef=Rte_Ev_Cyclic_OsTask_MemSer_0_10ms, OsTaskEventRef=Rte_Ev_Run_Ea_Ea_MainFunction, OsTaskEventRef=Rte_Ev_Run_NvBlockSwComponentType_NvBlockSwComponentTypeRunnable, OsTaskEventRef=Rte_Ev_Run_UclProxyCdd_CUclProxyCdd_Impl_MainFunction, OsTaskEventRef=Rte_Ev_Run_UclProxyCdd_OnDre_HealthDumpGetData, OsTaskEventRef=Rte_Ev_Run_UclProxyCdd_OnDre_HealthDumpGetHdr, OsTaskEventRef=Rte_Ev_Run_UclProxyCdd_OnDre_PowerSystemStateReqChange, OsTaskEventRef=Rte_Ev_Run_DmnMgr_DmnMgr_MonitorDmnExtendShutdownTime, OsTaskEventRef=Rte_Ev_Run_DmnMgr_DmnMgr_MonitorDmnHealthDumpData, OsTaskEventRef=Rte_Ev_Run_DmnMgr_DmnMgr_MonitorDmnHealthDumpHdrInfo, OsTaskEventRef=Rte_Ev_Run_DmnMgr_DmnMgr_MonitorDmnHealthFatalError, OsTaskEventRef=Rte_Ev_Run_DmnMgr_DmnMgr_MonitorDmnHeartBeat, OsTaskEventRef=Rte_Ev_Run_DmnMgr_DmnMgr_MonitorDmnKeepSystemAwake, OsTaskEventRef=Rte_Ev_Run_DmnMgr_DmnMgr_MonitorDmnPowerSystemState
      OsTask_Mcal: OsTaskPriority=5, OsTaskSchedule=NON, OsTaskType=BASIC
      OsTask_CANFun: OsTaskPriority=0, OsTaskSchedule=NON, OsTaskType=BASIC
      OsTask_EthFun: OsTaskPriority=7, OsTaskSchedule=NON, OsTaskType=BASIC
      OsTask_SafeFun: OsTaskPriority=8, OsTaskSchedule=NON, OsTaskType=BASIC
      OsTask_GaugeFun: OsTaskPriority=9, OsTaskSchedule=NON, OsTaskType=BASIC
      OsTask_LinFun: OsTaskPriority=10, OsTaskSchedule=NON, OsTaskType=BASIC
      OsTask_AudioFun: OsTaskPriority=11, OsTaskSchedule=NON, OsTaskType=BASIC
      OsTask_IndFun: OsTaskPriority=12, OsTaskSchedule=NON, OsTaskType=BASIC
      OsTask_WarnFun: OsTaskPriority=13, OsTaskSchedule=NON, OsTaskType=BASIC
      OsTask_TripFun: OsTaskPriority=14, OsTaskSchedule=NON, OsTaskType=BASIC
      OsTask_AppFun: OsTaskPriority=15, OsTaskSchedule=NON, OsTaskType=BASIC
      OsTask_FotaFun: OsTaskPriority=16, OsTaskSchedule=FULL, OsTaskType=BASIC
      OsTask_Graphics: OsTaskPriority=17, OsTaskSchedule=FULL, OsTaskType=EXTENDED, OsTaskEventRef=Rte_Ev_Cyclic_OsTask_Graphics_130msLP_0_130ms, OsTaskEventRef=Rte_Ev_Run_Test_Comp_GraphicsTaskStubRunnable
      OsTask_Diagnostics: OsTaskPriority=18, OsTaskSchedule=NON, OsTaskType=EXTENDED, OsTaskEventRef=Rte_Ev_Cyclic2_OsTask_Diagnostics_0_10ms, OsTaskEventRef=Rte_Ev_Cyclic_OsTask_Diagnostics_0_100ms
    9 x OsAlarm, all with OsAlarmCounterRef=SystemTimer, OsAlarmAccessingApplication=SystemApplication_OsCore0:
      Rte_Al_TE2_OsTask_ModeMgt_5msLP_0_5ms
        OsAlarmAction
          OsAlarmActivateTask: OsAlarmActivateTaskRef=OsTask_ModeMgt
      Rte_Al_TE2_OsTask_Mcal_10msLP_0_10ms
        OsAlarmAction
          OsAlarmActivateTask: OsAlarmActivateTaskRef=OsTask_Mcal
      Rte_Al_TE2_OsTask_SafeFun_10msLP_0_10ms
        OsAlarmAction
          OsAlarmActivateTask: OsAlarmActivateTaskRef=OsTask_SafeFun
      Rte_Al_TE2_MemSer_10msLP_0_10ms
        OsAlarmAction
          OsAlarmSetEvent: OsAlarmSetEventRef=Rte_Ev_Cyclic_MemSer_10msLP_0_10ms, OsAlarmSetEventTaskRef=Os/OsTask_MemSer
      Rte_Al_TE2_OsTask_Graphics_130msLP_0_130ms
        OsAlarmAction
          OsAlarmSetEvent: OsAlarmSetEventRef=Rte_Ev_Cyclic_OsTask_Graphics_130msLP_0_130ms, OsAlarmSetEventTaskRef=Os/OsTask_Graphics
      Rte_Al_TE_OsTask_Mcal_0_10ms
        OsAlarmAction
          OsAlarmActivateTask: OsAlarmActivateTaskRef=OsTask_Mcal
      Rte_Al_TE2_OsTask_MemSer_0_10ms
        OsAlarmAction
          OsAlarmSetEvent: OsAlarmSetEventRef=Rte_Ev_Cyclic2_OsTask_MemSer_0_10ms, OsAlarmSetEventTaskRef=Os/OsTask_MemSer
      Rte_Al_TE_OsTask_MemSer_0_10ms
        OsAlarmAction
          OsAlarmSetEvent: OsAlarmSetEventRef=Rte_Ev_Cyclic_OsTask_MemSer_0_10ms, OsAlarmSetEventTaskRef=Os/OsTask_MemSer
      Rte_Al_TE_Test_Comp_TxRxIpcMessage
        OsAlarmAction
          OsAlarmActivateTask: OsAlarmActivateTaskRef=OsTask_SafeFun
    Rte_Ev_Cyclic2_OsTask_MemSer_0_10ms (OsEvent)
    Rte_Ev_Cyclic_OsTask_MemSer_0_10ms (OsEvent)
    OsTask_NvmSpeedup (OsTask):
      OsTaskActivation = 1
      OsTaskPriority = 0
      OsTaskSchedule = NON
      OsTaskStackSharing = false
      OsTaskStackSize = 1024
      OsTaskType = EXTENDED
      OsTaskUsesFpu = false
      OsTaskAccessingApplication = SystemApplication_OsCore0
      OsTaskEventRef = Rte_Ev_Run_NvMExt_NvMExt_SpeedupRunnable
    Rte_Ev_Run_NvMExt_NvMExt_SpeedupRunnable (OsEvent)
    13 x OsAlarm, all with OsAlarmCounterRef=SystemTimer, OsAlarmAccessingApplication=SystemApplication_OsCore0:
      Rte_Al_TE_Test_Comp_AppTaskStubRunnable
        OsAlarmAction
          OsAlarmActivateTask: OsAlarmActivateTaskRef=OsTask_AppFun
      Rte_Al_TE_Test_Comp_AudioTaskStubRunnable
        OsAlarmAction
          OsAlarmActivateTask: OsAlarmActivateTaskRef=OsTask_AudioFun
      Rte_Al_TE_OsTask_CANFun_0_10ms
        OsAlarmAction
          OsAlarmActivateTask: OsAlarmActivateTaskRef=OsTask_CANFun
      Rte_Al_TE_OsTask_EthFun_0_10ms
        OsAlarmAction
          OsAlarmActivateTask: OsAlarmActivateTaskRef=OsTask_EthFun
      Rte_Al_TE_Test_Comp_FotaTaskStubRunnable
        OsAlarmAction
          OsAlarmActivateTask: OsAlarmActivateTaskRef=OsTask_FotaFun
      Rte_Al_TE_Test_Comp_GaugeTaskStubRunnable
        OsAlarmAction
          OsAlarmActivateTask: OsAlarmActivateTaskRef=OsTask_GaugeFun
      Rte_Al_TE_Test_Comp_GraphicsTaskStubRunnable
        OsAlarmAction
          OsAlarmSetEvent: OsAlarmSetEventRef=Rte_Ev_Run_Test_Comp_GraphicsTaskStubRunnable, OsAlarmSetEventTaskRef=Os/OsTask_Graphics
      Rte_Al_TE_Test_Comp_IndTaskStubRunnable
        OsAlarmAction
          OsAlarmActivateTask: OsAlarmActivateTaskRef=OsTask_IndFun
      Rte_Al_TE_Test_Comp_LinTaskStubRunnable
        OsAlarmAction
          OsAlarmActivateTask: OsAlarmActivateTaskRef=OsTask_LinFun
      Rte_Al_TE_Test_Comp_IoExp_MainFunction
        OsAlarmAction
          OsAlarmActivateTask: OsAlarmActivateTaskRef=OsTask_ModeMgt
      Rte_Al_TE_Test_Comp_TripTaskStubRunnable
        OsAlarmAction
          OsAlarmActivateTask: OsAlarmActivateTaskRef=OsTask_TripFun
      Rte_Al_TE_Test_Comp_WarnTaskStubRunnable
        OsAlarmAction
          OsAlarmActivateTask: OsAlarmActivateTaskRef=OsTask_WarnFun
      Rte_Al_TE_Test_Comp_WdgMgntTaskStubRunnable
        OsAlarmAction
          OsAlarmActivateTask: OsAlarmActivateTaskRef=OsTask_WdgMngt
    Rte_Ev_Run_Test_Comp_GraphicsTaskStubRunnable (OsEvent)
    Rte_Al_TE_NvMExt_NvMExt_SpeedupRunnable (OsAlarm): OsAlarmCounterRef=SystemTimer, OsAlarmAccessingApplication=SystemApplication_OsCore0
      OsAlarmAction
        OsAlarmSetEvent: OsAlarmSetEventRef=Rte_Ev_Run_NvMExt_NvMExt_SpeedupRunnable, OsAlarmSetEventTaskRef=Os/OsTask_NvmSpeedup
    7 x OsEvent:
      Rte_Ev_Run_DmnMgr_DmnMgr_MonitorDmnExtendShutdownTime
      Rte_Ev_Run_DmnMgr_DmnMgr_MonitorDmnHealthDumpData
      Rte_Ev_Run_DmnMgr_DmnMgr_MonitorDmnHealthDumpHdrInfo
      Rte_Ev_Run_DmnMgr_DmnMgr_MonitorDmnHealthFatalError
      Rte_Ev_Run_DmnMgr_DmnMgr_MonitorDmnHeartBeat
      Rte_Ev_Run_DmnMgr_DmnMgr_MonitorDmnKeepSystemAwake
      Rte_Ev_Run_DmnMgr_DmnMgr_MonitorDmnPowerSystemState
    Rte_Al_TE_OsTask_CddFun_0_10ms (OsAlarm): OsAlarmCounterRef=SystemTimer, OsAlarmAccessingApplication=SystemApplication_OsCore0
      OsAlarmAction
        OsAlarmSetEvent: OsAlarmSetEventRef=Rte_Ev_Cyclic_OsTask_CddFun_0_10ms, OsAlarmSetEventTaskRef=Os/OsTask_CddFun
    Rte_Ev_Cyclic_OsTask_CddFun_0_10ms (OsEvent)
    Rte_Al_TE_OsTask_CddFun_0_5ms (OsAlarm): OsAlarmCounterRef=SystemTimer, OsAlarmAccessingApplication=SystemApplication_OsCore0
      OsAlarmAction
        OsAlarmSetEvent: OsAlarmSetEventRef=Rte_Ev_Cyclic_OsTask_CddFun_0_5ms, OsAlarmSetEventTaskRef=Os/OsTask_CddFun
    Rte_Ev_Cyclic_OsTask_CddFun_0_5ms (OsEvent)
    Rte_Al_TE2_OsTask_Diagnostics_0_10ms (OsAlarm): OsAlarmCounterRef=SystemTimer, OsAlarmAccessingApplication=SystemApplication_OsCore0
      OsAlarmAction
        OsAlarmSetEvent: OsAlarmSetEventRef=Rte_Ev_Cyclic2_OsTask_Diagnostics_0_10ms, OsAlarmSetEventTaskRef=Os/OsTask_Diagnostics
    Rte_Al_TE_OsTask_Diagnostics_0_100ms (OsAlarm): OsAlarmCounterRef=SystemTimer, OsAlarmAccessingApplication=SystemApplication_OsCore0
      OsAlarmAction
        OsAlarmSetEvent: OsAlarmSetEventRef=Rte_Ev_Cyclic_OsTask_Diagnostics_0_100ms, OsAlarmSetEventTaskRef=Os/OsTask_Diagnostics
    Rte_Ev_Cyclic2_OsTask_Diagnostics_0_10ms (OsEvent)
    Rte_Ev_Cyclic_OsTask_Diagnostics_0_100ms (OsEvent)
