AUTOSAR XML (schema 00044)
package /ActiveEcuC
  ecuc value collection ActiveEcuC: ecu-extract=SYSTEM, ecuc-values=[Rte, Os, EcuC, Dcm, Dem, Ea, NvM]
