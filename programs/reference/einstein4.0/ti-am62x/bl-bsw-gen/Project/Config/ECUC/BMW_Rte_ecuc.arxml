[part 2 of 2: package /ActiveEcuC]
AUTOSAR XML (schema 00044)
package /ActiveEcuC  (continued)
  module config Rte: implementation-config-variant=VARIANT-PRE-COMPILE, module-description=Rte_Impl  (continued)
    MemAbstractStub_EcuSwComposition (RteSwComponentInstance): RteSoftwareComponentInstanceRef=MemAbstractStub
      61 x RteEventToTaskMapping, all with RteImmediateRestart=false:
        TMT_MemAbstract_MainFunction: RtePositionInTask=5, RteEventRef=TMT_MemAbstract_MainFunction, RteMappedToTaskRef=OsTask_MemSer, RteUsedOsEventRef=Rte_Ev_Cyclic_OsTask_MemSer_0_10ms, RteUsedOsAlarmRef=Rte_Al_TE_OsTask_MemSer_0_10ms
        OIT_MemAbstractMdl_NotifyJobEnd_BsFuSa_Communication_NvMNotifyJobFinished_JobFinished: RteEventRef=OIT_MemAbstractMdl_NotifyJobEnd_BsFuSa_Communication_NvMNotifyJobFinished_JobFinished
        OIT_MemAbstractMdl_NotifyJobEnd_BsFuSa_Warning_NvMNotifyJobFinished_JobFinished: RteEventRef=OIT_MemAbstractMdl_NotifyJobEnd_BsFuSa_Warning_NvMNotifyJobFinished_JobFinished
        OIT_MemAbstractMdl_NotifyJobEnd_BsRt_TachoGauge_NvMNotifyJobFinished_JobFinished: RteEventRef=OIT_MemAbstractMdl_NotifyJobEnd_BsRt_TachoGauge_NvMNotifyJobFinished_JobFinished
        OIT_MemAbstractMdl_NotifyJobEnd_BsRt_PowerGauge_NvMNotifyJobFinished_JobFinished: RteEventRef=OIT_MemAbstractMdl_NotifyJobEnd_BsRt_PowerGauge_NvMNotifyJobFinished_JobFinished
        OIT_MemAbstractMdl_NotifyJobEnd_BsConst_TripComputer_NvMNotifyJobFinished_JobFinished: RteEventRef=OIT_MemAbstractMdl_NotifyJobEnd_BsConst_TripComputer_NvMNotifyJobFinished_JobFinished
        OIT_MemAbstractMdl_NotifyJobEnd_BsReten_VisDlt_NvMNotifyJobFinished_JobFinished: RteEventRef=OIT_MemAbstractMdl_NotifyJobEnd_BsReten_VisDlt_NvMNotifyJobFinished_JobFinished
        OIT_MemAbstractMdl_NotifyJobEnd_BsShare_SwUpdReflash_NvMNotifyJobFinished_JobFinished: RteEventRef=OIT_MemAbstractMdl_NotifyJobEnd_BsShare_SwUpdReflash_NvMNotifyJobFinished_JobFinished
        OIT_MemAbstractMdl_NotifyJobEnd_BsShare_SwUpdFotaFinPrint_NvMNotifyJobFinished_JobFinished: RteEventRef=OIT_MemAbstractMdl_NotifyJobEnd_BsShare_SwUpdFotaFinPrint_NvMNotifyJobFinished_JobFinished
        OIT_MemAbstractMdl_NotifyJobEnd_BsConst_Warning_NvMNotifyJobFinished_JobFinished: RteEventRef=OIT_MemAbstractMdl_NotifyJobEnd_BsConst_Warning_NvMNotifyJobFinished_JobFinished
        OIT_MemAbstractMdl_NotifyJobEnd_BsRt_CusDlt_NvMNotifyJobFinished_JobFinished: RteEventRef=OIT_MemAbstractMdl_NotifyJobEnd_BsRt_CusDlt_NvMNotifyJobFinished_JobFinished
        OIT_MemAbstractMdl_NotifyJobEnd_BsConst_SpeedoGauge_NvMNotifyJobFinished_JobFinished: RteEventRef=OIT_MemAbstractMdl_NotifyJobEnd_BsConst_SpeedoGauge_NvMNotifyJobFinished_JobFinished
        OIT_MemAbstractMdl_NotifyJobEnd_BsConst_ServiceReminder_NvMNotifyJobFinished_JobFinished: RteEventRef=OIT_MemAbstractMdl_NotifyJobEnd_BsConst_ServiceReminder_NvMNotifyJobFinished_JobFinished
        OIT_MemAbstractMdl_NotifyJobEnd_BsReten_Power_NvMNotifyJobFinished_JobFinished: RteEventRef=OIT_MemAbstractMdl_NotifyJobEnd_BsReten_Power_NvMNotifyJobFinished_JobFinished
        OIT_MemAbstractMdl_NotifyJobEnd_BsRt_TempGauge_NvMNotifyJobFinished_JobFinished: RteEventRef=OIT_MemAbstractMdl_NotifyJobEnd_BsRt_TempGauge_NvMNotifyJobFinished_JobFinished
        OIT_MemAbstractMdl_NotifyJobEnd_BsConst_PowerGauge_NvMNotifyJobFinished_JobFinished: RteEventRef=OIT_MemAbstractMdl_NotifyJobEnd_BsConst_PowerGauge_NvMNotifyJobFinished_JobFinished
        OIT_MemAbstractMdl_NotifyJobEnd_BsFuSa_Config_NvMNotifyJobFinished_JobFinished: RteEventRef=OIT_MemAbstractMdl_NotifyJobEnd_BsFuSa_Config_NvMNotifyJobFinished_JobFinished
        OIT_MemAbstractMdl_NotifyJobEnd_BsDiag_ErrorRecord_NvMNotifyJobFinished_JobFinished: RteEventRef=OIT_MemAbstractMdl_NotifyJobEnd_BsDiag_ErrorRecord_NvMNotifyJobFinished_JobFinished
        OIT_MemAbstractMdl_NotifyJobEnd_BsReten_Display_NvMNotifyJobFinished_JobFinished: RteEventRef=OIT_MemAbstractMdl_NotifyJobEnd_BsReten_Display_NvMNotifyJobFinished_JobFinished
        OIT_MemAbstractMdl_NotifyJobEnd_BsConst_EngOffTimer_NvMNotifyJobFinished_JobFinished: RteEventRef=OIT_MemAbstractMdl_NotifyJobEnd_BsConst_EngOffTimer_NvMNotifyJobFinished_JobFinished
        OIT_MemAbstractMdl_NotifyJobEnd_BsReten_Warning_NvMNotifyJobFinished_JobFinished: RteEventRef=OIT_MemAbstractMdl_NotifyJobEnd_BsReten_Warning_NvMNotifyJobFinished_JobFinished
        OIT_MemAbstractMdl_NotifyJobEnd_BsConst_TempGauge_NvMNotifyJobFinished_JobFinished: RteEventRef=OIT_MemAbstractMdl_NotifyJobEnd_BsConst_TempGauge_NvMNotifyJobFinished_JobFinished
        OIT_MemAbstractMdl_NotifyJobEnd_BsDiag_Dtc_NvMNotifyJobFinished_JobFinished: RteEventRef=OIT_MemAbstractMdl_NotifyJobEnd_BsDiag_Dtc_NvMNotifyJobFinished_JobFinished
        OIT_MemAbstractMdl_NotifyJobEnd_BsRt_Illumination_NvMNotifyJobFinished_JobFinished: RteEventRef=OIT_MemAbstractMdl_NotifyJobEnd_BsRt_Illumination_NvMNotifyJobFinished_JobFinished
        OIT_MemAbstractMdl_NotifyJobEnd_BsReten_Tripcomputer_NvMNotifyJobFinished_JobFinished: RteEventRef=OIT_MemAbstractMdl_NotifyJobEnd_BsReten_Tripcomputer_NvMNotifyJobFinished_JobFinished
        OIT_MemAbstractMdl_NotifyJobEnd_BsConst_OilGauge_NvMNotifyJobFinished_JobFinished: RteEventRef=OIT_MemAbstractMdl_NotifyJobEnd_BsConst_OilGauge_NvMNotifyJobFinished_JobFinished
        OIT_MemAbstractMdl_NotifyJobEnd_BsConst_TachoGauge_NvMNotifyJobFinished_JobFinished: RteEventRef=OIT_MemAbstractMdl_NotifyJobEnd_BsConst_TachoGauge_NvMNotifyJobFinished_JobFinished
        OIT_MemAbstractMdl_NotifyJobEnd_BsConst_Communication_NvMNotifyJobFinished_JobFinished: RteEventRef=OIT_MemAbstractMdl_NotifyJobEnd_BsConst_Communication_NvMNotifyJobFinished_JobFinished
        OIT_MemAbstractMdl_NotifyJobEnd_BsConst_RealTimeClock_NvMNotifyJobFinished_JobFinished: RteEventRef=OIT_MemAbstractMdl_NotifyJobEnd_BsConst_RealTimeClock_NvMNotifyJobFinished_JobFinished
        OIT_MemAbstractMdl_NotifyJobEnd_BsFuSa_Audio_NvMNotifyJobFinished_JobFinished: RteEventRef=OIT_MemAbstractMdl_NotifyJobEnd_BsFuSa_Audio_NvMNotifyJobFinished_JobFinished
        OIT_MemAbstractMdl_NotifyJobEnd_BsRt_FuelGauge_NvMNotifyJobFinished_JobFinished: RteEventRef=OIT_MemAbstractMdl_NotifyJobEnd_BsRt_FuelGauge_NvMNotifyJobFinished_JobFinished
        OIT_MemAbstractMdl_NotifyJobEnd_BsReten_Gauges_NvMNotifyJobFinished_JobFinished: RteEventRef=OIT_MemAbstractMdl_NotifyJobEnd_BsReten_Gauges_NvMNotifyJobFinished_JobFinished
        OIT_MemAbstractMdl_NotifyJobEnd_BsReten_Audio_NvMNotifyJobFinished_JobFinished: RteEventRef=OIT_MemAbstractMdl_NotifyJobEnd_BsReten_Audio_NvMNotifyJobFinished_JobFinished
        OIT_MemAbstractMdl_NotifyJobEnd_BsShare_VisMeet_NvMNotifyJobFinished_JobFinished: RteEventRef=OIT_MemAbstractMdl_NotifyJobEnd_BsShare_VisMeet_NvMNotifyJobFinished_JobFinished
        OIT_MemAbstractMdl_NotifyJobEnd_BsConst_Illumination_NvMNotifyJobFinished_JobFinished: RteEventRef=OIT_MemAbstractMdl_NotifyJobEnd_BsConst_Illumination_NvMNotifyJobFinished_JobFinished
        OIT_MemAbstractMdl_NotifyJobEnd_BsConst_Power_NvMNotifyJobFinished_JobFinished: RteEventRef=OIT_MemAbstractMdl_NotifyJobEnd_BsConst_Power_NvMNotifyJobFinished_JobFinished
        OIT_MemAbstractMdl_NotifyJobEnd_BsRt_RealTimeClock_NvMNotifyJobFinished_JobFinished: RteEventRef=OIT_MemAbstractMdl_NotifyJobEnd_BsRt_RealTimeClock_NvMNotifyJobFinished_JobFinished
        OIT_MemAbstractMdl_NotifyJobEnd_BsConst_FuelGauge_NvMNotifyJobFinished_JobFinished: RteEventRef=OIT_MemAbstractMdl_NotifyJobEnd_BsConst_FuelGauge_NvMNotifyJobFinished_JobFinished
        OIT_MemAbstractMdl_NotifyJobEnd_BsFuSa_Display_NvMNotifyJobFinished_JobFinished: RteEventRef=OIT_MemAbstractMdl_NotifyJobEnd_BsFuSa_Display_NvMNotifyJobFinished_JobFinished
        OIT_MemAbstractMdl_NotifyJobEnd_BsRt_Warning_NvMNotifyJobFinished_JobFinished: RteEventRef=OIT_MemAbstractMdl_NotifyJobEnd_BsRt_Warning_NvMNotifyJobFinished_JobFinished
        OIT_MemAbstractMdl_NotifyJobEnd_RefCys_Certicificate_NvMNotifyJobFinished_JobFinished: RteEventRef=OIT_MemAbstractMdl_NotifyJobEnd_RefCys_Certicificate_NvMNotifyJobFinished_JobFinished
        OIT_MemAbstractMdl_NotifyJobEnd_BsFusa_Fota_NvMNotifyJobFinished_JobFinished: RteEventRef=OIT_MemAbstractMdl_NotifyJobEnd_BsFusa_Fota_NvMNotifyJobFinished_JobFinished
        OIT_MemAbstractMdl_NotifyJobEnd_BsRt_OilGauge_NvMNotifyJobFinished_JobFinished: RteEventRef=OIT_MemAbstractMdl_NotifyJobEnd_BsRt_OilGauge_NvMNotifyJobFinished_JobFinished
        OIT_MemAbstractMdl_NotifyJobEnd_BsShare_VehicleConfig_NvMNotifyJobFinished_JobFinished: RteEventRef=OIT_MemAbstractMdl_NotifyJobEnd_BsShare_VehicleConfig_NvMNotifyJobFinished_JobFinished
        OIT_MemAbstractMdl_NotifyJobEnd_BsReten_Communication_NvMNotifyJobFinished_JobFinished: RteEventRef=OIT_MemAbstractMdl_NotifyJobEnd_BsReten_Communication_NvMNotifyJobFinished_JobFinished
        OIT_MemAbstractMdl_NotifyJobEnd_BsReten_Illumination_NvMNotifyJobFinished_JobFinished: RteEventRef=OIT_MemAbstractMdl_NotifyJobEnd_BsReten_Illumination_NvMNotifyJobFinished_JobFinished
        OIT_MemAbstractMdl_NotifyJobEnd_BsRt_SpeedoGauge_NvMNotifyJobFinished_JobFinished: RteEventRef=OIT_MemAbstractMdl_NotifyJobEnd_BsRt_SpeedoGauge_NvMNotifyJobFinished_JobFinished
        OIT_MemAbstractMdl_NotifyJobEnd_BsShare_SwUpdFotaStatus_NvMNotifyJobFinished_JobFinished: RteEventRef=OIT_MemAbstractMdl_NotifyJobEnd_BsShare_SwUpdFotaStatus_NvMNotifyJobFinished_JobFinished
        OIT_MemAbstractMdl_NotifyJobEnd_BsReten_Odometer_NvMNotifyJobFinished_JobFinished: RteEventRef=OIT_MemAbstractMdl_NotifyJobEnd_BsReten_Odometer_NvMNotifyJobFinished_JobFinished
        OIT_MemAbstractMdl_NotifyJobEnd_BsRt_Odometer_NvMNotifyJobFinished_JobFinished: RteEventRef=OIT_MemAbstractMdl_NotifyJobEnd_BsRt_Odometer_NvMNotifyJobFinished_JobFinished
        OIT_MemAbstractMdl_NotifyJobEnd_RefCys_Certicificate1_NvMNotifyJobFinished_JobFinished: RteEventRef=OIT_MemAbstractMdl_NotifyJobEnd_RefCys_Certicificate1_NvMNotifyJobFinished_JobFinished
        OIT_MemAbstractMdl_NotifyJobEnd_BsRt_Personalization_NvMNotifyJobFinished_JobFinished: RteEventRef=OIT_MemAbstractMdl_NotifyJobEnd_BsRt_Personalization_NvMNotifyJobFinished_JobFinished
        OIT_MemAbstractMdl_NotifyJobEnd_BsShare_SwUpdFotadecrypt_NvMNotifyJobFinished_JobFinished: RteEventRef=OIT_MemAbstractMdl_NotifyJobEnd_BsShare_SwUpdFotadecrypt_NvMNotifyJobFinished_JobFinished
        OIT_MemAbstractMdl_NotifyJobEnd_BsConst_Audio_NvMNotifyJobFinished_JobFinished: RteEventRef=OIT_MemAbstractMdl_NotifyJobEnd_BsConst_Audio_NvMNotifyJobFinished_JobFinished
        OIT_MemAbstractMdl_NotifyJobEnd_BsFuSa_Power_NvMNotifyJobFinished_JobFinished: RteEventRef=OIT_MemAbstractMdl_NotifyJobEnd_BsFuSa_Power_NvMNotifyJobFinished_JobFinished
        OIT_MemAbstractMdl_NotifyJobEnd_BsReten_Personalization_NvMNotifyJobFinished_JobFinished: RteEventRef=OIT_MemAbstractMdl_NotifyJobEnd_BsReten_Personalization_NvMNotifyJobFinished_JobFinished
        OIT_MemAbstractMdl_NotifyJobEnd_BsCys_Certicificate_NvMNotifyJobFinished_JobFinished: RteEventRef=OIT_MemAbstractMdl_NotifyJobEnd_BsCys_Certicificate_NvMNotifyJobFinished_JobFinished
        OIT_MemAbstractMdl_NotifyJobEnd_BsShare_SwUpdFotaMode_NvMNotifyJobFinished_JobFinished: RteEventRef=OIT_MemAbstractMdl_NotifyJobEnd_BsShare_SwUpdFotaMode_NvMNotifyJobFinished_JobFinished
        OIT_MemAbstractMdl_NotifyJobEnd_BsRt_TripComputer_NvMNotifyJobFinished_JobFinished: RteEventRef=OIT_MemAbstractMdl_NotifyJobEnd_BsRt_TripComputer_NvMNotifyJobFinished_JobFinished
        OIT_MemAbstractMdl_NotifyJobEnd_BsReten_RealTimeClock_NvMNotifyJobFinished_JobFinished: RteEventRef=OIT_MemAbstractMdl_NotifyJobEnd_BsReten_RealTimeClock_NvMNotifyJobFinished_JobFinished
        OIT_MemAbstractMdl_NotifyJobEnd_BsShare_EcuPartNumber_NvMNotifyJobFinished_JobFinished: RteEventRef=OIT_MemAbstractMdl_NotifyJobEnd_BsShare_EcuPartNumber_NvMNotifyJobFinished_JobFinished
    EcuAppM_EcuSwComposition (RteSwComponentInstance): RteSoftwareComponentInstanceRef=EcuAppM
      3 x RteEventToTaskMapping, all with RteImmediateRestart=false:
        OIE_ppCS_EcuAppM_EcuAppM_SetWakeupSourcesTrigByEcuAppM_SetWakeupSources: RteEventRef=OIE_ppCS_EcuAppM_EcuAppM_SetWakeupSourcesTrigByEcuAppM_SetWakeupSources
        OIE_ppCS_EcuAppM_EcuAppM_InitTrigByInit: RteEventRef=OIE_ppCS_EcuAppM_EcuAppM_InitTrigByInit
        TEEcuAppM_MainFunction: RtePositionInTask=2, RteEventRef=TEEcuAppM_MainFunction, RteMappedToTaskRef=OsTask_Mcal, RteUsedOsAlarmRef=Rte_Al_TE_OsTask_Mcal_0_10ms
    EcuAppM (RteSwComponentType): RteComponentTypeRef=EcuAppM, RteImplementationRef=IMPL_EcuAppM
      ComponentTypeCalibration (RteComponentTypeCalibration): RteCalibrationSupportEnabled=false
    3 x RteSwComponentInstance:
      ComM_EcuSwComposition: RteSoftwareComponentInstanceRef=ComM
        Timer_ComM_MainFunction_0 (RteEventToTaskMapping):
          RteImmediateRestart = false
          RtePositionInTask = 2
          RteEventRef = Timer_ComM_MainFunction_0
          RteMappedToTaskRef = OsTask_CANFun
          RteUsedOsAlarmRef = Rte_Al_TE_OsTask_CANFun_0_10ms
      EcuM_EcuSwComposition: RteSoftwareComponentInstanceRef=EcuM
        13 x RteEventToTaskMapping, all with RteImmediateRestart=false:
          OpEventGetBootTarget_GetBootTarget_EcuM_BootTarget: RteEventRef=OpEventGetBootTarget_GetBootTarget_EcuM_BootTarget
          OpEventReleaseRUN_ReleaseRUN_StateRequest_EcuMConf_EcuMFixedUserConfig_EcuMUserConfig_CTRL_App: RteEventRef=OpEventReleaseRUN_ReleaseRUN_StateRequest_EcuMConf_EcuMFixedUserConfig_EcuMUserConfig_CTRL_App
          Timer_EcuM_MainFunction: RtePositionInTask=0, RteEventRef=Timer_EcuM_MainFunction, RteMappedToTaskRef=OsTask_Mcal, RteUsedOsAlarmRef=Rte_Al_TE_OsTask_Mcal_0_10ms
          OpEventGetShutdownCause_GetShutdownCause_EcuM_ShutdownTarget: RteEventRef=OpEventGetShutdownCause_GetShutdownCause_EcuM_ShutdownTarget
          OpEventGetLastShutdownTarget_GetLastShutdownTarget_EcuM_ShutdownTarget: RteEventRef=OpEventGetLastShutdownTarget_GetLastShutdownTarget_EcuM_ShutdownTarget
          OpEventRequestRUN_RequestRUN_StateRequest_EcuMConf_EcuMFixedUserConfig_EcuMUserConfig_CTRL_App: RteEventRef=OpEventRequestRUN_RequestRUN_StateRequest_EcuMConf_EcuMFixedUserConfig_EcuMUserConfig_CTRL_App
          OpEventSelectShutdownCause_SelectShutdownCause_EcuM_ShutdownTarget: RteEventRef=OpEventSelectShutdownCause_SelectShutdownCause_EcuM_ShutdownTarget
          OpEventSelectBootTarget_SelectBootTarget_EcuM_BootTarget: RteEventRef=OpEventSelectBootTarget_SelectBootTarget_EcuM_BootTarget
          OpEventRequestPOSTRUN_RequestPOSTRUN_StateRequest_EcuMConf_EcuMFixedUserConfig_EcuMUserConfig_CTRL_App: RteEventRef=OpEventRequestPOSTRUN_RequestPOSTRUN_StateRequest_EcuMConf_EcuMFixedUserConfig_EcuMUserConfig_CTRL_App
          OpEventSelectShutdownTarget_SelectShutdownTarget_EcuM_ShutdownTarget: RteEventRef=OpEventSelectShutdownTarget_SelectShutdownTarget_EcuM_ShutdownTarget
          OpEventGetShutdownTarget_GetShutdownTarget_EcuM_ShutdownTarget: RteEventRef=OpEventGetShutdownTarget_GetShutdownTarget_EcuM_ShutdownTarget
          OpEventReleasePOSTRUN_ReleasePOSTRUN_StateRequest_EcuMConf_EcuMFixedUserConfig_EcuMUserConfig_CTRL_App: RteEventRef=OpEventReleasePOSTRUN_ReleasePOSTRUN_StateRequest_EcuMConf_EcuMFixedUserConfig_EcuMUserConfig_CTRL_App
          OpEventGetStateWrapper_GetStateWrapper_StateRequest_EcuMConf_EcuMFixedUserConfig_EcuMUserConfig_CTRL_App: RteEventRef=OpEventGetStateWrapper_GetStateWrapper_StateRequest_EcuMConf_EcuMFixedUserConfig_EcuMUserConfig_CTRL_App
      MemAbstractMdl_EcuSwComposition: RteSoftwareComponentInstanceRef=MemAbstractMdl
        122 x RteEventToTaskMapping, all with RteImmediateRestart=false:
          OIE_pp_CS_MemAbs_NvMWriteStatus_MemAbstractMdl_NvmWriteStatusTrigByNvmWriteStatus: RteEventRef=OIE_pp_CS_MemAbs_NvMWriteStatus_MemAbstractMdl_NvmWriteStatusTrigByNvmWriteStatus
          OIE_pp_CS_MemAbsGet_MemAbstractMdl_Get_BsConst_Audio_ElementTrigByGet_BsConst_Audio_Element: RteEventRef=OIE_pp_CS_MemAbsGet_MemAbstractMdl_Get_BsConst_Audio_ElementTrigByGet_BsConst_Audio_Element
          OIE_pp_CS_MemAbsGet_MemAbstractMdl_Get_BsConst_Communication_ElementTrigByGet_BsConst_Communication_Element: RteEventRef=OIE_pp_CS_MemAbsGet_MemAbstractMdl_Get_BsConst_Communication_ElementTrigByGet_BsConst_Communication_Element
          OIE_pp_CS_MemAbsGet_MemAbstractMdl_Get_BsConst_EngOffTimer_ElementTrigByGet_BsConst_EngOffTimer_Element: RteEventRef=OIE_pp_CS_MemAbsGet_MemAbstractMdl_Get_BsConst_EngOffTimer_ElementTrigByGet_BsConst_EngOffTimer_Element
          OIE_pp_CS_MemAbsGet_MemAbstractMdl_Get_BsConst_FuelGauge_ElementTrigByGet_BsConst_FuelGauge_Element: RteEventRef=OIE_pp_CS_MemAbsGet_MemAbstractMdl_Get_BsConst_FuelGauge_ElementTrigByGet_BsConst_FuelGauge_Element
          OIE_pp_CS_MemAbsGet_MemAbstractMdl_Get_BsConst_Illumination_ElementTrigByGet_BsConst_Illumination_Element: RteEventRef=OIE_pp_CS_MemAbsGet_MemAbstractMdl_Get_BsConst_Illumination_ElementTrigByGet_BsConst_Illumination_Element
          OIE_pp_CS_MemAbsGet_MemAbstractMdl_Get_BsConst_OilGauge_ElementTrigByGet_BsConst_OilGauge_Element: RteEventRef=OIE_pp_CS_MemAbsGet_MemAbstractMdl_Get_BsConst_OilGauge_ElementTrigByGet_BsConst_OilGauge_Element
          OIE_pp_CS_MemAbsGet_MemAbstractMdl_Get_BsConst_PowerGauge_ElementTrigByGet_BsConst_PowerGauge_Element: RteEventRef=OIE_pp_CS_MemAbsGet_MemAbstractMdl_Get_BsConst_PowerGauge_ElementTrigByGet_BsConst_PowerGauge_Element
          OIE_pp_CS_MemAbsGet_MemAbstractMdl_Get_BsConst_Power_ElementTrigByGet_BsConst_Power_Element: RteEventRef=OIE_pp_CS_MemAbsGet_MemAbstractMdl_Get_BsConst_Power_ElementTrigByGet_BsConst_Power_Element
          OIE_pp_CS_MemAbsGet_MemAbstractMdl_Get_BsConst_RealTimeClock_ElementTrigByGet_BsConst_RealTimeClock_Element: RteEventRef=OIE_pp_CS_MemAbsGet_MemAbstractMdl_Get_BsConst_RealTimeClock_ElementTrigByGet_BsConst_RealTimeClock_Element
          OIE_pp_CS_MemAbsGet_MemAbstractMdl_Get_BsConst_ServiceReminder_ElementTrigByGet_BsConst_ServiceReminder_Element: RteEventRef=OIE_pp_CS_MemAbsGet_MemAbstractMdl_Get_BsConst_ServiceReminder_ElementTrigByGet_BsConst_ServiceReminder_Element
          OIE_pp_CS_MemAbsGet_MemAbstractMdl_Get_BsConst_SpeedoGauge_ElementTrigByGet_BsConst_SpeedoGauge_Element: RteEventRef=OIE_pp_CS_MemAbsGet_MemAbstractMdl_Get_BsConst_SpeedoGauge_ElementTrigByGet_BsConst_SpeedoGauge_Element
          OIE_pp_CS_MemAbsGet_MemAbstractMdl_Get_BsConst_TachoGauge_ElementTrigByGet_BsConst_TachoGauge_Element: RteEventRef=OIE_pp_CS_MemAbsGet_MemAbstractMdl_Get_BsConst_TachoGauge_ElementTrigByGet_BsConst_TachoGauge_Element
          OIE_pp_CS_MemAbsGet_MemAbstractMdl_Get_BsConst_TempGauge_ElementTrigByGet_BsConst_TempGauge_Element: RteEventRef=OIE_pp_CS_MemAbsGet_MemAbstractMdl_Get_BsConst_TempGauge_ElementTrigByGet_BsConst_TempGauge_Element
          OIE_pp_CS_MemAbsGet_MemAbstractMdl_Get_BsConst_TripComputer_ElementTrigByGet_BsConst_TripComputer_Element: RteEventRef=OIE_pp_CS_MemAbsGet_MemAbstractMdl_Get_BsConst_TripComputer_ElementTrigByGet_BsConst_TripComputer_Element
          OIE_pp_CS_MemAbsGet_MemAbstractMdl_Get_BsConst_Warning_ElementTrigByGet_BsConst_Warning_Element: RteEventRef=OIE_pp_CS_MemAbsGet_MemAbstractMdl_Get_BsConst_Warning_ElementTrigByGet_BsConst_Warning_Element
          OIE_pp_CS_MemAbsGet_MemAbstractMdl_Get_BsCys_Certicificate_ElementTrigByGet_BsCys_Certicificate_Element: RteEventRef=OIE_pp_CS_MemAbsGet_MemAbstractMdl_Get_BsCys_Certicificate_ElementTrigByGet_BsCys_Certicificate_Element
          OIE_pp_CS_MemAbsGet_MemAbstractMdl_Get_BsDiag_Dtc_ElementTrigByGet_BsDiag_Dtc_Element: RteEventRef=OIE_pp_CS_MemAbsGet_MemAbstractMdl_Get_BsDiag_Dtc_ElementTrigByGet_BsDiag_Dtc_Element
          OIE_pp_CS_MemAbsGet_MemAbstractMdl_Get_BsDiag_ErrorRecord_ElementTrigByGet_BsDiag_ErrorRecord_Element: RteEventRef=OIE_pp_CS_MemAbsGet_MemAbstractMdl_Get_BsDiag_ErrorRecord_ElementTrigByGet_BsDiag_ErrorRecord_Element
          OIE_pp_CS_MemAbsGet_MemAbstractMdl_Get_BsFuSa_Audio_ElementTrigByGet_BsFuSa_Audio_Element: RteEventRef=OIE_pp_CS_MemAbsGet_MemAbstractMdl_Get_BsFuSa_Audio_ElementTrigByGet_BsFuSa_Audio_Element
          OIE_pp_CS_MemAbsGet_MemAbstractMdl_Get_BsFuSa_Communication_ElementTrigByGet_BsFuSa_Communication_Element: RteEventRef=OIE_pp_CS_MemAbsGet_MemAbstractMdl_Get_BsFuSa_Communication_ElementTrigByGet_BsFuSa_Communication_Element
          OIE_pp_CS_MemAbsGet_MemAbstractMdl_Get_BsFuSa_Config_ElementTrigByGet_BsFuSa_Config_Element: RteEventRef=OIE_pp_CS_MemAbsGet_MemAbstractMdl_Get_BsFuSa_Config_ElementTrigByGet_BsFuSa_Config_Element
          OIE_pp_CS_MemAbsGet_MemAbstractMdl_Get_BsFuSa_Display_ElementTrigByGet_BsFuSa_Display_Element: RteEventRef=OIE_pp_CS_MemAbsGet_MemAbstractMdl_Get_BsFuSa_Display_ElementTrigByGet_BsFuSa_Display_Element
          OIE_pp_CS_MemAbsGet_MemAbstractMdl_Get_BsFuSa_Power_ElementTrigByGet_BsFuSa_Power_Element: RteEventRef=OIE_pp_CS_MemAbsGet_MemAbstractMdl_Get_BsFuSa_Power_ElementTrigByGet_BsFuSa_Power_Element
          OIE_pp_CS_MemAbsGet_MemAbstractMdl_Get_BsFuSa_Warning_ElementTrigByGet_BsFuSa_Warning_Element: RteEventRef=OIE_pp_CS_MemAbsGet_MemAbstractMdl_Get_BsFuSa_Warning_ElementTrigByGet_BsFuSa_Warning_Element
          OIE_pp_CS_MemAbsGet_MemAbstractMdl_Get_BsFusa_Fota_ElementTrigByGet_BsFusa_Fota_Element: RteEventRef=OIE_pp_CS_MemAbsGet_MemAbstractMdl_Get_BsFusa_Fota_ElementTrigByGet_BsFusa_Fota_Element
          OIE_pp_CS_MemAbsGet_MemAbstractMdl_Get_BsReten_Audio_ElementTrigByGet_BsReten_Audio_Element: RteEventRef=OIE_pp_CS_MemAbsGet_MemAbstractMdl_Get_BsReten_Audio_ElementTrigByGet_BsReten_Audio_Element
          OIE_pp_CS_MemAbsGet_MemAbstractMdl_Get_BsReten_Communication_ElementTrigByGet_BsReten_Communication_Element: RteEventRef=OIE_pp_CS_MemAbsGet_MemAbstractMdl_Get_BsReten_Communication_ElementTrigByGet_BsReten_Communication_Element
          OIE_pp_CS_MemAbsGet_MemAbstractMdl_Get_BsReten_Display_ElementTrigByGet_BsReten_Display_Element: RteEventRef=OIE_pp_CS_MemAbsGet_MemAbstractMdl_Get_BsReten_Display_ElementTrigByGet_BsReten_Display_Element
          OIE_pp_CS_MemAbsGet_MemAbstractMdl_Get_BsReten_Gauges_ElementTrigByGet_BsReten_Gauges_Element: RteEventRef=OIE_pp_CS_MemAbsGet_MemAbstractMdl_Get_BsReten_Gauges_ElementTrigByGet_BsReten_Gauges_Element
          OIE_pp_CS_MemAbsGet_MemAbstractMdl_Get_BsReten_Illumination_ElementTrigByGet_BsReten_Illumination_Element: RteEventRef=OIE_pp_CS_MemAbsGet_MemAbstractMdl_Get_BsReten_Illumination_ElementTrigByGet_BsReten_Illumination_Element
          OIE_pp_CS_MemAbsGet_MemAbstractMdl_Get_BsReten_Odometer_ElementTrigByGet_BsReten_Odometer_Element: RteEventRef=OIE_pp_CS_MemAbsGet_MemAbstractMdl_Get_BsReten_Odometer_ElementTrigByGet_BsReten_Odometer_Element
          OIE_pp_CS_MemAbsGet_MemAbstractMdl_Get_BsReten_Personalization_ElementTrigByGet_BsReten_Personalization_Element: RteEventRef=OIE_pp_CS_MemAbsGet_MemAbstractMdl_Get_BsReten_Personalization_ElementTrigByGet_BsReten_Personalization_Element
          OIE_pp_CS_MemAbsGet_MemAbstractMdl_Get_BsReten_Power_ElementTrigByGet_BsReten_Power_Element: RteEventRef=OIE_pp_CS_MemAbsGet_MemAbstractMdl_Get_BsReten_Power_ElementTrigByGet_BsReten_Power_Element
          OIE_pp_CS_MemAbsGet_MemAbstractMdl_Get_BsReten_RealTimeClock_ElementTrigByGet_BsReten_RealTimeClock_Element: RteEventRef=OIE_pp_CS_MemAbsGet_MemAbstractMdl_Get_BsReten_RealTimeClock_ElementTrigByGet_BsReten_RealTimeClock_Element
          OIE_pp_CS_MemAbsGet_MemAbstractMdl_Get_BsReten_Tripcomputer_ElementTrigByGet_BsReten_Tripcomputer_Element: RteEventRef=OIE_pp_CS_MemAbsGet_MemAbstractMdl_Get_BsReten_Tripcomputer_ElementTrigByGet_BsReten_Tripcomputer_Element
          OIE_pp_CS_MemAbsGet_MemAbstractMdl_Get_BsReten_VisDlt_ElementTrigByGet_BsReten_VisDlt_Element: RteEventRef=OIE_pp_CS_MemAbsGet_MemAbstractMdl_Get_BsReten_VisDlt_ElementTrigByGet_BsReten_VisDlt_Element
          OIE_pp_CS_MemAbsGet_MemAbstractMdl_Get_BsReten_Warning_ElementTrigByGet_BsReten_Warning_Element: RteEventRef=OIE_pp_CS_MemAbsGet_MemAbstractMdl_Get_BsReten_Warning_ElementTrigByGet_BsReten_Warning_Element
          OIE_pp_CS_MemAbsGet_MemAbstractMdl_Get_BsRt_CusDlt_ElementTrigByGet_BsRt_CusDlt_Element: RteEventRef=OIE_pp_CS_MemAbsGet_MemAbstractMdl_Get_BsRt_CusDlt_ElementTrigByGet_BsRt_CusDlt_Element
          OIE_pp_CS_MemAbsGet_MemAbstractMdl_Get_BsRt_FuelGauge_ElementTrigByGet_BsRt_FuelGauge_Element: RteEventRef=OIE_pp_CS_MemAbsGet_MemAbstractMdl_Get_BsRt_FuelGauge_ElementTrigByGet_BsRt_FuelGauge_Element
          OIE_pp_CS_MemAbsGet_MemAbstractMdl_Get_BsRt_Illumination_ElementTrigByGet_BsRt_Illumination_Element: RteEventRef=OIE_pp_CS_MemAbsGet_MemAbstractMdl_Get_BsRt_Illumination_ElementTrigByGet_BsRt_Illumination_Element
          OIE_pp_CS_MemAbsGet_MemAbstractMdl_Get_BsRt_Odometer_ElementTrigByGet_BsRt_Odometer_Element: RteEventRef=OIE_pp_CS_MemAbsGet_MemAbstractMdl_Get_BsRt_Odometer_ElementTrigByGet_BsRt_Odometer_Element
          OIE_pp_CS_MemAbsGet_MemAbstractMdl_Get_BsRt_OilGauge_ElementTrigByGet_BsRt_OilGauge_Element: RteEventRef=OIE_pp_CS_MemAbsGet_MemAbstractMdl_Get_BsRt_OilGauge_ElementTrigByGet_BsRt_OilGauge_Element
          OIE_pp_CS_MemAbsGet_MemAbstractMdl_Get_BsRt_Personalization_ElementTrigByGet_BsRt_Personalization_Element: RteEventRef=OIE_pp_CS_MemAbsGet_MemAbstractMdl_Get_BsRt_Personalization_ElementTrigByGet_BsRt_Personalization_Element
          OIE_pp_CS_MemAbsGet_MemAbstractMdl_Get_BsRt_PowerGauge_ElementTrigByGet_BsRt_PowerGauge_Element: RteEventRef=OIE_pp_CS_MemAbsGet_MemAbstractMdl_Get_BsRt_PowerGauge_ElementTrigByGet_BsRt_PowerGauge_Element
          OIE_pp_CS_MemAbsGet_MemAbstractMdl_Get_BsRt_RealTimeClock_ElementTrigByGet_BsRt_RealTimeClock_Element: RteEventRef=OIE_pp_CS_MemAbsGet_MemAbstractMdl_Get_BsRt_RealTimeClock_ElementTrigByGet_BsRt_RealTimeClock_Element
          OIE_pp_CS_MemAbsGet_MemAbstractMdl_Get_BsRt_SpeedoGauge_ElementTrigByGet_BsRt_SpeedoGauge_Element: RteEventRef=OIE_pp_CS_MemAbsGet_MemAbstractMdl_Get_BsRt_SpeedoGauge_ElementTrigByGet_BsRt_SpeedoGauge_Element
          OIE_pp_CS_MemAbsGet_MemAbstractMdl_Get_BsRt_TachoGauge_ElementTrigByGet_BsRt_TachoGauge_Element: RteEventRef=OIE_pp_CS_MemAbsGet_MemAbstractMdl_Get_BsRt_TachoGauge_ElementTrigByGet_BsRt_TachoGauge_Element
          OIE_pp_CS_MemAbsGet_MemAbstractMdl_Get_BsRt_TempGauge_ElementTrigByGet_BsRt_TempGauge_Element: RteEventRef=OIE_pp_CS_MemAbsGet_MemAbstractMdl_Get_BsRt_TempGauge_ElementTrigByGet_BsRt_TempGauge_Element
          OIE_pp_CS_MemAbsGet_MemAbstractMdl_Get_BsRt_TripComputer_ElementTrigByGet_BsRt_TripComputer_Element: RteEventRef=OIE_pp_CS_MemAbsGet_MemAbstractMdl_Get_BsRt_TripComputer_ElementTrigByGet_BsRt_TripComputer_Element
          OIE_pp_CS_MemAbsGet_MemAbstractMdl_Get_BsRt_Warning_ElementTrigByGet_BsRt_Warning_Element: RteEventRef=OIE_pp_CS_MemAbsGet_MemAbstractMdl_Get_BsRt_Warning_ElementTrigByGet_BsRt_Warning_Element
          OIE_pp_CS_MemAbsGet_MemAbstractMdl_Get_BsShare_EcuPartNumber_ElementTrigByGet_BsShare_EcuPartNumber_Element: RteEventRef=OIE_pp_CS_MemAbsGet_MemAbstractMdl_Get_BsShare_EcuPartNumber_ElementTrigByGet_BsShare_EcuPartNumber_Element
          OIE_pp_CS_MemAbsGet_MemAbstractMdl_Get_BsShare_SwUpdFotaFinPrint_ElementTrigByGet_BsShare_SwUpdFotaFinPrint_Element: RteEventRef=OIE_pp_CS_MemAbsGet_MemAbstractMdl_Get_BsShare_SwUpdFotaFinPrint_ElementTrigByGet_BsShare_SwUpdFotaFinPrint_Element
          OIE_pp_CS_MemAbsGet_MemAbstractMdl_Get_BsShare_SwUpdFotaMode_ElementTrigByGet_BsShare_SwUpdFotaMode_Element: RteEventRef=OIE_pp_CS_MemAbsGet_MemAbstractMdl_Get_BsShare_SwUpdFotaMode_ElementTrigByGet_BsShare_SwUpdFotaMode_Element
          OIE_pp_CS_MemAbsGet_MemAbstractMdl_Get_BsShare_SwUpdFotaStatus_ElementTrigByGet_BsShare_SwUpdFotaStatus_Element: RteEventRef=OIE_pp_CS_MemAbsGet_MemAbstractMdl_Get_BsShare_SwUpdFotaStatus_ElementTrigByGet_BsShare_SwUpdFotaStatus_Element
          OIE_pp_CS_MemAbsGet_MemAbstractMdl_Get_BsShare_SwUpdFotadecrypt_ElementTrigByGet_BsShare_SwUpdFotadecrypt_Element: RteEventRef=OIE_pp_CS_MemAbsGet_MemAbstractMdl_Get_BsShare_SwUpdFotadecrypt_ElementTrigByGet_BsShare_SwUpdFotadecrypt_Element
          OIE_pp_CS_MemAbsGet_MemAbstractMdl_Get_BsShare_SwUpdReflash_ElementTrigByGet_BsShare_SwUpdReflash_Element: RteEventRef=OIE_pp_CS_MemAbsGet_MemAbstractMdl_Get_BsShare_SwUpdReflash_ElementTrigByGet_BsShare_SwUpdReflash_Element
          OIE_pp_CS_MemAbsGet_MemAbstractMdl_Get_BsShare_VehicleConfig_ElementTrigByGet_BsShare_VehicleConfig_Element: RteEventRef=OIE_pp_CS_MemAbsGet_MemAbstractMdl_Get_BsShare_VehicleConfig_ElementTrigByGet_BsShare_VehicleConfig_Element
          OIE_pp_CS_MemAbsGet_MemAbstractMdl_Get_BsShare_VisMeet_ElementTrigByGet_BsShare_VisMeet_Element: RteEventRef=OIE_pp_CS_MemAbsGet_MemAbstractMdl_Get_BsShare_VisMeet_ElementTrigByGet_BsShare_VisMeet_Element
          OIE_pp_CS_MemAbsGet_MemAbstractMdl_Get_RefCys_Certicificate1_ElementTrigByGet_RefCys_Certicificate1_Element: RteEventRef=OIE_pp_CS_MemAbsGet_MemAbstractMdl_Get_RefCys_Certicificate1_ElementTrigByGet_RefCys_Certicificate1_Element
          OIE_pp_CS_MemAbsGet_MemAbstractMdl_Get_RefCys_Certicificate_ElementTrigByGet_RefCys_Certicificate_Element: RteEventRef=OIE_pp_CS_MemAbsGet_MemAbstractMdl_Get_RefCys_Certicificate_ElementTrigByGet_RefCys_Certicificate_Element
          OIE_pp_CS_MemAbsSet_MemAbstractMdl_Set_BsConst_Audio_ElementTrigBySet_BsConst_Audio_Element: RteEventRef=OIE_pp_CS_MemAbsSet_MemAbstractMdl_Set_BsConst_Audio_ElementTrigBySet_BsConst_Audio_Element
          OIE_pp_CS_MemAbsSet_MemAbstractMdl_Set_BsConst_Communication_ElementTrigBySet_BsConst_Communication_Element: RteEventRef=OIE_pp_CS_MemAbsSet_MemAbstractMdl_Set_BsConst_Communication_ElementTrigBySet_BsConst_Communication_Element
          OIE_pp_CS_MemAbsSet_MemAbstractMdl_Set_BsConst_EngOffTimer_ElementTrigBySet_BsConst_EngOffTimer_Element: RteEventRef=OIE_pp_CS_MemAbsSet_MemAbstractMdl_Set_BsConst_EngOffTimer_ElementTrigBySet_BsConst_EngOffTimer_Element
          OIE_pp_CS_MemAbsSet_MemAbstractMdl_Set_BsConst_FuelGauge_ElementTrigBySet_BsConst_FuelGauge_Element: RteEventRef=OIE_pp_CS_MemAbsSet_MemAbstractMdl_Set_BsConst_FuelGauge_ElementTrigBySet_BsConst_FuelGauge_Element
          OIE_pp_CS_MemAbsSet_MemAbstractMdl_Set_BsConst_Illumination_ElementTrigBySet_BsConst_Illumination_Element: RteEventRef=OIE_pp_CS_MemAbsSet_MemAbstractMdl_Set_BsConst_Illumination_ElementTrigBySet_BsConst_Illumination_Element
          OIE_pp_CS_MemAbsSet_MemAbstractMdl_Set_BsConst_OilGauge_ElementTrigBySet_BsConst_OilGauge_Element: RteEventRef=OIE_pp_CS_MemAbsSet_MemAbstractMdl_Set_BsConst_OilGauge_ElementTrigBySet_BsConst_OilGauge_Element
          OIE_pp_CS_MemAbsSet_MemAbstractMdl_Set_BsConst_PowerGauge_ElementTrigBySet_BsConst_PowerGauge_Element: RteEventRef=OIE_pp_CS_MemAbsSet_MemAbstractMdl_Set_BsConst_PowerGauge_ElementTrigBySet_BsConst_PowerGauge_Element
          OIE_pp_CS_MemAbsSet_MemAbstractMdl_Set_BsConst_Power_ElementTrigBySet_BsConst_Power_Element: RteEventRef=OIE_pp_CS_MemAbsSet_MemAbstractMdl_Set_BsConst_Power_ElementTrigBySet_BsConst_Power_Element
          OIE_pp_CS_MemAbsSet_MemAbstractMdl_Set_BsConst_RealTimeClock_ElementTrigBySet_BsConst_RealTimeClock_Element: RteEventRef=OIE_pp_CS_MemAbsSet_MemAbstractMdl_Set_BsConst_RealTimeClock_ElementTrigBySet_BsConst_RealTimeClock_Element
          OIE_pp_CS_MemAbsSet_MemAbstractMdl_Set_BsConst_ServiceReminder_ElementTrigBySet_BsConst_ServiceReminder_Element: RteEventRef=OIE_pp_CS_MemAbsSet_MemAbstractMdl_Set_BsConst_ServiceReminder_ElementTrigBySet_BsConst_ServiceReminder_Element
          OIE_pp_CS_MemAbsSet_MemAbstractMdl_Set_BsConst_SpeedoGauge_ElementTrigBySet_BsConst_SpeedoGauge_Element: RteEventRef=OIE_pp_CS_MemAbsSet_MemAbstractMdl_Set_BsConst_SpeedoGauge_ElementTrigBySet_BsConst_SpeedoGauge_Element
          OIE_pp_CS_MemAbsSet_MemAbstractMdl_Set_BsConst_TachoGauge_ElementTrigBySet_BsConst_TachoGauge_Element: RteEventRef=OIE_pp_CS_MemAbsSet_MemAbstractMdl_Set_BsConst_TachoGauge_ElementTrigBySet_BsConst_TachoGauge_Element
          OIE_pp_CS_MemAbsSet_MemAbstractMdl_Set_BsConst_TempGauge_ElementTrigBySet_BsConst_TempGauge_Element: RteEventRef=OIE_pp_CS_MemAbsSet_MemAbstractMdl_Set_BsConst_TempGauge_ElementTrigBySet_BsConst_TempGauge_Element
          OIE_pp_CS_MemAbsSet_MemAbstractMdl_Set_BsConst_TripComputer_ElementTrigBySet_BsConst_TripComputer_Element: RteEventRef=OIE_pp_CS_MemAbsSet_MemAbstractMdl_Set_BsConst_TripComputer_ElementTrigBySet_BsConst_TripComputer_Element
          OIE_pp_CS_MemAbsSet_MemAbstractMdl_Set_BsConst_Warning_ElementTrigBySet_BsConst_Warning_Element: RteEventRef=OIE_pp_CS_MemAbsSet_MemAbstractMdl_Set_BsConst_Warning_ElementTrigBySet_BsConst_Warning_Element
          OIE_pp_CS_MemAbsSet_MemAbstractMdl_Set_BsCys_Certicificate_ElementTrigBySet_BsCys_Certicificate_Element: RteEventRef=OIE_pp_CS_MemAbsSet_MemAbstractMdl_Set_BsCys_Certicificate_ElementTrigBySet_BsCys_Certicificate_Element
          OIE_pp_CS_MemAbsSet_MemAbstractMdl_Set_BsDiag_Dtc_ElementTrigBySet_BsDiag_Dtc_Element: RteEventRef=OIE_pp_CS_MemAbsSet_MemAbstractMdl_Set_BsDiag_Dtc_ElementTrigBySet_BsDiag_Dtc_Element
          OIE_pp_CS_MemAbsSet_MemAbstractMdl_Set_BsDiag_ErrorRecord_ElementTrigBySet_BsDiag_ErrorRecord_Element: RteEventRef=OIE_pp_CS_MemAbsSet_MemAbstractMdl_Set_BsDiag_ErrorRecord_ElementTrigBySet_BsDiag_ErrorRecord_Element
          OIE_pp_CS_MemAbsSet_MemAbstractMdl_Set_BsFuSa_Audio_ElementTrigBySet_BsFuSa_Audio_Element: RteEventRef=OIE_pp_CS_MemAbsSet_MemAbstractMdl_Set_BsFuSa_Audio_ElementTrigBySet_BsFuSa_Audio_Element
          OIE_pp_CS_MemAbsSet_MemAbstractMdl_Set_BsFuSa_Communication_ElementTrigBySet_BsFuSa_Communication_Element: RteEventRef=OIE_pp_CS_MemAbsSet_MemAbstractMdl_Set_BsFuSa_Communication_ElementTrigBySet_BsFuSa_Communication_Element
          OIE_pp_CS_MemAbsSet_MemAbstractMdl_Set_BsFuSa_Config_ElementTrigBySet_BsFuSa_Config_Element: RteEventRef=OIE_pp_CS_MemAbsSet_MemAbstractMdl_Set_BsFuSa_Config_ElementTrigBySet_BsFuSa_Config_Element
          OIE_pp_CS_MemAbsSet_MemAbstractMdl_Set_BsFuSa_Display_ElementTrigBySet_BsFuSa_Display_Element: RteEventRef=OIE_pp_CS_MemAbsSet_MemAbstractMdl_Set_BsFuSa_Display_ElementTrigBySet_BsFuSa_Display_Element
          OIE_pp_CS_MemAbsSet_MemAbstractMdl_Set_BsFuSa_Power_ElementTrigBySet_BsFuSa_Power_Element: RteEventRef=OIE_pp_CS_MemAbsSet_MemAbstractMdl_Set_BsFuSa_Power_ElementTrigBySet_BsFuSa_Power_Element
          OIE_pp_CS_MemAbsSet_MemAbstractMdl_Set_BsFuSa_Warning_ElementTrigBySet_BsFuSa_Warning_Element: RteEventRef=OIE_pp_CS_MemAbsSet_MemAbstractMdl_Set_BsFuSa_Warning_ElementTrigBySet_BsFuSa_Warning_Element
          OIE_pp_CS_MemAbsSet_MemAbstractMdl_Set_BsFusa_Fota_ElementTrigBySet_BsFusa_Fota_Element: RteEventRef=OIE_pp_CS_MemAbsSet_MemAbstractMdl_Set_BsFusa_Fota_ElementTrigBySet_BsFusa_Fota_Element
          OIE_pp_CS_MemAbsSet_MemAbstractMdl_Set_BsReten_Audio_ElementTrigBySet_BsReten_Audio_Element: RteEventRef=OIE_pp_CS_MemAbsSet_MemAbstractMdl_Set_BsReten_Audio_ElementTrigBySet_BsReten_Audio_Element
          OIE_pp_CS_MemAbsSet_MemAbstractMdl_Set_BsReten_Communication_ElementTrigBySet_BsReten_Communication_Element: RteEventRef=OIE_pp_CS_MemAbsSet_MemAbstractMdl_Set_BsReten_Communication_ElementTrigBySet_BsReten_Communication_Element
          OIE_pp_CS_MemAbsSet_MemAbstractMdl_Set_BsReten_Display_ElementTrigBySet_BsReten_Display_Element: RteEventRef=OIE_pp_CS_MemAbsSet_MemAbstractMdl_Set_BsReten_Display_ElementTrigBySet_BsReten_Display_Element
          OIE_pp_CS_MemAbsSet_MemAbstractMdl_Set_BsReten_Gauges_ElementTrigBySet_BsReten_Gauges_Element: RteEventRef=OIE_pp_CS_MemAbsSet_MemAbstractMdl_Set_BsReten_Gauges_ElementTrigBySet_BsReten_Gauges_Element
          OIE_pp_CS_MemAbsSet_MemAbstractMdl_Set_BsReten_Illumination_ElementTrigBySet_BsReten_Illumination_Element: RteEventRef=OIE_pp_CS_MemAbsSet_MemAbstractMdl_Set_BsReten_Illumination_ElementTrigBySet_BsReten_Illumination_Element
          OIE_pp_CS_MemAbsSet_MemAbstractMdl_Set_BsReten_Odometer_ElementTrigBySet_BsReten_Odometer_Element: RteEventRef=OIE_pp_CS_MemAbsSet_MemAbstractMdl_Set_BsReten_Odometer_ElementTrigBySet_BsReten_Odometer_Element
          OIE_pp_CS_MemAbsSet_MemAbstractMdl_Set_BsReten_Personalization_ElementTrigBySet_BsReten_Personalization_Element: RteEventRef=OIE_pp_CS_MemAbsSet_MemAbstractMdl_Set_BsReten_Personalization_ElementTrigBySet_BsReten_Personalization_Element
          OIE_pp_CS_MemAbsSet_MemAbstractMdl_Set_BsReten_Power_ElementTrigBySet_BsReten_Power_Element: RteEventRef=OIE_pp_CS_MemAbsSet_MemAbstractMdl_Set_BsReten_Power_ElementTrigBySet_BsReten_Power_Element
          OIE_pp_CS_MemAbsSet_MemAbstractMdl_Set_BsReten_RealTimeClock_ElementTrigBySet_BsReten_RealTimeClock_Element: RteEventRef=OIE_pp_CS_MemAbsSet_MemAbstractMdl_Set_BsReten_RealTimeClock_ElementTrigBySet_BsReten_RealTimeClock_Element
          OIE_pp_CS_MemAbsSet_MemAbstractMdl_Set_BsReten_Tripcomputer_ElementTrigBySet_BsReten_Tripcomputer_Element: RteEventRef=OIE_pp_CS_MemAbsSet_MemAbstractMdl_Set_BsReten_Tripcomputer_ElementTrigBySet_BsReten_Tripcomputer_Element
          OIE_pp_CS_MemAbsSet_MemAbstractMdl_Set_BsReten_VisDlt_ElementTrigBySet_BsReten_VisDlt_Element: RteEventRef=OIE_pp_CS_MemAbsSet_MemAbstractMdl_Set_BsReten_VisDlt_ElementTrigBySet_BsReten_VisDlt_Element
          OIE_pp_CS_MemAbsSet_MemAbstractMdl_Set_BsReten_Warning_ElementTrigBySet_BsReten_Warning_Element: RteEventRef=OIE_pp_CS_MemAbsSet_MemAbstractMdl_Set_BsReten_Warning_ElementTrigBySet_BsReten_Warning_Element
          OIE_pp_CS_MemAbsSet_MemAbstractMdl_Set_BsRt_CusDlt_ElementTrigBySet_BsRt_CusDlt_Element: RteEventRef=OIE_pp_CS_MemAbsSet_MemAbstractMdl_Set_BsRt_CusDlt_ElementTrigBySet_BsRt_CusDlt_Element
          OIE_pp_CS_MemAbsSet_MemAbstractMdl_Set_BsRt_FuelGauge_ElementTrigBySet_BsRt_FuelGauge_Element: RteEventRef=OIE_pp_CS_MemAbsSet_MemAbstractMdl_Set_BsRt_FuelGauge_ElementTrigBySet_BsRt_FuelGauge_Element
          OIE_pp_CS_MemAbsSet_MemAbstractMdl_Set_BsRt_Illumination_ElementTrigBySet_BsRt_Illumination_Element: RteEventRef=OIE_pp_CS_MemAbsSet_MemAbstractMdl_Set_BsRt_Illumination_ElementTrigBySet_BsRt_Illumination_Element
          OIE_pp_CS_MemAbsSet_MemAbstractMdl_Set_BsRt_Odometer_ElementTrigBySet_BsRt_Odometer_Element: RteEventRef=OIE_pp_CS_MemAbsSet_MemAbstractMdl_Set_BsRt_Odometer_ElementTrigBySet_BsRt_Odometer_Element
          OIE_pp_CS_MemAbsSet_MemAbstractMdl_Set_BsRt_OilGauge_ElementTrigBySet_BsRt_OilGauge_Element: RteEventRef=OIE_pp_CS_MemAbsSet_MemAbstractMdl_Set_BsRt_OilGauge_ElementTrigBySet_BsRt_OilGauge_Element
          OIE_pp_CS_MemAbsSet_MemAbstractMdl_Set_BsRt_Personalization_ElementTrigBySet_BsRt_Personalization_Element: RteEventRef=OIE_pp_CS_MemAbsSet_MemAbstractMdl_Set_BsRt_Personalization_ElementTrigBySet_BsRt_Personalization_Element
          OIE_pp_CS_MemAbsSet_MemAbstractMdl_Set_BsRt_PowerGauge_ElementTrigBySet_BsRt_PowerGauge_Element: RteEventRef=OIE_pp_CS_MemAbsSet_MemAbstractMdl_Set_BsRt_PowerGauge_ElementTrigBySet_BsRt_PowerGauge_Element
          OIE_pp_CS_MemAbsSet_MemAbstractMdl_Set_BsRt_RealTimeClock_ElementTrigBySet_BsRt_RealTimeClock_Element: RteEventRef=OIE_pp_CS_MemAbsSet_MemAbstractMdl_Set_BsRt_RealTimeClock_ElementTrigBySet_BsRt_RealTimeClock_Element
          OIE_pp_CS_MemAbsSet_MemAbstractMdl_Set_BsRt_SpeedoGauge_ElementTrigBySet_BsRt_SpeedoGauge_Element: RteEventRef=OIE_pp_CS_MemAbsSet_MemAbstractMdl_Set_BsRt_SpeedoGauge_ElementTrigBySet_BsRt_SpeedoGauge_Element
          OIE_pp_CS_MemAbsSet_MemAbstractMdl_Set_BsRt_TachoGauge_ElementTrigBySet_BsRt_TachoGauge_Element: RteEventRef=OIE_pp_CS_MemAbsSet_MemAbstractMdl_Set_BsRt_TachoGauge_ElementTrigBySet_BsRt_TachoGauge_Element
          OIE_pp_CS_MemAbsSet_MemAbstractMdl_Set_BsRt_TempGauge_ElementTrigBySet_BsRt_TempGauge_Element: RteEventRef=OIE_pp_CS_MemAbsSet_MemAbstractMdl_Set_BsRt_TempGauge_ElementTrigBySet_BsRt_TempGauge_Element
          OIE_pp_CS_MemAbsSet_MemAbstractMdl_Set_BsRt_TripComputer_ElementTrigBySet_BsRt_TripComputer_Element: RteEventRef=OIE_pp_CS_MemAbsSet_MemAbstractMdl_Set_BsRt_TripComputer_ElementTrigBySet_BsRt_TripComputer_Element
          OIE_pp_CS_MemAbsSet_MemAbstractMdl_Set_BsRt_Warning_ElementTrigBySet_BsRt_Warning_Element: RteEventRef=OIE_pp_CS_MemAbsSet_MemAbstractMdl_Set_BsRt_Warning_ElementTrigBySet_BsRt_Warning_Element
          OIE_pp_CS_MemAbsSet_MemAbstractMdl_Set_BsShare_EcuPartNumber_ElementTrigBySet_BsShare_EcuPartNumber_Element: RteEventRef=OIE_pp_CS_MemAbsSet_MemAbstractMdl_Set_BsShare_EcuPartNumber_ElementTrigBySet_BsShare_EcuPartNumber_Element
          OIE_pp_CS_MemAbsSet_MemAbstractMdl_Set_BsShare_SwUpdFotaFinPrint_ElementTrigBySet_BsShare_SwUpdFotaFinPrint_Element: RteEventRef=OIE_pp_CS_MemAbsSet_MemAbstractMdl_Set_BsShare_SwUpdFotaFinPrint_ElementTrigBySet_BsShare_SwUpdFotaFinPrint_Element
          OIE_pp_CS_MemAbsSet_MemAbstractMdl_Set_BsShare_SwUpdFotaMode_ElementTrigBySet_BsShare_SwUpdFotaMode_Element: RteEventRef=OIE_pp_CS_MemAbsSet_MemAbstractMdl_Set_BsShare_SwUpdFotaMode_ElementTrigBySet_BsShare_SwUpdFotaMode_Element
          OIE_pp_CS_MemAbsSet_MemAbstractMdl_Set_BsShare_SwUpdFotaStatus_ElementTrigBySet_BsShare_SwUpdFotaStatus_Element: RteEventRef=OIE_pp_CS_MemAbsSet_MemAbstractMdl_Set_BsShare_SwUpdFotaStatus_ElementTrigBySet_BsShare_SwUpdFotaStatus_Element
          OIE_pp_CS_MemAbsSet_MemAbstractMdl_Set_BsShare_SwUpdFotadecrypt_ElementTrigBySet_BsShare_SwUpdFotadecrypt_Element: RteEventRef=OIE_pp_CS_MemAbsSet_MemAbstractMdl_Set_BsShare_SwUpdFotadecrypt_ElementTrigBySet_BsShare_SwUpdFotadecrypt_Element
          OIE_pp_CS_MemAbsSet_MemAbstractMdl_Set_BsShare_SwUpdReflash_ElementTrigBySet_BsShare_SwUpdReflash_Element: RteEventRef=OIE_pp_CS_MemAbsSet_MemAbstractMdl_Set_BsShare_SwUpdReflash_ElementTrigBySet_BsShare_SwUpdReflash_Element
          OIE_pp_CS_MemAbsSet_MemAbstractMdl_Set_BsShare_VehicleConfig_ElementTrigBySet_BsShare_VehicleConfig_Element: RteEventRef=OIE_pp_CS_MemAbsSet_MemAbstractMdl_Set_BsShare_VehicleConfig_ElementTrigBySet_BsShare_VehicleConfig_Element
          OIE_pp_CS_MemAbsSet_MemAbstractMdl_Set_BsShare_VisMeet_ElementTrigBySet_BsShare_VisMeet_Element: RteEventRef=OIE_pp_CS_MemAbsSet_MemAbstractMdl_Set_BsShare_VisMeet_ElementTrigBySet_BsShare_VisMeet_Element
          OIE_pp_CS_MemAbsSet_MemAbstractMdl_Set_RefCys_Certicificate1_ElementTrigBySet_RefCys_Certicificate1_Element: RteEventRef=OIE_pp_CS_MemAbsSet_MemAbstractMdl_Set_RefCys_Certicificate1_ElementTrigBySet_RefCys_Certicificate1_Element
          OIE_pp_CS_MemAbsSet_MemAbstractMdl_Set_RefCys_Certicificate_ElementTrigBySet_RefCys_Certicificate_Element: RteEventRef=OIE_pp_CS_MemAbsSet_MemAbstractMdl_Set_RefCys_Certicificate_ElementTrigBySet_RefCys_Certicificate_Element
          TEMemAbstractMdl_MainFunction: RtePositionInTask=14, RteEventRef=TEMemAbstractMdl_MainFunction, RteMappedToTaskRef=OsTask_MemSer, RteUsedOsEventRef=Rte_Ev_Cyclic_OsTask_MemSer_0_10ms, RteUsedOsAlarmRef=Rte_Al_TE_OsTask_MemSer_0_10ms
    MemAbstractMdl (RteSwComponentType): RteComponentTypeRef=MemAbstractMdl, RteImplementationRef=IMPL_MemAbstractMdl
      ComponentTypeCalibration (RteComponentTypeCalibration): RteCalibrationSupportEnabled=false
    DmnMgr_EcuSwComposition (RteSwComponentInstance): RteSoftwareComponentInstanceRef=DmnMgr
      15 x RteEventToTaskMapping, all with RteImmediateRestart=false:
        TECDmnMgr_Impl_MainFunction: RtePositionInTask=16, RteEventRef=TECDmnMgr_Impl_MainFunction, RteMappedToTaskRef=OsTask_MemSer, RteUsedOsEventRef=Rte_Ev_Cyclic_OsTask_MemSer_0_10ms, RteUsedOsAlarmRef=Rte_Al_TE_OsTask_MemSer_0_10ms
        OIE_pp_CmpLibCmd_CDmnMgr_CDmnMgr_Impl_OnCommandTrigByImpl_OnCommand: RteEventRef=OIE_pp_CmpLibCmd_CDmnMgr_CDmnMgr_Impl_OnCommandTrigByImpl_OnCommand
        OIE_ppCS_DmnSystemStateChange_DmnMgr_DmnSystemStateChangeReqTrigByDmnSystemStateChangeReq: RteEventRef=OIE_ppCS_DmnSystemStateChange_DmnMgr_DmnSystemStateChangeReqTrigByDmnSystemStateChangeReq
        OIE_ppCS_DmnSystemStateChange_DmnMgr_DmnSystemStateChangeStatusTrigByDmnSystemStateChangeStatus: RteEventRef=OIE_ppCS_DmnSystemStateChange_DmnMgr_DmnSystemStateChangeStatusTrigByDmnSystemStateChangeStatus
        OIE_ppCS_UclSystemCallbacks_DmnMgr_ErrorNotificationTrigByErrorNotification: RteEventRef=OIE_ppCS_UclSystemCallbacks_DmnMgr_ErrorNotificationTrigByErrorNotification
        OIE_ppCS_UclSystemCallbacks_DmnMgr_LinkStatusChangedTrigByLinkStatusChanged: RteEventRef=OIE_ppCS_UclSystemCallbacks_DmnMgr_LinkStatusChangedTrigByLinkStatusChanged
        DREDmnMgr_MonitorDmnExtendShutdownTimeTrigByPowerExtendShutdownTimeData: RtePositionInTask=17, RteEventRef=DREDmnMgr_MonitorDmnExtendShutdownTimeTrigByPowerExtendShutdownTimeData, RteMappedToTaskRef=OsTask_MemSer, RteUsedOsEventRef=Rte_Ev_Run_DmnMgr_DmnMgr_MonitorDmnExtendShutdownTime
        DREDmnMgr_MonitorDmnHealthDumpDataTrigByHealthDumpDataData: RtePositionInTask=18, RteEventRef=DREDmnMgr_MonitorDmnHealthDumpDataTrigByHealthDumpDataData, RteMappedToTaskRef=OsTask_MemSer, RteUsedOsEventRef=Rte_Ev_Run_DmnMgr_DmnMgr_MonitorDmnHealthDumpData
        DREDmnMgr_MonitorDmnHealthDumpHdrInfoTrigByHealthDumpHdrInfoData: RtePositionInTask=19, RteEventRef=DREDmnMgr_MonitorDmnHealthDumpHdrInfoTrigByHealthDumpHdrInfoData, RteMappedToTaskRef=OsTask_MemSer, RteUsedOsEventRef=Rte_Ev_Run_DmnMgr_DmnMgr_MonitorDmnHealthDumpHdrInfo
        DREDmnMgr_MonitorDmnHealthFatalErrorTrigByHealthDomainFatalErrorData: RtePositionInTask=20, RteEventRef=DREDmnMgr_MonitorDmnHealthFatalErrorTrigByHealthDomainFatalErrorData, RteMappedToTaskRef=OsTask_MemSer, RteUsedOsEventRef=Rte_Ev_Run_DmnMgr_DmnMgr_MonitorDmnHealthFatalError
        DREDmnMgr_MonitorDmnHeartBeatTrigByHealthDomainHeartbeatData: RtePositionInTask=21, RteEventRef=DREDmnMgr_MonitorDmnHeartBeatTrigByHealthDomainHeartbeatData, RteMappedToTaskRef=OsTask_MemSer, RteUsedOsEventRef=Rte_Ev_Run_DmnMgr_DmnMgr_MonitorDmnHeartBeat
        DREDmnMgr_MonitorDmnKeepSystemAwakeTrigByPowerKeepSystemAwakeData: RtePositionInTask=22, RteEventRef=DREDmnMgr_MonitorDmnKeepSystemAwakeTrigByPowerKeepSystemAwakeData, RteMappedToTaskRef=OsTask_MemSer, RteUsedOsEventRef=Rte_Ev_Run_DmnMgr_DmnMgr_MonitorDmnKeepSystemAwake
        DREDmnMgr_MonitorDmnPowerSystemStateTrigByPowerSystemStateData: RtePositionInTask=23, RteEventRef=DREDmnMgr_MonitorDmnPowerSystemStateTrigByPowerSystemStateData, RteMappedToTaskRef=OsTask_MemSer, RteUsedOsEventRef=Rte_Ev_Run_DmnMgr_DmnMgr_MonitorDmnPowerSystemState
        OIE_ppCS_DomainMonitoring_DmnMgr_StartDomainMonitoringTrigByStartDomainMonitoring: RteEventRef=OIE_ppCS_DomainMonitoring_DmnMgr_StartDomainMonitoringTrigByStartDomainMonitoring
        OIE_ppCS_DomainMonitoring_DmnMgr_StopDomainMonitoringTrigByStopDomainMonitoring: RteEventRef=OIE_ppCS_DomainMonitoring_DmnMgr_StopDomainMonitoringTrigByStopDomainMonitoring
    DmnMgr (RteSwComponentType): RteComponentTypeRef=DmnMgr, RteImplementationRef=IMPL_DmnMgr
      ComponentTypeCalibration (RteComponentTypeCalibration): RteCalibrationSupportEnabled=false
    SciDrv_EcuSwComposition (RteSwComponentInstance): RteSoftwareComponentInstanceRef=SciDrv
      TMT_SciDrv_MainFunction (RteEventToTaskMapping):
        RteImmediateRestart = false
        RtePositionInTask = 7
        RteEventRef = TMT_SciDrv_MainFunction
        RteMappedToTaskRef = OsTask_Mcal
        RteUsedOsAlarmRef = Rte_Al_TE_OsTask_Mcal_0_10ms
    SciDrv (RteSwComponentType): RteComponentTypeRef=SciDrv, RteImplementationRef=SciDrv_Implementation
      ComponentTypeCalibration (RteComponentTypeCalibration): RteCalibrationSupportEnabled=false
    CSleepManager_EcuSwComposition (RteSwComponentInstance): RteSoftwareComponentInstanceRef=CSleepManager
      TECSleepManager_Impl_MainFunction (RteEventToTaskMapping):
        RteImmediateRestart = false
        RtePositionInTask = 24
        RteEventRef = TECSleepManager_Impl_MainFunction
        RteMappedToTaskRef = OsTask_MemSer
        RteUsedOsEventRef = Rte_Ev_Cyclic_OsTask_MemSer_0_10ms
        RteUsedOsAlarmRef = Rte_Al_TE_OsTask_MemSer_0_10ms
      OIE_pp_CmpLibCmd_CSleepManager_Impl_OnCommandTrigByImpl_OnCommand (RteEventToTaskMapping): RteImmediateRestart=false, RteEventRef=OIE_pp_CmpLibCmd_CSleepManager_Impl_OnCommandTrigByImpl_OnCommand
    CSleepManager (RteSwComponentType): RteComponentTypeRef=CSleepManager, RteImplementationRef=IMPL_CSleepManager
      ComponentTypeCalibration (RteComponentTypeCalibration): RteCalibrationSupportEnabled=false
    UclProxyCdd_001 (RteSwComponentType): RteComponentTypeRef=UclProxyCdd, RteImplementationRef=IMPL_UclProxyCdd
      ComponentTypeCalibration (RteComponentTypeCalibration): RteCalibrationSupportEnabled=false
    CBacklightCdd_EcuSwComposition (RteSwComponentInstance): RteSoftwareComponentInstanceRef=CBacklightCdd
      7 x RteEventToTaskMapping, all with RteImmediateRestart=false:
        OIE_pp_CS_Backlight_service_CBacklightCdd_GetBrightnessValueTrigByGetBrightnessValue: RteEventRef=OIE_pp_CS_Backlight_service_CBacklightCdd_GetBrightnessValueTrigByGetBrightnessValue
        OIE_pp_CS_Backlight_Status_CBacklightCdd_GetStatusTrigByGetStatus: RteEventRef=OIE_pp_CS_Backlight_Status_CBacklightCdd_GetStatusTrigByGetStatus
        OIE_pp_CS_Backlight_service_CBacklightCdd_GetThermalValueTrigByGetThermalValue: RteEventRef=OIE_pp_CS_Backlight_service_CBacklightCdd_GetThermalValueTrigByGetThermalValue
        TECBacklightCdd_Impl_MainFunction: RtePositionInTask=1, RteEventRef=TECBacklightCdd_Impl_MainFunction, RteMappedToTaskRef=OsTask_CddFun, RteUsedOsEventRef=Rte_Ev_Cyclic_OsTask_CddFun_0_10ms, RteUsedOsAlarmRef=Rte_Al_TE_OsTask_CddFun_0_10ms
        OIE_pp_CmpLibCmd_CBacklightCdd_CBacklightCdd_Impl_OnCommandTrigByImpl_OnCommand: RteEventRef=OIE_pp_CmpLibCmd_CBacklightCdd_CBacklightCdd_Impl_OnCommandTrigByImpl_OnCommand
        OIE_pp_CS_Backlight_Notify_CBacklightCdd_NotifyDisplayPowerStateTrigByNotifyDisplayPowerState: RteEventRef=OIE_pp_CS_Backlight_Notify_CBacklightCdd_NotifyDisplayPowerStateTrigByNotifyDisplayPowerState
        OIE_pp_CS_Backlight_service_CBacklightCdd_SetBrightnessValueTrigBySetBrightnessValue: RteEventRef=OIE_pp_CS_Backlight_service_CBacklightCdd_SetBrightnessValueTrigBySetBrightnessValue
    CBacklightCdd (RteSwComponentType): RteComponentTypeRef=CBacklightCdd, RteImplementationRef=IMPL_CBacklightCdd
      ComponentTypeCalibration (RteComponentTypeCalibration): RteCalibrationSupportEnabled=false
    CDisplayCdd_EcuSwComposition (RteSwComponentInstance): RteSoftwareComponentInstanceRef=CDisplayCdd
      7 x RteEventToTaskMapping, all with RteImmediateRestart=false:
        OIE_ppCS_DisplayCdd_GammaSet_CDisplayCdd_GetGammaCorrectionStatusTrigByGetGammaCorrectionStatus: RteEventRef=OIE_ppCS_DisplayCdd_GammaSet_CDisplayCdd_GetGammaCorrectionStatusTrigByGetGammaCorrectionStatus
        OIE_pp_CS_DisplayCdd_Status_CDisplayCdd_GetStatusTrigByGetStatus: RteEventRef=OIE_pp_CS_DisplayCdd_Status_CDisplayCdd_GetStatusTrigByGetStatus
        OIE_ppCS_DisplayCdd_Cbk_CDisplayCdd_I2cSeqEndCallbackTrigByI2cSeqEndCallback: RteEventRef=OIE_ppCS_DisplayCdd_Cbk_CDisplayCdd_I2cSeqEndCallbackTrigByI2cSeqEndCallback
        TECDisplayCdd_Impl_MainFunction: RtePositionInTask=2, RteEventRef=TECDisplayCdd_Impl_MainFunction, RteMappedToTaskRef=OsTask_CddFun, RteUsedOsEventRef=Rte_Ev_Cyclic_OsTask_CddFun_0_10ms, RteUsedOsAlarmRef=Rte_Al_TE_OsTask_CddFun_0_10ms
        OIE_pp_CmpLibCmd_CDisplayCdd_CDisplayCdd_Impl_OnCommandTrigByImpl_OnCommand: RteEventRef=OIE_pp_CmpLibCmd_CDisplayCdd_CDisplayCdd_Impl_OnCommandTrigByImpl_OnCommand
        OIE_ppCS_DisplayCdd_GammaSet_CDisplayCdd_SetGammaCorrectionTrigBySetGammaCorrection: RteEventRef=OIE_ppCS_DisplayCdd_GammaSet_CDisplayCdd_SetGammaCorrectionTrigBySetGammaCorrection
        OIE_pp_CS_DisplayCdd_Status_CDisplayCdd_SetStateTrigBySetState: RteEventRef=OIE_pp_CS_DisplayCdd_Status_CDisplayCdd_SetStateTrigBySetState
    CDisplayCdd (RteSwComponentType): RteComponentTypeRef=CDisplayCdd, RteImplementationRef=IMPL_CDisplayCdd
      ComponentTypeCalibration (RteComponentTypeCalibration): RteCalibrationSupportEnabled=false
    CCDD_EcuPowerM_EcuSwComposition (RteSwComponentInstance): RteSoftwareComponentInstanceRef=CCDD_EcuPowerM
      4 x RteEventToTaskMapping, all with RteImmediateRestart=false:
        OIE_ppCS_RequestPower_EcuPowerM_GetDeviceStatusTrigByEcuPowerM_GetDeviceStatus: RteEventRef=OIE_ppCS_RequestPower_EcuPowerM_GetDeviceStatusTrigByEcuPowerM_GetDeviceStatus
        OIE_ppCS_RequestPower_EcuPowerM_RequestPowerTrigByEcuPowerM_RequestPower: RteEventRef=OIE_ppCS_RequestPower_EcuPowerM_RequestPowerTrigByEcuPowerM_RequestPower
        TECCDD_EcuPowerM_Impl_MainFunction: RtePositionInTask=4, RteEventRef=TECCDD_EcuPowerM_Impl_MainFunction, RteMappedToTaskRef=OsTask_CddFun, RteUsedOsEventRef=Rte_Ev_Cyclic_OsTask_CddFun_0_5ms, RteUsedOsAlarmRef=Rte_Al_TE_OsTask_CddFun_0_5ms
        OIE_pp_CmpLibCmd_CCDD_EcuPowerM_Impl_OnCommandTrigByImpl_OnCommand: RteEventRef=OIE_pp_CmpLibCmd_CCDD_EcuPowerM_Impl_OnCommandTrigByImpl_OnCommand
    CBattMdl_EcuSwComposition (RteSwComponentInstance): RteSoftwareComponentInstanceRef=CBattMdl
      TECBattMdl_Impl_MainFunction (RteEventToTaskMapping):
        RteImmediateRestart = false
        RtePositionInTask = 3
        RteEventRef = TECBattMdl_Impl_MainFunction
        RteMappedToTaskRef = OsTask_CddFun
        RteUsedOsEventRef = Rte_Ev_Cyclic_OsTask_CddFun_0_5ms
        RteUsedOsAlarmRef = Rte_Al_TE_OsTask_CddFun_0_5ms
      OIE_pp_CmpLibCmd_CBattMdl_CBattMdl_Impl_OnCommandTrigByImpl_OnCommand (RteEventToTaskMapping): RteImmediateRestart=false, RteEventRef=OIE_pp_CmpLibCmd_CBattMdl_CBattMdl_Impl_OnCommandTrigByImpl_OnCommand
    CBattMdl (RteSwComponentType): RteComponentTypeRef=CBattMdl, RteImplementationRef=IMPL_CBattMdl
      ComponentTypeCalibration (RteComponentTypeCalibration): RteCalibrationSupportEnabled=false
    CCDD_EcuPowerM (RteSwComponentType): RteComponentTypeRef=CCDD_EcuPowerM, RteImplementationRef=IMPL_CCDD_EcuPowerM
      ComponentTypeCalibration (RteComponentTypeCalibration): RteCalibrationSupportEnabled=false
    Dlt_EcuSwComposition (RteSwComponentInstance): RteSoftwareComponentInstanceRef=Dlt
      22 x RteEventToTaskMapping, all with RteImmediateRestart=false:
        OIE_ppCS_Dlt_DetForwardErrorTrace_Dlt_DetForwardErrorTraceTrigByDetForwardErrorTrace: RteEventRef=OIE_ppCS_Dlt_DetForwardErrorTrace_Dlt_DetForwardErrorTraceTrigByDetForwardErrorTrace
        OIE_ppCS_Dlt_GetDefaultLogLevel_Dlt_GetDefaultLogLevelTrigByGetDefaultLogLevel: RteEventRef=OIE_ppCS_Dlt_GetDefaultLogLevel_Dlt_GetDefaultLogLevelTrigByGetDefaultLogLevel
        OIE_ppCS_Dlt_GetDefaultTraceStatus_Dlt_GetDefaultTraceStatusTrigByGetDefaultTraceStatus: RteEventRef=OIE_ppCS_Dlt_GetDefaultTraceStatus_Dlt_GetDefaultTraceStatusTrigByGetDefaultTraceStatus
        OIE_ppCS_Dlt_GetLogChannelNames_Dlt_GetLogChannelNamesTrigByGetLogChannelNames: RteEventRef=OIE_ppCS_Dlt_GetLogChannelNames_Dlt_GetLogChannelNamesTrigByGetLogChannelNames
        OIE_ppCS_Dlt_GetLogChannelThreshold_Dlt_GetLogChannelThresholdTrigByGetLogChannelThreshold: RteEventRef=OIE_ppCS_Dlt_GetLogChannelThreshold_Dlt_GetLogChannelThresholdTrigByGetLogChannelThreshold
        OIE_ppCS_Dlt_GetLogInfo_Dlt_GetLogInfoTrigByGetLogInfo: RteEventRef=OIE_ppCS_Dlt_GetLogInfo_Dlt_GetLogInfoTrigByGetLogInfo
        OIE_ppCS_Dlt_GetTraceStatus_Dlt_GetTraceStatusTrigByGetTraceStatus: RteEventRef=OIE_ppCS_Dlt_GetTraceStatus_Dlt_GetTraceStatusTrigByGetTraceStatus
        OIE_ppCS_Dlt_InjectCall_SESSION_Dlt_InjectCall_SESSIONTrigByInjectCall_SESSION: RteEventRef=OIE_ppCS_Dlt_InjectCall_SESSION_Dlt_InjectCall_SESSIONTrigByInjectCall_SESSION
        TEDlt_MainFunction: RtePositionInTask=4, RteEventRef=TEDlt_MainFunction, RteMappedToTaskRef=OsTask_Diagnostics, RteUsedOsEventRef=Rte_Ev_Cyclic_OsTask_Diagnostics_0_100ms, RteUsedOsAlarmRef=Rte_Al_TE_OsTask_Diagnostics_0_100ms
        OIE_ppCS_Dlt_RegisterContext_Dlt_RegisterContextTrigByRegisterContext: RteEventRef=OIE_ppCS_Dlt_RegisterContext_Dlt_RegisterContextTrigByRegisterContext
        OIE_ppCS_Dlt_ResetToFactoryDefault_Dlt_ResetToFactoryDefaultTrigByResetToFactoryDefault: RteEventRef=OIE_ppCS_Dlt_ResetToFactoryDefault_Dlt_ResetToFactoryDefaultTrigByResetToFactoryDefault
        OIE_ppCS_Dlt_SendLogMessage_Dlt_SendLogMessageTrigBySendLogMessage: RteEventRef=OIE_ppCS_Dlt_SendLogMessage_Dlt_SendLogMessageTrigBySendLogMessage
        OIE_ppCS_Dlt_SendTraceMessage_Dlt_SendTraceMessageTrigBySendTraceMessage: RteEventRef=OIE_ppCS_Dlt_SendTraceMessage_Dlt_SendTraceMessageTrigBySendTraceMessage
        OIE_ppCS_Dlt_SetDefaultLogLevel_Dlt_SetDefaultLogLevelTrigBySetDefaultLogLevel: RteEventRef=OIE_ppCS_Dlt_SetDefaultLogLevel_Dlt_SetDefaultLogLevelTrigBySetDefaultLogLevel
        OIE_ppCS_Dlt_SetDefaultTraceStatus_Dlt_SetDefaultTraceStatusTrigBySetDefaultTraceStatus: RteEventRef=OIE_ppCS_Dlt_SetDefaultTraceStatus_Dlt_SetDefaultTraceStatusTrigBySetDefaultTraceStatus
        OIE_ppCS_Dlt_SetLogChannelAssignment_Dlt_SetLogChannelAssignmentTrigBySetLogChannelAssignment: RteEventRef=OIE_ppCS_Dlt_SetLogChannelAssignment_Dlt_SetLogChannelAssignmentTrigBySetLogChannelAssignment
        OIE_ppCS_Dlt_SetLogChannelThreshold_Dlt_SetLogChannelThresholdTrigBySetLogChannelThreshold: RteEventRef=OIE_ppCS_Dlt_SetLogChannelThreshold_Dlt_SetLogChannelThresholdTrigBySetLogChannelThreshold
        OIE_ppCS_Dlt_SetLogLevel_Dlt_SetLogLevelTrigBySetLogLevel: RteEventRef=OIE_ppCS_Dlt_SetLogLevel_Dlt_SetLogLevelTrigBySetLogLevel
        OIE_ppCS_Dlt_SetMessageFiltering_Dlt_SetMessageFilteringTrigBySetMessageFiltering: RteEventRef=OIE_ppCS_Dlt_SetMessageFiltering_Dlt_SetMessageFilteringTrigBySetMessageFiltering
        OIE_ppCS_Dlt_SetTraceStatus_Dlt_SetTraceStatusTrigBySetTraceStatus: RteEventRef=OIE_ppCS_Dlt_SetTraceStatus_Dlt_SetTraceStatusTrigBySetTraceStatus
        OIE_ppCS_Dlt_StoreConfiguration_Dlt_StoreConfigurationTrigByStoreConfiguration: RteEventRef=OIE_ppCS_Dlt_StoreConfiguration_Dlt_StoreConfigurationTrigByStoreConfiguration
        OIE_ppCS_Dlt_UnregisterContext_Dlt_UnregisterContextTrigByUnregisterContext: RteEventRef=OIE_ppCS_Dlt_UnregisterContext_Dlt_UnregisterContextTrigByUnregisterContext
    DltExt_EcuSwComposition (RteSwComponentInstance): RteSoftwareComponentInstanceRef=DltExt
      4 x RteEventToTaskMapping, all with RteImmediateRestart=false:
        TEDltExt_MainFunction: RtePositionInTask=3, RteEventRef=TEDltExt_MainFunction, RteMappedToTaskRef=OsTask_Diagnostics, RteUsedOsEventRef=Rte_Ev_Cyclic_OsTask_Diagnostics_0_100ms, RteUsedOsAlarmRef=Rte_Al_TE_OsTask_Diagnostics_0_100ms
        OIE_ppCS_DltExt_SendLogMessage_DltExt_SendLogMessageTrigBySendLogMessage: RteEventRef=OIE_ppCS_DltExt_SendLogMessage_DltExt_SendLogMessageTrigBySendLogMessage
        OIE_ppCS_SetCounterToDefault_DltExt_SetCounterToDefaultTrigBySetCounterToDefault: RteEventRef=OIE_ppCS_SetCounterToDefault_DltExt_SetCounterToDefaultTrigBySetCounterToDefault
        OIE_ppCS_SetLogsToDefault_DltExt_SetLogsToDefaultTrigBySetLogsToDefault: RteEventRef=OIE_ppCS_SetLogsToDefault_DltExt_SetLogsToDefaultTrigBySetLogsToDefault
    3 x RteSwComponentType:
      Dlt: RteComponentTypeRef=Dlt, RteImplementationRef=IMPL_Dlt
        ComponentTypeCalibration (RteComponentTypeCalibration): RteCalibrationSupportEnabled=false
      DltExt: RteComponentTypeRef=DltExt, RteImplementationRef=IMPL_DltExt
        ComponentTypeCalibration (RteComponentTypeCalibration): RteCalibrationSupportEnabled=false
      CRtcCdd: RteComponentTypeRef=CRtcCdd, RteImplementationRef=IMPL_CRtcCdd
        ComponentTypeCalibration (RteComponentTypeCalibration): RteCalibrationSupportEnabled=false
    RtcCdd_EcuSwComposition (RteSwComponentInstance): RteSoftwareComponentInstanceRef=RtcCdd
      6 x RteEventToTaskMapping, all with RteImmediateRestart=false:
        TECRtcCdd_Impl_MainFunction: RtePositionInTask=5, RteEventRef=TECRtcCdd_Impl_MainFunction, RteMappedToTaskRef=OsTask_CddFun, RteUsedOsEventRef=Rte_Ev_Cyclic_OsTask_CddFun_0_10ms, RteUsedOsAlarmRef=Rte_Al_TE_OsTask_CddFun_0_10ms
        OIE_pp_CS_TIRtcServices_RtcCdd_ClearAlarmTrigByRtcCdd_ClearAlarm: RteEventRef=OIE_pp_CS_TIRtcServices_RtcCdd_ClearAlarmTrigByRtcCdd_ClearAlarm
        OIE_pp_CS_TIRtcServices_RtcCdd_GetTimeTrigByRtcCdd_GetTime: RteEventRef=OIE_pp_CS_TIRtcServices_RtcCdd_GetTimeTrigByRtcCdd_GetTime
        OIE_pp_CS_TIRtcServices_RtcCdd_SetAlarmTrigByRtcCdd_SetAlarm: RteEventRef=OIE_pp_CS_TIRtcServices_RtcCdd_SetAlarmTrigByRtcCdd_SetAlarm
        OIE_pp_CS_TIRtcServices_RtcCdd_SetTimeTrigByRtcCdd_SetTime: RteEventRef=OIE_pp_CS_TIRtcServices_RtcCdd_SetTimeTrigByRtcCdd_SetTime
        OIT_pp_CmpLibCmd_CRTCCdd_Impl_OnCommand_pp_CmpLibCmd_CRTCCdd_Impl_OnCommand: RteEventRef=OIT_pp_CmpLibCmd_CRTCCdd_Impl_OnCommand_pp_CmpLibCmd_CRTCCdd_Impl_OnCommand
    RtcCdd (RteSwComponentType): RteComponentTypeRef=RtcCdd, RteImplementationRef=IMPL_RtcCdd
      ComponentTypeCalibration (RteComponentTypeCalibration): RteCalibrationSupportEnabled=false
