[part 1 of 2: package /ActiveEcuC]
AUTOSAR XML (schema 00044)
package /ActiveEcuC
  module config Rte: implementation-config-variant=VARIANT-PRE-COMPILE, module-description=Rte_Impl
    RteOsInteraction
      24 x RteUsedOsActivation, all with RteExpectedActivationOffset=0, RteExpectedTickDuration=0:
        Rte_Al_TE_UclProxyCdd_CUclProxyCdd_Impl_MainFunction: RteActivationOsAlarmRef=Rte_Al_TE_UclProxyCdd_CUclProxyCdd_Impl_MainFunction, RteActivationOsTaskRef=OsTask_MemSer
        Rte_Al_TE_Ea_Ea_MainFunction: RteActivationOsAlarmRef=Rte_Al_TE_Ea_Ea_MainFunction, RteActivationOsTaskRef=OsTask_MemSer
        Rte_Al_TE_OsTask_Mcal_0_10ms: RteActivationOsAlarmRef=Rte_Al_TE_OsTask_Mcal_0_10ms, RteActivationOsTaskRef=OsTask_Mcal
        Rte_Al_TE2_OsTask_MemSer_0_10ms: RteActivationOsAlarmRef=Rte_Al_TE2_OsTask_MemSer_0_10ms, RteActivationOsTaskRef=OsTask_MemSer
        Rte_Al_TE_OsTask_MemSer_0_10ms: RteActivationOsAlarmRef=Rte_Al_TE_OsTask_MemSer_0_10ms, RteActivationOsTaskRef=OsTask_MemSer
        Rte_Al_TE_Test_Comp_TxRxIpcMessage: RteActivationOsAlarmRef=Rte_Al_TE_Test_Comp_TxRxIpcMessage, RteActivationOsTaskRef=OsTask_SafeFun
        Rte_Al_TE_Test_Comp_AppTaskStubRunnable: RteActivationOsAlarmRef=Rte_Al_TE_Test_Comp_AppTaskStubRunnable, RteActivationOsTaskRef=OsTask_AppFun
        Rte_Al_TE_Test_Comp_AudioTaskStubRunnable: RteActivationOsAlarmRef=Rte_Al_TE_Test_Comp_AudioTaskStubRunnable, RteActivationOsTaskRef=OsTask_AudioFun
        Rte_Al_TE_OsTask_CANFun_0_10ms: RteActivationOsAlarmRef=Rte_Al_TE_OsTask_CANFun_0_10ms, RteActivationOsTaskRef=OsTask_CANFun
        Rte_Al_TE_OsTask_EthFun_0_10ms: RteActivationOsAlarmRef=Rte_Al_TE_OsTask_EthFun_0_10ms, RteActivationOsTaskRef=OsTask_EthFun
        Rte_Al_TE_Test_Comp_FotaTaskStubRunnable: RteActivationOsAlarmRef=Rte_Al_TE_Test_Comp_FotaTaskStubRunnable, RteActivationOsTaskRef=OsTask_FotaFun
        Rte_Al_TE_Test_Comp_GaugeTaskStubRunnable: RteActivationOsAlarmRef=Rte_Al_TE_Test_Comp_GaugeTaskStubRunnable, RteActivationOsTaskRef=OsTask_GaugeFun
        Rte_Al_TE_Test_Comp_GraphicsTaskStubRunnable: RteActivationOsAlarmRef=Rte_Al_TE_Test_Comp_GraphicsTaskStubRunnable, RteActivationOsTaskRef=OsTask_Graphics
        Rte_Al_TE_Test_Comp_IndTaskStubRunnable: RteActivationOsAlarmRef=Rte_Al_TE_Test_Comp_IndTaskStubRunnable, RteActivationOsTaskRef=OsTask_IndFun
        Rte_Al_TE_Test_Comp_LinTaskStubRunnable: RteActivationOsAlarmRef=Rte_Al_TE_Test_Comp_LinTaskStubRunnable, RteActivationOsTaskRef=OsTask_LinFun
        Rte_Al_TE_Test_Comp_IoExp_MainFunction: RteActivationOsAlarmRef=Rte_Al_TE_Test_Comp_IoExp_MainFunction, RteActivationOsTaskRef=OsTask_ModeMgt
        Rte_Al_TE_Test_Comp_TripTaskStubRunnable: RteActivationOsAlarmRef=Rte_Al_TE_Test_Comp_TripTaskStubRunnable, RteActivationOsTaskRef=OsTask_TripFun
        Rte_Al_TE_Test_Comp_WarnTaskStubRunnable: RteActivationOsAlarmRef=Rte_Al_TE_Test_Comp_WarnTaskStubRunnable, RteActivationOsTaskRef=OsTask_WarnFun
        Rte_Al_TE_Test_Comp_WdgMgntTaskStubRunnable: RteActivationOsAlarmRef=Rte_Al_TE_Test_Comp_WdgMgntTaskStubRunnable, RteActivationOsTaskRef=OsTask_WdgMngt
        Rte_Al_TE_NvMExt_NvMExt_SpeedupRunnable: RteActivationOsAlarmRef=Rte_Al_TE_NvMExt_NvMExt_SpeedupRunnable, RteActivationOsTaskRef=OsTask_NvmSpeedup
        Rte_Al_TE_OsTask_CddFun_0_10ms: RteActivationOsAlarmRef=Rte_Al_TE_OsTask_CddFun_0_10ms, RteActivationOsTaskRef=OsTask_CddFun
        Rte_Al_TE_OsTask_CddFun_0_5ms: RteActivationOsAlarmRef=Rte_Al_TE_OsTask_CddFun_0_5ms, RteActivationOsTaskRef=OsTask_CddFun
        Rte_Al_TE2_OsTask_Diagnostics_0_10ms: RteActivationOsAlarmRef=Rte_Al_TE2_OsTask_Diagnostics_0_10ms, RteActivationOsTaskRef=OsTask_Diagnostics
        Rte_Al_TE_OsTask_Diagnostics_0_100ms: RteActivationOsAlarmRef=Rte_Al_TE_OsTask_Diagnostics_0_100ms, RteActivationOsTaskRef=OsTask_Diagnostics
    RteGeneration:
      RteGenerationMode = COMPATIBILITY_MODE
      RteIocInteractionReturnValue = RTE_IOC
      RteValueRangeCheckEnabled = false
      RteCalibrationSupport = NONE
      RteCodeVendorId = 30
      RteDevErrorDetect = false
      RteDevErrorDetectUninit = false
      RteMeasurementSupport = false
      RteOptimizationMode = MEMORY
      RteVfbTraceEnabled = false
    RteInitializationBehavior: RteInitializationStrategy=RTE_INITIALIZATION_STRATEGY_AT_DATA_DECLARATION, RteSectionInitializationPolicy=INIT
    RteBswGeneral: RteSchMVersionInfoApi=false, RteUseComShadowSignalApi=false
    Rte (RteBswModuleInstance): RteBswImplementationRef=Rte_Impl, RteBswModuleConfigurationRef=Rte
    UclProxyCdd_EcuSwComposition (RteSwComponentInstance): RteSoftwareComponentInstanceRef=UclProxyCdd
      7 x RteEventToTaskMapping, all with RteImmediateRestart=false:
        OIE_ppCS_UclInitShutdown_CUclProxyCdd_Impl_InitializeTrigByImpl_Initialize: RteEventRef=OIE_ppCS_UclInitShutdown_CUclProxyCdd_Impl_InitializeTrigByImpl_Initialize
        DREOnDre_HealthDumpGetDataTrigByHealthDumpGetDataData: RtePositionInTask=8, RteEventRef=DREOnDre_HealthDumpGetDataTrigByHealthDumpGetDataData, RteMappedToTaskRef=OsTask_MemSer, RteUsedOsEventRef=Rte_Ev_Run_UclProxyCdd_OnDre_HealthDumpGetData
        DREOnDre_HealthDumpGetHdrTrigByHealthDumpGetHdrData: RtePositionInTask=9, RteEventRef=DREOnDre_HealthDumpGetHdrTrigByHealthDumpGetHdrData, RteMappedToTaskRef=OsTask_MemSer, RteUsedOsEventRef=Rte_Ev_Run_UclProxyCdd_OnDre_HealthDumpGetHdr
        OIE_ppCS_UclInitShutdown_CUclProxyCdd_Impl_ShutdownTrigByImpl_Shutdown: RteEventRef=OIE_ppCS_UclInitShutdown_CUclProxyCdd_Impl_ShutdownTrigByImpl_Shutdown
        TECUclProxyCdd_Impl_MainFunction: RtePositionInTask=4, RteEventRef=TECUclProxyCdd_Impl_MainFunction, RteMappedToTaskRef=OsTask_MemSer, RteUsedOsEventRef=Rte_Ev_Run_UclProxyCdd_CUclProxyCdd_Impl_MainFunction, RteUsedOsAlarmRef=Rte_Al_TE_UclProxyCdd_CUclProxyCdd_Impl_MainFunction
        OIE_pp_CmpLibCmd_CUclProxyCdd_CUclProxyCdd_Impl_OnCommandTrigByImpl_OnCommand: RteEventRef=OIE_pp_CmpLibCmd_CUclProxyCdd_CUclProxyCdd_Impl_OnCommandTrigByImpl_OnCommand
        DREOnDre_PowerSystemStateReqChangeTrigByPowerSystemStateReqChangeData: RtePositionInTask=11, RteEventRef=DREOnDre_PowerSystemStateReqChangeTrigByPowerSystemStateReqChangeData, RteMappedToTaskRef=OsTask_MemSer, RteUsedOsEventRef=Rte_Ev_Run_UclProxyCdd_OnDre_PowerSystemStateReqChange
    Test_Comp_EcuSwComposition (RteSwComponentInstance): RteSoftwareComponentInstanceRef=Test_Comp
      26 x RteEventToTaskMapping, all with RteImmediateRestart=false:
        OIT_rCS_UclSystemCallbacks_LinkStatusChanged_rCS_UclSystemCallbacks_LinkStatusChanged: RteEventRef=OIT_rCS_UclSystemCallbacks_LinkStatusChanged_rCS_UclSystemCallbacks_LinkStatusChanged
        OIT_rCS_UclSystemCallbacks_ErrorNotification_rCS_UclSystemCallbacks_ErrorNotification: RteEventRef=OIT_rCS_UclSystemCallbacks_ErrorNotification_rCS_UclSystemCallbacks_ErrorNotification
        TMT_Test_Comp_MainFunction: RtePositionInTask=12, RteEventRef=TMT_Test_Comp_MainFunction, RteMappedToTaskRef=OsTask_MemSer, RteUsedOsEventRef=Rte_Ev_Cyclic_OsTask_MemSer_0_10ms, RteUsedOsAlarmRef=Rte_Al_TE_OsTask_MemSer_0_10ms
        TMT_TcpIp_MainFunction: RtePositionInTask=2, RteEventRef=TMT_TcpIp_MainFunction, RteMappedToTaskRef=OsTask_EthFun, RteUsedOsAlarmRef=Rte_Al_TE_OsTask_EthFun_0_10ms
        TMT_TxRxIpcMessage: RtePositionInTask=0, RteEventRef=TMT_TxRxIpcMessage, RteMappedToTaskRef=OsTask_SafeFun, RteUsedOsAlarmRef=Rte_Al_TE_Test_Comp_TxRxIpcMessage
        TMT_EthIf_MainFunctionState: RtePositionInTask=0, RteEventRef=TMT_EthIf_MainFunctionState, RteMappedToTaskRef=OsTask_EthFun, RteUsedOsAlarmRef=Rte_Al_TE_OsTask_EthFun_0_10ms
        TMT_Com_MainFunctionTx: RtePositionInTask=1, RteEventRef=TMT_Com_MainFunctionTx, RteMappedToTaskRef=OsTask_CANFun, RteUsedOsAlarmRef=Rte_Al_TE_OsTask_CANFun_0_10ms
        TMT_EthSM_MainFunction: RtePositionInTask=1, RteEventRef=TMT_EthSM_MainFunction, RteMappedToTaskRef=OsTask_EthFun, RteUsedOsAlarmRef=Rte_Al_TE_OsTask_EthFun_0_10ms
        TMT_CanSM_MainFunction: RtePositionInTask=3, RteEventRef=TMT_CanSM_MainFunction, RteMappedToTaskRef=OsTask_CANFun, RteUsedOsAlarmRef=Rte_Al_TE_OsTask_CANFun_0_10ms
        TMT_Spi_MainFunction_Handling: RtePositionInTask=3, RteEventRef=TMT_Spi_MainFunction_Handling, RteMappedToTaskRef=OsTask_MemSer, RteUsedOsEventRef=Rte_Ev_Cyclic_OsTask_MemSer_0_10ms, RteUsedOsAlarmRef=Rte_Al_TE_OsTask_MemSer_0_10ms
        TMT_EepDrv_MainFunction: RtePositionInTask=2, RteEventRef=TMT_EepDrv_MainFunction, RteMappedToTaskRef=OsTask_MemSer, RteUsedOsEventRef=Rte_Ev_Cyclic_OsTask_MemSer_0_10ms, RteUsedOsAlarmRef=Rte_Al_TE_OsTask_MemSer_0_10ms
        TMT_Com_MainFunctionRx: RtePositionInTask=0, RteEventRef=TMT_Com_MainFunctionRx, RteMappedToTaskRef=OsTask_CANFun, RteUsedOsAlarmRef=Rte_Al_TE_OsTask_CANFun_0_10ms
        TMT_I2c_MainFunction: RtePositionInTask=3, RteEventRef=TMT_I2c_MainFunction, RteMappedToTaskRef=OsTask_Mcal, RteUsedOsAlarmRef=Rte_Al_TE_OsTask_Mcal_0_10ms
        TMT_IoExp_MainFunction: RtePositionInTask=0, RteEventRef=TMT_IoExp_MainFunction, RteMappedToTaskRef=OsTask_ModeMgt, RteUsedOsAlarmRef=Rte_Al_TE_Test_Comp_IoExp_MainFunction
        TMT_SoAd_MainFunction: RtePositionInTask=3, RteEventRef=TMT_SoAd_MainFunction, RteMappedToTaskRef=OsTask_EthFun, RteUsedOsAlarmRef=Rte_Al_TE_OsTask_EthFun_0_10ms
        TMT_WdgMgntTaskStubRunnable: RtePositionInTask=0, RteEventRef=TMT_WdgMgntTaskStubRunnable, RteMappedToTaskRef=OsTask_WdgMngt, RteUsedOsAlarmRef=Rte_Al_TE_Test_Comp_WdgMgntTaskStubRunnable
        TMT_IndTaskStubRunnable: RtePositionInTask=0, RteEventRef=TMT_IndTaskStubRunnable, RteMappedToTaskRef=OsTask_IndFun, RteUsedOsAlarmRef=Rte_Al_TE_Test_Comp_IndTaskStubRunnable
        TMT_WarnTaskStubRunnable: RtePositionInTask=0, RteEventRef=TMT_WarnTaskStubRunnable, RteMappedToTaskRef=OsTask_WarnFun, RteUsedOsAlarmRef=Rte_Al_TE_Test_Comp_WarnTaskStubRunnable
        TMT_LinTaskStubRunnable: RtePositionInTask=0, RteEventRef=TMT_LinTaskStubRunnable, RteMappedToTaskRef=OsTask_LinFun, RteUsedOsAlarmRef=Rte_Al_TE_Test_Comp_LinTaskStubRunnable
        TMT_TripTaskStubRunnable: RtePositionInTask=0, RteEventRef=TMT_TripTaskStubRunnable, RteMappedToTaskRef=OsTask_TripFun, RteUsedOsAlarmRef=Rte_Al_TE_Test_Comp_TripTaskStubRunnable
        TMT_FotaTaskStubRunnable: RtePositionInTask=0, RteEventRef=TMT_FotaTaskStubRunnable, RteMappedToTaskRef=OsTask_FotaFun, RteUsedOsAlarmRef=Rte_Al_TE_Test_Comp_FotaTaskStubRunnable
        TMT_GraphicsTaskStubRunnable: RtePositionInTask=0, RteEventRef=TMT_GraphicsTaskStubRunnable, RteMappedToTaskRef=OsTask_Graphics, RteUsedOsEventRef=Rte_Ev_Run_Test_Comp_GraphicsTaskStubRunnable, RteUsedOsAlarmRef=Rte_Al_TE_Test_Comp_GraphicsTaskStubRunnable
        TMT_AppTaskStubRunnable: RtePositionInTask=0, RteEventRef=TMT_AppTaskStubRunnable, RteMappedToTaskRef=OsTask_AppFun, RteUsedOsAlarmRef=Rte_Al_TE_Test_Comp_AppTaskStubRunnable
        TMT_AudioTaskStubRunnable: RtePositionInTask=0, RteEventRef=TMT_AudioTaskStubRunnable, RteMappedToTaskRef=OsTask_AudioFun, RteUsedOsAlarmRef=Rte_Al_TE_Test_Comp_AudioTaskStubRunnable
        TMT_CddTaskStubRunnable: RtePositionInTask=0, RteEventRef=TMT_CddTaskStubRunnable, RteMappedToTaskRef=OsTask_CddFun, RteUsedOsEventRef=Rte_Ev_Cyclic_OsTask_CddFun_0_5ms, RteUsedOsAlarmRef=Rte_Al_TE_OsTask_CddFun_0_5ms
        TMT_GaugeTaskStubRunnable: RtePositionInTask=0, RteEventRef=TMT_GaugeTaskStubRunnable, RteMappedToTaskRef=OsTask_GaugeFun, RteUsedOsAlarmRef=Rte_Al_TE_Test_Comp_GaugeTaskStubRunnable
    UclProxyCdd (RteSwComponentType): RteComponentTypeRef=UclProxyCdd, RteImplementationRef=UclProxyCdd_Implementation
      ComponentTypeCalibration (RteComponentTypeCalibration): RteCalibrationSupportEnabled=false
    Test_Comp (RteSwComponentType): RteComponentTypeRef=Test_Comp, RteImplementationRef=Test_Comp_Implementation
      ComponentTypeCalibration (RteComponentTypeCalibration): RteCalibrationSupportEnabled=false
    Os_OsCore0_swc_EcuSwComposition (RteSwComponentInstance): RteSoftwareComponentInstanceRef=Os_OsCore0_swc
      OpEventGetCounterValue_GetCounterValue_OsService_SystemTimer (RteEventToTaskMapping):
        RteImmediateRestart = false
        RtePositionInTask = 5
        RteEventRef = OpEventGetCounterValue_GetCounterValue_OsService_SystemTimer
        RteMappedToTaskRef = OsTask_Mcal
      OpEventGetElapsedValue_GetElapsedValue_OsService_SystemTimer (RteEventToTaskMapping):
        RteImmediateRestart = false
        RtePositionInTask = 6
        RteEventRef = OpEventGetElapsedValue_GetElapsedValue_OsService_SystemTimer
        RteMappedToTaskRef = OsTask_Mcal
    Dcm (RteBswModuleInstance): RteBswImplementationRef=Dcm_Impl, RteBswModuleConfigurationRef=Dcm
      Dcm_MainFunctionTimingEvent0 (RteBswEventToTaskMapping):
        RteBswImmediateRestart = false
        RteBswPositionInTask = 0
        RteBswEventRef = Dcm_MainFunctionTimingEvent0
        RteBswMappedToTaskRef = OsTask_Diagnostics
        RteBswUsedOsEventRef = Rte_Ev_Cyclic2_OsTask_Diagnostics_0_10ms
        RteBswUsedOsAlarmRef = Rte_Al_TE2_OsTask_Diagnostics_0_10ms
      DCM_EXCLUSIVE_AREA_0 (RteBswExclusiveAreaImpl): RteExclusiveAreaImplMechanism=ALL_INTERRUPT_BLOCKING, RteBswExclusiveAreaRef=DCM_EXCLUSIVE_AREA_0
    Dem (RteBswModuleInstance): RteBswImplementationRef=Dem_Impl, RteBswModuleConfigurationRef=Dem
      Dem_MasterMainFunctionTimingEvent0 (RteBswEventToTaskMapping):
        RteBswImmediateRestart = false
        RteBswPositionInTask = 1
        RteBswEventRef = Dem_MasterMainFunctionTimingEvent0
        RteBswMappedToTaskRef = OsTask_Diagnostics
        RteBswUsedOsEventRef = Rte_Ev_Cyclic2_OsTask_Diagnostics_0_10ms
        RteBswUsedOsAlarmRef = Rte_Al_TE2_OsTask_Diagnostics_0_10ms
      Dem_SatelliteMainFunctionTimingEvent0 (RteBswEventToTaskMapping):
        RteBswImmediateRestart = false
        RteBswPositionInTask = 2
        RteBswEventRef = Dem_SatelliteMainFunctionTimingEvent0
        RteBswMappedToTaskRef = OsTask_Diagnostics
        RteBswUsedOsEventRef = Rte_Ev_Cyclic2_OsTask_Diagnostics_0_10ms
        RteBswUsedOsAlarmRef = Rte_Al_TE2_OsTask_Diagnostics_0_10ms
      5 x RteBswExclusiveAreaImpl, all with RteExclusiveAreaImplMechanism=ALL_INTERRUPT_BLOCKING:
        DEM_EXCLUSIVE_AREA_{0..4}: RteBswExclusiveAreaRef=DEM_EXCLUSIVE_AREA_{0..4}
    3 x RteSwComponentInstance:
      DemMaster_0_EcuSwComposition: RteSoftwareComponentInstanceRef=DemMaster_0
        16 x RteEventToTaskMapping, all with RteImmediateRestart=false:
          Timer_Dem_MasterMainFunction: RtePositionInTask=1, RteEventRef=Timer_Dem_MasterMainFunction, RteMappedToTaskRef=OsTask_Diagnostics, RteUsedOsEventRef=Rte_Ev_Cyclic2_OsTask_Diagnostics_0_10ms, RteUsedOsAlarmRef=Rte_Al_TE2_OsTask_Diagnostics_0_10ms
          OpEventPostRunRequested_GetPostRunRequested_DemServices: RteEventRef=OpEventPostRunRequested_GetPostRunRequested_DemServices
          OpEventGetDTCStatusAvailabilityMask_GetDTCStatusAvailabilityMask_DemServices: RteEventRef=OpEventGetDTCStatusAvailabilityMask_GetDTCStatusAvailabilityMask_DemServices
          OpEventGetEventUdsStatus_GetEventUdsStatus_GeneralEvtInfo: RteEventRef=OpEventGetEventUdsStatus_GetEventUdsStatus_GeneralEvtInfo
          OpEventGetEventStatus_GetEventStatus_GeneralEvtInfo: RteEventRef=OpEventGetEventStatus_GetEventStatus_GeneralEvtInfo
          OpEventGetEventFailed_GetEventFailed_GeneralEvtInfo: RteEventRef=OpEventGetEventFailed_GetEventFailed_GeneralEvtInfo
          OpEventGetEventTested_GetEventTested_GeneralEvtInfo: RteEventRef=OpEventGetEventTested_GetEventTested_GeneralEvtInfo
          OpEventGetDTCOfEvent_GetDTCOfEvent_GeneralEvtInfo: RteEventRef=OpEventGetDTCOfEvent_GetDTCOfEvent_GeneralEvtInfo
          OpEventGetFaultDetectionCounter_GetFaultDetectionCounter_GeneralEvtInfo: RteEventRef=OpEventGetFaultDetectionCounter_GetFaultDetectionCounter_GeneralEvtInfo
          OpEventGetEventFreezeFrameDataEx_GetEventFreezeFrameDataEx_GeneralEvtInfo: RteEventRef=OpEventGetEventFreezeFrameDataEx_GetEventFreezeFrameDataEx_GeneralEvtInfo
          OpEventGetEventExtendedDataRecordEx_GetEventExtendedDataRecordEx_GeneralEvtInfo: RteEventRef=OpEventGetEventExtendedDataRecordEx_GetEventExtendedDataRecordEx_GeneralEvtInfo
          OpEventGetEventEnableCondition_GetEventEnableCondition_GeneralEvtInfo: RteEventRef=OpEventGetEventEnableCondition_GetEventEnableCondition_GeneralEvtInfo
          OpEventGetDebouncingOfEvent_GetDebouncingOfEvent_GeneralEvtInfo: RteEventRef=OpEventGetDebouncingOfEvent_GetDebouncingOfEvent_GeneralEvtInfo
          OpEventGetMonitorStatus_GetMonitorStatus_GeneralEvtInfo: RteEventRef=OpEventGetMonitorStatus_GetMonitorStatus_GeneralEvtInfo
          OpEventGetOperationCycleState_GetOperationCycleState_OpCycle_DemOperationCycle: RteEventRef=OpEventGetOperationCycleState_GetOperationCycleState_OpCycle_DemOperationCycle
          OpEventSetOperationCycleState_SetOperationCycleState_OpCycle_DemOperationCycle: RteEventRef=OpEventSetOperationCycleState_SetOperationCycleState_OpCycle_DemOperationCycle
      DemSatellite_0_EcuSwComposition: RteSoftwareComponentInstanceRef=DemSatellite_0
        34 x RteEventToTaskMapping, all with RteImmediateRestart=false:
          Timer_Dem_SatelliteMainFunction: RtePositionInTask=2, RteEventRef=Timer_Dem_SatelliteMainFunction, RteMappedToTaskRef=OsTask_Diagnostics, RteUsedOsEventRef=Rte_Ev_Cyclic2_OsTask_Diagnostics_0_10ms, RteUsedOsAlarmRef=Rte_Al_TE2_OsTask_Diagnostics_0_10ms
          OpEventGetEventUdsStatus_GetEventUdsStatus_EvtInfo_DemEventParameter: RteEventRef=OpEventGetEventUdsStatus_GetEventUdsStatus_EvtInfo_DemEventParameter
          OpEventGetEventUdsStatus_GetEventUdsStatus_Event_DemEventParameter: RteEventRef=OpEventGetEventUdsStatus_GetEventUdsStatus_Event_DemEventParameter
          OpEventGetEventUdsStatus_GetEventUdsStatus_GeneralEvtInfo: RteEventRef=OpEventGetEventUdsStatus_GetEventUdsStatus_GeneralEvtInfo
          OpEventGetEventStatus_GetEventStatus_EvtInfo_DemEventParameter: RteEventRef=OpEventGetEventStatus_GetEventStatus_EvtInfo_DemEventParameter
          OpEventGetEventStatus_GetEventStatus_Event_DemEventParameter: RteEventRef=OpEventGetEventStatus_GetEventStatus_Event_DemEventParameter
          OpEventGetEventStatus_GetEventStatus_GeneralEvtInfo: RteEventRef=OpEventGetEventStatus_GetEventStatus_GeneralEvtInfo
          OpEventGetEventFailed_GetEventFailed_EvtInfo_DemEventParameter: RteEventRef=OpEventGetEventFailed_GetEventFailed_EvtInfo_DemEventParameter
          OpEventGetEventFailed_GetEventFailed_Event_DemEventParameter: RteEventRef=OpEventGetEventFailed_GetEventFailed_Event_DemEventParameter
          OpEventGetEventFailed_GetEventFailed_GeneralEvtInfo: RteEventRef=OpEventGetEventFailed_GetEventFailed_GeneralEvtInfo
          OpEventGetEventTested_GetEventTested_EvtInfo_DemEventParameter: RteEventRef=OpEventGetEventTested_GetEventTested_EvtInfo_DemEventParameter
          OpEventGetEventTested_GetEventTested_Event_DemEventParameter: RteEventRef=OpEventGetEventTested_GetEventTested_Event_DemEventParameter
          OpEventGetEventTested_GetEventTested_GeneralEvtInfo: RteEventRef=OpEventGetEventTested_GetEventTested_GeneralEvtInfo
          OpEventGetDTCOfEvent_GetDTCOfEvent_EvtInfo_DemEventParameter: RteEventRef=OpEventGetDTCOfEvent_GetDTCOfEvent_EvtInfo_DemEventParameter
          OpEventGetDTCOfEvent_GetDTCOfEvent_Event_DemEventParameter: RteEventRef=OpEventGetDTCOfEvent_GetDTCOfEvent_Event_DemEventParameter
          OpEventGetDTCOfEvent_GetDTCOfEvent_GeneralEvtInfo: RteEventRef=OpEventGetDTCOfEvent_GetDTCOfEvent_GeneralEvtInfo
          OpEventGetFaultDetectionCounter_GetFaultDetectionCounter_EvtInfo_DemEventParameter: RteEventRef=OpEventGetFaultDetectionCounter_GetFaultDetectionCounter_EvtInfo_DemEventParameter
          OpEventGetFaultDetectionCounter_GetFaultDetectionCounter_Event_DemEventParameter: RteEventRef=OpEventGetFaultDetectionCounter_GetFaultDetectionCounter_Event_DemEventParameter
          OpEventGetFaultDetectionCounter_GetFaultDetectionCounter_GeneralEvtInfo: RteEventRef=OpEventGetFaultDetectionCounter_GetFaultDetectionCounter_GeneralEvtInfo
          OpEventGetEventFreezeFrameDataEx_GetEventFreezeFrameDataEx_EvtInfo_DemEventParameter: RteEventRef=OpEventGetEventFreezeFrameDataEx_GetEventFreezeFrameDataEx_EvtInfo_DemEventParameter
          OpEventGetEventFreezeFrameDataEx_GetEventFreezeFrameDataEx_Event_DemEventParameter: RteEventRef=OpEventGetEventFreezeFrameDataEx_GetEventFreezeFrameDataEx_Event_DemEventParameter
          OpEventGetEventFreezeFrameDataEx_GetEventFreezeFrameDataEx_GeneralEvtInfo: RteEventRef=OpEventGetEventFreezeFrameDataEx_GetEventFreezeFrameDataEx_GeneralEvtInfo
          OpEventGetEventExtendedDataRecordEx_GetEventExtendedDataRecordEx_EvtInfo_DemEventParameter: RteEventRef=OpEventGetEventExtendedDataRecordEx_GetEventExtendedDataRecordEx_EvtInfo_DemEventParameter
          OpEventGetEventExtendedDataRecordEx_GetEventExtendedDataRecordEx_Event_DemEventParameter: RteEventRef=OpEventGetEventExtendedDataRecordEx_GetEventExtendedDataRecordEx_Event_DemEventParameter
          OpEventGetEventExtendedDataRecordEx_GetEventExtendedDataRecordEx_GeneralEvtInfo: RteEventRef=OpEventGetEventExtendedDataRecordEx_GetEventExtendedDataRecordEx_GeneralEvtInfo
          OpEventGetEventEnableCondition_GetEventEnableCondition_EvtInfo_DemEventParameter: RteEventRef=OpEventGetEventEnableCondition_GetEventEnableCondition_EvtInfo_DemEventParameter
          OpEventGetEventEnableCondition_GetEventEnableCondition_GeneralEvtInfo: RteEventRef=OpEventGetEventEnableCondition_GetEventEnableCondition_GeneralEvtInfo
          OpEventGetDebouncingOfEvent_GetDebouncingOfEvent_EvtInfo_DemEventParameter: RteEventRef=OpEventGetDebouncingOfEvent_GetDebouncingOfEvent_EvtInfo_DemEventParameter
          OpEventGetDebouncingOfEvent_GetDebouncingOfEvent_GeneralEvtInfo: RteEventRef=OpEventGetDebouncingOfEvent_GetDebouncingOfEvent_GeneralEvtInfo
          OpEventGetMonitorStatus_GetMonitorStatus_EvtInfo_DemEventParameter: RteEventRef=OpEventGetMonitorStatus_GetMonitorStatus_EvtInfo_DemEventParameter
          OpEventGetMonitorStatus_GetMonitorStatus_GeneralEvtInfo: RteEventRef=OpEventGetMonitorStatus_GetMonitorStatus_GeneralEvtInfo
          OpEventSetEventStatus_SetEventStatus_Event_DemEventParameter: RteEventRef=OpEventSetEventStatus_SetEventStatus_Event_DemEventParameter
          OpEventResetEventStatus_ResetEventStatus_Event_DemEventParameter: RteEventRef=OpEventResetEventStatus_ResetEventStatus_Event_DemEventParameter
          OpEventResetEventDebounceStatus_ResetEventDebounceStatus_Event_DemEventParameter: RteEventRef=OpEventResetEventDebounceStatus_ResetEventDebounceStatus_Event_DemEventParameter
      NvBlockSwComponentType_EcuSwComposition: RteSoftwareComponentInstanceRef=NvBlockSwComponentType
        60 x RteNvRamAllocation:
          NvmBlock_NvBlockSwComponentType_NVNeed_NVBlockDescriptor_002: RteNvmRomBlockLocationSymbol=Rte_NvBlockSwComponentType_NVBlockDescriptor_BsReten_Personalization_ROM_NVBlockDescriptor_BsReten_Personalization, RteNvmBlockRef=NvBlockSwComponentTypeNVBlockDescriptor_BsReten_Personalization, RteSwNvBlockDescriptorRef=NVBlockDescriptor_BsReten_Personalization
          NvmBlock_NvBlockSwComponentType_NVNeed_NVBlockDescriptor_003: RteNvmRomBlockLocationSymbol=Rte_NvBlockSwComponentType_NVBlockDescriptor_BsRt_OilGauge_ROM_NVBlockDescriptor_BsRt_OilGauge, RteNvmBlockRef=NvBlockSwComponentTypeNVBlockDescriptor_BsRt_OilGauge, RteSwNvBlockDescriptorRef=NVBlockDescriptor_BsRt_OilGauge
          NvmBlock_NvBlockSwComponentType_NVNeed_NVBlockDescriptor_004: RteNvmRomBlockLocationSymbol=Rte_NvBlockSwComponentType_NVBlockDescriptor_BsReten_Gauges_ROM_NVBlockDescriptor_BsReten_Gauges, RteNvmBlockRef=NvBlockSwComponentTypeNVBlockDescriptor_BsReten_Gauges, RteSwNvBlockDescriptorRef=NVBlockDescriptor_BsReten_Gauges
          NvmBlock_NvBlockSwComponentType_NVNeed_NVBlockDescriptor_005: RteNvmRomBlockLocationSymbol=Rte_NvBlockSwComponentType_NVBlockDescriptor_BsRt_Illumination_ROM_NVBlockDescriptor_BsRt_Illumination, RteNvmBlockRef=NvBlockSwComponentTypeNVBlockDescriptor_BsRt_Illumination, RteSwNvBlockDescriptorRef=NVBlockDescriptor_BsRt_Illumination
          NvmBlock_NvBlockSwComponentType_NVNeed_NVBlockDescriptor_006: RteNvmRomBlockLocationSymbol=Rte_NvBlockSwComponentType_NVBlockDescriptor_BsRt_TachoGauge_ROM_NVBlockDescriptor_BsRt_TachoGauge, RteNvmBlockRef=NvBlockSwComponentTypeNVBlockDescriptor_BsRt_TachoGauge, RteSwNvBlockDescriptorRef=NVBlockDescriptor_BsRt_TachoGauge
          NvmBlock_NvBlockSwComponentType_NVNeed_NVBlockDescriptor_007: RteNvmRomBlockLocationSymbol=Rte_NvBlockSwComponentType_NVBlockDescriptor_BsShare_EcuPartNumber_ROM_NVBlockDescriptor_BsShare_EcuPartNumber, RteNvmBlockRef=NvBlockSwComponentTypeNVBlockDescriptor_BsShare_EcuPartNumber, RteSwNvBlockDescriptorRef=NVBlockDescriptor_BsShare_EcuPartNumber
          NvmBlock_NvBlockSwComponentType_NVNeed_NVBlockDescriptor_008: RteNvmRomBlockLocationSymbol=Rte_NvBlockSwComponentType_NVBlockDescriptor_BsRt_FuelGauge_ROM_NVBlockDescriptor_BsRt_FuelGauge, RteNvmBlockRef=NvBlockSwComponentTypeNVBlockDescriptor_BsRt_FuelGauge, RteSwNvBlockDescriptorRef=NVBlockDescriptor_BsRt_FuelGauge
          NvmBlock_NvBlockSwComponentType_NVNeed_NVBlockDescriptor_009: RteNvmRomBlockLocationSymbol=Rte_NvBlockSwComponentType_NVBlockDescriptor_BsConst_ServiceReminder_ROM_NVBlockDescriptor_BsConst_ServiceReminder, RteNvmBlockRef=NvBlockSwComponentTypeNVBlockDescriptor_BsConst_ServiceReminder, RteSwNvBlockDescriptorRef=NVBlockDescriptor_BsConst_ServiceReminder
          NvmBlock_NvBlockSwComponentType_NVNeed_NVBlockDescriptor_010: RteNvmRomBlockLocationSymbol=Rte_NvBlockSwComponentType_NVBlockDescriptor_BsFuSa_Config_ROM_NVBlockDescriptor_BsFuSa_Config, RteNvmBlockRef=NvBlockSwComponentTypeNVBlockDescriptor_BsFuSa_Config, RteSwNvBlockDescriptorRef=NVBlockDescriptor_BsFuSa_Config
          NvmBlock_NvBlockSwComponentType_NVNeed_NVBlockDescriptor_011: RteNvmRomBlockLocationSymbol=Rte_NvBlockSwComponentType_NVBlockDescriptor_BsFuSa_Warning_ROM_NVBlockDescriptor_BsFuSa_Warning, RteNvmBlockRef=NvBlockSwComponentTypeNVBlockDescriptor_BsFuSa_Warning, RteSwNvBlockDescriptorRef=NVBlockDescriptor_BsFuSa_Warning
          NvmBlock_NvBlockSwComponentType_NVNeed_NVBlockDescriptor_012: RteNvmRomBlockLocationSymbol=Rte_NvBlockSwComponentType_NVBlockDescriptor_BsRt_Odometer_ROM_NVBlockDescriptor_BsRt_Odometer, RteNvmBlockRef=NvBlockSwComponentTypeNVBlockDescriptor_BsRt_Odometer, RteSwNvBlockDescriptorRef=NVBlockDescriptor_BsRt_Odometer
          NvmBlock_NvBlockSwComponentType_NVNeed_NVBlockDescriptor_013: RteNvmRomBlockLocationSymbol=Rte_NvBlockSwComponentType_NVBlockDescriptor_BsFuSa_Power_ROM_NVBlockDescriptor_BsFuSa_Power, RteNvmBlockRef=NvBlockSwComponentTypeNVBlockDescriptor_BsFuSa_Power, RteSwNvBlockDescriptorRef=NVBlockDescriptor_BsFuSa_Power
          NvmBlock_NvBlockSwComponentType_NVNeed_NVBlockDescriptor_014: RteNvmRomBlockLocationSymbol=Rte_NvBlockSwComponentType_NVBlockDescriptor_BsReten_Power_ROM_NVBlockDescriptor_BsReten_Power, RteNvmBlockRef=NvBlockSwComponentTypeNVBlockDescriptor_BsReten_Power, RteSwNvBlockDescriptorRef=NVBlockDescriptor_BsReten_Power
          NvmBlock_NvBlockSwComponentType_NVNeed_NVBlockDescriptor_015: RteNvmRomBlockLocationSymbol=Rte_NvBlockSwComponentType_NVBlockDescriptor_BsRt_PowerGauge_ROM_NVBlockDescriptor_BsRt_PowerGauge, RteNvmBlockRef=NvBlockSwComponentTypeNVBlockDescriptor_BsRt_PowerGauge, RteSwNvBlockDescriptorRef=NVBlockDescriptor_BsRt_PowerGauge
          NvmBlock_NvBlockSwComponentType_NVNeed_NVBlockDescriptor_016: RteNvmRomBlockLocationSymbol=Rte_NvBlockSwComponentType_NVBlockDescriptor_BsConst_TripComputer_ROM_NVBlockDescriptor_BsConst_TripComputer, RteNvmBlockRef=NvBlockSwComponentTypeNVBlockDescriptor_BsConst_TripComputer, RteSwNvBlockDescriptorRef=NVBlockDescriptor_BsConst_TripComputer
          NvmBlock_NvBlockSwComponentType_NVNeed_NVBlockDescriptor_017: RteNvmRomBlockLocationSymbol=Rte_NvBlockSwComponentType_NVBlockDescriptor_BsFuSa_Display_ROM_NVBlockDescriptor_BsFuSa_Display, RteNvmBlockRef=NvBlockSwComponentTypeNVBlockDescriptor_BsFuSa_Display, RteSwNvBlockDescriptorRef=NVBlockDescriptor_BsFuSa_Display
          NvmBlock_NvBlockSwComponentType_NVNeed_NVBlockDescriptor_018: RteNvmRomBlockLocationSymbol=Rte_NvBlockSwComponentType_NVBlockDescriptor_BsReten_Display_ROM_NVBlockDescriptor_BsReten_Display, RteNvmBlockRef=NvBlockSwComponentTypeNVBlockDescriptor_BsReten_Display, RteSwNvBlockDescriptorRef=NVBlockDescriptor_BsReten_Display
          NvmBlock_NvBlockSwComponentType_NVNeed_NVBlockDescriptor_019: RteNvmRomBlockLocationSymbol=Rte_NvBlockSwComponentType_NVBlockDescriptor_BsReten_VisDlt_ROM_NVBlockDescriptor_BsReten_VisDlt, RteNvmBlockRef=NvBlockSwComponentTypeNVBlockDescriptor_BsReten_VisDlt, RteSwNvBlockDescriptorRef=NVBlockDescriptor_BsReten_VisDlt
          NvmBlock_NvBlockSwComponentType_NVNeed_NVBlockDescriptor_020: RteNvmRomBlockLocationSymbol=Rte_NvBlockSwComponentType_NVBlockDescriptor_BsRt_Warning_ROM_NVBlockDescriptor_BsRt_Warning, RteNvmBlockRef=NvBlockSwComponentTypeNVBlockDescriptor_BsRt_Warning, RteSwNvBlockDescriptorRef=NVBlockDescriptor_BsRt_Warning
          NvmBlock_NvBlockSwComponentType_NVNeed_NVBlockDescriptor_021: RteNvmRomBlockLocationSymbol=Rte_NvBlockSwComponentType_NVBlockDescriptor_BsShare_SwUpdFotadecrypt_ROM_NVBlockDescriptor_BsShare_SwUpdFotadecrypt, RteNvmBlockRef=NvBlockSwComponentTypeNVBlockDescriptor_BsShare_SwUpdFotadecrypt, RteSwNvBlockDescriptorRef=NVBlockDescriptor_BsShare_SwUpdFotadecrypt
          NvmBlock_NvBlockSwComponentType_NVNeed_NVBlockDescriptor_022: RteNvmRomBlockLocationSymbol=Rte_NvBlockSwComponentType_NVBlockDescriptor_BsCys_Certicificate_ROM_NVBlockDescriptor_BsCys_Certicificate, RteNvmBlockRef=NvBlockSwComponentTypeNVBlockDescriptor_BsCys_Certicificate, RteSwNvBlockDescriptorRef=NVBlockDescriptor_BsCys_Certicificate
          NvmBlock_NvBlockSwComponentType_NVNeed_NVBlockDescriptor_023: RteNvmRomBlockLocationSymbol=Rte_NvBlockSwComponentType_NVBlockDescriptor_BsConst_TachoGauge_ROM_NVBlockDescriptor_BsConst_TachoGauge, RteNvmBlockRef=NvBlockSwComponentTypeNVBlockDescriptor_BsConst_TachoGauge, RteSwNvBlockDescriptorRef=NVBlockDescriptor_BsConst_TachoGauge
          NvmBlock_NvBlockSwComponentType_NVNeed_NVBlockDescriptor_024: RteNvmRomBlockLocationSymbol=Rte_NvBlockSwComponentType_NVBlockDescriptor_BsRt_TempGauge_ROM_NVBlockDescriptor_BsRt_TempGauge, RteNvmBlockRef=NvBlockSwComponentTypeNVBlockDescriptor_BsRt_TempGauge, RteSwNvBlockDescriptorRef=NVBlockDescriptor_BsRt_TempGauge
          NvmBlock_NvBlockSwComponentType_NVNeed_NVBlockDescriptor_025: RteNvmRomBlockLocationSymbol=Rte_NvBlockSwComponentType_NVBlockDescriptor_RefCys_Certicificate_ROM_NVBlockDescriptor_RefCys_Certicificate, RteNvmBlockRef=NvBlockSwComponentTypeNVBlockDescriptor_RefCys_Certicificate, RteSwNvBlockDescriptorRef=NVBlockDescriptor_RefCys_Certicificate
          NvmBlock_NvBlockSwComponentType_NVNeed_NVBlockDescriptor_026: RteNvmRomBlockLocationSymbol=Rte_NvBlockSwComponentType_NVBlockDescriptor_BsFusa_Fota_ROM_NVBlockDescriptor_BsFusa_Fota, RteNvmBlockRef=NvBlockSwComponentTypeNVBlockDescriptor_BsFusa_Fota, RteSwNvBlockDescriptorRef=NVBlockDescriptor_BsFusa_Fota
          NvmBlock_NvBlockSwComponentType_NVNeed_NVBlockDescriptor_027: RteNvmRomBlockLocationSymbol=Rte_NvBlockSwComponentType_NVBlockDescriptor_BsConst_SpeedoGauge_ROM_NVBlockDescriptor_BsConst_SpeedoGauge, RteNvmBlockRef=NvBlockSwComponentTypeNVBlockDescriptor_BsConst_SpeedoGauge, RteSwNvBlockDescriptorRef=NVBlockDescriptor_BsConst_SpeedoGauge
          NvmBlock_NvBlockSwComponentType_NVNeed_NVBlockDescriptor_028: RteNvmRomBlockLocationSymbol=Rte_NvBlockSwComponentType_NVBlockDescriptor_BsReten_Odometer_ROM_NVBlockDescriptor_BsReten_Odometer, RteNvmBlockRef=NvBlockSwComponentTypeNVBlockDescriptor_BsReten_Odometer, RteSwNvBlockDescriptorRef=NVBlockDescriptor_BsReten_Odometer
          NvmBlock_NvBlockSwComponentType_NVNeed_NVBlockDescriptor_029: RteNvmRomBlockLocationSymbol=Rte_NvBlockSwComponentType_NVBlockDescriptor_BsConst_Communication_ROM_NVBlockDescriptor_BsConst_Communication, RteNvmBlockRef=NvBlockSwComponentTypeNVBlockDescriptor_BsConst_Communication, RteSwNvBlockDescriptorRef=NVBlockDescriptor_BsConst_Communication
          NvmBlock_NvBlockSwComponentType_NVNeed_NVBlockDescriptor_030: RteNvmRomBlockLocationSymbol=Rte_NvBlockSwComponentType_NVBlockDescriptor_BsConst_Power_ROM_NVBlockDescriptor_BsConst_Power, RteNvmBlockRef=NvBlockSwComponentTypeNVBlockDescriptor_BsConst_Power, RteSwNvBlockDescriptorRef=NVBlockDescriptor_BsConst_Power
          NvmBlock_NvBlockSwComponentType_NVNeed_NVBlockDescriptor_031: RteNvmRomBlockLocationSymbol=Rte_NvBlockSwComponentType_NVBlockDescriptor_BsFuSa_Communication_ROM_NVBlockDescriptor_BsFuSa_Communication, RteNvmBlockRef=NvBlockSwComponentTypeNVBlockDescriptor_BsFuSa_Communication, RteSwNvBlockDescriptorRef=NVBlockDescriptor_BsFuSa_Communication
          NvmBlock_NvBlockSwComponentType_NVNeed_NVBlockDescriptor_032: RteNvmRomBlockLocationSymbol=Rte_NvBlockSwComponentType_NVBlockDescriptor_BsShare_SwUpdFotaMode_ROM_NVBlockDescriptor_BsShare_SwUpdFotaMode, RteNvmBlockRef=NvBlockSwComponentTypeNVBlockDescriptor_BsShare_SwUpdFotaMode, RteSwNvBlockDescriptorRef=NVBlockDescriptor_BsShare_SwUpdFotaMode
          NvmBlock_NvBlockSwComponentType_NVNeed_NVBlockDescriptor_033: RteNvmRomBlockLocationSymbol=Rte_NvBlockSwComponentType_NVBlockDescriptor_BsConst_Warning_ROM_NVBlockDescriptor_BsConst_Warning, RteNvmBlockRef=NvBlockSwComponentTypeNVBlockDescriptor_BsConst_Warning, RteSwNvBlockDescriptorRef=NVBlockDescriptor_BsConst_Warning
          NvmBlock_NvBlockSwComponentType_NVNeed_NVBlockDescriptor_034: RteNvmRomBlockLocationSymbol=Rte_NvBlockSwComponentType_NVBlockDescriptor_BsConst_RealTimeClock_ROM_NVBlockDescriptor_BsConst_RealTimeClock, RteNvmBlockRef=NvBlockSwComponentTypeNVBlockDescriptor_BsConst_RealTimeClock, RteSwNvBlockDescriptorRef=NVBlockDescriptor_BsConst_RealTimeClock
          NvmBlock_NvBlockSwComponentType_NVNeed_NVBlockDescriptor_035: RteNvmRomBlockLocationSymbol=Rte_NvBlockSwComponentType_NVBlockDescriptor_BsRt_TripComputer_ROM_NVBlockDescriptor_BsRt_TripComputer, RteNvmBlockRef=NvBlockSwComponentTypeNVBlockDescriptor_BsRt_TripComputer, RteSwNvBlockDescriptorRef=NVBlockDescriptor_BsRt_TripComputer
          NvmBlock_NvBlockSwComponentType_NVNeed_NVBlockDescriptor_036: RteNvmRomBlockLocationSymbol=Rte_NvBlockSwComponentType_NVBlockDescriptor_BsConst_PowerGauge_ROM_NVBlockDescriptor_BsConst_PowerGauge, RteNvmBlockRef=NvBlockSwComponentTypeNVBlockDescriptor_BsConst_PowerGauge, RteSwNvBlockDescriptorRef=NVBlockDescriptor_BsConst_PowerGauge
          NvmBlock_NvBlockSwComponentType_NVNeed_NVBlockDescriptor_037: RteNvmRomBlockLocationSymbol=Rte_NvBlockSwComponentType_NVBlockDescriptor_BsConst_OilGauge_ROM_NVBlockDescriptor_BsConst_OilGauge, RteNvmBlockRef=NvBlockSwComponentTypeNVBlockDescriptor_BsConst_OilGauge, RteSwNvBlockDescriptorRef=NVBlockDescriptor_BsConst_OilGauge
          NvmBlock_NvBlockSwComponentType_NVNeed_NVBlockDescriptor_038: RteNvmRomBlockLocationSymbol=Rte_NvBlockSwComponentType_NVBlockDescriptor_BsConst_EngOffTimer_ROM_NVBlockDescriptor_BsConst_EngOffTimer, RteNvmBlockRef=NvBlockSwComponentTypeNVBlockDescriptor_BsConst_EngOffTimer, RteSwNvBlockDescriptorRef=NVBlockDescriptor_BsConst_EngOffTimer
          NvmBlock_NvBlockSwComponentType_NVNeed_NVBlockDescriptor_039: RteNvmRomBlockLocationSymbol=Rte_NvBlockSwComponentType_NVBlockDescriptor_BsDiag_Dtc_ROM_NVBlockDescriptor_BsDiag_Dtc, RteNvmBlockRef=NvBlockSwComponentTypeNVBlockDescriptor_BsDiag_Dtc, RteSwNvBlockDescriptorRef=NVBlockDescriptor_BsDiag_Dtc
          NvmBlock_NvBlockSwComponentType_NVNeed_NVBlockDescriptor_040: RteNvmRomBlockLocationSymbol=Rte_NvBlockSwComponentType_NVBlockDescriptor_BsShare_VisMeet_ROM_NVBlockDescriptor_BsShare_VisMeet, RteNvmBlockRef=NvBlockSwComponentTypeNVBlockDescriptor_BsShare_VisMeet, RteSwNvBlockDescriptorRef=NVBlockDescriptor_BsShare_VisMeet
          NvmBlock_NvBlockSwComponentType_NVNeed_NVBlockDescriptor_041: RteNvmRomBlockLocationSymbol=Rte_NvBlockSwComponentType_NVBlockDescriptor_BsReten_Communication_ROM_NVBlockDescriptor_BsReten_Communication, RteNvmBlockRef=NvBlockSwComponentTypeNVBlockDescriptor_BsReten_Communication, RteSwNvBlockDescriptorRef=NVBlockDescriptor_BsReten_Communication
          NvmBlock_NvBlockSwComponentType_NVNeed_NVBlockDescriptor_042: RteNvmRomBlockLocationSymbol=Rte_NvBlockSwComponentType_NVBlockDescriptor_BsRt_SpeedoGauge_ROM_NVBlockDescriptor_BsRt_SpeedoGauge, RteNvmBlockRef=NvBlockSwComponentTypeNVBlockDescriptor_BsRt_SpeedoGauge, RteSwNvBlockDescriptorRef=NVBlockDescriptor_BsRt_SpeedoGauge
          NvmBlock_NvBlockSwComponentType_NVNeed_NVBlockDescriptor_043: RteNvmRomBlockLocationSymbol=Rte_NvBlockSwComponentType_NVBlockDescriptor_BsRt_Personalization_ROM_NVBlockDescriptor_BsRt_Personalization, RteNvmBlockRef=NvBlockSwComponentTypeNVBlockDescriptor_BsRt_Personalization, RteSwNvBlockDescriptorRef=NVBlockDescriptor_BsRt_Personalization
          NvmBlock_NvBlockSwComponentType_NVNeed_NVBlockDescriptor_044: RteNvmRomBlockLocationSymbol=Rte_NvBlockSwComponentType_NVBlockDescriptor_BsReten_Audio_ROM_NVBlockDescriptor_BsReten_Audio, RteNvmBlockRef=NvBlockSwComponentTypeNVBlockDescriptor_BsReten_Audio, RteSwNvBlockDescriptorRef=NVBlockDescriptor_BsReten_Audio
          NvmBlock_NvBlockSwComponentType_NVNeed_NVBlockDescriptor_045: RteNvmRomBlockLocationSymbol=Rte_NvBlockSwComponentType_NVBlockDescriptor_BsDiag_ErrorRecord_ROM_NVBlockDescriptor_BsDiag_ErrorRecord, RteNvmBlockRef=NvBlockSwComponentTypeNVBlockDescriptor_BsDiag_ErrorRecord, RteSwNvBlockDescriptorRef=NVBlockDescriptor_BsDiag_ErrorRecord
          NvmBlock_NvBlockSwComponentType_NVNeed_NVBlockDescriptor_046: RteNvmRomBlockLocationSymbol=Rte_NvBlockSwComponentType_NVBlockDescriptor_BsRt_CusDlt_ROM_NVBlockDescriptor_BsRt_CusDlt, RteNvmBlockRef=NvBlockSwComponentTypeNVBlockDescriptor_BsRt_CusDlt, RteSwNvBlockDescriptorRef=NVBlockDescriptor_BsRt_CusDlt
          NvmBlock_NvBlockSwComponentType_NVNeed_NVBlockDescriptor_047: RteNvmRomBlockLocationSymbol=Rte_NvBlockSwComponentType_NVBlockDescriptor_BsConst_TempGauge_ROM_NVBlockDescriptor_BsConst_TempGauge, RteNvmBlockRef=NvBlockSwComponentTypeNVBlockDescriptor_BsConst_TempGauge, RteSwNvBlockDescriptorRef=NVBlockDescriptor_BsConst_TempGauge
          NvmBlock_NvBlockSwComponentType_NVNeed_NVBlockDescriptor_048: RteNvmRomBlockLocationSymbol=Rte_NvBlockSwComponentType_NVBlockDescriptor_BsConst_FuelGauge_ROM_NVBlockDescriptor_BsConst_FuelGauge, RteNvmBlockRef=NvBlockSwComponentTypeNVBlockDescriptor_BsConst_FuelGauge, RteSwNvBlockDescriptorRef=NVBlockDescriptor_BsConst_FuelGauge
          NvmBlock_NvBlockSwComponentType_NVNeed_NVBlockDescriptor_049: RteNvmRomBlockLocationSymbol=Rte_NvBlockSwComponentType_NVBlockDescriptor_BsReten_Illumination_ROM_NVBlockDescriptor_BsReten_Illumination, RteNvmBlockRef=NvBlockSwComponentTypeNVBlockDescriptor_BsReten_Illumination, RteSwNvBlockDescriptorRef=NVBlockDescriptor_BsReten_Illumination
          NvmBlock_NvBlockSwComponentType_NVNeed_NVBlockDescriptor_050: RteNvmRomBlockLocationSymbol=Rte_NvBlockSwComponentType_NVBlockDescriptor_BsShare_VehicleConfig_ROM_NVBlockDescriptor_BsShare_VehicleConfig, RteNvmBlockRef=NvBlockSwComponentTypeNVBlockDescriptor_BsShare_VehicleConfig, RteSwNvBlockDescriptorRef=NVBlockDescriptor_BsShare_VehicleConfig
          NvmBlock_NvBlockSwComponentType_NVNeed_NVBlockDescriptor_051: RteNvmRomBlockLocationSymbol=Rte_NvBlockSwComponentType_NVBlockDescriptor_BsFuSa_Audio_ROM_NVBlockDescriptor_BsFuSa_Audio, RteNvmBlockRef=NvBlockSwComponentTypeNVBlockDescriptor_BsFuSa_Audio, RteSwNvBlockDescriptorRef=NVBlockDescriptor_BsFuSa_Audio
          NvmBlock_NvBlockSwComponentType_NVNeed_NVBlockDescriptor_052: RteNvmRomBlockLocationSymbol=Rte_NvBlockSwComponentType_NVBlockDescriptor_BsConst_Illumination_ROM_NVBlockDescriptor_BsConst_Illumination, RteNvmBlockRef=NvBlockSwComponentTypeNVBlockDescriptor_BsConst_Illumination, RteSwNvBlockDescriptorRef=NVBlockDescriptor_BsConst_Illumination
          NvmBlock_NvBlockSwComponentType_NVNeed_NVBlockDescriptor_053: RteNvmRomBlockLocationSymbol=Rte_NvBlockSwComponentType_NVBlockDescriptor_BsReten_Warning_ROM_NVBlockDescriptor_BsReten_Warning, RteNvmBlockRef=NvBlockSwComponentTypeNVBlockDescriptor_BsReten_Warning, RteSwNvBlockDescriptorRef=NVBlockDescriptor_BsReten_Warning
          NvmBlock_NvBlockSwComponentType_NVNeed_NVBlockDescriptor_054: RteNvmRomBlockLocationSymbol=Rte_NvBlockSwComponentType_NVBlockDescriptor_BsShare_SwUpdFotaStatus_ROM_NVBlockDescriptor_BsShare_SwUpdFotaStatus, RteNvmBlockRef=NvBlockSwComponentTypeNVBlockDescriptor_BsShare_SwUpdFotaStatus, RteSwNvBlockDescriptorRef=NVBlockDescriptor_BsShare_SwUpdFotaStatus
          NvmBlock_NvBlockSwComponentType_NVNeed_NVBlockDescriptor_055: RteNvmRomBlockLocationSymbol=Rte_NvBlockSwComponentType_NVBlockDescriptor_BsConst_Audio_ROM_NVBlockDescriptor_BsConst_Audio, RteNvmBlockRef=NvBlockSwComponentTypeNVBlockDescriptor_BsConst_Audio, RteSwNvBlockDescriptorRef=NVBlockDescriptor_BsConst_Audio
          NvmBlock_NvBlockSwComponentType_NVNeed_NVBlockDescriptor_056: RteNvmRomBlockLocationSymbol=Rte_NvBlockSwComponentType_NVBlockDescriptor_BsShare_SwUpdFotaFinPrint_ROM_NVBlockDescriptor_BsShare_SwUpdFotaFinPrint, RteNvmBlockRef=NvBlockSwComponentTypeNVBlockDescriptor_BsShare_SwUpdFotaFinPrint, RteSwNvBlockDescriptorRef=NVBlockDescriptor_BsShare_SwUpdFotaFinPrint
          NvmBlock_NvBlockSwComponentType_NVNeed_NVBlockDescriptor_057: RteNvmRomBlockLocationSymbol=Rte_NvBlockSwComponentType_NVBlockDescriptor_BsReten_Tripcomputer_ROM_NVBlockDescriptor_BsReten_Tripcomputer, RteNvmBlockRef=NvBlockSwComponentTypeNVBlockDescriptor_BsReten_Tripcomputer, RteSwNvBlockDescriptorRef=NVBlockDescriptor_BsReten_Tripcomputer
          NvmBlock_NvBlockSwComponentType_NVNeed_NVBlockDescriptor_058: RteNvmRomBlockLocationSymbol=Rte_NvBlockSwComponentType_NVBlockDescriptor_BsReten_RealTimeClock_ROM_NVBlockDescriptor_BsReten_RealTimeClock, RteNvmBlockRef=NvBlockSwComponentTypeNVBlockDescriptor_BsReten_RealTimeClock, RteSwNvBlockDescriptorRef=NVBlockDescriptor_BsReten_RealTimeClock
          NvmBlock_NvBlockSwComponentType_NVNeed_NVBlockDescriptor_059: RteNvmRomBlockLocationSymbol=Rte_NvBlockSwComponentType_NVBlockDescriptor_BsRt_RealTimeClock_ROM_NVBlockDescriptor_BsRt_RealTimeClock, RteNvmBlockRef=NvBlockSwComponentTypeNVBlockDescriptor_BsRt_RealTimeClock, RteSwNvBlockDescriptorRef=NVBlockDescriptor_BsRt_RealTimeClock
          NvmBlock_NvBlockSwComponentType_NVNeed_NVBlockDescriptor_060: RteNvmRomBlockLocationSymbol=Rte_NvBlockSwComponentType_NVBlockDescriptor_BsShare_SwUpdReflash_ROM_NVBlockDescriptor_BsShare_SwUpdReflash, RteNvmBlockRef=NvBlockSwComponentTypeNVBlockDescriptor_BsShare_SwUpdReflash, RteSwNvBlockDescriptorRef=NVBlockDescriptor_BsShare_SwUpdReflash
          NvmBlock_NvBlockSwComponentType_NVNeed_NVBlockDescriptor_061: RteNvmRomBlockLocationSymbol=Rte_NvBlockSwComponentType_NVBlockDescriptor_RefCys_Certicificate1_ROM_NVBlockDescriptor_RefCys_Certicificate1, RteNvmBlockRef=NvBlockSwComponentTypeNVBlockDescriptor_RefCys_Certicificate1, RteSwNvBlockDescriptorRef=NVBlockDescriptor_RefCys_Certicificate1
        60 x RteEventToTaskMapping, all with RteImmediateRestart=false, RtePositionInTask=15, RteMappedToTaskRef=OsTask_MemSer:
          DRT_NvBlockSwComponentTypeRunnable_BsReten_Display_Element_Value: RteEventRef=DRT_NvBlockSwComponentTypeRunnable_BsReten_Display_Element_Value
          DRT_NvBlockSwComponentTypeRunnable_BsRt_FuelGauge_Element_Value: RteEventRef=DRT_NvBlockSwComponentTypeRunnable_BsRt_FuelGauge_Element_Value
          DRT_NvBlockSwComponentTypeRunnable_BsShare_SwUpdFotaStatus_Element_Value: RteEventRef=DRT_NvBlockSwComponentTypeRunnable_BsShare_SwUpdFotaStatus_Element_Value
          DRT_NvBlockSwComponentTypeRunnable_BsShare_VisMeet_Element_Value: RteEventRef=DRT_NvBlockSwComponentTypeRunnable_BsShare_VisMeet_Element_Value
          DRT_NvBlockSwComponentTypeRunnable_BsConst_ServiceReminder_Element_Value: RteEventRef=DRT_NvBlockSwComponentTypeRunnable_BsConst_ServiceReminder_Element_Value
          DRT_NvBlockSwComponentTypeRunnable_BsShare_SwUpdFotaMode_Element_Value: RteEventRef=DRT_NvBlockSwComponentTypeRunnable_BsShare_SwUpdFotaMode_Element_Value
          DRT_NvBlockSwComponentTypeRunnable_BsConst_SpeedoGauge_Element_Value: RteEventRef=DRT_NvBlockSwComponentTypeRunnable_BsConst_SpeedoGauge_Element_Value
          DRT_NvBlockSwComponentTypeRunnable_BsConst_TachoGauge_Element_Value: RteEventRef=DRT_NvBlockSwComponentTypeRunnable_BsConst_TachoGauge_Element_Value
          DRT_NvBlockSwComponentTypeRunnable_BsConst_FuelGauge_Element_Value: RteEventRef=DRT_NvBlockSwComponentTypeRunnable_BsConst_FuelGauge_Element_Value
          DRT_NvBlockSwComponentTypeRunnable_BsFuSa_Warning_Element_Value: RteEventRef=DRT_NvBlockSwComponentTypeRunnable_BsFuSa_Warning_Element_Value
          DRT_NvBlockSwComponentTypeRunnable_BsFuSa_Power_Element_Value: RteEventRef=DRT_NvBlockSwComponentTypeRunnable_BsFuSa_Power_Element_Value
          DRT_NvBlockSwComponentTypeRunnable_BsFuSa_Config_Element_Value: RteEventRef=DRT_NvBlockSwComponentTypeRunnable_BsFuSa_Config_Element_Value
          DRT_NvBlockSwComponentTypeRunnable_BsReten_Power_Element_Value: RteEventRef=DRT_NvBlockSwComponentTypeRunnable_BsReten_Power_Element_Value
          DRT_NvBlockSwComponentTypeRunnable_BsDiag_ErrorRecord_Element_Value: RteEventRef=DRT_NvBlockSwComponentTypeRunnable_BsDiag_ErrorRecord_Element_Value
          DRT_NvBlockSwComponentTypeRunnable_BsRt_TripComputer_Element_Value: RteEventRef=DRT_NvBlockSwComponentTypeRunnable_BsRt_TripComputer_Element_Value
          DRT_NvBlockSwComponentTypeRunnable_BsReten_Warning_Element_Value: RteEventRef=DRT_NvBlockSwComponentTypeRunnable_BsReten_Warning_Element_Value
          DRT_NvBlockSwComponentTypeRunnable_BsReten_Gauges_Element_Value: RteEventRef=DRT_NvBlockSwComponentTypeRunnable_BsReten_Gauges_Element_Value
          DRT_NvBlockSwComponentTypeRunnable_BsShare_EcuPartNumber_Element_Value: RteEventRef=DRT_NvBlockSwComponentTypeRunnable_BsShare_EcuPartNumber_Element_Value
          DRT_NvBlockSwComponentTypeRunnable_BsReten_VisDlt_Element_Value: RteEventRef=DRT_NvBlockSwComponentTypeRunnable_BsReten_VisDlt_Element_Value
          DRT_NvBlockSwComponentTypeRunnable_BsRt_Illumination_Element_Value: RteEventRef=DRT_NvBlockSwComponentTypeRunnable_BsRt_Illumination_Element_Value
          DRT_NvBlockSwComponentTypeRunnable_BsRt_Warning_Element_Value: RteEventRef=DRT_NvBlockSwComponentTypeRunnable_BsRt_Warning_Element_Value
          DRT_NvBlockSwComponentTypeRunnable_BsReten_Personalization_Element_Value: RteEventRef=DRT_NvBlockSwComponentTypeRunnable_BsReten_Personalization_Element_Value
          DRT_NvBlockSwComponentTypeRunnable_BsConst_TripComputer_Element_Value: RteEventRef=DRT_NvBlockSwComponentTypeRunnable_BsConst_TripComputer_Element_Value
          DRT_NvBlockSwComponentTypeRunnable_BsReten_Tripcomputer_Element_Value: RteEventRef=DRT_NvBlockSwComponentTypeRunnable_BsReten_Tripcomputer_Element_Value
          DRT_NvBlockSwComponentTypeRunnable_RefCys_Certicificate_Element_Value: RteEventRef=DRT_NvBlockSwComponentTypeRunnable_RefCys_Certicificate_Element_Value
          DRT_NvBlockSwComponentTypeRunnable_BsReten_RealTimeClock_Element_Value: RteEventRef=DRT_NvBlockSwComponentTypeRunnable_BsReten_RealTimeClock_Element_Value
          DRT_NvBlockSwComponentTypeRunnable_BsShare_SwUpdFotadecrypt_Element_Value: RteEventRef=DRT_NvBlockSwComponentTypeRunnable_BsShare_SwUpdFotadecrypt_Element_Value
          DRT_NvBlockSwComponentTypeRunnable_BsFuSa_Display_Element_Value: RteEventRef=DRT_NvBlockSwComponentTypeRunnable_BsFuSa_Display_Element_Value
          DRT_NvBlockSwComponentTypeRunnable_BsReten_Communication_Element_Value: RteEventRef=DRT_NvBlockSwComponentTypeRunnable_BsReten_Communication_Element_Value
          DRT_NvBlockSwComponentTypeRunnable_BsRt_TachoGauge_Element_Value: RteEventRef=DRT_NvBlockSwComponentTypeRunnable_BsRt_TachoGauge_Element_Value
          DRT_NvBlockSwComponentTypeRunnable_RefCys_Certicificate1_Element_Value: RteEventRef=DRT_NvBlockSwComponentTypeRunnable_RefCys_Certicificate1_Element_Value
          DRT_NvBlockSwComponentTypeRunnable_BsConst_Warning_Element_Value: RteEventRef=DRT_NvBlockSwComponentTypeRunnable_BsConst_Warning_Element_Value
          DRT_NvBlockSwComponentTypeRunnable_BsReten_Audio_Element_Value: RteEventRef=DRT_NvBlockSwComponentTypeRunnable_BsReten_Audio_Element_Value
          DRT_NvBlockSwComponentTypeRunnable_BsConst_RealTimeClock_Element_Value: RteEventRef=DRT_NvBlockSwComponentTypeRunnable_BsConst_RealTimeClock_Element_Value
          DRT_NvBlockSwComponentTypeRunnable_BsFuSa_Audio_Element_Value: RteEventRef=DRT_NvBlockSwComponentTypeRunnable_BsFuSa_Audio_Element_Value
          DRT_NvBlockSwComponentTypeRunnable_BsRt_SpeedoGauge_Element_Value: RteEventRef=DRT_NvBlockSwComponentTypeRunnable_BsRt_SpeedoGauge_Element_Value
          DRT_NvBlockSwComponentTypeRunnable_BsRt_CusDlt_Element_Value: RteEventRef=DRT_NvBlockSwComponentTypeRunnable_BsRt_CusDlt_Element_Value
          DRT_NvBlockSwComponentTypeRunnable_BsRt_RealTimeClock_Element_Value: RteEventRef=DRT_NvBlockSwComponentTypeRunnable_BsRt_RealTimeClock_Element_Value
          DRT_NvBlockSwComponentTypeRunnable_BsConst_Illumination_Element_Value: RteEventRef=DRT_NvBlockSwComponentTypeRunnable_BsConst_Illumination_Element_Value
          DRT_NvBlockSwComponentTypeRunnable_BsRt_TempGauge_Element_Value: RteEventRef=DRT_NvBlockSwComponentTypeRunnable_BsRt_TempGauge_Element_Value
          DRT_NvBlockSwComponentTypeRunnable_BsShare_SwUpdReflash_Element_Value: RteEventRef=DRT_NvBlockSwComponentTypeRunnable_BsShare_SwUpdReflash_Element_Value
          DRT_NvBlockSwComponentTypeRunnable_BsRt_Odometer_Element_Value: RteEventRef=DRT_NvBlockSwComponentTypeRunnable_BsRt_Odometer_Element_Value
          DRT_NvBlockSwComponentTypeRunnable_BsFuSa_Communication_Element_Value: RteEventRef=DRT_NvBlockSwComponentTypeRunnable_BsFuSa_Communication_Element_Value
          DRT_NvBlockSwComponentTypeRunnable_BsConst_OilGauge_Element_Value: RteEventRef=DRT_NvBlockSwComponentTypeRunnable_BsConst_OilGauge_Element_Value
          DRT_NvBlockSwComponentTypeRunnable_BsRt_Personalization_Element_Value: RteEventRef=DRT_NvBlockSwComponentTypeRunnable_BsRt_Personalization_Element_Value
          DRT_NvBlockSwComponentTypeRunnable_BsConst_Audio_Element_Value: RteEventRef=DRT_NvBlockSwComponentTypeRunnable_BsConst_Audio_Element_Value
          DRT_NvBlockSwComponentTypeRunnable_BsConst_EngOffTimer_Element_Value: RteEventRef=DRT_NvBlockSwComponentTypeRunnable_BsConst_EngOffTimer_Element_Value
          DRT_NvBlockSwComponentTypeRunnable_BsFusa_Fota_Element_Value: RteEventRef=DRT_NvBlockSwComponentTypeRunnable_BsFusa_Fota_Element_Value
          DRT_NvBlockSwComponentTypeRunnable_BsConst_TempGauge_Element_Value: RteEventRef=DRT_NvBlockSwComponentTypeRunnable_BsConst_TempGauge_Element_Value
          DRT_NvBlockSwComponentTypeRunnable_BsShare_SwUpdFotaFinPrint_Element_Value: RteEventRef=DRT_NvBlockSwComponentTypeRunnable_BsShare_SwUpdFotaFinPrint_Element_Value
          DRT_NvBlockSwComponentTypeRunnable_BsDiag_Dtc_Element_Value: RteEventRef=DRT_NvBlockSwComponentTypeRunnable_BsDiag_Dtc_Element_Value
          DRT_NvBlockSwComponentTypeRunnable_BsReten_Illumination_Element_Value: RteEventRef=DRT_NvBlockSwComponentTypeRunnable_BsReten_Illumination_Element_Value
          DRT_NvBlockSwComponentTypeRunnable_BsReten_Odometer_Element_Value: RteEventRef=DRT_NvBlockSwComponentTypeRunnable_BsReten_Odometer_Element_Value
          DRT_NvBlockSwComponentTypeRunnable_BsShare_VehicleConfig_Element_Value: RteEventRef=DRT_NvBlockSwComponentTypeRunnable_BsShare_VehicleConfig_Element_Value
          DRT_NvBlockSwComponentTypeRunnable_BsRt_OilGauge_Element_Value: RteEventRef=DRT_NvBlockSwComponentTypeRunnable_BsRt_OilGauge_Element_Value
          DRT_NvBlockSwComponentTypeRunnable_BsConst_PowerGauge_Element_Value: RteEventRef=DRT_NvBlockSwComponentTypeRunnable_BsConst_PowerGauge_Element_Value
          DRT_NvBlockSwComponentTypeRunnable_BsConst_Power_Element_Value: RteEventRef=DRT_NvBlockSwComponentTypeRunnable_BsConst_Power_Element_Value
          DRT_NvBlockSwComponentTypeRunnable_BsCys_Certicificate_Element_Value: RteEventRef=DRT_NvBlockSwComponentTypeRunnable_BsCys_Certicificate_Element_Value
          DRT_NvBlockSwComponentTypeRunnable_BsRt_PowerGauge_Element_Value: RteEventRef=DRT_NvBlockSwComponentTypeRunnable_BsRt_PowerGauge_Element_Value
          DRT_NvBlockSwComponentTypeRunnable_BsConst_Communication_Element_Value: RteEventRef=DRT_NvBlockSwComponentTypeRunnable_BsConst_Communication_Element_Value
    MemAbstractStub (RteSwComponentType): RteComponentTypeRef=MemAbstractStub, RteImplementationRef=MemAbstractStub_Implementation
      ComponentTypeCalibration (RteComponentTypeCalibration): RteCalibrationSupportEnabled=false
    NvBlockSwComponentType (RteSwComponentType): RteComponentTypeRef=NvBlockSwComponentType, RteImplementationRef=NvBlockSwComponentType_Implementation
      ComponentTypeCalibration (RteComponentTypeCalibration): RteCalibrationSupportEnabled=false
    NvM (RteBswModuleInstance): RteBswImplementationRef=NvM_Impl, RteBswModuleConfigurationRef=NvM
      NvM_MainFunctionTimingEvent0 (RteBswEventToTaskMapping):
        RteBswImmediateRestart = false
        RteBswPositionInTask = 0
        RteBswEventRef = NvM_MainFunctionTimingEvent0
        RteBswMappedToTaskRef = OsTask_MemSer
        RteBswUsedOsEventRef = Rte_Ev_Cyclic2_OsTask_MemSer_0_10ms
        RteBswUsedOsAlarmRef = Rte_Al_TE2_OsTask_MemSer_0_10ms
      NVM_EXCLUSIVE_AREA_0 (RteBswExclusiveAreaImpl): RteExclusiveAreaImplMechanism=ALL_INTERRUPT_BLOCKING, RteBswExclusiveAreaRef=NVM_EXCLUSIVE_AREA_0
    5 x RteSwComponentInstance:
      NvM_EcuSwComposition: RteSoftwareComponentInstanceRef=NvM
        601 x RteEventToTaskMapping, all with RteImmediateRestart=false:
          Timer_NvM_MainFunction: RtePositionInTask=0, RteEventRef=Timer_NvM_MainFunction, RteMappedToTaskRef=OsTask_MemSer, RteUsedOsEventRef=Rte_Ev_Cyclic2_OsTask_MemSer_0_10ms, RteUsedOsAlarmRef=Rte_Al_TE2_OsTask_MemSer_0_10ms
          OpEventEraseBlock_EraseBlock_PS_NvBlockSwComponentTypeNVBlockDescriptor_BsShare_VehicleConfig: RteEventRef=OpEventEraseBlock_EraseBlock_PS_NvBlockSwComponentTypeNVBlockDescriptor_BsShare_VehicleConfig
          OpEventSetBlockProtection_SetBlockProtection_PAdmin_NvBlockSwComponentTypeNVBlockDescriptor_BsCys_Certicificate: RteEventRef=OpEventSetBlockProtection_SetBlockProtection_PAdmin_NvBlockSwComponentTypeNVBlockDescriptor_BsCys_Certicificate
          OpEventGetErrorStatus_GetErrorStatus_PS_NvBlockSwComponentTypeNVBlockDescriptor_BsShare_VisMeet: RteEventRef=OpEventGetErrorStatus_GetErrorStatus_PS_NvBlockSwComponentTypeNVBlockDescriptor_BsShare_VisMeet
          OpEventSetRamBlockStatus_SetRamBlockStatus_PS_NvBlockSwComponentTypeNVBlockDescriptor_BsReten_VisDlt: RteEventRef=OpEventSetRamBlockStatus_SetRamBlockStatus_PS_NvBlockSwComponentTypeNVBlockDescriptor_BsReten_VisDlt
          OpEventGetErrorStatus_GetErrorStatus_PS_NvBlockSwComponentTypeNVBlockDescriptor_BsRt_SpeedoGauge: RteEventRef=OpEventGetErrorStatus_GetErrorStatus_PS_NvBlockSwComponentTypeNVBlockDescriptor_BsRt_SpeedoGauge
          OpEventWriteBlock_WriteBlock_PS_NvBlockSwComponentTypeNVBlockDescriptor_BsShare_SwUpdFotadecrypt: RteEventRef=OpEventWriteBlock_WriteBlock_PS_NvBlockSwComponentTypeNVBlockDescriptor_BsShare_SwUpdFotadecrypt
          OpEventWriteBlock_WriteBlock_PS_NvBlockSwComponentTypeNVBlockDescriptor_BsConst_Power: RteEventRef=OpEventWriteBlock_WriteBlock_PS_NvBlockSwComponentTypeNVBlockDescriptor_BsConst_Power
          OpEventRestoreBlockDefaults_RestoreBlockDefaults_PS_NvBlockSwComponentTypeNVBlockDescriptor_BsShare_SwUpdFotaFinPrint: RteEventRef=OpEventRestoreBlockDefaults_RestoreBlockDefaults_PS_NvBlockSwComponentTypeNVBlockDescriptor_BsShare_SwUpdFotaFinPrint
          OpEventInvalidateNvBlock_InvalidateNvBlock_PS_NvBlockSwComponentTypeNVBlockDescriptor_BsRt_Illumination: RteEventRef=OpEventInvalidateNvBlock_InvalidateNvBlock_PS_NvBlockSwComponentTypeNVBlockDescriptor_BsRt_Illumination
          OpEventWriteBlock_WriteBlock_PS_NvBlockSwComponentTypeNVBlockDescriptor_BsReten_Odometer: RteEventRef=OpEventWriteBlock_WriteBlock_PS_NvBlockSwComponentTypeNVBlockDescriptor_BsReten_Odometer
          OpEventRestoreBlockDefaults_RestoreBlockDefaults_PS_NvBlockSwComponentTypeNVBlockDescriptor_BsFuSa_Audio: RteEventRef=OpEventRestoreBlockDefaults_RestoreBlockDefaults_PS_NvBlockSwComponentTypeNVBlockDescriptor_BsFuSa_Audio
          OpEventInvalidateNvBlock_InvalidateNvBlock_PS_NvBlockSwComponentTypeNVBlockDescriptor_BsConst_FuelGauge: RteEventRef=OpEventInvalidateNvBlock_InvalidateNvBlock_PS_NvBlockSwComponentTypeNVBlockDescriptor_BsConst_FuelGauge
          OpEventSetRamBlockStatus_SetRamBlockStatus_PS_NvBlockSwComponentTypeNVBlockDescriptor_BsConst_Illumination: RteEventRef=OpEventSetRamBlockStatus_SetRamBlockStatus_PS_NvBlockSwComponentTypeNVBlockDescriptor_BsConst_Illumination
          OpEventInvalidateNvBlock_InvalidateNvBlock_PS_NvBlockSwComponentTypeNVBlockDescriptor_BsRt_CusDlt: RteEventRef=OpEventInvalidateNvBlock_InvalidateNvBlock_PS_NvBlockSwComponentTypeNVBlockDescriptor_BsRt_CusDlt
          OpEventWriteBlock_WriteBlock_PS_NvBlockSwComponentTypeNVBlockDescriptor_BsConst_ServiceReminder: RteEventRef=OpEventWriteBlock_WriteBlock_PS_NvBlockSwComponentTypeNVBlockDescriptor_BsConst_ServiceReminder
          OpEventInvalidateNvBlock_InvalidateNvBlock_PS_NvBlockSwComponentTypeNVBlockDescriptor_BsConst_Power: RteEventRef=OpEventInvalidateNvBlock_InvalidateNvBlock_PS_NvBlockSwComponentTypeNVBlockDescriptor_BsConst_Power
          OpEventEraseBlock_EraseBlock_PS_NvBlockSwComponentTypeNVBlockDescriptor_BsRt_Warning: RteEventRef=OpEventEraseBlock_EraseBlock_PS_NvBlockSwComponentTypeNVBlockDescriptor_BsRt_Warning
          OpEventEraseBlock_EraseBlock_PS_NvBlockSwComponentTypeNVBlockDescriptor_BsConst_OilGauge: RteEventRef=OpEventEraseBlock_EraseBlock_PS_NvBlockSwComponentTypeNVBlockDescriptor_BsConst_OilGauge
          OpEventSetRamBlockStatus_SetRamBlockStatus_PS_NvBlockSwComponentTypeNVBlockDescriptor_BsShare_VisMeet: RteEventRef=OpEventSetRamBlockStatus_SetRamBlockStatus_PS_NvBlockSwComponentTypeNVBlockDescriptor_BsShare_VisMeet
          OpEventRestoreBlockDefaults_RestoreBlockDefaults_PS_NvBlockSwComponentTypeNVBlockDescriptor_BsShare_EcuPartNumber: RteEventRef=OpEventRestoreBlockDefaults_RestoreBlockDefaults_PS_NvBlockSwComponentTypeNVBlockDescriptor_BsShare_EcuPartNumber
          OpEventEraseBlock_EraseBlock_PS_NvBlockSwComponentTypeNVBlockDescriptor_BsReten_Personalization: RteEventRef=OpEventEraseBlock_EraseBlock_PS_NvBlockSwComponentTypeNVBlockDescriptor_BsReten_Personalization
          OpEventGetErrorStatus_GetErrorStatus_PS_NvBlockSwComponentTypeNVBlockDescriptor_BsShare_SwUpdFotaStatus: RteEventRef=OpEventGetErrorStatus_GetErrorStatus_PS_NvBlockSwComponentTypeNVBlockDescriptor_BsShare_SwUpdFotaStatus
          OpEventSetRamBlockStatus_SetRamBlockStatus_PS_NvBlockSwComponentTypeNVBlockDescriptor_BsReten_Display: RteEventRef=OpEventSetRamBlockStatus_SetRamBlockStatus_PS_NvBlockSwComponentTypeNVBlockDescriptor_BsReten_Display
          OpEventEraseBlock_EraseBlock_PS_NvBlockSwComponentTypeNVBlockDescriptor_BsConst_PowerGauge: RteEventRef=OpEventEraseBlock_EraseBlock_PS_NvBlockSwComponentTypeNVBlockDescriptor_BsConst_PowerGauge
          OpEventReadBlock_ReadBlock_PS_NvBlockSwComponentTypeNVBlockDescriptor_BsRt_OilGauge: RteEventRef=OpEventReadBlock_ReadBlock_PS_NvBlockSwComponentTypeNVBlockDescriptor_BsRt_OilGauge
          OpEventGetErrorStatus_GetErrorStatus_PS_NvBlockSwComponentTypeNVBlockDescriptor_BsRt_Odometer: RteEventRef=OpEventGetErrorStatus_GetErrorStatus_PS_NvBlockSwComponentTypeNVBlockDescriptor_BsRt_Odometer
          OpEventGetErrorStatus_GetErrorStatus_PS_NvBlockSwComponentTypeNVBlockDescriptor_BsShare_SwUpdFotaMode: RteEventRef=OpEventGetErrorStatus_GetErrorStatus_PS_NvBlockSwComponentTypeNVBlockDescriptor_BsShare_SwUpdFotaMode
          OpEventSetRamBlockStatus_SetRamBlockStatus_PS_NvBlockSwComponentTypeNVBlockDescriptor_BsRt_Personalization: RteEventRef=OpEventSetRamBlockStatus_SetRamBlockStatus_PS_NvBlockSwComponentTypeNVBlockDescriptor_BsRt_Personalization
          OpEventSetRamBlockStatus_SetRamBlockStatus_PS_NvBlockSwComponentTypeNVBlockDescriptor_BsConst_FuelGauge: RteEventRef=OpEventSetRamBlockStatus_SetRamBlockStatus_PS_NvBlockSwComponentTypeNVBlockDescriptor_BsConst_FuelGauge
          OpEventSetRamBlockStatus_SetRamBlockStatus_PS_NvBlockSwComponentTypeNVBlockDescriptor_BsRt_PowerGauge: RteEventRef=OpEventSetRamBlockStatus_SetRamBlockStatus_PS_NvBlockSwComponentTypeNVBlockDescriptor_BsRt_PowerGauge
          OpEventWriteBlock_WriteBlock_PS_NvBlockSwComponentTypeNVBlockDescriptor_BsRt_OilGauge: RteEventRef=OpEventWriteBlock_WriteBlock_PS_NvBlockSwComponentTypeNVBlockDescriptor_BsRt_OilGauge
          OpEventReadBlock_ReadBlock_PS_NvBlockSwComponentTypeNVBlockDescriptor_BsShare_EcuPartNumber: RteEventRef=OpEventReadBlock_ReadBlock_PS_NvBlockSwComponentTypeNVBlockDescriptor_BsShare_EcuPartNumber
          OpEventSetRamBlockStatus_SetRamBlockStatus_PS_NvBlockSwComponentTypeNVBlockDescriptor_BsReten_Tripcomputer: RteEventRef=OpEventSetRamBlockStatus_SetRamBlockStatus_PS_NvBlockSwComponentTypeNVBlockDescriptor_BsReten_Tripcomputer
          OpEventWriteBlock_WriteBlock_PS_NvBlockSwComponentTypeNVBlockDescriptor_BsConst_Warning: RteEventRef=OpEventWriteBlock_WriteBlock_PS_NvBlockSwComponentTypeNVBlockDescriptor_BsConst_Warning
          OpEventGetErrorStatus_GetErrorStatus_PS_NvBlockSwComponentTypeNVBlockDescriptor_BsFuSa_Warning: RteEventRef=OpEventGetErrorStatus_GetErrorStatus_PS_NvBlockSwComponentTypeNVBlockDescriptor_BsFuSa_Warning
          OpEventSetBlockProtection_SetBlockProtection_PAdmin_NvBlockSwComponentTypeNVBlockDescriptor_BsReten_Illumination: RteEventRef=OpEventSetBlockProtection_SetBlockProtection_PAdmin_NvBlockSwComponentTypeNVBlockDescriptor_BsReten_Illumination
          OpEventInvalidateNvBlock_InvalidateNvBlock_PS_NvBlockSwComponentTypeNVBlockDescriptor_BsRt_RealTimeClock: RteEventRef=OpEventInvalidateNvBlock_InvalidateNvBlock_PS_NvBlockSwComponentTypeNVBlockDescriptor_BsRt_RealTimeClock
          OpEventGetErrorStatus_GetErrorStatus_PS_NvBlockSwComponentTypeNVBlockDescriptor_BsDiag_ErrorRecord: RteEventRef=OpEventGetErrorStatus_GetErrorStatus_PS_NvBlockSwComponentTypeNVBlockDescriptor_BsDiag_ErrorRecord
          OpEventWriteBlock_WriteBlock_PS_NvBlockSwComponentTypeNVBlockDescriptor_BsReten_Power: RteEventRef=OpEventWriteBlock_WriteBlock_PS_NvBlockSwComponentTypeNVBlockDescriptor_BsReten_Power
          OpEventEraseBlock_EraseBlock_PS_NvBlockSwComponentTypeNVBlockDescriptor_BsReten_Odometer: RteEventRef=OpEventEraseBlock_EraseBlock_PS_NvBlockSwComponentTypeNVBlockDescriptor_BsReten_Odometer
          OpEventSetBlockProtection_SetBlockProtection_PAdmin_NvBlockSwComponentTypeNVBlockDescriptor_BsShare_SwUpdFotadecrypt: RteEventRef=OpEventSetBlockProtection_SetBlockProtection_PAdmin_NvBlockSwComponentTypeNVBlockDescriptor_BsShare_SwUpdFotadecrypt
          OpEventInvalidateNvBlock_InvalidateNvBlock_PS_NvBlockSwComponentTypeNVBlockDescriptor_BsRt_Personalization: RteEventRef=OpEventInvalidateNvBlock_InvalidateNvBlock_PS_NvBlockSwComponentTypeNVBlockDescriptor_BsRt_Personalization
          OpEventSetBlockProtection_SetBlockProtection_PAdmin_NvBlockSwComponentTypeNVBlockDescriptor_BsRt_RealTimeClock: RteEventRef=OpEventSetBlockProtection_SetBlockProtection_PAdmin_NvBlockSwComponentTypeNVBlockDescriptor_BsRt_RealTimeClock
          OpEventSetRamBlockStatus_SetRamBlockStatus_PS_NvBlockSwComponentTypeNVBlockDescriptor_BsRt_RealTimeClock: RteEventRef=OpEventSetRamBlockStatus_SetRamBlockStatus_PS_NvBlockSwComponentTypeNVBlockDescriptor_BsRt_RealTimeClock
          OpEventSetRamBlockStatus_SetRamBlockStatus_PS_NvBlockSwComponentTypeNVBlockDescriptor_BsRt_TripComputer: RteEventRef=OpEventSetRamBlockStatus_SetRamBlockStatus_PS_NvBlockSwComponentTypeNVBlockDescriptor_BsRt_TripComputer
          OpEventSetRamBlockStatus_SetRamBlockStatus_PS_NvBlockSwComponentTypeNVBlockDescriptor_BsConst_OilGauge: RteEventRef=OpEventSetRamBlockStatus_SetRamBlockStatus_PS_NvBlockSwComponentTypeNVBlockDescriptor_BsConst_OilGauge
          OpEventRestoreBlockDefaults_RestoreBlockDefaults_PS_NvBlockSwComponentTypeNVBlockDescriptor_BsConst_TripComputer: RteEventRef=OpEventRestoreBlockDefaults_RestoreBlockDefaults_PS_NvBlockSwComponentTypeNVBlockDescriptor_BsConst_TripComputer
          OpEventWriteBlock_WriteBlock_PS_NvBlockSwComponentTypeNVBlockDescriptor_BsShare_EcuPartNumber: RteEventRef=OpEventWriteBlock_WriteBlock_PS_NvBlockSwComponentTypeNVBlockDescriptor_BsShare_EcuPartNumber
          OpEventInvalidateNvBlock_InvalidateNvBlock_PS_NvBlockSwComponentTypeNVBlockDescriptor_BsReten_Personalization: RteEventRef=OpEventInvalidateNvBlock_InvalidateNvBlock_PS_NvBlockSwComponentTypeNVBlockDescriptor_BsReten_Personalization
          OpEventWriteBlock_WriteBlock_PS_NvBlockSwComponentTypeNVBlockDescriptor_BsFuSa_Audio: RteEventRef=OpEventWriteBlock_WriteBlock_PS_NvBlockSwComponentTypeNVBlockDescriptor_BsFuSa_Audio
          OpEventInvalidateNvBlock_InvalidateNvBlock_PS_NvBlockSwComponentTypeNVBlockDescriptor_BsShare_SwUpdFotaFinPrint: RteEventRef=OpEventInvalidateNvBlock_InvalidateNvBlock_PS_NvBlockSwComponentTypeNVBlockDescriptor_BsShare_SwUpdFotaFinPrint
          OpEventRestoreBlockDefaults_RestoreBlockDefaults_PS_NvBlockSwComponentTypeNVBlockDescriptor_BsFuSa_Display: RteEventRef=OpEventRestoreBlockDefaults_RestoreBlockDefaults_PS_NvBlockSwComponentTypeNVBlockDescriptor_BsFuSa_Display
          OpEventEraseBlock_EraseBlock_PS_NvBlockSwComponentTypeNVBlockDescriptor_BsDiag_Dtc: RteEventRef=OpEventEraseBlock_EraseBlock_PS_NvBlockSwComponentTypeNVBlockDescriptor_BsDiag_Dtc
          OpEventInvalidateNvBlock_InvalidateNvBlock_PS_NvBlockSwComponentTypeNVBlockDescriptor_BsRt_TempGauge: RteEventRef=OpEventInvalidateNvBlock_InvalidateNvBlock_PS_NvBlockSwComponentTypeNVBlockDescriptor_BsRt_TempGauge
          OpEventEraseBlock_EraseBlock_PS_NvBlockSwComponentTypeNVBlockDescriptor_BsFuSa_Power: RteEventRef=OpEventEraseBlock_EraseBlock_PS_NvBlockSwComponentTypeNVBlockDescriptor_BsFuSa_Power
          OpEventRestoreBlockDefaults_RestoreBlockDefaults_PS_NvBlockSwComponentTypeNVBlockDescriptor_BsConst_Illumination: RteEventRef=OpEventRestoreBlockDefaults_RestoreBlockDefaults_PS_NvBlockSwComponentTypeNVBlockDescriptor_BsConst_Illumination
          OpEventRestoreBlockDefaults_RestoreBlockDefaults_PS_NvBlockSwComponentTypeNVBlockDescriptor_BsRt_FuelGauge: RteEventRef=OpEventRestoreBlockDefaults_RestoreBlockDefaults_PS_NvBlockSwComponentTypeNVBlockDescriptor_BsRt_FuelGauge
          OpEventSetBlockProtection_SetBlockProtection_PAdmin_NvBlockSwComponentTypeNVBlockDescriptor_BsFuSa_Communication: RteEventRef=OpEventSetBlockProtection_SetBlockProtection_PAdmin_NvBlockSwComponentTypeNVBlockDescriptor_BsFuSa_Communication
          OpEventEraseBlock_EraseBlock_PS_NvBlockSwComponentTypeNVBlockDescriptor_BsShare_EcuPartNumber: RteEventRef=OpEventEraseBlock_EraseBlock_PS_NvBlockSwComponentTypeNVBlockDescriptor_BsShare_EcuPartNumber
          OpEventRestoreBlockDefaults_RestoreBlockDefaults_PS_NvBlockSwComponentTypeNVBlockDescriptor_BsDiag_ErrorRecord: RteEventRef=OpEventRestoreBlockDefaults_RestoreBlockDefaults_PS_NvBlockSwComponentTypeNVBlockDescriptor_BsDiag_ErrorRecord
          OpEventEraseBlock_EraseBlock_PS_NvBlockSwComponentTypeNVBlockDescriptor_BsRt_TachoGauge: RteEventRef=OpEventEraseBlock_EraseBlock_PS_NvBlockSwComponentTypeNVBlockDescriptor_BsRt_TachoGauge
          OpEventEraseBlock_EraseBlock_PS_NvBlockSwComponentTypeNVBlockDescriptor_BsConst_TempGauge: RteEventRef=OpEventEraseBlock_EraseBlock_PS_NvBlockSwComponentTypeNVBlockDescriptor_BsConst_TempGauge
          OpEventGetErrorStatus_GetErrorStatus_PS_NvBlockSwComponentTypeNVBlockDescriptor_BsRt_Illumination: RteEventRef=OpEventGetErrorStatus_GetErrorStatus_PS_NvBlockSwComponentTypeNVBlockDescriptor_BsRt_Illumination
          OpEventInvalidateNvBlock_InvalidateNvBlock_PS_NvBlockSwComponentTypeNVBlockDescriptor_BsReten_Communication: RteEventRef=OpEventInvalidateNvBlock_InvalidateNvBlock_PS_NvBlockSwComponentTypeNVBlockDescriptor_BsReten_Communication
          OpEventSetBlockProtection_SetBlockProtection_PAdmin_NvBlockSwComponentTypeNVBlockDescriptor_BsConst_ServiceReminder: RteEventRef=OpEventSetBlockProtection_SetBlockProtection_PAdmin_NvBlockSwComponentTypeNVBlockDescriptor_BsConst_ServiceReminder
          OpEventReadBlock_ReadBlock_PS_NvBlockSwComponentTypeNVBlockDescriptor_BsReten_Gauges: RteEventRef=OpEventReadBlock_ReadBlock_PS_NvBlockSwComponentTypeNVBlockDescriptor_BsReten_Gauges
          OpEventWriteBlock_WriteBlock_PS_NvBlockSwComponentTypeNVBlockDescriptor_BsShare_SwUpdFotaStatus: RteEventRef=OpEventWriteBlock_WriteBlock_PS_NvBlockSwComponentTypeNVBlockDescriptor_BsShare_SwUpdFotaStatus
          OpEventInvalidateNvBlock_InvalidateNvBlock_PS_NvBlockSwComponentTypeNVBlockDescriptor_BsShare_VehicleConfig: RteEventRef=OpEventInvalidateNvBlock_InvalidateNvBlock_PS_NvBlockSwComponentTypeNVBlockDescriptor_BsShare_VehicleConfig
          OpEventRestoreBlockDefaults_RestoreBlockDefaults_PS_NvBlockSwComponentTypeNVBlockDescriptor_BsConst_FuelGauge: RteEventRef=OpEventRestoreBlockDefaults_RestoreBlockDefaults_PS_NvBlockSwComponentTypeNVBlockDescriptor_BsConst_FuelGauge
          OpEventWriteBlock_WriteBlock_PS_NvBlockSwComponentTypeNVBlockDescriptor_BsConst_EngOffTimer: RteEventRef=OpEventWriteBlock_WriteBlock_PS_NvBlockSwComponentTypeNVBlockDescriptor_BsConst_EngOffTimer
          OpEventReadBlock_ReadBlock_PS_NvBlockSwComponentTypeNVBlockDescriptor_BsConst_TempGauge: RteEventRef=OpEventReadBlock_ReadBlock_PS_NvBlockSwComponentTypeNVBlockDescriptor_BsConst_TempGauge
          OpEventGetErrorStatus_GetErrorStatus_PS_NvBlockSwComponentTypeNVBlockDescriptor_BsFuSa_Display: RteEventRef=OpEventGetErrorStatus_GetErrorStatus_PS_NvBlockSwComponentTypeNVBlockDescriptor_BsFuSa_Display
          OpEventInvalidateNvBlock_InvalidateNvBlock_PS_NvBlockSwComponentTypeNVBlockDescriptor_BsCys_Certicificate: RteEventRef=OpEventInvalidateNvBlock_InvalidateNvBlock_PS_NvBlockSwComponentTypeNVBlockDescriptor_BsCys_Certicificate
          OpEventWriteBlock_WriteBlock_PS_NvBlockSwComponentTypeNVBlockDescriptor_BsConst_Illumination: RteEventRef=OpEventWriteBlock_WriteBlock_PS_NvBlockSwComponentTypeNVBlockDescriptor_BsConst_Illumination
          OpEventReadBlock_ReadBlock_PS_NvBlockSwComponentTypeNVBlockDescriptor_BsConst_RealTimeClock: RteEventRef=OpEventReadBlock_ReadBlock_PS_NvBlockSwComponentTypeNVBlockDescriptor_BsConst_RealTimeClock
          OpEventInvalidateNvBlock_InvalidateNvBlock_PS_NvBlockSwComponentTypeNVBlockDescriptor_RefCys_Certicificate1: RteEventRef=OpEventInvalidateNvBlock_InvalidateNvBlock_PS_NvBlockSwComponentTypeNVBlockDescriptor_RefCys_Certicificate1
          OpEventGetErrorStatus_GetErrorStatus_PS_NvBlockSwComponentTypeNVBlockDescriptor_BsRt_FuelGauge: RteEventRef=OpEventGetErrorStatus_GetErrorStatus_PS_NvBlockSwComponentTypeNVBlockDescriptor_BsRt_FuelGauge
          OpEventWriteBlock_WriteBlock_PS_NvBlockSwComponentTypeNVBlockDescriptor_BsCys_Certicificate: RteEventRef=OpEventWriteBlock_WriteBlock_PS_NvBlockSwComponentTypeNVBlockDescriptor_BsCys_Certicificate
          OpEventSetBlockProtection_SetBlockProtection_PAdmin_NvBlockSwComponentTypeNVBlockDescriptor_BsReten_Display: RteEventRef=OpEventSetBlockProtection_SetBlockProtection_PAdmin_NvBlockSwComponentTypeNVBlockDescriptor_BsReten_Display
          OpEventSetBlockProtection_SetBlockProtection_PAdmin_NvBlockSwComponentTypeNVBlockDescriptor_BsReten_Gauges: RteEventRef=OpEventSetBlockProtection_SetBlockProtection_PAdmin_NvBlockSwComponentTypeNVBlockDescriptor_BsReten_Gauges
          OpEventGetErrorStatus_GetErrorStatus_PS_NvBlockSwComponentTypeNVBlockDescriptor_BsRt_CusDlt: RteEventRef=OpEventGetErrorStatus_GetErrorStatus_PS_NvBlockSwComponentTypeNVBlockDescriptor_BsRt_CusDlt
          OpEventSetRamBlockStatus_SetRamBlockStatus_PS_NvBlockSwComponentTypeNVBlockDescriptor_BsConst_ServiceReminder: RteEventRef=OpEventSetRamBlockStatus_SetRamBlockStatus_PS_NvBlockSwComponentTypeNVBlockDescriptor_BsConst_ServiceReminder
          OpEventSetBlockProtection_SetBlockProtection_PAdmin_NvBlockSwComponentTypeNVBlockDescriptor_BsConst_TripComputer: RteEventRef=OpEventSetBlockProtection_SetBlockProtection_PAdmin_NvBlockSwComponentTypeNVBlockDescriptor_BsConst_TripComputer
          OpEventRestoreBlockDefaults_RestoreBlockDefaults_PS_NvBlockSwComponentTypeNVBlockDescriptor_BsDiag_Dtc: RteEventRef=OpEventRestoreBlockDefaults_RestoreBlockDefaults_PS_NvBlockSwComponentTypeNVBlockDescriptor_BsDiag_Dtc
          OpEventRestoreBlockDefaults_RestoreBlockDefaults_PS_NvBlockSwComponentTypeNVBlockDescriptor_BsReten_Power: RteEventRef=OpEventRestoreBlockDefaults_RestoreBlockDefaults_PS_NvBlockSwComponentTypeNVBlockDescriptor_BsReten_Power
          OpEventSetBlockProtection_SetBlockProtection_PAdmin_NvBlockSwComponentTypeNVBlockDescriptor_BsFuSa_Audio: RteEventRef=OpEventSetBlockProtection_SetBlockProtection_PAdmin_NvBlockSwComponentTypeNVBlockDescriptor_BsFuSa_Audio
          OpEventWriteBlock_WriteBlock_PS_NvBlockSwComponentTypeNVBlockDescriptor_BsFuSa_Warning: RteEventRef=OpEventWriteBlock_WriteBlock_PS_NvBlockSwComponentTypeNVBlockDescriptor_BsFuSa_Warning
          OpEventReadBlock_ReadBlock_PS_NvBlockSwComponentTypeNVBlockDescriptor_BsRt_Warning: RteEventRef=OpEventReadBlock_ReadBlock_PS_NvBlockSwComponentTypeNVBlockDescriptor_BsRt_Warning
          OpEventEraseBlock_EraseBlock_PS_NvBlockSwComponentTypeNVBlockDescriptor_RefCys_Certicificate: RteEventRef=OpEventEraseBlock_EraseBlock_PS_NvBlockSwComponentTypeNVBlockDescriptor_RefCys_Certicificate
          OpEventSetRamBlockStatus_SetRamBlockStatus_PS_NvBlockSwComponentTypeNVBlockDescriptor_BsReten_Gauges: RteEventRef=OpEventSetRamBlockStatus_SetRamBlockStatus_PS_NvBlockSwComponentTypeNVBlockDescriptor_BsReten_Gauges
          OpEventRestoreBlockDefaults_RestoreBlockDefaults_PS_NvBlockSwComponentTypeNVBlockDescriptor_BsConst_PowerGauge: RteEventRef=OpEventRestoreBlockDefaults_RestoreBlockDefaults_PS_NvBlockSwComponentTypeNVBlockDescriptor_BsConst_PowerGauge
          OpEventReadBlock_ReadBlock_PS_NvBlockSwComponentTypeNVBlockDescriptor_BsReten_RealTimeClock: RteEventRef=OpEventReadBlock_ReadBlock_PS_NvBlockSwComponentTypeNVBlockDescriptor_BsReten_RealTimeClock
          OpEventSetRamBlockStatus_SetRamBlockStatus_PS_NvBlockSwComponentTypeNVBlockDescriptor_BsRt_OilGauge: RteEventRef=OpEventSetRamBlockStatus_SetRamBlockStatus_PS_NvBlockSwComponentTypeNVBlockDescriptor_BsRt_OilGauge
          OpEventSetRamBlockStatus_SetRamBlockStatus_PS_NvBlockSwComponentTypeNVBlockDescriptor_BsRt_TachoGauge: RteEventRef=OpEventSetRamBlockStatus_SetRamBlockStatus_PS_NvBlockSwComponentTypeNVBlockDescriptor_BsRt_TachoGauge
          OpEventSetBlockProtection_SetBlockProtection_PAdmin_NvBlockSwComponentTypeNVBlockDescriptor_BsConst_TachoGauge: RteEventRef=OpEventSetBlockProtection_SetBlockProtection_PAdmin_NvBlockSwComponentTypeNVBlockDescriptor_BsConst_TachoGauge
          OpEventSetBlockProtection_SetBlockProtection_PAdmin_NvBlockSwComponentTypeNVBlockDescriptor_BsRt_TripComputer: RteEventRef=OpEventSetBlockProtection_SetBlockProtection_PAdmin_NvBlockSwComponentTypeNVBlockDescriptor_BsRt_TripComputer
          OpEventSetBlockProtection_SetBlockProtection_PAdmin_NvBlockSwComponentTypeNVBlockDescriptor_BsDiag_Dtc: RteEventRef=OpEventSetBlockProtection_SetBlockProtection_PAdmin_NvBlockSwComponentTypeNVBlockDescriptor_BsDiag_Dtc
          OpEventInvalidateNvBlock_InvalidateNvBlock_PS_NvBlockSwComponentTypeNVBlockDescriptor_BsConst_PowerGauge: RteEventRef=OpEventInvalidateNvBlock_InvalidateNvBlock_PS_NvBlockSwComponentTypeNVBlockDescriptor_BsConst_PowerGauge
          OpEventWriteBlock_WriteBlock_PS_NvBlockSwComponentTypeNVBlockDescriptor_BsFuSa_Display: RteEventRef=OpEventWriteBlock_WriteBlock_PS_NvBlockSwComponentTypeNVBlockDescriptor_BsFuSa_Display
          OpEventEraseBlock_EraseBlock_PS_NvBlockSwComponentTypeNVBlockDescriptor_BsReten_Power: RteEventRef=OpEventEraseBlock_EraseBlock_PS_NvBlockSwComponentTypeNVBlockDescriptor_BsReten_Power
          OpEventGetErrorStatus_GetErrorStatus_PS_NvBlockSwComponentTypeNVBlockDescriptor_BsRt_TripComputer: RteEventRef=OpEventGetErrorStatus_GetErrorStatus_PS_NvBlockSwComponentTypeNVBlockDescriptor_BsRt_TripComputer
          OpEventReadBlock_ReadBlock_PS_NvBlockSwComponentTypeNVBlockDescriptor_BsFuSa_Communication: RteEventRef=OpEventReadBlock_ReadBlock_PS_NvBlockSwComponentTypeNVBlockDescriptor_BsFuSa_Communication
          OpEventRestoreBlockDefaults_RestoreBlockDefaults_PS_NvBlockSwComponentTypeNVBlockDescriptor_BsRt_PowerGauge: RteEventRef=OpEventRestoreBlockDefaults_RestoreBlockDefaults_PS_NvBlockSwComponentTypeNVBlockDescriptor_BsRt_PowerGauge
          OpEventGetErrorStatus_GetErrorStatus_PS_NvBlockSwComponentTypeNVBlockDescriptor_BsReten_Communication: RteEventRef=OpEventGetErrorStatus_GetErrorStatus_PS_NvBlockSwComponentTypeNVBlockDescriptor_BsReten_Communication
          OpEventRestoreBlockDefaults_RestoreBlockDefaults_PS_NvBlockSwComponentTypeNVBlockDescriptor_BsConst_EngOffTimer: RteEventRef=OpEventRestoreBlockDefaults_RestoreBlockDefaults_PS_NvBlockSwComponentTypeNVBlockDescriptor_BsConst_EngOffTimer
          OpEventReadBlock_ReadBlock_PS_NvBlockSwComponentTypeNVBlockDescriptor_BsReten_VisDlt: RteEventRef=OpEventReadBlock_ReadBlock_PS_NvBlockSwComponentTypeNVBlockDescriptor_BsReten_VisDlt
          OpEventGetErrorStatus_GetErrorStatus_PS_NvBlockSwComponentTypeNVBlockDescriptor_BsReten_Audio: RteEventRef=OpEventGetErrorStatus_GetErrorStatus_PS_NvBlockSwComponentTypeNVBlockDescriptor_BsReten_Audio
          OpEventWriteBlock_WriteBlock_PS_NvBlockSwComponentTypeNVBlockDescriptor_BsConst_RealTimeClock: RteEventRef=OpEventWriteBlock_WriteBlock_PS_NvBlockSwComponentTypeNVBlockDescriptor_BsConst_RealTimeClock
          OpEventEraseBlock_EraseBlock_PS_NvBlockSwComponentTypeNVBlockDescriptor_BsRt_Odometer: RteEventRef=OpEventEraseBlock_EraseBlock_PS_NvBlockSwComponentTypeNVBlockDescriptor_BsRt_Odometer
          OpEventGetErrorStatus_GetErrorStatus_PS_NvBlockSwComponentTypeNVBlockDescriptor_BsConst_Illumination: RteEventRef=OpEventGetErrorStatus_GetErrorStatus_PS_NvBlockSwComponentTypeNVBlockDescriptor_BsConst_Illumination
          OpEventRestoreBlockDefaults_RestoreBlockDefaults_PS_NvBlockSwComponentTypeNVBlockDescriptor_BsReten_Communication: RteEventRef=OpEventRestoreBlockDefaults_RestoreBlockDefaults_PS_NvBlockSwComponentTypeNVBlockDescriptor_BsReten_Communication
          OpEventEraseBlock_EraseBlock_PS_NvBlockSwComponentTypeNVBlockDescriptor_BsRt_PowerGauge: RteEventRef=OpEventEraseBlock_EraseBlock_PS_NvBlockSwComponentTypeNVBlockDescriptor_BsRt_PowerGauge
          OpEventWriteBlock_WriteBlock_PS_NvBlockSwComponentTypeNVBlockDescriptor_BsConst_TripComputer: RteEventRef=OpEventWriteBlock_WriteBlock_PS_NvBlockSwComponentTypeNVBlockDescriptor_BsConst_TripComputer
          OpEventSetBlockProtection_SetBlockProtection_PAdmin_NvBlockSwComponentTypeNVBlockDescriptor_BsShare_VisMeet: RteEventRef=OpEventSetBlockProtection_SetBlockProtection_PAdmin_NvBlockSwComponentTypeNVBlockDescriptor_BsShare_VisMeet
          OpEventSetBlockProtection_SetBlockProtection_PAdmin_NvBlockSwComponentTypeNVBlockDescriptor_BsReten_RealTimeClock: RteEventRef=OpEventSetBlockProtection_SetBlockProtection_PAdmin_NvBlockSwComponentTypeNVBlockDescriptor_BsReten_RealTimeClock
          OpEventSetBlockProtection_SetBlockProtection_PAdmin_NvBlockSwComponentTypeNVBlockDescriptor_BsRt_TempGauge: RteEventRef=OpEventSetBlockProtection_SetBlockProtection_PAdmin_NvBlockSwComponentTypeNVBlockDescriptor_BsRt_TempGauge
          OpEventWriteBlock_WriteBlock_PS_NvBlockSwComponentTypeNVBlockDescriptor_BsRt_Illumination: RteEventRef=OpEventWriteBlock_WriteBlock_PS_NvBlockSwComponentTypeNVBlockDescriptor_BsRt_Illumination
          OpEventEraseBlock_EraseBlock_PS_NvBlockSwComponentTypeNVBlockDescriptor_BsConst_Illumination: RteEventRef=OpEventEraseBlock_EraseBlock_PS_NvBlockSwComponentTypeNVBlockDescriptor_BsConst_Illumination
          OpEventSetBlockProtection_SetBlockProtection_PAdmin_NvBlockSwComponentTypeNVBlockDescriptor_BsConst_Power: RteEventRef=OpEventSetBlockProtection_SetBlockProtection_PAdmin_NvBlockSwComponentTypeNVBlockDescriptor_BsConst_Power
          OpEventEraseBlock_EraseBlock_PS_NvBlockSwComponentTypeNVBlockDescriptor_BsReten_VisDlt: RteEventRef=OpEventEraseBlock_EraseBlock_PS_NvBlockSwComponentTypeNVBlockDescriptor_BsReten_VisDlt
          OpEventGetErrorStatus_GetErrorStatus_PS_NvBlockSwComponentTypeNVBlockDescriptor_BsShare_SwUpdReflash: RteEventRef=OpEventGetErrorStatus_GetErrorStatus_PS_NvBlockSwComponentTypeNVBlockDescriptor_BsShare_SwUpdReflash
          OpEventInvalidateNvBlock_InvalidateNvBlock_PS_NvBlockSwComponentTypeNVBlockDescriptor_BsFuSa_Communication: RteEventRef=OpEventInvalidateNvBlock_InvalidateNvBlock_PS_NvBlockSwComponentTypeNVBlockDescriptor_BsFuSa_Communication
          OpEventSetRamBlockStatus_SetRamBlockStatus_PS_NvBlockSwComponentTypeNVBlockDescriptor_BsRt_SpeedoGauge: RteEventRef=OpEventSetRamBlockStatus_SetRamBlockStatus_PS_NvBlockSwComponentTypeNVBlockDescriptor_BsRt_SpeedoGauge
          OpEventGetErrorStatus_GetErrorStatus_PS_NvBlockSwComponentTypeNVBlockDescriptor_BsConst_Power: RteEventRef=OpEventGetErrorStatus_GetErrorStatus_PS_NvBlockSwComponentTypeNVBlockDescriptor_BsConst_Power
          OpEventInvalidateNvBlock_InvalidateNvBlock_PS_NvBlockSwComponentTypeNVBlockDescriptor_BsConst_OilGauge: RteEventRef=OpEventInvalidateNvBlock_InvalidateNvBlock_PS_NvBlockSwComponentTypeNVBlockDescriptor_BsConst_OilGauge
          OpEventEraseBlock_EraseBlock_PS_NvBlockSwComponentTypeNVBlockDescriptor_BsFusa_Fota: RteEventRef=OpEventEraseBlock_EraseBlock_PS_NvBlockSwComponentTypeNVBlockDescriptor_BsFusa_Fota
          OpEventGetErrorStatus_GetErrorStatus_PS_NvBlockSwComponentTypeNVBlockDescriptor_BsReten_Gauges: RteEventRef=OpEventGetErrorStatus_GetErrorStatus_PS_NvBlockSwComponentTypeNVBlockDescriptor_BsReten_Gauges
          OpEventSetRamBlockStatus_SetRamBlockStatus_PS_NvBlockSwComponentTypeNVBlockDescriptor_BsReten_Odometer: RteEventRef=OpEventSetRamBlockStatus_SetRamBlockStatus_PS_NvBlockSwComponentTypeNVBlockDescriptor_BsReten_Odometer
          OpEventInvalidateNvBlock_InvalidateNvBlock_PS_NvBlockSwComponentTypeNVBlockDescriptor_BsShare_SwUpdFotadecrypt: RteEventRef=OpEventInvalidateNvBlock_InvalidateNvBlock_PS_NvBlockSwComponentTypeNVBlockDescriptor_BsShare_SwUpdFotadecrypt
          OpEventGetErrorStatus_GetErrorStatus_PS_NvBlockSwComponentTypeNVBlockDescriptor_BsShare_EcuPartNumber: RteEventRef=OpEventGetErrorStatus_GetErrorStatus_PS_NvBlockSwComponentTypeNVBlockDescriptor_BsShare_EcuPartNumber
          OpEventReadBlock_ReadBlock_PS_NvBlockSwComponentTypeNVBlockDescriptor_BsFuSa_Display: RteEventRef=OpEventReadBlock_ReadBlock_PS_NvBlockSwComponentTypeNVBlockDescriptor_BsFuSa_Display
          OpEventEraseBlock_EraseBlock_PS_NvBlockSwComponentTypeNVBlockDescriptor_BsRt_TripComputer: RteEventRef=OpEventEraseBlock_EraseBlock_PS_NvBlockSwComponentTypeNVBlockDescriptor_BsRt_TripComputer
          OpEventRestoreBlockDefaults_RestoreBlockDefaults_PS_NvBlockSwComponentTypeNVBlockDescriptor_BsConst_Communication: RteEventRef=OpEventRestoreBlockDefaults_RestoreBlockDefaults_PS_NvBlockSwComponentTypeNVBlockDescriptor_BsConst_Communication
          OpEventInvalidateNvBlock_InvalidateNvBlock_PS_NvBlockSwComponentTypeNVBlockDescriptor_BsConst_EngOffTimer: RteEventRef=OpEventInvalidateNvBlock_InvalidateNvBlock_PS_NvBlockSwComponentTypeNVBlockDescriptor_BsConst_EngOffTimer
          OpEventSetBlockProtection_SetBlockProtection_PAdmin_NvBlockSwComponentTypeNVBlockDescriptor_BsDiag_ErrorRecord: RteEventRef=OpEventSetBlockProtection_SetBlockProtection_PAdmin_NvBlockSwComponentTypeNVBlockDescriptor_BsDiag_ErrorRecord
          OpEventGetErrorStatus_GetErrorStatus_PS_NvBlockSwComponentTypeNVBlockDescriptor_BsRt_TempGauge: RteEventRef=OpEventGetErrorStatus_GetErrorStatus_PS_NvBlockSwComponentTypeNVBlockDescriptor_BsRt_TempGauge
          OpEventSetBlockProtection_SetBlockProtection_PAdmin_NvBlockSwComponentTypeNVBlockDescriptor_BsConst_FuelGauge: RteEventRef=OpEventSetBlockProtection_SetBlockProtection_PAdmin_NvBlockSwComponentTypeNVBlockDescriptor_BsConst_FuelGauge
          OpEventSetBlockProtection_SetBlockProtection_PAdmin_NvBlockSwComponentTypeNVBlockDescriptor_BsConst_Warning: RteEventRef=OpEventSetBlockProtection_SetBlockProtection_PAdmin_NvBlockSwComponentTypeNVBlockDescriptor_BsConst_Warning
          OpEventWriteBlock_WriteBlock_PS_NvBlockSwComponentTypeNVBlockDescriptor_BsRt_TachoGauge: RteEventRef=OpEventWriteBlock_WriteBlock_PS_NvBlockSwComponentTypeNVBlockDescriptor_BsRt_TachoGauge
          OpEventEraseBlock_EraseBlock_PS_NvBlockSwComponentTypeNVBlockDescriptor_BsConst_RealTimeClock: RteEventRef=OpEventEraseBlock_EraseBlock_PS_NvBlockSwComponentTypeNVBlockDescriptor_BsConst_RealTimeClock
          OpEventSetBlockProtection_SetBlockProtection_PAdmin_NvBlockSwComponentTypeNVBlockDescriptor_BsConst_Audio: RteEventRef=OpEventSetBlockProtection_SetBlockProtection_PAdmin_NvBlockSwComponentTypeNVBlockDescriptor_BsConst_Audio
          OpEventSetBlockProtection_SetBlockProtection_PAdmin_NvBlockSwComponentTypeNVBlockDescriptor_BsReten_Odometer: RteEventRef=OpEventSetBlockProtection_SetBlockProtection_PAdmin_NvBlockSwComponentTypeNVBlockDescriptor_BsReten_Odometer
          OpEventGetErrorStatus_GetErrorStatus_PS_NvBlockSwComponentTypeNVBlockDescriptor_BsFuSa_Power: RteEventRef=OpEventGetErrorStatus_GetErrorStatus_PS_NvBlockSwComponentTypeNVBlockDescriptor_BsFuSa_Power
          OpEventGetErrorStatus_GetErrorStatus_PS_NvBlockSwComponentTypeNVBlockDescriptor_BsRt_RealTimeClock: RteEventRef=OpEventGetErrorStatus_GetErrorStatus_PS_NvBlockSwComponentTypeNVBlockDescriptor_BsRt_RealTimeClock
          OpEventReadBlock_ReadBlock_PS_NvBlockSwComponentTypeNVBlockDescriptor_BsReten_Warning: RteEventRef=OpEventReadBlock_ReadBlock_PS_NvBlockSwComponentTypeNVBlockDescriptor_BsReten_Warning
          OpEventInvalidateNvBlock_InvalidateNvBlock_PS_NvBlockSwComponentTypeNVBlockDescriptor_BsReten_Power: RteEventRef=OpEventInvalidateNvBlock_InvalidateNvBlock_PS_NvBlockSwComponentTypeNVBlockDescriptor_BsReten_Power
          OpEventSetBlockProtection_SetBlockProtection_PAdmin_NvBlockSwComponentTypeNVBlockDescriptor_BsConst_Communication: RteEventRef=OpEventSetBlockProtection_SetBlockProtection_PAdmin_NvBlockSwComponentTypeNVBlockDescriptor_BsConst_Communication
          OpEventSetBlockProtection_SetBlockProtection_PAdmin_NvBlockSwComponentTypeNVBlockDescriptor_BsShare_EcuPartNumber: RteEventRef=OpEventSetBlockProtection_SetBlockProtection_PAdmin_NvBlockSwComponentTypeNVBlockDescriptor_BsShare_EcuPartNumber
          OpEventReadBlock_ReadBlock_PS_NvBlockSwComponentTypeNVBlockDescriptor_RefCys_Certicificate1: RteEventRef=OpEventReadBlock_ReadBlock_PS_NvBlockSwComponentTypeNVBlockDescriptor_RefCys_Certicificate1
          OpEventEraseBlock_EraseBlock_PS_NvBlockSwComponentTypeNVBlockDescriptor_BsConst_Power: RteEventRef=OpEventEraseBlock_EraseBlock_PS_NvBlockSwComponentTypeNVBlockDescriptor_BsConst_Power
          OpEventRestoreBlockDefaults_RestoreBlockDefaults_PS_NvBlockSwComponentTypeNVBlockDescriptor_BsConst_OilGauge: RteEventRef=OpEventRestoreBlockDefaults_RestoreBlockDefaults_PS_NvBlockSwComponentTypeNVBlockDescriptor_BsConst_OilGauge
          OpEventSetRamBlockStatus_SetRamBlockStatus_PS_NvBlockSwComponentTypeNVBlockDescriptor_BsConst_Audio: RteEventRef=OpEventSetRamBlockStatus_SetRamBlockStatus_PS_NvBlockSwComponentTypeNVBlockDescriptor_BsConst_Audio
          OpEventRestoreBlockDefaults_RestoreBlockDefaults_PS_NvBlockSwComponentTypeNVBlockDescriptor_BsConst_SpeedoGauge: RteEventRef=OpEventRestoreBlockDefaults_RestoreBlockDefaults_PS_NvBlockSwComponentTypeNVBlockDescriptor_BsConst_SpeedoGauge
          OpEventSetBlockProtection_SetBlockProtection_PAdmin_NvBlockSwComponentTypeNVBlockDescriptor_BsShare_SwUpdFotaStatus: RteEventRef=OpEventSetBlockProtection_SetBlockProtection_PAdmin_NvBlockSwComponentTypeNVBlockDescriptor_BsShare_SwUpdFotaStatus
          OpEventSetBlockProtection_SetBlockProtection_PAdmin_NvBlockSwComponentTypeNVBlockDescriptor_BsShare_VehicleConfig: RteEventRef=OpEventSetBlockProtection_SetBlockProtection_PAdmin_NvBlockSwComponentTypeNVBlockDescriptor_BsShare_VehicleConfig
          OpEventSetRamBlockStatus_SetRamBlockStatus_PS_NvBlockSwComponentTypeNVBlockDescriptor_BsReten_Communication: RteEventRef=OpEventSetRamBlockStatus_SetRamBlockStatus_PS_NvBlockSwComponentTypeNVBlockDescriptor_BsReten_Communication
          OpEventSetBlockProtection_SetBlockProtection_PAdmin_NvBlockSwComponentTypeNVBlockDescriptor_BsRt_Personalization: RteEventRef=OpEventSetBlockProtection_SetBlockProtection_PAdmin_NvBlockSwComponentTypeNVBlockDescriptor_BsRt_Personalization
          OpEventWriteBlock_WriteBlock_PS_NvBlockSwComponentTypeNVBlockDescriptor_BsReten_VisDlt: RteEventRef=OpEventWriteBlock_WriteBlock_PS_NvBlockSwComponentTypeNVBlockDescriptor_BsReten_VisDlt
          OpEventWriteBlock_WriteBlock_PS_NvBlockSwComponentTypeNVBlockDescriptor_BsRt_TripComputer: RteEventRef=OpEventWriteBlock_WriteBlock_PS_NvBlockSwComponentTypeNVBlockDescriptor_BsRt_TripComputer
          OpEventInvalidateNvBlock_InvalidateNvBlock_PS_NvBlockSwComponentTypeNVBlockDescriptor_BsFuSa_Audio: RteEventRef=OpEventInvalidateNvBlock_InvalidateNvBlock_PS_NvBlockSwComponentTypeNVBlockDescriptor_BsFuSa_Audio
          OpEventGetErrorStatus_GetErrorStatus_PS_NvBlockSwComponentTypeNVBlockDescriptor_BsRt_OilGauge: RteEventRef=OpEventGetErrorStatus_GetErrorStatus_PS_NvBlockSwComponentTypeNVBlockDescriptor_BsRt_OilGauge
          OpEventGetErrorStatus_GetErrorStatus_PS_NvBlockSwComponentTypeNVBlockDescriptor_BsRt_PowerGauge: RteEventRef=OpEventGetErrorStatus_GetErrorStatus_PS_NvBlockSwComponentTypeNVBlockDescriptor_BsRt_PowerGauge
          OpEventReadBlock_ReadBlock_PS_NvBlockSwComponentTypeNVBlockDescriptor_BsDiag_Dtc: RteEventRef=OpEventReadBlock_ReadBlock_PS_NvBlockSwComponentTypeNVBlockDescriptor_BsDiag_Dtc
          OpEventSetBlockProtection_SetBlockProtection_PAdmin_NvBlockSwComponentTypeNVBlockDescriptor_BsRt_FuelGauge: RteEventRef=OpEventSetBlockProtection_SetBlockProtection_PAdmin_NvBlockSwComponentTypeNVBlockDescriptor_BsRt_FuelGauge
          OpEventWriteBlock_WriteBlock_PS_NvBlockSwComponentTypeNVBlockDescriptor_BsConst_FuelGauge: RteEventRef=OpEventWriteBlock_WriteBlock_PS_NvBlockSwComponentTypeNVBlockDescriptor_BsConst_FuelGauge
          OpEventSetBlockProtection_SetBlockProtection_PAdmin_NvBlockSwComponentTypeNVBlockDescriptor_BsRt_OilGauge: RteEventRef=OpEventSetBlockProtection_SetBlockProtection_PAdmin_NvBlockSwComponentTypeNVBlockDescriptor_BsRt_OilGauge
          OpEventSetRamBlockStatus_SetRamBlockStatus_PS_NvBlockSwComponentTypeNVBlockDescriptor_BsFuSa_Power: RteEventRef=OpEventSetRamBlockStatus_SetRamBlockStatus_PS_NvBlockSwComponentTypeNVBlockDescriptor_BsFuSa_Power
          OpEventGetErrorStatus_GetErrorStatus_PS_NvBlockSwComponentTypeNVBlockDescriptor_BsReten_Personalization: RteEventRef=OpEventGetErrorStatus_GetErrorStatus_PS_NvBlockSwComponentTypeNVBlockDescriptor_BsReten_Personalization
          OpEventGetErrorStatus_GetErrorStatus_PS_NvBlockSwComponentTypeNVBlockDescriptor_BsConst_TripComputer: RteEventRef=OpEventGetErrorStatus_GetErrorStatus_PS_NvBlockSwComponentTypeNVBlockDescriptor_BsConst_TripComputer
          OpEventWriteBlock_WriteBlock_PS_NvBlockSwComponentTypeNVBlockDescriptor_BsRt_Warning: RteEventRef=OpEventWriteBlock_WriteBlock_PS_NvBlockSwComponentTypeNVBlockDescriptor_BsRt_Warning
          OpEventRestoreBlockDefaults_RestoreBlockDefaults_PS_NvBlockSwComponentTypeNVBlockDescriptor_BsRt_CusDlt: RteEventRef=OpEventRestoreBlockDefaults_RestoreBlockDefaults_PS_NvBlockSwComponentTypeNVBlockDescriptor_BsRt_CusDlt
          OpEventEraseBlock_EraseBlock_PS_NvBlockSwComponentTypeNVBlockDescriptor_BsRt_TempGauge: RteEventRef=OpEventEraseBlock_EraseBlock_PS_NvBlockSwComponentTypeNVBlockDescriptor_BsRt_TempGauge
          OpEventEraseBlock_EraseBlock_PS_NvBlockSwComponentTypeNVBlockDescriptor_BsRt_Personalization: RteEventRef=OpEventEraseBlock_EraseBlock_PS_NvBlockSwComponentTypeNVBlockDescriptor_BsRt_Personalization
          OpEventSetRamBlockStatus_SetRamBlockStatus_PS_NvBlockSwComponentTypeNVBlockDescriptor_BsShare_EcuPartNumber: RteEventRef=OpEventSetRamBlockStatus_SetRamBlockStatus_PS_NvBlockSwComponentTypeNVBlockDescriptor_BsShare_EcuPartNumber
          OpEventReadBlock_ReadBlock_PS_NvBlockSwComponentTypeNVBlockDescriptor_BsConst_ServiceReminder: RteEventRef=OpEventReadBlock_ReadBlock_PS_NvBlockSwComponentTypeNVBlockDescriptor_BsConst_ServiceReminder
          OpEventReadBlock_ReadBlock_PS_NvBlockSwComponentTypeNVBlockDescriptor_BsRt_SpeedoGauge: RteEventRef=OpEventReadBlock_ReadBlock_PS_NvBlockSwComponentTypeNVBlockDescriptor_BsRt_SpeedoGauge
          OpEventSetRamBlockStatus_SetRamBlockStatus_PS_NvBlockSwComponentTypeNVBlockDescriptor_BsRt_CusDlt: RteEventRef=OpEventSetRamBlockStatus_SetRamBlockStatus_PS_NvBlockSwComponentTypeNVBlockDescriptor_BsRt_CusDlt
          OpEventWriteBlock_WriteBlock_PS_NvBlockSwComponentTypeNVBlockDescriptor_BsFuSa_Config: RteEventRef=OpEventWriteBlock_WriteBlock_PS_NvBlockSwComponentTypeNVBlockDescriptor_BsFuSa_Config
          OpEventInvalidateNvBlock_InvalidateNvBlock_PS_NvBlockSwComponentTypeNVBlockDescriptor_BsFuSa_Power: RteEventRef=OpEventInvalidateNvBlock_InvalidateNvBlock_PS_NvBlockSwComponentTypeNVBlockDescriptor_BsFuSa_Power
          OpEventRestoreBlockDefaults_RestoreBlockDefaults_PS_NvBlockSwComponentTypeNVBlockDescriptor_BsConst_Power: RteEventRef=OpEventRestoreBlockDefaults_RestoreBlockDefaults_PS_NvBlockSwComponentTypeNVBlockDescriptor_BsConst_Power
          OpEventSetBlockProtection_SetBlockProtection_PAdmin_NvBlockSwComponentTypeNVBlockDescriptor_BsConst_OilGauge: RteEventRef=OpEventSetBlockProtection_SetBlockProtection_PAdmin_NvBlockSwComponentTypeNVBlockDescriptor_BsConst_OilGauge
          OpEventGetErrorStatus_GetErrorStatus_PS_NvBlockSwComponentTypeNVBlockDescriptor_BsConst_OilGauge: RteEventRef=OpEventGetErrorStatus_GetErrorStatus_PS_NvBlockSwComponentTypeNVBlockDescriptor_BsConst_OilGauge
          OpEventReadBlock_ReadBlock_PS_NvBlockSwComponentTypeNVBlockDescriptor_BsShare_SwUpdFotaStatus: RteEventRef=OpEventReadBlock_ReadBlock_PS_NvBlockSwComponentTypeNVBlockDescriptor_BsShare_SwUpdFotaStatus
          OpEventWriteBlock_WriteBlock_PS_NvBlockSwComponentTypeNVBlockDescriptor_BsFuSa_Communication: RteEventRef=OpEventWriteBlock_WriteBlock_PS_NvBlockSwComponentTypeNVBlockDescriptor_BsFuSa_Communication
          OpEventRestoreBlockDefaults_RestoreBlockDefaults_PS_NvBlockSwComponentTypeNVBlockDescriptor_BsShare_SwUpdFotadecrypt: RteEventRef=OpEventRestoreBlockDefaults_RestoreBlockDefaults_PS_NvBlockSwComponentTypeNVBlockDescriptor_BsShare_SwUpdFotadecrypt
          OpEventInvalidateNvBlock_InvalidateNvBlock_PS_NvBlockSwComponentTypeNVBlockDescriptor_RefCys_Certicificate: RteEventRef=OpEventInvalidateNvBlock_InvalidateNvBlock_PS_NvBlockSwComponentTypeNVBlockDescriptor_RefCys_Certicificate
          OpEventEraseBlock_EraseBlock_PS_NvBlockSwComponentTypeNVBlockDescriptor_BsShare_SwUpdFotaFinPrint: RteEventRef=OpEventEraseBlock_EraseBlock_PS_NvBlockSwComponentTypeNVBlockDescriptor_BsShare_SwUpdFotaFinPrint
          OpEventWriteBlock_WriteBlock_PS_NvBlockSwComponentTypeNVBlockDescriptor_BsShare_VehicleConfig: RteEventRef=OpEventWriteBlock_WriteBlock_PS_NvBlockSwComponentTypeNVBlockDescriptor_BsShare_VehicleConfig
          OpEventReadBlock_ReadBlock_PS_NvBlockSwComponentTypeNVBlockDescriptor_BsConst_PowerGauge: RteEventRef=OpEventReadBlock_ReadBlock_PS_NvBlockSwComponentTypeNVBlockDescriptor_BsConst_PowerGauge
          OpEventSetRamBlockStatus_SetRamBlockStatus_PS_NvBlockSwComponentTypeNVBlockDescriptor_BsRt_Illumination: RteEventRef=OpEventSetRamBlockStatus_SetRamBlockStatus_PS_NvBlockSwComponentTypeNVBlockDescriptor_BsRt_Illumination
          OpEventReadBlock_ReadBlock_PS_NvBlockSwComponentTypeNVBlockDescriptor_BsReten_Power: RteEventRef=OpEventReadBlock_ReadBlock_PS_NvBlockSwComponentTypeNVBlockDescriptor_BsReten_Power
          OpEventEraseBlock_EraseBlock_PS_NvBlockSwComponentTypeNVBlockDescriptor_BsRt_Illumination: RteEventRef=OpEventEraseBlock_EraseBlock_PS_NvBlockSwComponentTypeNVBlockDescriptor_BsRt_Illumination
          OpEventWriteBlock_WriteBlock_PS_NvBlockSwComponentTypeNVBlockDescriptor_BsReten_Display: RteEventRef=OpEventWriteBlock_WriteBlock_PS_NvBlockSwComponentTypeNVBlockDescriptor_BsReten_Display
          OpEventWriteBlock_WriteBlock_PS_NvBlockSwComponentTypeNVBlockDescriptor_BsReten_Gauges: RteEventRef=OpEventWriteBlock_WriteBlock_PS_NvBlockSwComponentTypeNVBlockDescriptor_BsReten_Gauges
          OpEventGetErrorStatus_GetErrorStatus_PS_NvBlockSwComponentTypeNVBlockDescriptor_BsRt_TachoGauge: RteEventRef=OpEventGetErrorStatus_GetErrorStatus_PS_NvBlockSwComponentTypeNVBlockDescriptor_BsRt_TachoGauge
          OpEventReadBlock_ReadBlock_PS_NvBlockSwComponentTypeNVBlockDescriptor_BsRt_PowerGauge: RteEventRef=OpEventReadBlock_ReadBlock_PS_NvBlockSwComponentTypeNVBlockDescriptor_BsRt_PowerGauge
          OpEventSetRamBlockStatus_SetRamBlockStatus_PS_NvBlockSwComponentTypeNVBlockDescriptor_BsDiag_Dtc: RteEventRef=OpEventSetRamBlockStatus_SetRamBlockStatus_PS_NvBlockSwComponentTypeNVBlockDescriptor_BsDiag_Dtc
          OpEventReadBlock_ReadBlock_PS_NvBlockSwComponentTypeNVBlockDescriptor_BsReten_Display: RteEventRef=OpEventReadBlock_ReadBlock_PS_NvBlockSwComponentTypeNVBlockDescriptor_BsReten_Display
          OpEventSetRamBlockStatus_SetRamBlockStatus_PS_NvBlockSwComponentTypeNVBlockDescriptor_BsFuSa_Warning: RteEventRef=OpEventSetRamBlockStatus_SetRamBlockStatus_PS_NvBlockSwComponentTypeNVBlockDescriptor_BsFuSa_Warning
          OpEventRestoreBlockDefaults_RestoreBlockDefaults_PS_NvBlockSwComponentTypeNVBlockDescriptor_BsRt_SpeedoGauge: RteEventRef=OpEventRestoreBlockDefaults_RestoreBlockDefaults_PS_NvBlockSwComponentTypeNVBlockDescriptor_BsRt_SpeedoGauge
          OpEventSetRamBlockStatus_SetRamBlockStatus_PS_NvBlockSwComponentTypeNVBlockDescriptor_BsShare_VehicleConfig: RteEventRef=OpEventSetRamBlockStatus_SetRamBlockStatus_PS_NvBlockSwComponentTypeNVBlockDescriptor_BsShare_VehicleConfig
          OpEventSetRamBlockStatus_SetRamBlockStatus_PS_NvBlockSwComponentTypeNVBlockDescriptor_BsConst_PowerGauge: RteEventRef=OpEventSetRamBlockStatus_SetRamBlockStatus_PS_NvBlockSwComponentTypeNVBlockDescriptor_BsConst_PowerGauge
          OpEventGetErrorStatus_GetErrorStatus_PS_NvBlockSwComponentTypeNVBlockDescriptor_BsReten_Odometer: RteEventRef=OpEventGetErrorStatus_GetErrorStatus_PS_NvBlockSwComponentTypeNVBlockDescriptor_BsReten_Odometer
          OpEventInvalidateNvBlock_InvalidateNvBlock_PS_NvBlockSwComponentTypeNVBlockDescriptor_BsRt_TachoGauge: RteEventRef=OpEventInvalidateNvBlock_InvalidateNvBlock_PS_NvBlockSwComponentTypeNVBlockDescriptor_BsRt_TachoGauge
          OpEventSetBlockProtection_SetBlockProtection_PAdmin_NvBlockSwComponentTypeNVBlockDescriptor_BsConst_TempGauge: RteEventRef=OpEventSetBlockProtection_SetBlockProtection_PAdmin_NvBlockSwComponentTypeNVBlockDescriptor_BsConst_TempGauge
          OpEventInvalidateNvBlock_InvalidateNvBlock_PS_NvBlockSwComponentTypeNVBlockDescriptor_BsReten_Odometer: RteEventRef=OpEventInvalidateNvBlock_InvalidateNvBlock_PS_NvBlockSwComponentTypeNVBlockDescriptor_BsReten_Odometer
          OpEventInvalidateNvBlock_InvalidateNvBlock_PS_NvBlockSwComponentTypeNVBlockDescriptor_BsConst_Audio: RteEventRef=OpEventInvalidateNvBlock_InvalidateNvBlock_PS_NvBlockSwComponentTypeNVBlockDescriptor_BsConst_Audio
          OpEventRestoreBlockDefaults_RestoreBlockDefaults_PS_NvBlockSwComponentTypeNVBlockDescriptor_BsConst_Audio: RteEventRef=OpEventRestoreBlockDefaults_RestoreBlockDefaults_PS_NvBlockSwComponentTypeNVBlockDescriptor_BsConst_Audio
          OpEventWriteBlock_WriteBlock_PS_NvBlockSwComponentTypeNVBlockDescriptor_BsConst_SpeedoGauge: RteEventRef=OpEventWriteBlock_WriteBlock_PS_NvBlockSwComponentTypeNVBlockDescriptor_BsConst_SpeedoGauge
          OpEventSetRamBlockStatus_SetRamBlockStatus_PS_NvBlockSwComponentTypeNVBlockDescriptor_BsShare_SwUpdFotaFinPrint: RteEventRef=OpEventSetRamBlockStatus_SetRamBlockStatus_PS_NvBlockSwComponentTypeNVBlockDescriptor_BsShare_SwUpdFotaFinPrint
          OpEventRestoreBlockDefaults_RestoreBlockDefaults_PS_NvBlockSwComponentTypeNVBlockDescriptor_BsRt_OilGauge: RteEventRef=OpEventRestoreBlockDefaults_RestoreBlockDefaults_PS_NvBlockSwComponentTypeNVBlockDescriptor_BsRt_OilGauge
          OpEventGetErrorStatus_GetErrorStatus_PS_NvBlockSwComponentTypeNVBlockDescriptor_BsConst_Communication: RteEventRef=OpEventGetErrorStatus_GetErrorStatus_PS_NvBlockSwComponentTypeNVBlockDescriptor_BsConst_Communication
          OpEventEraseBlock_EraseBlock_PS_NvBlockSwComponentTypeNVBlockDescriptor_BsFuSa_Config: RteEventRef=OpEventEraseBlock_EraseBlock_PS_NvBlockSwComponentTypeNVBlockDescriptor_BsFuSa_Config
          OpEventGetErrorStatus_GetErrorStatus_PS_NvBlockSwComponentTypeNVBlockDescriptor_BsConst_Audio: RteEventRef=OpEventGetErrorStatus_GetErrorStatus_PS_NvBlockSwComponentTypeNVBlockDescriptor_BsConst_Audio
          OpEventEraseBlock_EraseBlock_PS_NvBlockSwComponentTypeNVBlockDescriptor_BsReten_Tripcomputer: RteEventRef=OpEventEraseBlock_EraseBlock_PS_NvBlockSwComponentTypeNVBlockDescriptor_BsReten_Tripcomputer
          OpEventReadBlock_ReadBlock_PS_NvBlockSwComponentTypeNVBlockDescriptor_BsReten_Personalization: RteEventRef=OpEventReadBlock_ReadBlock_PS_NvBlockSwComponentTypeNVBlockDescriptor_BsReten_Personalization
          OpEventSetBlockProtection_SetBlockProtection_PAdmin_NvBlockSwComponentTypeNVBlockDescriptor_BsRt_PowerGauge: RteEventRef=OpEventSetBlockProtection_SetBlockProtection_PAdmin_NvBlockSwComponentTypeNVBlockDescriptor_BsRt_PowerGauge
          OpEventEraseBlock_EraseBlock_PS_NvBlockSwComponentTypeNVBlockDescriptor_BsConst_Warning: RteEventRef=OpEventEraseBlock_EraseBlock_PS_NvBlockSwComponentTypeNVBlockDescriptor_BsConst_Warning
          OpEventSetRamBlockStatus_SetRamBlockStatus_PS_NvBlockSwComponentTypeNVBlockDescriptor_BsConst_EngOffTimer: RteEventRef=OpEventSetRamBlockStatus_SetRamBlockStatus_PS_NvBlockSwComponentTypeNVBlockDescriptor_BsConst_EngOffTimer
          OpEventSetRamBlockStatus_SetRamBlockStatus_PS_NvBlockSwComponentTypeNVBlockDescriptor_BsReten_Illumination: RteEventRef=OpEventSetRamBlockStatus_SetRamBlockStatus_PS_NvBlockSwComponentTypeNVBlockDescriptor_BsReten_Illumination
          OpEventEraseBlock_EraseBlock_PS_NvBlockSwComponentTypeNVBlockDescriptor_BsConst_TripComputer: RteEventRef=OpEventEraseBlock_EraseBlock_PS_NvBlockSwComponentTypeNVBlockDescriptor_BsConst_TripComputer
          OpEventWriteBlock_WriteBlock_PS_NvBlockSwComponentTypeNVBlockDescriptor_BsRt_CusDlt: RteEventRef=OpEventWriteBlock_WriteBlock_PS_NvBlockSwComponentTypeNVBlockDescriptor_BsRt_CusDlt
          OpEventReadBlock_ReadBlock_PS_NvBlockSwComponentTypeNVBlockDescriptor_BsCys_Certicificate: RteEventRef=OpEventReadBlock_ReadBlock_PS_NvBlockSwComponentTypeNVBlockDescriptor_BsCys_Certicificate
          OpEventSetRamBlockStatus_SetRamBlockStatus_PS_NvBlockSwComponentTypeNVBlockDescriptor_BsConst_Warning: RteEventRef=OpEventSetRamBlockStatus_SetRamBlockStatus_PS_NvBlockSwComponentTypeNVBlockDescriptor_BsConst_Warning
          OpEventEraseBlock_EraseBlock_PS_NvBlockSwComponentTypeNVBlockDescriptor_BsCys_Certicificate: RteEventRef=OpEventEraseBlock_EraseBlock_PS_NvBlockSwComponentTypeNVBlockDescriptor_BsCys_Certicificate
          OpEventRestoreBlockDefaults_RestoreBlockDefaults_PS_NvBlockSwComponentTypeNVBlockDescriptor_BsReten_Personalization: RteEventRef=OpEventRestoreBlockDefaults_RestoreBlockDefaults_PS_NvBlockSwComponentTypeNVBlockDescriptor_BsReten_Personalization
          OpEventWriteBlock_WriteBlock_PS_NvBlockSwComponentTypeNVBlockDescriptor_BsRt_Personalization: RteEventRef=OpEventWriteBlock_WriteBlock_PS_NvBlockSwComponentTypeNVBlockDescriptor_BsRt_Personalization
          OpEventInvalidateNvBlock_InvalidateNvBlock_PS_NvBlockSwComponentTypeNVBlockDescriptor_BsShare_SwUpdFotaMode: RteEventRef=OpEventInvalidateNvBlock_InvalidateNvBlock_PS_NvBlockSwComponentTypeNVBlockDescriptor_BsShare_SwUpdFotaMode
          OpEventGetErrorStatus_GetErrorStatus_PS_NvBlockSwComponentTypeNVBlockDescriptor_BsRt_Personalization: RteEventRef=OpEventGetErrorStatus_GetErrorStatus_PS_NvBlockSwComponentTypeNVBlockDescriptor_BsRt_Personalization
          OpEventRestoreBlockDefaults_RestoreBlockDefaults_PS_NvBlockSwComponentTypeNVBlockDescriptor_BsReten_VisDlt: RteEventRef=OpEventRestoreBlockDefaults_RestoreBlockDefaults_PS_NvBlockSwComponentTypeNVBlockDescriptor_BsReten_VisDlt
          OpEventReadBlock_ReadBlock_PS_NvBlockSwComponentTypeNVBlockDescriptor_BsConst_Illumination: RteEventRef=OpEventReadBlock_ReadBlock_PS_NvBlockSwComponentTypeNVBlockDescriptor_BsConst_Illumination
          OpEventSetRamBlockStatus_SetRamBlockStatus_PS_NvBlockSwComponentTypeNVBlockDescriptor_BsFusa_Fota: RteEventRef=OpEventSetRamBlockStatus_SetRamBlockStatus_PS_NvBlockSwComponentTypeNVBlockDescriptor_BsFusa_Fota
          OpEventSetRamBlockStatus_SetRamBlockStatus_PS_NvBlockSwComponentTypeNVBlockDescriptor_BsShare_SwUpdFotadecrypt: RteEventRef=OpEventSetRamBlockStatus_SetRamBlockStatus_PS_NvBlockSwComponentTypeNVBlockDescriptor_BsShare_SwUpdFotadecrypt
          OpEventInvalidateNvBlock_InvalidateNvBlock_PS_NvBlockSwComponentTypeNVBlockDescriptor_BsShare_SwUpdReflash: RteEventRef=OpEventInvalidateNvBlock_InvalidateNvBlock_PS_NvBlockSwComponentTypeNVBlockDescriptor_BsShare_SwUpdReflash
          OpEventGetErrorStatus_GetErrorStatus_PS_NvBlockSwComponentTypeNVBlockDescriptor_BsFuSa_Communication: RteEventRef=OpEventGetErrorStatus_GetErrorStatus_PS_NvBlockSwComponentTypeNVBlockDescriptor_BsFuSa_Communication
          OpEventWriteBlock_WriteBlock_PS_NvBlockSwComponentTypeNVBlockDescriptor_BsConst_Communication: RteEventRef=OpEventWriteBlock_WriteBlock_PS_NvBlockSwComponentTypeNVBlockDescriptor_BsConst_Communication
          OpEventGetErrorStatus_GetErrorStatus_PS_NvBlockSwComponentTypeNVBlockDescriptor_BsConst_TachoGauge: RteEventRef=OpEventGetErrorStatus_GetErrorStatus_PS_NvBlockSwComponentTypeNVBlockDescriptor_BsConst_TachoGauge
          OpEventReadBlock_ReadBlock_PS_NvBlockSwComponentTypeNVBlockDescriptor_BsRt_Personalization: RteEventRef=OpEventReadBlock_ReadBlock_PS_NvBlockSwComponentTypeNVBlockDescriptor_BsRt_Personalization
          OpEventGetErrorStatus_GetErrorStatus_PS_NvBlockSwComponentTypeNVBlockDescriptor_BsConst_PowerGauge: RteEventRef=OpEventGetErrorStatus_GetErrorStatus_PS_NvBlockSwComponentTypeNVBlockDescriptor_BsConst_PowerGauge
          OpEventReadBlock_ReadBlock_PS_NvBlockSwComponentTypeNVBlockDescriptor_BsConst_Audio: RteEventRef=OpEventReadBlock_ReadBlock_PS_NvBlockSwComponentTypeNVBlockDescriptor_BsConst_Audio
          OpEventSetRamBlockStatus_SetRamBlockStatus_PS_NvBlockSwComponentTypeNVBlockDescriptor_BsShare_SwUpdReflash: RteEventRef=OpEventSetRamBlockStatus_SetRamBlockStatus_PS_NvBlockSwComponentTypeNVBlockDescriptor_BsShare_SwUpdReflash
          OpEventReadBlock_ReadBlock_PS_NvBlockSwComponentTypeNVBlockDescriptor_BsShare_SwUpdFotadecrypt: RteEventRef=OpEventReadBlock_ReadBlock_PS_NvBlockSwComponentTypeNVBlockDescriptor_BsShare_SwUpdFotadecrypt
          OpEventWriteBlock_WriteBlock_PS_NvBlockSwComponentTypeNVBlockDescriptor_BsRt_RealTimeClock: RteEventRef=OpEventWriteBlock_WriteBlock_PS_NvBlockSwComponentTypeNVBlockDescriptor_BsRt_RealTimeClock
          OpEventEraseBlock_EraseBlock_PS_NvBlockSwComponentTypeNVBlockDescriptor_BsConst_SpeedoGauge: RteEventRef=OpEventEraseBlock_EraseBlock_PS_NvBlockSwComponentTypeNVBlockDescriptor_BsConst_SpeedoGauge
          OpEventSetRamBlockStatus_SetRamBlockStatus_PS_NvBlockSwComponentTypeNVBlockDescriptor_BsCys_Certicificate: RteEventRef=OpEventSetRamBlockStatus_SetRamBlockStatus_PS_NvBlockSwComponentTypeNVBlockDescriptor_BsCys_Certicificate
          OpEventInvalidateNvBlock_InvalidateNvBlock_PS_NvBlockSwComponentTypeNVBlockDescriptor_BsReten_Audio: RteEventRef=OpEventInvalidateNvBlock_InvalidateNvBlock_PS_NvBlockSwComponentTypeNVBlockDescriptor_BsReten_Audio
          OpEventEraseBlock_EraseBlock_PS_NvBlockSwComponentTypeNVBlockDescriptor_BsFuSa_Communication: RteEventRef=OpEventEraseBlock_EraseBlock_PS_NvBlockSwComponentTypeNVBlockDescriptor_BsFuSa_Communication
          OpEventGetErrorStatus_GetErrorStatus_PS_NvBlockSwComponentTypeNVBlockDescriptor_BsShare_SwUpdFotadecrypt: RteEventRef=OpEventGetErrorStatus_GetErrorStatus_PS_NvBlockSwComponentTypeNVBlockDescriptor_BsShare_SwUpdFotadecrypt
          OpEventWriteBlock_WriteBlock_PS_NvBlockSwComponentTypeNVBlockDescriptor_BsRt_FuelGauge: RteEventRef=OpEventWriteBlock_WriteBlock_PS_NvBlockSwComponentTypeNVBlockDescriptor_BsRt_FuelGauge
          OpEventWriteBlock_WriteBlock_PS_NvBlockSwComponentTypeNVBlockDescriptor_BsConst_TempGauge: RteEventRef=OpEventWriteBlock_WriteBlock_PS_NvBlockSwComponentTypeNVBlockDescriptor_BsConst_TempGauge
          OpEventRestoreBlockDefaults_RestoreBlockDefaults_PS_NvBlockSwComponentTypeNVBlockDescriptor_BsConst_Warning: RteEventRef=OpEventRestoreBlockDefaults_RestoreBlockDefaults_PS_NvBlockSwComponentTypeNVBlockDescriptor_BsConst_Warning
          OpEventSetRamBlockStatus_SetRamBlockStatus_PS_NvBlockSwComponentTypeNVBlockDescriptor_BsRt_TempGauge: RteEventRef=OpEventSetRamBlockStatus_SetRamBlockStatus_PS_NvBlockSwComponentTypeNVBlockDescriptor_BsRt_TempGauge
          OpEventEraseBlock_EraseBlock_PS_NvBlockSwComponentTypeNVBlockDescriptor_BsReten_Communication: RteEventRef=OpEventEraseBlock_EraseBlock_PS_NvBlockSwComponentTypeNVBlockDescriptor_BsReten_Communication
          OpEventInvalidateNvBlock_InvalidateNvBlock_PS_NvBlockSwComponentTypeNVBlockDescriptor_BsDiag_Dtc: RteEventRef=OpEventInvalidateNvBlock_InvalidateNvBlock_PS_NvBlockSwComponentTypeNVBlockDescriptor_BsDiag_Dtc
          OpEventWriteBlock_WriteBlock_PS_NvBlockSwComponentTypeNVBlockDescriptor_BsRt_Odometer: RteEventRef=OpEventWriteBlock_WriteBlock_PS_NvBlockSwComponentTypeNVBlockDescriptor_BsRt_Odometer
          OpEventSetBlockProtection_SetBlockProtection_PAdmin_NvBlockSwComponentTypeNVBlockDescriptor_BsFuSa_Power: RteEventRef=OpEventSetBlockProtection_SetBlockProtection_PAdmin_NvBlockSwComponentTypeNVBlockDescriptor_BsFuSa_Power
          OpEventInvalidateNvBlock_InvalidateNvBlock_PS_NvBlockSwComponentTypeNVBlockDescriptor_BsConst_TripComputer: RteEventRef=OpEventInvalidateNvBlock_InvalidateNvBlock_PS_NvBlockSwComponentTypeNVBlockDescriptor_BsConst_TripComputer
          OpEventSetRamBlockStatus_SetRamBlockStatus_PS_NvBlockSwComponentTypeNVBlockDescriptor_BsConst_TachoGauge: RteEventRef=OpEventSetRamBlockStatus_SetRamBlockStatus_PS_NvBlockSwComponentTypeNVBlockDescriptor_BsConst_TachoGauge
          OpEventRestoreBlockDefaults_RestoreBlockDefaults_PS_NvBlockSwComponentTypeNVBlockDescriptor_BsReten_Audio: RteEventRef=OpEventRestoreBlockDefaults_RestoreBlockDefaults_PS_NvBlockSwComponentTypeNVBlockDescriptor_BsReten_Audio
          OpEventRestoreBlockDefaults_RestoreBlockDefaults_PS_NvBlockSwComponentTypeNVBlockDescriptor_BsReten_Gauges: RteEventRef=OpEventRestoreBlockDefaults_RestoreBlockDefaults_PS_NvBlockSwComponentTypeNVBlockDescriptor_BsReten_Gauges
          OpEventGetErrorStatus_GetErrorStatus_PS_NvBlockSwComponentTypeNVBlockDescriptor_BsFuSa_Config: RteEventRef=OpEventGetErrorStatus_GetErrorStatus_PS_NvBlockSwComponentTypeNVBlockDescriptor_BsFuSa_Config
          OpEventSetRamBlockStatus_SetRamBlockStatus_PS_NvBlockSwComponentTypeNVBlockDescriptor_RefCys_Certicificate: RteEventRef=OpEventSetRamBlockStatus_SetRamBlockStatus_PS_NvBlockSwComponentTypeNVBlockDescriptor_RefCys_Certicificate
          OpEventGetErrorStatus_GetErrorStatus_PS_NvBlockSwComponentTypeNVBlockDescriptor_BsReten_Tripcomputer: RteEventRef=OpEventGetErrorStatus_GetErrorStatus_PS_NvBlockSwComponentTypeNVBlockDescriptor_BsReten_Tripcomputer
          OpEventReadBlock_ReadBlock_PS_NvBlockSwComponentTypeNVBlockDescriptor_BsReten_Odometer: RteEventRef=OpEventReadBlock_ReadBlock_PS_NvBlockSwComponentTypeNVBlockDescriptor_BsReten_Odometer
          OpEventEraseBlock_EraseBlock_PS_NvBlockSwComponentTypeNVBlockDescriptor_BsFuSa_Audio: RteEventRef=OpEventEraseBlock_EraseBlock_PS_NvBlockSwComponentTypeNVBlockDescriptor_BsFuSa_Audio
          OpEventRestoreBlockDefaults_RestoreBlockDefaults_PS_NvBlockSwComponentTypeNVBlockDescriptor_BsCys_Certicificate: RteEventRef=OpEventRestoreBlockDefaults_RestoreBlockDefaults_PS_NvBlockSwComponentTypeNVBlockDescriptor_BsCys_Certicificate
          OpEventSetBlockProtection_SetBlockProtection_PAdmin_NvBlockSwComponentTypeNVBlockDescriptor_RefCys_Certicificate: RteEventRef=OpEventSetBlockProtection_SetBlockProtection_PAdmin_NvBlockSwComponentTypeNVBlockDescriptor_RefCys_Certicificate
          OpEventInvalidateNvBlock_InvalidateNvBlock_PS_NvBlockSwComponentTypeNVBlockDescriptor_BsReten_Warning: RteEventRef=OpEventInvalidateNvBlock_InvalidateNvBlock_PS_NvBlockSwComponentTypeNVBlockDescriptor_BsReten_Warning
          OpEventEraseBlock_EraseBlock_PS_NvBlockSwComponentTypeNVBlockDescriptor_BsFuSa_Warning: RteEventRef=OpEventEraseBlock_EraseBlock_PS_NvBlockSwComponentTypeNVBlockDescriptor_BsFuSa_Warning
          OpEventRestoreBlockDefaults_RestoreBlockDefaults_PS_NvBlockSwComponentTypeNVBlockDescriptor_BsFuSa_Config: RteEventRef=OpEventRestoreBlockDefaults_RestoreBlockDefaults_PS_NvBlockSwComponentTypeNVBlockDescriptor_BsFuSa_Config
          OpEventRestoreBlockDefaults_RestoreBlockDefaults_PS_NvBlockSwComponentTypeNVBlockDescriptor_BsFusa_Fota: RteEventRef=OpEventRestoreBlockDefaults_RestoreBlockDefaults_PS_NvBlockSwComponentTypeNVBlockDescriptor_BsFusa_Fota
          OpEventGetErrorStatus_GetErrorStatus_PS_NvBlockSwComponentTypeNVBlockDescriptor_BsConst_FuelGauge: RteEventRef=OpEventGetErrorStatus_GetErrorStatus_PS_NvBlockSwComponentTypeNVBlockDescriptor_BsConst_FuelGauge
          OpEventGetErrorStatus_GetErrorStatus_PS_NvBlockSwComponentTypeNVBlockDescriptor_BsCys_Certicificate: RteEventRef=OpEventGetErrorStatus_GetErrorStatus_PS_NvBlockSwComponentTypeNVBlockDescriptor_BsCys_Certicificate
          OpEventReadBlock_ReadBlock_PS_NvBlockSwComponentTypeNVBlockDescriptor_BsConst_Warning: RteEventRef=OpEventReadBlock_ReadBlock_PS_NvBlockSwComponentTypeNVBlockDescriptor_BsConst_Warning
          OpEventReadBlock_ReadBlock_PS_NvBlockSwComponentTypeNVBlockDescriptor_BsReten_Audio: RteEventRef=OpEventReadBlock_ReadBlock_PS_NvBlockSwComponentTypeNVBlockDescriptor_BsReten_Audio
          OpEventGetErrorStatus_GetErrorStatus_PS_NvBlockSwComponentTypeNVBlockDescriptor_BsReten_RealTimeClock: RteEventRef=OpEventGetErrorStatus_GetErrorStatus_PS_NvBlockSwComponentTypeNVBlockDescriptor_BsReten_RealTimeClock
          OpEventSetBlockProtection_SetBlockProtection_PAdmin_NvBlockSwComponentTypeNVBlockDescriptor_BsRt_Illumination: RteEventRef=OpEventSetBlockProtection_SetBlockProtection_PAdmin_NvBlockSwComponentTypeNVBlockDescriptor_BsRt_Illumination
          OpEventRestoreBlockDefaults_RestoreBlockDefaults_PS_NvBlockSwComponentTypeNVBlockDescriptor_BsReten_RealTimeClock: RteEventRef=OpEventRestoreBlockDefaults_RestoreBlockDefaults_PS_NvBlockSwComponentTypeNVBlockDescriptor_BsReten_RealTimeClock
          OpEventRestoreBlockDefaults_RestoreBlockDefaults_PS_NvBlockSwComponentTypeNVBlockDescriptor_BsRt_TachoGauge: RteEventRef=OpEventRestoreBlockDefaults_RestoreBlockDefaults_PS_NvBlockSwComponentTypeNVBlockDescriptor_BsRt_TachoGauge
          OpEventEraseBlock_EraseBlock_PS_NvBlockSwComponentTypeNVBlockDescriptor_BsRt_CusDlt: RteEventRef=OpEventEraseBlock_EraseBlock_PS_NvBlockSwComponentTypeNVBlockDescriptor_BsRt_CusDlt
          OpEventInvalidateNvBlock_InvalidateNvBlock_PS_NvBlockSwComponentTypeNVBlockDescriptor_BsConst_RealTimeClock: RteEventRef=OpEventInvalidateNvBlock_InvalidateNvBlock_PS_NvBlockSwComponentTypeNVBlockDescriptor_BsConst_RealTimeClock
          OpEventSetBlockProtection_SetBlockProtection_PAdmin_NvBlockSwComponentTypeNVBlockDescriptor_BsReten_Communication: RteEventRef=OpEventSetBlockProtection_SetBlockProtection_PAdmin_NvBlockSwComponentTypeNVBlockDescriptor_BsReten_Communication
          OpEventEraseBlock_EraseBlock_PS_NvBlockSwComponentTypeNVBlockDescriptor_BsReten_Audio: RteEventRef=OpEventEraseBlock_EraseBlock_PS_NvBlockSwComponentTypeNVBlockDescriptor_BsReten_Audio
          OpEventRestoreBlockDefaults_RestoreBlockDefaults_PS_NvBlockSwComponentTypeNVBlockDescriptor_BsShare_SwUpdFotaMode: RteEventRef=OpEventRestoreBlockDefaults_RestoreBlockDefaults_PS_NvBlockSwComponentTypeNVBlockDescriptor_BsShare_SwUpdFotaMode
          OpEventSetRamBlockStatus_SetRamBlockStatus_PS_NvBlockSwComponentTypeNVBlockDescriptor_BsConst_Communication: RteEventRef=OpEventSetRamBlockStatus_SetRamBlockStatus_PS_NvBlockSwComponentTypeNVBlockDescriptor_BsConst_Communication
          OpEventSetRamBlockStatus_SetRamBlockStatus_PS_NvBlockSwComponentTypeNVBlockDescriptor_BsConst_Power: RteEventRef=OpEventSetRamBlockStatus_SetRamBlockStatus_PS_NvBlockSwComponentTypeNVBlockDescriptor_BsConst_Power
          OpEventEraseBlock_EraseBlock_PS_NvBlockSwComponentTypeNVBlockDescriptor_BsConst_FuelGauge: RteEventRef=OpEventEraseBlock_EraseBlock_PS_NvBlockSwComponentTypeNVBlockDescriptor_BsConst_FuelGauge
          OpEventReadBlock_ReadBlock_PS_NvBlockSwComponentTypeNVBlockDescriptor_BsConst_SpeedoGauge: RteEventRef=OpEventReadBlock_ReadBlock_PS_NvBlockSwComponentTypeNVBlockDescriptor_BsConst_SpeedoGauge
          OpEventWriteBlock_WriteBlock_PS_NvBlockSwComponentTypeNVBlockDescriptor_BsReten_Tripcomputer: RteEventRef=OpEventWriteBlock_WriteBlock_PS_NvBlockSwComponentTypeNVBlockDescriptor_BsReten_Tripcomputer
          OpEventInvalidateNvBlock_InvalidateNvBlock_PS_NvBlockSwComponentTypeNVBlockDescriptor_BsRt_SpeedoGauge: RteEventRef=OpEventInvalidateNvBlock_InvalidateNvBlock_PS_NvBlockSwComponentTypeNVBlockDescriptor_BsRt_SpeedoGauge
          OpEventSetBlockProtection_SetBlockProtection_PAdmin_NvBlockSwComponentTypeNVBlockDescriptor_BsFuSa_Warning: RteEventRef=OpEventSetBlockProtection_SetBlockProtection_PAdmin_NvBlockSwComponentTypeNVBlockDescriptor_BsFuSa_Warning
          OpEventRestoreBlockDefaults_RestoreBlockDefaults_PS_NvBlockSwComponentTypeNVBlockDescriptor_BsShare_VehicleConfig: RteEventRef=OpEventRestoreBlockDefaults_RestoreBlockDefaults_PS_NvBlockSwComponentTypeNVBlockDescriptor_BsShare_VehicleConfig
          OpEventGetErrorStatus_GetErrorStatus_PS_NvBlockSwComponentTypeNVBlockDescriptor_BsReten_Power: RteEventRef=OpEventGetErrorStatus_GetErrorStatus_PS_NvBlockSwComponentTypeNVBlockDescriptor_BsReten_Power
          OpEventEraseBlock_EraseBlock_PS_NvBlockSwComponentTypeNVBlockDescriptor_BsRt_RealTimeClock: RteEventRef=OpEventEraseBlock_EraseBlock_PS_NvBlockSwComponentTypeNVBlockDescriptor_BsRt_RealTimeClock
          OpEventEraseBlock_EraseBlock_PS_NvBlockSwComponentTypeNVBlockDescriptor_RefCys_Certicificate1: RteEventRef=OpEventEraseBlock_EraseBlock_PS_NvBlockSwComponentTypeNVBlockDescriptor_RefCys_Certicificate1
          OpEventInvalidateNvBlock_InvalidateNvBlock_PS_NvBlockSwComponentTypeNVBlockDescriptor_BsRt_Odometer: RteEventRef=OpEventInvalidateNvBlock_InvalidateNvBlock_PS_NvBlockSwComponentTypeNVBlockDescriptor_BsRt_Odometer
          OpEventRestoreBlockDefaults_RestoreBlockDefaults_PS_NvBlockSwComponentTypeNVBlockDescriptor_BsConst_TempGauge: RteEventRef=OpEventRestoreBlockDefaults_RestoreBlockDefaults_PS_NvBlockSwComponentTypeNVBlockDescriptor_BsConst_TempGauge
          OpEventEraseBlock_EraseBlock_PS_NvBlockSwComponentTypeNVBlockDescriptor_BsReten_Warning: RteEventRef=OpEventEraseBlock_EraseBlock_PS_NvBlockSwComponentTypeNVBlockDescriptor_BsReten_Warning
          OpEventEraseBlock_EraseBlock_PS_NvBlockSwComponentTypeNVBlockDescriptor_BsRt_FuelGauge: RteEventRef=OpEventEraseBlock_EraseBlock_PS_NvBlockSwComponentTypeNVBlockDescriptor_BsRt_FuelGauge
          OpEventWriteBlock_WriteBlock_PS_NvBlockSwComponentTypeNVBlockDescriptor_BsDiag_ErrorRecord: RteEventRef=OpEventWriteBlock_WriteBlock_PS_NvBlockSwComponentTypeNVBlockDescriptor_BsDiag_ErrorRecord
          OpEventReadBlock_ReadBlock_PS_NvBlockSwComponentTypeNVBlockDescriptor_BsConst_FuelGauge: RteEventRef=OpEventReadBlock_ReadBlock_PS_NvBlockSwComponentTypeNVBlockDescriptor_BsConst_FuelGauge
          OpEventEraseBlock_EraseBlock_PS_NvBlockSwComponentTypeNVBlockDescriptor_BsFuSa_Display: RteEventRef=OpEventEraseBlock_EraseBlock_PS_NvBlockSwComponentTypeNVBlockDescriptor_BsFuSa_Display
          OpEventSetBlockProtection_SetBlockProtection_PAdmin_NvBlockSwComponentTypeNVBlockDescriptor_BsReten_Personalization: RteEventRef=OpEventSetBlockProtection_SetBlockProtection_PAdmin_NvBlockSwComponentTypeNVBlockDescriptor_BsReten_Personalization
          OpEventSetRamBlockStatus_SetRamBlockStatus_PS_NvBlockSwComponentTypeNVBlockDescriptor_BsShare_SwUpdFotaStatus: RteEventRef=OpEventSetRamBlockStatus_SetRamBlockStatus_PS_NvBlockSwComponentTypeNVBlockDescriptor_BsShare_SwUpdFotaStatus
          OpEventReadBlock_ReadBlock_PS_NvBlockSwComponentTypeNVBlockDescriptor_BsRt_TempGauge: RteEventRef=OpEventReadBlock_ReadBlock_PS_NvBlockSwComponentTypeNVBlockDescriptor_BsRt_TempGauge
          OpEventSetBlockProtection_SetBlockProtection_PAdmin_NvBlockSwComponentTypeNVBlockDescriptor_BsFuSa_Display: RteEventRef=OpEventSetBlockProtection_SetBlockProtection_PAdmin_NvBlockSwComponentTypeNVBlockDescriptor_BsFuSa_Display
          OpEventGetErrorStatus_GetErrorStatus_PS_NvBlockSwComponentTypeNVBlockDescriptor_BsDiag_Dtc: RteEventRef=OpEventGetErrorStatus_GetErrorStatus_PS_NvBlockSwComponentTypeNVBlockDescriptor_BsDiag_Dtc
          OpEventSetBlockProtection_SetBlockProtection_PAdmin_NvBlockSwComponentTypeNVBlockDescriptor_BsReten_VisDlt: RteEventRef=OpEventSetBlockProtection_SetBlockProtection_PAdmin_NvBlockSwComponentTypeNVBlockDescriptor_BsReten_VisDlt
          OpEventReadBlock_ReadBlock_PS_NvBlockSwComponentTypeNVBlockDescriptor_BsConst_TachoGauge: RteEventRef=OpEventReadBlock_ReadBlock_PS_NvBlockSwComponentTypeNVBlockDescriptor_BsConst_TachoGauge
          OpEventReadBlock_ReadBlock_PS_NvBlockSwComponentTypeNVBlockDescriptor_BsShare_SwUpdFotaMode: RteEventRef=OpEventReadBlock_ReadBlock_PS_NvBlockSwComponentTypeNVBlockDescriptor_BsShare_SwUpdFotaMode
          OpEventSetRamBlockStatus_SetRamBlockStatus_PS_NvBlockSwComponentTypeNVBlockDescriptor_BsFuSa_Config: RteEventRef=OpEventSetRamBlockStatus_SetRamBlockStatus_PS_NvBlockSwComponentTypeNVBlockDescriptor_BsFuSa_Config
          OpEventSetRamBlockStatus_SetRamBlockStatus_PS_NvBlockSwComponentTypeNVBlockDescriptor_BsReten_RealTimeClock: RteEventRef=OpEventSetRamBlockStatus_SetRamBlockStatus_PS_NvBlockSwComponentTypeNVBlockDescriptor_BsReten_RealTimeClock
          OpEventSetRamBlockStatus_SetRamBlockStatus_PS_NvBlockSwComponentTypeNVBlockDescriptor_BsShare_SwUpdFotaMode: RteEventRef=OpEventSetRamBlockStatus_SetRamBlockStatus_PS_NvBlockSwComponentTypeNVBlockDescriptor_BsShare_SwUpdFotaMode
          OpEventSetBlockProtection_SetBlockProtection_PAdmin_NvBlockSwComponentTypeNVBlockDescriptor_BsConst_RealTimeClock: RteEventRef=OpEventSetBlockProtection_SetBlockProtection_PAdmin_NvBlockSwComponentTypeNVBlockDescriptor_BsConst_RealTimeClock
          OpEventEraseBlock_EraseBlock_PS_NvBlockSwComponentTypeNVBlockDescriptor_BsConst_Audio: RteEventRef=OpEventEraseBlock_EraseBlock_PS_NvBlockSwComponentTypeNVBlockDescriptor_BsConst_Audio
          OpEventEraseBlock_EraseBlock_PS_NvBlockSwComponentTypeNVBlockDescriptor_BsShare_SwUpdFotadecrypt: RteEventRef=OpEventEraseBlock_EraseBlock_PS_NvBlockSwComponentTypeNVBlockDescriptor_BsShare_SwUpdFotadecrypt
          OpEventWriteBlock_WriteBlock_PS_NvBlockSwComponentTypeNVBlockDescriptor_BsReten_RealTimeClock: RteEventRef=OpEventWriteBlock_WriteBlock_PS_NvBlockSwComponentTypeNVBlockDescriptor_BsReten_RealTimeClock
          OpEventInvalidateNvBlock_InvalidateNvBlock_PS_NvBlockSwComponentTypeNVBlockDescriptor_BsRt_Warning: RteEventRef=OpEventInvalidateNvBlock_InvalidateNvBlock_PS_NvBlockSwComponentTypeNVBlockDescriptor_BsRt_Warning
          OpEventInvalidateNvBlock_InvalidateNvBlock_PS_NvBlockSwComponentTypeNVBlockDescriptor_BsConst_Illumination: RteEventRef=OpEventInvalidateNvBlock_InvalidateNvBlock_PS_NvBlockSwComponentTypeNVBlockDescriptor_BsConst_Illumination
          OpEventInvalidateNvBlock_InvalidateNvBlock_PS_NvBlockSwComponentTypeNVBlockDescriptor_BsFuSa_Display: RteEventRef=OpEventInvalidateNvBlock_InvalidateNvBlock_PS_NvBlockSwComponentTypeNVBlockDescriptor_BsFuSa_Display
          OpEventReadBlock_ReadBlock_PS_NvBlockSwComponentTypeNVBlockDescriptor_BsRt_RealTimeClock: RteEventRef=OpEventReadBlock_ReadBlock_PS_NvBlockSwComponentTypeNVBlockDescriptor_BsRt_RealTimeClock
          OpEventWriteBlock_WriteBlock_PS_NvBlockSwComponentTypeNVBlockDescriptor_BsConst_OilGauge: RteEventRef=OpEventWriteBlock_WriteBlock_PS_NvBlockSwComponentTypeNVBlockDescriptor_BsConst_OilGauge
          OpEventRestoreBlockDefaults_RestoreBlockDefaults_PS_NvBlockSwComponentTypeNVBlockDescriptor_BsRt_TripComputer: RteEventRef=OpEventRestoreBlockDefaults_RestoreBlockDefaults_PS_NvBlockSwComponentTypeNVBlockDescriptor_BsRt_TripComputer
          OpEventRestoreBlockDefaults_RestoreBlockDefaults_PS_NvBlockSwComponentTypeNVBlockDescriptor_BsConst_RealTimeClock: RteEventRef=OpEventRestoreBlockDefaults_RestoreBlockDefaults_PS_NvBlockSwComponentTypeNVBlockDescriptor_BsConst_RealTimeClock
          OpEventGetErrorStatus_GetErrorStatus_PS_NvBlockSwComponentTypeNVBlockDescriptor_BsShare_VehicleConfig: RteEventRef=OpEventGetErrorStatus_GetErrorStatus_PS_NvBlockSwComponentTypeNVBlockDescriptor_BsShare_VehicleConfig
          OpEventSetRamBlockStatus_SetRamBlockStatus_PS_NvBlockSwComponentTypeNVBlockDescriptor_BsFuSa_Display: RteEventRef=OpEventSetRamBlockStatus_SetRamBlockStatus_PS_NvBlockSwComponentTypeNVBlockDescriptor_BsFuSa_Display
          OpEventRestoreBlockDefaults_RestoreBlockDefaults_PS_NvBlockSwComponentTypeNVBlockDescriptor_BsRt_Illumination: RteEventRef=OpEventRestoreBlockDefaults_RestoreBlockDefaults_PS_NvBlockSwComponentTypeNVBlockDescriptor_BsRt_Illumination
          OpEventRestoreBlockDefaults_RestoreBlockDefaults_PS_NvBlockSwComponentTypeNVBlockDescriptor_BsShare_SwUpdFotaStatus: RteEventRef=OpEventRestoreBlockDefaults_RestoreBlockDefaults_PS_NvBlockSwComponentTypeNVBlockDescriptor_BsShare_SwUpdFotaStatus
          OpEventSetRamBlockStatus_SetRamBlockStatus_PS_NvBlockSwComponentTypeNVBlockDescriptor_BsReten_Personalization: RteEventRef=OpEventSetRamBlockStatus_SetRamBlockStatus_PS_NvBlockSwComponentTypeNVBlockDescriptor_BsReten_Personalization
          OpEventReadBlock_ReadBlock_PS_NvBlockSwComponentTypeNVBlockDescriptor_BsConst_OilGauge: RteEventRef=OpEventReadBlock_ReadBlock_PS_NvBlockSwComponentTypeNVBlockDescriptor_BsConst_OilGauge
          OpEventEraseBlock_EraseBlock_PS_NvBlockSwComponentTypeNVBlockDescriptor_BsReten_RealTimeClock: RteEventRef=OpEventEraseBlock_EraseBlock_PS_NvBlockSwComponentTypeNVBlockDescriptor_BsReten_RealTimeClock
          OpEventWriteBlock_WriteBlock_PS_NvBlockSwComponentTypeNVBlockDescriptor_BsDiag_Dtc: RteEventRef=OpEventWriteBlock_WriteBlock_PS_NvBlockSwComponentTypeNVBlockDescriptor_BsDiag_Dtc
          OpEventRestoreBlockDefaults_RestoreBlockDefaults_PS_NvBlockSwComponentTypeNVBlockDescriptor_BsReten_Display: RteEventRef=OpEventRestoreBlockDefaults_RestoreBlockDefaults_PS_NvBlockSwComponentTypeNVBlockDescriptor_BsReten_Display
          OpEventSetBlockProtection_SetBlockProtection_PAdmin_NvBlockSwComponentTypeNVBlockDescriptor_BsRt_CusDlt: RteEventRef=OpEventSetBlockProtection_SetBlockProtection_PAdmin_NvBlockSwComponentTypeNVBlockDescriptor_BsRt_CusDlt
          OpEventRestoreBlockDefaults_RestoreBlockDefaults_PS_NvBlockSwComponentTypeNVBlockDescriptor_BsFuSa_Communication: RteEventRef=OpEventRestoreBlockDefaults_RestoreBlockDefaults_PS_NvBlockSwComponentTypeNVBlockDescriptor_BsFuSa_Communication
          OpEventGetErrorStatus_GetErrorStatus_PS_NvBlockSwComponentTypeNVBlockDescriptor_BsConst_ServiceReminder: RteEventRef=OpEventGetErrorStatus_GetErrorStatus_PS_NvBlockSwComponentTypeNVBlockDescriptor_BsConst_ServiceReminder
          OpEventEraseBlock_EraseBlock_PS_NvBlockSwComponentTypeNVBlockDescriptor_BsConst_Communication: RteEventRef=OpEventEraseBlock_EraseBlock_PS_NvBlockSwComponentTypeNVBlockDescriptor_BsConst_Communication
          OpEventSetBlockProtection_SetBlockProtection_PAdmin_NvBlockSwComponentTypeNVBlockDescriptor_BsShare_SwUpdFotaFinPrint: RteEventRef=OpEventSetBlockProtection_SetBlockProtection_PAdmin_NvBlockSwComponentTypeNVBlockDescriptor_BsShare_SwUpdFotaFinPrint
          OpEventGetErrorStatus_GetErrorStatus_PS_NvBlockSwComponentTypeNVBlockDescriptor_BsFuSa_Audio: RteEventRef=OpEventGetErrorStatus_GetErrorStatus_PS_NvBlockSwComponentTypeNVBlockDescriptor_BsFuSa_Audio
          OpEventReadBlock_ReadBlock_PS_NvBlockSwComponentTypeNVBlockDescriptor_BsConst_Power: RteEventRef=OpEventReadBlock_ReadBlock_PS_NvBlockSwComponentTypeNVBlockDescriptor_BsConst_Power
          OpEventReadBlock_ReadBlock_PS_NvBlockSwComponentTypeNVBlockDescriptor_BsFuSa_Config: RteEventRef=OpEventReadBlock_ReadBlock_PS_NvBlockSwComponentTypeNVBlockDescriptor_BsFuSa_Config
          OpEventSetBlockProtection_SetBlockProtection_PAdmin_NvBlockSwComponentTypeNVBlockDescriptor_BsReten_Audio: RteEventRef=OpEventSetBlockProtection_SetBlockProtection_PAdmin_NvBlockSwComponentTypeNVBlockDescriptor_BsReten_Audio
          OpEventWriteBlock_WriteBlock_PS_NvBlockSwComponentTypeNVBlockDescriptor_BsReten_Personalization: RteEventRef=OpEventWriteBlock_WriteBlock_PS_NvBlockSwComponentTypeNVBlockDescriptor_BsReten_Personalization
          OpEventInvalidateNvBlock_InvalidateNvBlock_PS_NvBlockSwComponentTypeNVBlockDescriptor_BsRt_PowerGauge: RteEventRef=OpEventInvalidateNvBlock_InvalidateNvBlock_PS_NvBlockSwComponentTypeNVBlockDescriptor_BsRt_PowerGauge
          OpEventSetRamBlockStatus_SetRamBlockStatus_PS_NvBlockSwComponentTypeNVBlockDescriptor_BsReten_Warning: RteEventRef=OpEventSetRamBlockStatus_SetRamBlockStatus_PS_NvBlockSwComponentTypeNVBlockDescriptor_BsReten_Warning
          OpEventRestoreBlockDefaults_RestoreBlockDefaults_PS_NvBlockSwComponentTypeNVBlockDescriptor_BsFuSa_Warning: RteEventRef=OpEventRestoreBlockDefaults_RestoreBlockDefaults_PS_NvBlockSwComponentTypeNVBlockDescriptor_BsFuSa_Warning
          OpEventInvalidateNvBlock_InvalidateNvBlock_PS_NvBlockSwComponentTypeNVBlockDescriptor_BsReten_Gauges: RteEventRef=OpEventInvalidateNvBlock_InvalidateNvBlock_PS_NvBlockSwComponentTypeNVBlockDescriptor_BsReten_Gauges
          OpEventReadBlock_ReadBlock_PS_NvBlockSwComponentTypeNVBlockDescriptor_BsShare_VehicleConfig: RteEventRef=OpEventReadBlock_ReadBlock_PS_NvBlockSwComponentTypeNVBlockDescriptor_BsShare_VehicleConfig
          OpEventWriteBlock_WriteBlock_PS_NvBlockSwComponentTypeNVBlockDescriptor_BsReten_Communication: RteEventRef=OpEventWriteBlock_WriteBlock_PS_NvBlockSwComponentTypeNVBlockDescriptor_BsReten_Communication
          OpEventInvalidateNvBlock_InvalidateNvBlock_PS_NvBlockSwComponentTypeNVBlockDescriptor_BsShare_EcuPartNumber: RteEventRef=OpEventInvalidateNvBlock_InvalidateNvBlock_PS_NvBlockSwComponentTypeNVBlockDescriptor_BsShare_EcuPartNumber
          OpEventInvalidateNvBlock_InvalidateNvBlock_PS_NvBlockSwComponentTypeNVBlockDescriptor_BsReten_Illumination: RteEventRef=OpEventInvalidateNvBlock_InvalidateNvBlock_PS_NvBlockSwComponentTypeNVBlockDescriptor_BsReten_Illumination
          OpEventEraseBlock_EraseBlock_PS_NvBlockSwComponentTypeNVBlockDescriptor_BsRt_SpeedoGauge: RteEventRef=OpEventEraseBlock_EraseBlock_PS_NvBlockSwComponentTypeNVBlockDescriptor_BsRt_SpeedoGauge
          OpEventSetBlockProtection_SetBlockProtection_PAdmin_NvBlockSwComponentTypeNVBlockDescriptor_BsConst_EngOffTimer: RteEventRef=OpEventSetBlockProtection_SetBlockProtection_PAdmin_NvBlockSwComponentTypeNVBlockDescriptor_BsConst_EngOffTimer
          OpEventWriteBlock_WriteBlock_PS_NvBlockSwComponentTypeNVBlockDescriptor_BsShare_SwUpdFotaMode: RteEventRef=OpEventWriteBlock_WriteBlock_PS_NvBlockSwComponentTypeNVBlockDescriptor_BsShare_SwUpdFotaMode
          OpEventEraseBlock_EraseBlock_PS_NvBlockSwComponentTypeNVBlockDescriptor_BsReten_Illumination: RteEventRef=OpEventEraseBlock_EraseBlock_PS_NvBlockSwComponentTypeNVBlockDescriptor_BsReten_Illumination
          OpEventWriteBlock_WriteBlock_PS_NvBlockSwComponentTypeNVBlockDescriptor_RefCys_Certicificate1: RteEventRef=OpEventWriteBlock_WriteBlock_PS_NvBlockSwComponentTypeNVBlockDescriptor_RefCys_Certicificate1
          OpEventWriteBlock_WriteBlock_PS_NvBlockSwComponentTypeNVBlockDescriptor_BsShare_VisMeet: RteEventRef=OpEventWriteBlock_WriteBlock_PS_NvBlockSwComponentTypeNVBlockDescriptor_BsShare_VisMeet
          OpEventInvalidateNvBlock_InvalidateNvBlock_PS_NvBlockSwComponentTypeNVBlockDescriptor_BsReten_RealTimeClock: RteEventRef=OpEventInvalidateNvBlock_InvalidateNvBlock_PS_NvBlockSwComponentTypeNVBlockDescriptor_BsReten_RealTimeClock
          OpEventSetRamBlockStatus_SetRamBlockStatus_PS_NvBlockSwComponentTypeNVBlockDescriptor_BsConst_TempGauge: RteEventRef=OpEventSetRamBlockStatus_SetRamBlockStatus_PS_NvBlockSwComponentTypeNVBlockDescriptor_BsConst_TempGauge
          OpEventSetRamBlockStatus_SetRamBlockStatus_PS_NvBlockSwComponentTypeNVBlockDescriptor_BsFuSa_Communication: RteEventRef=OpEventSetRamBlockStatus_SetRamBlockStatus_PS_NvBlockSwComponentTypeNVBlockDescriptor_BsFuSa_Communication
          OpEventReadBlock_ReadBlock_PS_NvBlockSwComponentTypeNVBlockDescriptor_BsRt_TripComputer: RteEventRef=OpEventReadBlock_ReadBlock_PS_NvBlockSwComponentTypeNVBlockDescriptor_BsRt_TripComputer
          OpEventRestoreBlockDefaults_RestoreBlockDefaults_PS_NvBlockSwComponentTypeNVBlockDescriptor_BsRt_Odometer: RteEventRef=OpEventRestoreBlockDefaults_RestoreBlockDefaults_PS_NvBlockSwComponentTypeNVBlockDescriptor_BsRt_Odometer
          OpEventSetBlockProtection_SetBlockProtection_PAdmin_NvBlockSwComponentTypeNVBlockDescriptor_RefCys_Certicificate1: RteEventRef=OpEventSetBlockProtection_SetBlockProtection_PAdmin_NvBlockSwComponentTypeNVBlockDescriptor_RefCys_Certicificate1
          OpEventReadBlock_ReadBlock_PS_NvBlockSwComponentTypeNVBlockDescriptor_BsFuSa_Audio: RteEventRef=OpEventReadBlock_ReadBlock_PS_NvBlockSwComponentTypeNVBlockDescriptor_BsFuSa_Audio
          OpEventReadBlock_ReadBlock_PS_NvBlockSwComponentTypeNVBlockDescriptor_BsReten_Illumination: RteEventRef=OpEventReadBlock_ReadBlock_PS_NvBlockSwComponentTypeNVBlockDescriptor_BsReten_Illumination
          OpEventSetBlockProtection_SetBlockProtection_PAdmin_NvBlockSwComponentTypeNVBlockDescriptor_BsConst_SpeedoGauge: RteEventRef=OpEventSetBlockProtection_SetBlockProtection_PAdmin_NvBlockSwComponentTypeNVBlockDescriptor_BsConst_SpeedoGauge
          OpEventEraseBlock_EraseBlock_PS_NvBlockSwComponentTypeNVBlockDescriptor_BsShare_SwUpdReflash: RteEventRef=OpEventEraseBlock_EraseBlock_PS_NvBlockSwComponentTypeNVBlockDescriptor_BsShare_SwUpdReflash
          OpEventWriteBlock_WriteBlock_PS_NvBlockSwComponentTypeNVBlockDescriptor_BsRt_SpeedoGauge: RteEventRef=OpEventWriteBlock_WriteBlock_PS_NvBlockSwComponentTypeNVBlockDescriptor_BsRt_SpeedoGauge
          OpEventSetRamBlockStatus_SetRamBlockStatus_PS_NvBlockSwComponentTypeNVBlockDescriptor_BsConst_SpeedoGauge: RteEventRef=OpEventSetRamBlockStatus_SetRamBlockStatus_PS_NvBlockSwComponentTypeNVBlockDescriptor_BsConst_SpeedoGauge
          OpEventRestoreBlockDefaults_RestoreBlockDefaults_PS_NvBlockSwComponentTypeNVBlockDescriptor_BsShare_VisMeet: RteEventRef=OpEventRestoreBlockDefaults_RestoreBlockDefaults_PS_NvBlockSwComponentTypeNVBlockDescriptor_BsShare_VisMeet
          OpEventSetBlockProtection_SetBlockProtection_PAdmin_NvBlockSwComponentTypeNVBlockDescriptor_BsRt_TachoGauge: RteEventRef=OpEventSetBlockProtection_SetBlockProtection_PAdmin_NvBlockSwComponentTypeNVBlockDescriptor_BsRt_TachoGauge
          OpEventInvalidateNvBlock_InvalidateNvBlock_PS_NvBlockSwComponentTypeNVBlockDescriptor_BsConst_TempGauge: RteEventRef=OpEventInvalidateNvBlock_InvalidateNvBlock_PS_NvBlockSwComponentTypeNVBlockDescriptor_BsConst_TempGauge
          OpEventReadBlock_ReadBlock_PS_NvBlockSwComponentTypeNVBlockDescriptor_BsRt_FuelGauge: RteEventRef=OpEventReadBlock_ReadBlock_PS_NvBlockSwComponentTypeNVBlockDescriptor_BsRt_FuelGauge
          OpEventSetBlockProtection_SetBlockProtection_PAdmin_NvBlockSwComponentTypeNVBlockDescriptor_BsRt_Odometer: RteEventRef=OpEventSetBlockProtection_SetBlockProtection_PAdmin_NvBlockSwComponentTypeNVBlockDescriptor_BsRt_Odometer
          OpEventRestoreBlockDefaults_RestoreBlockDefaults_PS_NvBlockSwComponentTypeNVBlockDescriptor_BsConst_TachoGauge: RteEventRef=OpEventRestoreBlockDefaults_RestoreBlockDefaults_PS_NvBlockSwComponentTypeNVBlockDescriptor_BsConst_TachoGauge
          OpEventReadBlock_ReadBlock_PS_NvBlockSwComponentTypeNVBlockDescriptor_BsConst_EngOffTimer: RteEventRef=OpEventReadBlock_ReadBlock_PS_NvBlockSwComponentTypeNVBlockDescriptor_BsConst_EngOffTimer
          OpEventWriteBlock_WriteBlock_PS_NvBlockSwComponentTypeNVBlockDescriptor_BsRt_PowerGauge: RteEventRef=OpEventWriteBlock_WriteBlock_PS_NvBlockSwComponentTypeNVBlockDescriptor_BsRt_PowerGauge
          OpEventInvalidateNvBlock_InvalidateNvBlock_PS_NvBlockSwComponentTypeNVBlockDescriptor_BsConst_ServiceReminder: RteEventRef=OpEventInvalidateNvBlock_InvalidateNvBlock_PS_NvBlockSwComponentTypeNVBlockDescriptor_BsConst_ServiceReminder
          OpEventWriteBlock_WriteBlock_PS_NvBlockSwComponentTypeNVBlockDescriptor_BsConst_TachoGauge: RteEventRef=OpEventWriteBlock_WriteBlock_PS_NvBlockSwComponentTypeNVBlockDescriptor_BsConst_TachoGauge
          OpEventInvalidateNvBlock_InvalidateNvBlock_PS_NvBlockSwComponentTypeNVBlockDescriptor_BsShare_SwUpdFotaStatus: RteEventRef=OpEventInvalidateNvBlock_InvalidateNvBlock_PS_NvBlockSwComponentTypeNVBlockDescriptor_BsShare_SwUpdFotaStatus
          OpEventEraseBlock_EraseBlock_PS_NvBlockSwComponentTypeNVBlockDescriptor_BsDiag_ErrorRecord: RteEventRef=OpEventEraseBlock_EraseBlock_PS_NvBlockSwComponentTypeNVBlockDescriptor_BsDiag_ErrorRecord
          OpEventGetErrorStatus_GetErrorStatus_PS_NvBlockSwComponentTypeNVBlockDescriptor_BsReten_Display: RteEventRef=OpEventGetErrorStatus_GetErrorStatus_PS_NvBlockSwComponentTypeNVBlockDescriptor_BsReten_Display
          OpEventEraseBlock_EraseBlock_PS_NvBlockSwComponentTypeNVBlockDescriptor_BsConst_EngOffTimer: RteEventRef=OpEventEraseBlock_EraseBlock_PS_NvBlockSwComponentTypeNVBlockDescriptor_BsConst_EngOffTimer
          OpEventReadBlock_ReadBlock_PS_NvBlockSwComponentTypeNVBlockDescriptor_BsReten_Communication: RteEventRef=OpEventReadBlock_ReadBlock_PS_NvBlockSwComponentTypeNVBlockDescriptor_BsReten_Communication
          OpEventInvalidateNvBlock_InvalidateNvBlock_PS_NvBlockSwComponentTypeNVBlockDescriptor_BsShare_VisMeet: RteEventRef=OpEventInvalidateNvBlock_InvalidateNvBlock_PS_NvBlockSwComponentTypeNVBlockDescriptor_BsShare_VisMeet
          OpEventSetRamBlockStatus_SetRamBlockStatus_PS_NvBlockSwComponentTypeNVBlockDescriptor_BsFuSa_Audio: RteEventRef=OpEventSetRamBlockStatus_SetRamBlockStatus_PS_NvBlockSwComponentTypeNVBlockDescriptor_BsFuSa_Audio
          OpEventReadBlock_ReadBlock_PS_NvBlockSwComponentTypeNVBlockDescriptor_BsShare_VisMeet: RteEventRef=OpEventReadBlock_ReadBlock_PS_NvBlockSwComponentTypeNVBlockDescriptor_BsShare_VisMeet
          OpEventReadBlock_ReadBlock_PS_NvBlockSwComponentTypeNVBlockDescriptor_BsConst_TripComputer: RteEventRef=OpEventReadBlock_ReadBlock_PS_NvBlockSwComponentTypeNVBlockDescriptor_BsConst_TripComputer
          OpEventRestoreBlockDefaults_RestoreBlockDefaults_PS_NvBlockSwComponentTypeNVBlockDescriptor_BsShare_SwUpdReflash: RteEventRef=OpEventRestoreBlockDefaults_RestoreBlockDefaults_PS_NvBlockSwComponentTypeNVBlockDescriptor_BsShare_SwUpdReflash
          OpEventWriteBlock_WriteBlock_PS_NvBlockSwComponentTypeNVBlockDescriptor_BsFusa_Fota: RteEventRef=OpEventWriteBlock_WriteBlock_PS_NvBlockSwComponentTypeNVBlockDescriptor_BsFusa_Fota
          OpEventSetRamBlockStatus_SetRamBlockStatus_PS_NvBlockSwComponentTypeNVBlockDescriptor_BsDiag_ErrorRecord: RteEventRef=OpEventSetRamBlockStatus_SetRamBlockStatus_PS_NvBlockSwComponentTypeNVBlockDescriptor_BsDiag_ErrorRecord
          OpEventSetBlockProtection_SetBlockProtection_PAdmin_NvBlockSwComponentTypeNVBlockDescriptor_BsRt_Warning: RteEventRef=OpEventSetBlockProtection_SetBlockProtection_PAdmin_NvBlockSwComponentTypeNVBlockDescriptor_BsRt_Warning
          OpEventGetErrorStatus_GetErrorStatus_PS_NvBlockSwComponentTypeNVBlockDescriptor_BsReten_VisDlt: RteEventRef=OpEventGetErrorStatus_GetErrorStatus_PS_NvBlockSwComponentTypeNVBlockDescriptor_BsReten_VisDlt
          OpEventEraseBlock_EraseBlock_PS_NvBlockSwComponentTypeNVBlockDescriptor_BsRt_OilGauge: RteEventRef=OpEventEraseBlock_EraseBlock_PS_NvBlockSwComponentTypeNVBlockDescriptor_BsRt_OilGauge
          OpEventEraseBlock_EraseBlock_PS_NvBlockSwComponentTypeNVBlockDescriptor_BsReten_Display: RteEventRef=OpEventEraseBlock_EraseBlock_PS_NvBlockSwComponentTypeNVBlockDescriptor_BsReten_Display
          OpEventReadBlock_ReadBlock_PS_NvBlockSwComponentTypeNVBlockDescriptor_BsConst_Communication: RteEventRef=OpEventReadBlock_ReadBlock_PS_NvBlockSwComponentTypeNVBlockDescriptor_BsConst_Communication
          OpEventInvalidateNvBlock_InvalidateNvBlock_PS_NvBlockSwComponentTypeNVBlockDescriptor_BsConst_SpeedoGauge: RteEventRef=OpEventInvalidateNvBlock_InvalidateNvBlock_PS_NvBlockSwComponentTypeNVBlockDescriptor_BsConst_SpeedoGauge
          OpEventWriteBlock_WriteBlock_PS_NvBlockSwComponentTypeNVBlockDescriptor_BsShare_SwUpdFotaFinPrint: RteEventRef=OpEventWriteBlock_WriteBlock_PS_NvBlockSwComponentTypeNVBlockDescriptor_BsShare_SwUpdFotaFinPrint
          OpEventSetBlockProtection_SetBlockProtection_PAdmin_NvBlockSwComponentTypeNVBlockDescriptor_BsConst_PowerGauge: RteEventRef=OpEventSetBlockProtection_SetBlockProtection_PAdmin_NvBlockSwComponentTypeNVBlockDescriptor_BsConst_PowerGauge
          OpEventSetBlockProtection_SetBlockProtection_PAdmin_NvBlockSwComponentTypeNVBlockDescriptor_BsFuSa_Config: RteEventRef=OpEventSetBlockProtection_SetBlockProtection_PAdmin_NvBlockSwComponentTypeNVBlockDescriptor_BsFuSa_Config
          OpEventSetBlockProtection_SetBlockProtection_PAdmin_NvBlockSwComponentTypeNVBlockDescriptor_BsRt_SpeedoGauge: RteEventRef=OpEventSetBlockProtection_SetBlockProtection_PAdmin_NvBlockSwComponentTypeNVBlockDescriptor_BsRt_SpeedoGauge
          OpEventInvalidateNvBlock_InvalidateNvBlock_PS_NvBlockSwComponentTypeNVBlockDescriptor_BsReten_VisDlt: RteEventRef=OpEventInvalidateNvBlock_InvalidateNvBlock_PS_NvBlockSwComponentTypeNVBlockDescriptor_BsReten_VisDlt
          OpEventReadBlock_ReadBlock_PS_NvBlockSwComponentTypeNVBlockDescriptor_BsFuSa_Warning: RteEventRef=OpEventReadBlock_ReadBlock_PS_NvBlockSwComponentTypeNVBlockDescriptor_BsFuSa_Warning
          OpEventReadBlock_ReadBlock_PS_NvBlockSwComponentTypeNVBlockDescriptor_BsReten_Tripcomputer: RteEventRef=OpEventReadBlock_ReadBlock_PS_NvBlockSwComponentTypeNVBlockDescriptor_BsReten_Tripcomputer
          OpEventInvalidateNvBlock_InvalidateNvBlock_PS_NvBlockSwComponentTypeNVBlockDescriptor_BsFusa_Fota: RteEventRef=OpEventInvalidateNvBlock_InvalidateNvBlock_PS_NvBlockSwComponentTypeNVBlockDescriptor_BsFusa_Fota
          OpEventSetBlockProtection_SetBlockProtection_PAdmin_NvBlockSwComponentTypeNVBlockDescriptor_BsReten_Tripcomputer: RteEventRef=OpEventSetBlockProtection_SetBlockProtection_PAdmin_NvBlockSwComponentTypeNVBlockDescriptor_BsReten_Tripcomputer
          OpEventSetBlockProtection_SetBlockProtection_PAdmin_NvBlockSwComponentTypeNVBlockDescriptor_BsFusa_Fota: RteEventRef=OpEventSetBlockProtection_SetBlockProtection_PAdmin_NvBlockSwComponentTypeNVBlockDescriptor_BsFusa_Fota
          OpEventSetRamBlockStatus_SetRamBlockStatus_PS_NvBlockSwComponentTypeNVBlockDescriptor_BsRt_Odometer: RteEventRef=OpEventSetRamBlockStatus_SetRamBlockStatus_PS_NvBlockSwComponentTypeNVBlockDescriptor_BsRt_Odometer
          OpEventSetBlockProtection_SetBlockProtection_PAdmin_NvBlockSwComponentTypeNVBlockDescriptor_BsShare_SwUpdFotaMode: RteEventRef=OpEventSetBlockProtection_SetBlockProtection_PAdmin_NvBlockSwComponentTypeNVBlockDescriptor_BsShare_SwUpdFotaMode
          OpEventSetRamBlockStatus_SetRamBlockStatus_PS_NvBlockSwComponentTypeNVBlockDescriptor_BsRt_FuelGauge: RteEventRef=OpEventSetRamBlockStatus_SetRamBlockStatus_PS_NvBlockSwComponentTypeNVBlockDescriptor_BsRt_FuelGauge
          OpEventEraseBlock_EraseBlock_PS_NvBlockSwComponentTypeNVBlockDescriptor_BsReten_Gauges: RteEventRef=OpEventEraseBlock_EraseBlock_PS_NvBlockSwComponentTypeNVBlockDescriptor_BsReten_Gauges
          OpEventGetErrorStatus_GetErrorStatus_PS_NvBlockSwComponentTypeNVBlockDescriptor_BsFusa_Fota: RteEventRef=OpEventGetErrorStatus_GetErrorStatus_PS_NvBlockSwComponentTypeNVBlockDescriptor_BsFusa_Fota
          OpEventRestoreBlockDefaults_RestoreBlockDefaults_PS_NvBlockSwComponentTypeNVBlockDescriptor_BsReten_Odometer: RteEventRef=OpEventRestoreBlockDefaults_RestoreBlockDefaults_PS_NvBlockSwComponentTypeNVBlockDescriptor_BsReten_Odometer
          OpEventRestoreBlockDefaults_RestoreBlockDefaults_PS_NvBlockSwComponentTypeNVBlockDescriptor_RefCys_Certicificate: RteEventRef=OpEventRestoreBlockDefaults_RestoreBlockDefaults_PS_NvBlockSwComponentTypeNVBlockDescriptor_RefCys_Certicificate
          OpEventSetRamBlockStatus_SetRamBlockStatus_PS_NvBlockSwComponentTypeNVBlockDescriptor_BsReten_Audio: RteEventRef=OpEventSetRamBlockStatus_SetRamBlockStatus_PS_NvBlockSwComponentTypeNVBlockDescriptor_BsReten_Audio
          OpEventRestoreBlockDefaults_RestoreBlockDefaults_PS_NvBlockSwComponentTypeNVBlockDescriptor_BsReten_Warning: RteEventRef=OpEventRestoreBlockDefaults_RestoreBlockDefaults_PS_NvBlockSwComponentTypeNVBlockDescriptor_BsReten_Warning
          OpEventInvalidateNvBlock_InvalidateNvBlock_PS_NvBlockSwComponentTypeNVBlockDescriptor_BsConst_Warning: RteEventRef=OpEventInvalidateNvBlock_InvalidateNvBlock_PS_NvBlockSwComponentTypeNVBlockDescriptor_BsConst_Warning
          OpEventGetErrorStatus_GetErrorStatus_PS_NvBlockSwComponentTypeNVBlockDescriptor_BsConst_Warning: RteEventRef=OpEventGetErrorStatus_GetErrorStatus_PS_NvBlockSwComponentTypeNVBlockDescriptor_BsConst_Warning
          OpEventWriteBlock_WriteBlock_PS_NvBlockSwComponentTypeNVBlockDescriptor_BsFuSa_Power: RteEventRef=OpEventWriteBlock_WriteBlock_PS_NvBlockSwComponentTypeNVBlockDescriptor_BsFuSa_Power
          OpEventInvalidateNvBlock_InvalidateNvBlock_PS_NvBlockSwComponentTypeNVBlockDescriptor_BsConst_Communication: RteEventRef=OpEventInvalidateNvBlock_InvalidateNvBlock_PS_NvBlockSwComponentTypeNVBlockDescriptor_BsConst_Communication
          OpEventReadBlock_ReadBlock_PS_NvBlockSwComponentTypeNVBlockDescriptor_BsRt_TachoGauge: RteEventRef=OpEventReadBlock_ReadBlock_PS_NvBlockSwComponentTypeNVBlockDescriptor_BsRt_TachoGauge
          OpEventEraseBlock_EraseBlock_PS_NvBlockSwComponentTypeNVBlockDescriptor_BsShare_VisMeet: RteEventRef=OpEventEraseBlock_EraseBlock_PS_NvBlockSwComponentTypeNVBlockDescriptor_BsShare_VisMeet
          OpEventWriteBlock_WriteBlock_PS_NvBlockSwComponentTypeNVBlockDescriptor_BsConst_PowerGauge: RteEventRef=OpEventWriteBlock_WriteBlock_PS_NvBlockSwComponentTypeNVBlockDescriptor_BsConst_PowerGauge
          OpEventReadBlock_ReadBlock_PS_NvBlockSwComponentTypeNVBlockDescriptor_BsRt_Odometer: RteEventRef=OpEventReadBlock_ReadBlock_PS_NvBlockSwComponentTypeNVBlockDescriptor_BsRt_Odometer
          OpEventEraseBlock_EraseBlock_PS_NvBlockSwComponentTypeNVBlockDescriptor_BsConst_ServiceReminder: RteEventRef=OpEventEraseBlock_EraseBlock_PS_NvBlockSwComponentTypeNVBlockDescriptor_BsConst_ServiceReminder
          OpEventGetErrorStatus_GetErrorStatus_PS_NvBlockSwComponentTypeNVBlockDescriptor_BsReten_Warning: RteEventRef=OpEventGetErrorStatus_GetErrorStatus_PS_NvBlockSwComponentTypeNVBlockDescriptor_BsReten_Warning
          OpEventInvalidateNvBlock_InvalidateNvBlock_PS_NvBlockSwComponentTypeNVBlockDescriptor_BsReten_Display: RteEventRef=OpEventInvalidateNvBlock_InvalidateNvBlock_PS_NvBlockSwComponentTypeNVBlockDescriptor_BsReten_Display
          OpEventReadBlock_ReadBlock_PS_NvBlockSwComponentTypeNVBlockDescriptor_RefCys_Certicificate: RteEventRef=OpEventReadBlock_ReadBlock_PS_NvBlockSwComponentTypeNVBlockDescriptor_RefCys_Certicificate
          OpEventWriteBlock_WriteBlock_PS_NvBlockSwComponentTypeNVBlockDescriptor_RefCys_Certicificate: RteEventRef=OpEventWriteBlock_WriteBlock_PS_NvBlockSwComponentTypeNVBlockDescriptor_RefCys_Certicificate
          OpEventSetBlockProtection_SetBlockProtection_PAdmin_NvBlockSwComponentTypeNVBlockDescriptor_BsReten_Power: RteEventRef=OpEventSetBlockProtection_SetBlockProtection_PAdmin_NvBlockSwComponentTypeNVBlockDescriptor_BsReten_Power
          OpEventRestoreBlockDefaults_RestoreBlockDefaults_PS_NvBlockSwComponentTypeNVBlockDescriptor_BsReten_Illumination: RteEventRef=OpEventRestoreBlockDefaults_RestoreBlockDefaults_PS_NvBlockSwComponentTypeNVBlockDescriptor_BsReten_Illumination
          OpEventInvalidateNvBlock_InvalidateNvBlock_PS_NvBlockSwComponentTypeNVBlockDescriptor_BsRt_TripComputer: RteEventRef=OpEventInvalidateNvBlock_InvalidateNvBlock_PS_NvBlockSwComponentTypeNVBlockDescriptor_BsRt_TripComputer
          OpEventInvalidateNvBlock_InvalidateNvBlock_PS_NvBlockSwComponentTypeNVBlockDescriptor_BsDiag_ErrorRecord: RteEventRef=OpEventInvalidateNvBlock_InvalidateNvBlock_PS_NvBlockSwComponentTypeNVBlockDescriptor_BsDiag_ErrorRecord
          OpEventSetBlockProtection_SetBlockProtection_PAdmin_NvBlockSwComponentTypeNVBlockDescriptor_BsConst_Illumination: RteEventRef=OpEventSetBlockProtection_SetBlockProtection_PAdmin_NvBlockSwComponentTypeNVBlockDescriptor_BsConst_Illumination
          OpEventGetErrorStatus_GetErrorStatus_PS_NvBlockSwComponentTypeNVBlockDescriptor_BsReten_Illumination: RteEventRef=OpEventGetErrorStatus_GetErrorStatus_PS_NvBlockSwComponentTypeNVBlockDescriptor_BsReten_Illumination
          OpEventSetRamBlockStatus_SetRamBlockStatus_PS_NvBlockSwComponentTypeNVBlockDescriptor_BsConst_RealTimeClock: RteEventRef=OpEventSetRamBlockStatus_SetRamBlockStatus_PS_NvBlockSwComponentTypeNVBlockDescriptor_BsConst_RealTimeClock
          OpEventRestoreBlockDefaults_RestoreBlockDefaults_PS_NvBlockSwComponentTypeNVBlockDescriptor_BsRt_TempGauge: RteEventRef=OpEventRestoreBlockDefaults_RestoreBlockDefaults_PS_NvBlockSwComponentTypeNVBlockDescriptor_BsRt_TempGauge
          OpEventGetErrorStatus_GetErrorStatus_PS_NvBlockSwComponentTypeNVBlockDescriptor_BsConst_SpeedoGauge: RteEventRef=OpEventGetErrorStatus_GetErrorStatus_PS_NvBlockSwComponentTypeNVBlockDescriptor_BsConst_SpeedoGauge
          OpEventInvalidateNvBlock_InvalidateNvBlock_PS_NvBlockSwComponentTypeNVBlockDescriptor_BsConst_TachoGauge: RteEventRef=OpEventInvalidateNvBlock_InvalidateNvBlock_PS_NvBlockSwComponentTypeNVBlockDescriptor_BsConst_TachoGauge
          OpEventEraseBlock_EraseBlock_PS_NvBlockSwComponentTypeNVBlockDescriptor_BsShare_SwUpdFotaMode: RteEventRef=OpEventEraseBlock_EraseBlock_PS_NvBlockSwComponentTypeNVBlockDescriptor_BsShare_SwUpdFotaMode
          OpEventGetErrorStatus_GetErrorStatus_PS_NvBlockSwComponentTypeNVBlockDescriptor_RefCys_Certicificate1: RteEventRef=OpEventGetErrorStatus_GetErrorStatus_PS_NvBlockSwComponentTypeNVBlockDescriptor_RefCys_Certicificate1
          OpEventInvalidateNvBlock_InvalidateNvBlock_PS_NvBlockSwComponentTypeNVBlockDescriptor_BsRt_FuelGauge: RteEventRef=OpEventInvalidateNvBlock_InvalidateNvBlock_PS_NvBlockSwComponentTypeNVBlockDescriptor_BsRt_FuelGauge
          OpEventGetErrorStatus_GetErrorStatus_PS_NvBlockSwComponentTypeNVBlockDescriptor_BsConst_TempGauge: RteEventRef=OpEventGetErrorStatus_GetErrorStatus_PS_NvBlockSwComponentTypeNVBlockDescriptor_BsConst_TempGauge
          OpEventWriteBlock_WriteBlock_PS_NvBlockSwComponentTypeNVBlockDescriptor_BsReten_Warning: RteEventRef=OpEventWriteBlock_WriteBlock_PS_NvBlockSwComponentTypeNVBlockDescriptor_BsReten_Warning
          OpEventReadBlock_ReadBlock_PS_NvBlockSwComponentTypeNVBlockDescriptor_BsRt_CusDlt: RteEventRef=OpEventReadBlock_ReadBlock_PS_NvBlockSwComponentTypeNVBlockDescriptor_BsRt_CusDlt
          OpEventGetErrorStatus_GetErrorStatus_PS_NvBlockSwComponentTypeNVBlockDescriptor_BsShare_SwUpdFotaFinPrint: RteEventRef=OpEventGetErrorStatus_GetErrorStatus_PS_NvBlockSwComponentTypeNVBlockDescriptor_BsShare_SwUpdFotaFinPrint
          OpEventWriteBlock_WriteBlock_PS_NvBlockSwComponentTypeNVBlockDescriptor_BsRt_TempGauge: RteEventRef=OpEventWriteBlock_WriteBlock_PS_NvBlockSwComponentTypeNVBlockDescriptor_BsRt_TempGauge
          OpEventWriteBlock_WriteBlock_PS_NvBlockSwComponentTypeNVBlockDescriptor_BsShare_SwUpdReflash: RteEventRef=OpEventWriteBlock_WriteBlock_PS_NvBlockSwComponentTypeNVBlockDescriptor_BsShare_SwUpdReflash
          OpEventGetErrorStatus_GetErrorStatus_PS_NvBlockSwComponentTypeNVBlockDescriptor_BsRt_Warning: RteEventRef=OpEventGetErrorStatus_GetErrorStatus_PS_NvBlockSwComponentTypeNVBlockDescriptor_BsRt_Warning
          OpEventEraseBlock_EraseBlock_PS_NvBlockSwComponentTypeNVBlockDescriptor_BsShare_SwUpdFotaStatus: RteEventRef=OpEventEraseBlock_EraseBlock_PS_NvBlockSwComponentTypeNVBlockDescriptor_BsShare_SwUpdFotaStatus
          OpEventReadBlock_ReadBlock_PS_NvBlockSwComponentTypeNVBlockDescriptor_BsDiag_ErrorRecord: RteEventRef=OpEventReadBlock_ReadBlock_PS_NvBlockSwComponentTypeNVBlockDescriptor_BsDiag_ErrorRecord
          OpEventReadBlock_ReadBlock_PS_NvBlockSwComponentTypeNVBlockDescriptor_BsShare_SwUpdFotaFinPrint: RteEventRef=OpEventReadBlock_ReadBlock_PS_NvBlockSwComponentTypeNVBlockDescriptor_BsShare_SwUpdFotaFinPrint
          OpEventInvalidateNvBlock_InvalidateNvBlock_PS_NvBlockSwComponentTypeNVBlockDescriptor_BsFuSa_Warning: RteEventRef=OpEventInvalidateNvBlock_InvalidateNvBlock_PS_NvBlockSwComponentTypeNVBlockDescriptor_BsFuSa_Warning
          OpEventGetErrorStatus_GetErrorStatus_PS_NvBlockSwComponentTypeNVBlockDescriptor_BsConst_EngOffTimer: RteEventRef=OpEventGetErrorStatus_GetErrorStatus_PS_NvBlockSwComponentTypeNVBlockDescriptor_BsConst_EngOffTimer
          OpEventSetRamBlockStatus_SetRamBlockStatus_PS_NvBlockSwComponentTypeNVBlockDescriptor_BsReten_Power: RteEventRef=OpEventSetRamBlockStatus_SetRamBlockStatus_PS_NvBlockSwComponentTypeNVBlockDescriptor_BsReten_Power
          OpEventWriteBlock_WriteBlock_PS_NvBlockSwComponentTypeNVBlockDescriptor_BsReten_Illumination: RteEventRef=OpEventWriteBlock_WriteBlock_PS_NvBlockSwComponentTypeNVBlockDescriptor_BsReten_Illumination
          OpEventRestoreBlockDefaults_RestoreBlockDefaults_PS_NvBlockSwComponentTypeNVBlockDescriptor_BsRt_Personalization: RteEventRef=OpEventRestoreBlockDefaults_RestoreBlockDefaults_PS_NvBlockSwComponentTypeNVBlockDescriptor_BsRt_Personalization
          OpEventSetRamBlockStatus_SetRamBlockStatus_PS_NvBlockSwComponentTypeNVBlockDescriptor_BsRt_Warning: RteEventRef=OpEventSetRamBlockStatus_SetRamBlockStatus_PS_NvBlockSwComponentTypeNVBlockDescriptor_BsRt_Warning
          OpEventInvalidateNvBlock_InvalidateNvBlock_PS_NvBlockSwComponentTypeNVBlockDescriptor_BsReten_Tripcomputer: RteEventRef=OpEventInvalidateNvBlock_InvalidateNvBlock_PS_NvBlockSwComponentTypeNVBlockDescriptor_BsReten_Tripcomputer
          OpEventReadBlock_ReadBlock_PS_NvBlockSwComponentTypeNVBlockDescriptor_BsShare_SwUpdReflash: RteEventRef=OpEventReadBlock_ReadBlock_PS_NvBlockSwComponentTypeNVBlockDescriptor_BsShare_SwUpdReflash
          OpEventSetBlockProtection_SetBlockProtection_PAdmin_NvBlockSwComponentTypeNVBlockDescriptor_BsReten_Warning: RteEventRef=OpEventSetBlockProtection_SetBlockProtection_PAdmin_NvBlockSwComponentTypeNVBlockDescriptor_BsReten_Warning
          OpEventReadBlock_ReadBlock_PS_NvBlockSwComponentTypeNVBlockDescriptor_BsFuSa_Power: RteEventRef=OpEventReadBlock_ReadBlock_PS_NvBlockSwComponentTypeNVBlockDescriptor_BsFuSa_Power
          OpEventRestoreBlockDefaults_RestoreBlockDefaults_PS_NvBlockSwComponentTypeNVBlockDescriptor_RefCys_Certicificate1: RteEventRef=OpEventRestoreBlockDefaults_RestoreBlockDefaults_PS_NvBlockSwComponentTypeNVBlockDescriptor_RefCys_Certicificate1
          OpEventGetErrorStatus_GetErrorStatus_PS_NvBlockSwComponentTypeNVBlockDescriptor_RefCys_Certicificate: RteEventRef=OpEventGetErrorStatus_GetErrorStatus_PS_NvBlockSwComponentTypeNVBlockDescriptor_RefCys_Certicificate
          OpEventSetBlockProtection_SetBlockProtection_PAdmin_NvBlockSwComponentTypeNVBlockDescriptor_BsShare_SwUpdReflash: RteEventRef=OpEventSetBlockProtection_SetBlockProtection_PAdmin_NvBlockSwComponentTypeNVBlockDescriptor_BsShare_SwUpdReflash
          OpEventRestoreBlockDefaults_RestoreBlockDefaults_PS_NvBlockSwComponentTypeNVBlockDescriptor_BsRt_Warning: RteEventRef=OpEventRestoreBlockDefaults_RestoreBlockDefaults_PS_NvBlockSwComponentTypeNVBlockDescriptor_BsRt_Warning
          OpEventGetErrorStatus_GetErrorStatus_PS_NvBlockSwComponentTypeNVBlockDescriptor_BsConst_RealTimeClock: RteEventRef=OpEventGetErrorStatus_GetErrorStatus_PS_NvBlockSwComponentTypeNVBlockDescriptor_BsConst_RealTimeClock
          OpEventReadBlock_ReadBlock_PS_NvBlockSwComponentTypeNVBlockDescriptor_BsRt_Illumination: RteEventRef=OpEventReadBlock_ReadBlock_PS_NvBlockSwComponentTypeNVBlockDescriptor_BsRt_Illumination
          OpEventWriteBlock_WriteBlock_PS_NvBlockSwComponentTypeNVBlockDescriptor_BsConst_Audio: RteEventRef=OpEventWriteBlock_WriteBlock_PS_NvBlockSwComponentTypeNVBlockDescriptor_BsConst_Audio
          OpEventEraseBlock_EraseBlock_PS_NvBlockSwComponentTypeNVBlockDescriptor_BsConst_TachoGauge: RteEventRef=OpEventEraseBlock_EraseBlock_PS_NvBlockSwComponentTypeNVBlockDescriptor_BsConst_TachoGauge
          OpEventInvalidateNvBlock_InvalidateNvBlock_PS_NvBlockSwComponentTypeNVBlockDescriptor_BsRt_OilGauge: RteEventRef=OpEventInvalidateNvBlock_InvalidateNvBlock_PS_NvBlockSwComponentTypeNVBlockDescriptor_BsRt_OilGauge
          OpEventInvalidateNvBlock_InvalidateNvBlock_PS_NvBlockSwComponentTypeNVBlockDescriptor_BsFuSa_Config: RteEventRef=OpEventInvalidateNvBlock_InvalidateNvBlock_PS_NvBlockSwComponentTypeNVBlockDescriptor_BsFuSa_Config
          OpEventRestoreBlockDefaults_RestoreBlockDefaults_PS_NvBlockSwComponentTypeNVBlockDescriptor_BsConst_ServiceReminder: RteEventRef=OpEventRestoreBlockDefaults_RestoreBlockDefaults_PS_NvBlockSwComponentTypeNVBlockDescriptor_BsConst_ServiceReminder
          OpEventSetRamBlockStatus_SetRamBlockStatus_PS_NvBlockSwComponentTypeNVBlockDescriptor_BsConst_TripComputer: RteEventRef=OpEventSetRamBlockStatus_SetRamBlockStatus_PS_NvBlockSwComponentTypeNVBlockDescriptor_BsConst_TripComputer
          OpEventReadBlock_ReadBlock_PS_NvBlockSwComponentTypeNVBlockDescriptor_BsFusa_Fota: RteEventRef=OpEventReadBlock_ReadBlock_PS_NvBlockSwComponentTypeNVBlockDescriptor_BsFusa_Fota
          OpEventRestoreBlockDefaults_RestoreBlockDefaults_PS_NvBlockSwComponentTypeNVBlockDescriptor_BsFuSa_Power: RteEventRef=OpEventRestoreBlockDefaults_RestoreBlockDefaults_PS_NvBlockSwComponentTypeNVBlockDescriptor_BsFuSa_Power
          OpEventWriteBlock_WriteBlock_PS_NvBlockSwComponentTypeNVBlockDescriptor_BsReten_Audio: RteEventRef=OpEventWriteBlock_WriteBlock_PS_NvBlockSwComponentTypeNVBlockDescriptor_BsReten_Audio
          OpEventRestoreBlockDefaults_RestoreBlockDefaults_PS_NvBlockSwComponentTypeNVBlockDescriptor_BsReten_Tripcomputer: RteEventRef=OpEventRestoreBlockDefaults_RestoreBlockDefaults_PS_NvBlockSwComponentTypeNVBlockDescriptor_BsReten_Tripcomputer
          OpEventRestoreBlockDefaults_RestoreBlockDefaults_PS_NvBlockSwComponentTypeNVBlockDescriptor_BsRt_RealTimeClock: RteEventRef=OpEventRestoreBlockDefaults_RestoreBlockDefaults_PS_NvBlockSwComponentTypeNVBlockDescriptor_BsRt_RealTimeClock
          OpEventSetRamBlockStatus_SetRamBlockStatus_PS_NvBlockSwComponentTypeNVBlockDescriptor_RefCys_Certicificate1: RteEventRef=OpEventSetRamBlockStatus_SetRamBlockStatus_PS_NvBlockSwComponentTypeNVBlockDescriptor_RefCys_Certicificate1
          OpEventSetDataIndex_SetDataIndex_PS_NvBlockSwComponentTypeNVBlockDescriptor_BsConst_ServiceReminder: RteEventRef=OpEventSetDataIndex_SetDataIndex_PS_NvBlockSwComponentTypeNVBlockDescriptor_BsConst_ServiceReminder
          OpEventSetDataIndex_SetDataIndex_PS_NvBlockSwComponentTypeNVBlockDescriptor_BsConst_OilGauge: RteEventRef=OpEventSetDataIndex_SetDataIndex_PS_NvBlockSwComponentTypeNVBlockDescriptor_BsConst_OilGauge
          OpEventSetDataIndex_SetDataIndex_PS_NvBlockSwComponentTypeNVBlockDescriptor_BsCys_Certicificate: RteEventRef=OpEventSetDataIndex_SetDataIndex_PS_NvBlockSwComponentTypeNVBlockDescriptor_BsCys_Certicificate
          OpEventGetDataIndex_GetDataIndex_PS_NvBlockSwComponentTypeNVBlockDescriptor_BsReten_Tripcomputer: RteEventRef=OpEventGetDataIndex_GetDataIndex_PS_NvBlockSwComponentTypeNVBlockDescriptor_BsReten_Tripcomputer
          OpEventSetDataIndex_SetDataIndex_PS_NvBlockSwComponentTypeNVBlockDescriptor_BsRt_PowerGauge: RteEventRef=OpEventSetDataIndex_SetDataIndex_PS_NvBlockSwComponentTypeNVBlockDescriptor_BsRt_PowerGauge
          OpEventGetDataIndex_GetDataIndex_PS_NvBlockSwComponentTypeNVBlockDescriptor_BsReten_Illumination: RteEventRef=OpEventGetDataIndex_GetDataIndex_PS_NvBlockSwComponentTypeNVBlockDescriptor_BsReten_Illumination
          OpEventGetDataIndex_GetDataIndex_PS_NvBlockSwComponentTypeNVBlockDescriptor_BsReten_RealTimeClock: RteEventRef=OpEventGetDataIndex_GetDataIndex_PS_NvBlockSwComponentTypeNVBlockDescriptor_BsReten_RealTimeClock
          OpEventSetDataIndex_SetDataIndex_PS_NvBlockSwComponentTypeNVBlockDescriptor_BsRt_Warning: RteEventRef=OpEventSetDataIndex_SetDataIndex_PS_NvBlockSwComponentTypeNVBlockDescriptor_BsRt_Warning
          OpEventSetDataIndex_SetDataIndex_PS_NvBlockSwComponentTypeNVBlockDescriptor_BsRt_FuelGauge: RteEventRef=OpEventSetDataIndex_SetDataIndex_PS_NvBlockSwComponentTypeNVBlockDescriptor_BsRt_FuelGauge
          OpEventSetDataIndex_SetDataIndex_PS_NvBlockSwComponentTypeNVBlockDescriptor_BsRt_TripComputer: RteEventRef=OpEventSetDataIndex_SetDataIndex_PS_NvBlockSwComponentTypeNVBlockDescriptor_BsRt_TripComputer
          OpEventSetDataIndex_SetDataIndex_PS_NvBlockSwComponentTypeNVBlockDescriptor_BsReten_Gauges: RteEventRef=OpEventSetDataIndex_SetDataIndex_PS_NvBlockSwComponentTypeNVBlockDescriptor_BsReten_Gauges
          OpEventSetDataIndex_SetDataIndex_PS_NvBlockSwComponentTypeNVBlockDescriptor_BsFuSa_Display: RteEventRef=OpEventSetDataIndex_SetDataIndex_PS_NvBlockSwComponentTypeNVBlockDescriptor_BsFuSa_Display
          OpEventSetDataIndex_SetDataIndex_PS_NvBlockSwComponentTypeNVBlockDescriptor_BsReten_Communication: RteEventRef=OpEventSetDataIndex_SetDataIndex_PS_NvBlockSwComponentTypeNVBlockDescriptor_BsReten_Communication
          OpEventGetDataIndex_GetDataIndex_PS_NvBlockSwComponentTypeNVBlockDescriptor_BsConst_Communication: RteEventRef=OpEventGetDataIndex_GetDataIndex_PS_NvBlockSwComponentTypeNVBlockDescriptor_BsConst_Communication
          OpEventGetDataIndex_GetDataIndex_PS_NvBlockSwComponentTypeNVBlockDescriptor_BsShare_EcuPartNumber: RteEventRef=OpEventGetDataIndex_GetDataIndex_PS_NvBlockSwComponentTypeNVBlockDescriptor_BsShare_EcuPartNumber
          OpEventSetDataIndex_SetDataIndex_PS_NvBlockSwComponentTypeNVBlockDescriptor_BsDiag_ErrorRecord: RteEventRef=OpEventSetDataIndex_SetDataIndex_PS_NvBlockSwComponentTypeNVBlockDescriptor_BsDiag_ErrorRecord
          OpEventGetDataIndex_GetDataIndex_PS_NvBlockSwComponentTypeNVBlockDescriptor_BsReten_Display: RteEventRef=OpEventGetDataIndex_GetDataIndex_PS_NvBlockSwComponentTypeNVBlockDescriptor_BsReten_Display
          OpEventGetDataIndex_GetDataIndex_PS_NvBlockSwComponentTypeNVBlockDescriptor_BsReten_Gauges: RteEventRef=OpEventGetDataIndex_GetDataIndex_PS_NvBlockSwComponentTypeNVBlockDescriptor_BsReten_Gauges
          OpEventSetDataIndex_SetDataIndex_PS_NvBlockSwComponentTypeNVBlockDescriptor_BsShare_SwUpdReflash: RteEventRef=OpEventSetDataIndex_SetDataIndex_PS_NvBlockSwComponentTypeNVBlockDescriptor_BsShare_SwUpdReflash
          OpEventSetDataIndex_SetDataIndex_PS_NvBlockSwComponentTypeNVBlockDescriptor_BsReten_Audio: RteEventRef=OpEventSetDataIndex_SetDataIndex_PS_NvBlockSwComponentTypeNVBlockDescriptor_BsReten_Audio
          OpEventGetDataIndex_GetDataIndex_PS_NvBlockSwComponentTypeNVBlockDescriptor_BsFuSa_Display: RteEventRef=OpEventGetDataIndex_GetDataIndex_PS_NvBlockSwComponentTypeNVBlockDescriptor_BsFuSa_Display
          OpEventSetDataIndex_SetDataIndex_PS_NvBlockSwComponentTypeNVBlockDescriptor_BsConst_PowerGauge: RteEventRef=OpEventSetDataIndex_SetDataIndex_PS_NvBlockSwComponentTypeNVBlockDescriptor_BsConst_PowerGauge
          OpEventGetDataIndex_GetDataIndex_PS_NvBlockSwComponentTypeNVBlockDescriptor_BsReten_Communication: RteEventRef=OpEventGetDataIndex_GetDataIndex_PS_NvBlockSwComponentTypeNVBlockDescriptor_BsReten_Communication
          OpEventGetDataIndex_GetDataIndex_PS_NvBlockSwComponentTypeNVBlockDescriptor_BsShare_SwUpdFotaMode: RteEventRef=OpEventGetDataIndex_GetDataIndex_PS_NvBlockSwComponentTypeNVBlockDescriptor_BsShare_SwUpdFotaMode
          OpEventGetDataIndex_GetDataIndex_PS_NvBlockSwComponentTypeNVBlockDescriptor_BsShare_VehicleConfig: RteEventRef=OpEventGetDataIndex_GetDataIndex_PS_NvBlockSwComponentTypeNVBlockDescriptor_BsShare_VehicleConfig
          OpEventSetDataIndex_SetDataIndex_PS_NvBlockSwComponentTypeNVBlockDescriptor_BsConst_Power: RteEventRef=OpEventSetDataIndex_SetDataIndex_PS_NvBlockSwComponentTypeNVBlockDescriptor_BsConst_Power
          OpEventSetDataIndex_SetDataIndex_PS_NvBlockSwComponentTypeNVBlockDescriptor_BsConst_TripComputer: RteEventRef=OpEventSetDataIndex_SetDataIndex_PS_NvBlockSwComponentTypeNVBlockDescriptor_BsConst_TripComputer
          OpEventSetDataIndex_SetDataIndex_PS_NvBlockSwComponentTypeNVBlockDescriptor_BsRt_OilGauge: RteEventRef=OpEventSetDataIndex_SetDataIndex_PS_NvBlockSwComponentTypeNVBlockDescriptor_BsRt_OilGauge
          OpEventSetDataIndex_SetDataIndex_PS_NvBlockSwComponentTypeNVBlockDescriptor_BsReten_Illumination: RteEventRef=OpEventSetDataIndex_SetDataIndex_PS_NvBlockSwComponentTypeNVBlockDescriptor_BsReten_Illumination
          OpEventSetDataIndex_SetDataIndex_PS_NvBlockSwComponentTypeNVBlockDescriptor_BsConst_SpeedoGauge: RteEventRef=OpEventSetDataIndex_SetDataIndex_PS_NvBlockSwComponentTypeNVBlockDescriptor_BsConst_SpeedoGauge
          OpEventGetDataIndex_GetDataIndex_PS_NvBlockSwComponentTypeNVBlockDescriptor_BsConst_ServiceReminder: RteEventRef=OpEventGetDataIndex_GetDataIndex_PS_NvBlockSwComponentTypeNVBlockDescriptor_BsConst_ServiceReminder
          OpEventGetDataIndex_GetDataIndex_PS_NvBlockSwComponentTypeNVBlockDescriptor_BsShare_VisMeet: RteEventRef=OpEventGetDataIndex_GetDataIndex_PS_NvBlockSwComponentTypeNVBlockDescriptor_BsShare_VisMeet
          OpEventGetDataIndex_GetDataIndex_PS_NvBlockSwComponentTypeNVBlockDescriptor_BsReten_Power: RteEventRef=OpEventGetDataIndex_GetDataIndex_PS_NvBlockSwComponentTypeNVBlockDescriptor_BsReten_Power
          OpEventGetDataIndex_GetDataIndex_PS_NvBlockSwComponentTypeNVBlockDescriptor_BsRt_Personalization: RteEventRef=OpEventGetDataIndex_GetDataIndex_PS_NvBlockSwComponentTypeNVBlockDescriptor_BsRt_Personalization
          OpEventSetDataIndex_SetDataIndex_PS_NvBlockSwComponentTypeNVBlockDescriptor_BsRt_Personalization: RteEventRef=OpEventSetDataIndex_SetDataIndex_PS_NvBlockSwComponentTypeNVBlockDescriptor_BsRt_Personalization
          OpEventGetDataIndex_GetDataIndex_PS_NvBlockSwComponentTypeNVBlockDescriptor_BsConst_Warning: RteEventRef=OpEventGetDataIndex_GetDataIndex_PS_NvBlockSwComponentTypeNVBlockDescriptor_BsConst_Warning
          OpEventGetDataIndex_GetDataIndex_PS_NvBlockSwComponentTypeNVBlockDescriptor_BsShare_SwUpdReflash: RteEventRef=OpEventGetDataIndex_GetDataIndex_PS_NvBlockSwComponentTypeNVBlockDescriptor_BsShare_SwUpdReflash
          OpEventGetDataIndex_GetDataIndex_PS_NvBlockSwComponentTypeNVBlockDescriptor_BsConst_OilGauge: RteEventRef=OpEventGetDataIndex_GetDataIndex_PS_NvBlockSwComponentTypeNVBlockDescriptor_BsConst_OilGauge
          OpEventGetDataIndex_GetDataIndex_PS_NvBlockSwComponentTypeNVBlockDescriptor_BsRt_RealTimeClock: RteEventRef=OpEventGetDataIndex_GetDataIndex_PS_NvBlockSwComponentTypeNVBlockDescriptor_BsRt_RealTimeClock
          OpEventSetDataIndex_SetDataIndex_PS_NvBlockSwComponentTypeNVBlockDescriptor_BsRt_RealTimeClock: RteEventRef=OpEventSetDataIndex_SetDataIndex_PS_NvBlockSwComponentTypeNVBlockDescriptor_BsRt_RealTimeClock
          OpEventSetDataIndex_SetDataIndex_PS_NvBlockSwComponentTypeNVBlockDescriptor_RefCys_Certicificate: RteEventRef=OpEventSetDataIndex_SetDataIndex_PS_NvBlockSwComponentTypeNVBlockDescriptor_RefCys_Certicificate
          OpEventSetDataIndex_SetDataIndex_PS_NvBlockSwComponentTypeNVBlockDescriptor_BsConst_TachoGauge: RteEventRef=OpEventSetDataIndex_SetDataIndex_PS_NvBlockSwComponentTypeNVBlockDescriptor_BsConst_TachoGauge
          OpEventGetDataIndex_GetDataIndex_PS_NvBlockSwComponentTypeNVBlockDescriptor_BsRt_CusDlt: RteEventRef=OpEventGetDataIndex_GetDataIndex_PS_NvBlockSwComponentTypeNVBlockDescriptor_BsRt_CusDlt
          OpEventSetDataIndex_SetDataIndex_PS_NvBlockSwComponentTypeNVBlockDescriptor_BsShare_EcuPartNumber: RteEventRef=OpEventSetDataIndex_SetDataIndex_PS_NvBlockSwComponentTypeNVBlockDescriptor_BsShare_EcuPartNumber
          OpEventGetDataIndex_GetDataIndex_PS_NvBlockSwComponentTypeNVBlockDescriptor_BsConst_PowerGauge: RteEventRef=OpEventGetDataIndex_GetDataIndex_PS_NvBlockSwComponentTypeNVBlockDescriptor_BsConst_PowerGauge
          OpEventSetDataIndex_SetDataIndex_PS_NvBlockSwComponentTypeNVBlockDescriptor_BsConst_FuelGauge: RteEventRef=OpEventSetDataIndex_SetDataIndex_PS_NvBlockSwComponentTypeNVBlockDescriptor_BsConst_FuelGauge
          OpEventGetDataIndex_GetDataIndex_PS_NvBlockSwComponentTypeNVBlockDescriptor_RefCys_Certicificate1: RteEventRef=OpEventGetDataIndex_GetDataIndex_PS_NvBlockSwComponentTypeNVBlockDescriptor_RefCys_Certicificate1
          OpEventSetDataIndex_SetDataIndex_PS_NvBlockSwComponentTypeNVBlockDescriptor_BsShare_VehicleConfig: RteEventRef=OpEventSetDataIndex_SetDataIndex_PS_NvBlockSwComponentTypeNVBlockDescriptor_BsShare_VehicleConfig
          OpEventGetDataIndex_GetDataIndex_PS_NvBlockSwComponentTypeNVBlockDescriptor_BsFuSa_Power: RteEventRef=OpEventGetDataIndex_GetDataIndex_PS_NvBlockSwComponentTypeNVBlockDescriptor_BsFuSa_Power
          OpEventGetDataIndex_GetDataIndex_PS_NvBlockSwComponentTypeNVBlockDescriptor_BsReten_Warning: RteEventRef=OpEventGetDataIndex_GetDataIndex_PS_NvBlockSwComponentTypeNVBlockDescriptor_BsReten_Warning
          OpEventSetDataIndex_SetDataIndex_PS_NvBlockSwComponentTypeNVBlockDescriptor_BsFusa_Fota: RteEventRef=OpEventSetDataIndex_SetDataIndex_PS_NvBlockSwComponentTypeNVBlockDescriptor_BsFusa_Fota
          OpEventGetDataIndex_GetDataIndex_PS_NvBlockSwComponentTypeNVBlockDescriptor_BsRt_OilGauge: RteEventRef=OpEventGetDataIndex_GetDataIndex_PS_NvBlockSwComponentTypeNVBlockDescriptor_BsRt_OilGauge
          OpEventGetDataIndex_GetDataIndex_PS_NvBlockSwComponentTypeNVBlockDescriptor_BsRt_Odometer: RteEventRef=OpEventGetDataIndex_GetDataIndex_PS_NvBlockSwComponentTypeNVBlockDescriptor_BsRt_Odometer
          OpEventGetDataIndex_GetDataIndex_PS_NvBlockSwComponentTypeNVBlockDescriptor_BsFuSa_Config: RteEventRef=OpEventGetDataIndex_GetDataIndex_PS_NvBlockSwComponentTypeNVBlockDescriptor_BsFuSa_Config
          OpEventGetDataIndex_GetDataIndex_PS_NvBlockSwComponentTypeNVBlockDescriptor_BsConst_SpeedoGauge: RteEventRef=OpEventGetDataIndex_GetDataIndex_PS_NvBlockSwComponentTypeNVBlockDescriptor_BsConst_SpeedoGauge
          OpEventGetDataIndex_GetDataIndex_PS_NvBlockSwComponentTypeNVBlockDescriptor_BsRt_SpeedoGauge: RteEventRef=OpEventGetDataIndex_GetDataIndex_PS_NvBlockSwComponentTypeNVBlockDescriptor_BsRt_SpeedoGauge
          OpEventGetDataIndex_GetDataIndex_PS_NvBlockSwComponentTypeNVBlockDescriptor_BsFuSa_Communication: RteEventRef=OpEventGetDataIndex_GetDataIndex_PS_NvBlockSwComponentTypeNVBlockDescriptor_BsFuSa_Communication
          OpEventSetDataIndex_SetDataIndex_PS_NvBlockSwComponentTypeNVBlockDescriptor_BsConst_EngOffTimer: RteEventRef=OpEventSetDataIndex_SetDataIndex_PS_NvBlockSwComponentTypeNVBlockDescriptor_BsConst_EngOffTimer
          OpEventGetDataIndex_GetDataIndex_PS_NvBlockSwComponentTypeNVBlockDescriptor_RefCys_Certicificate: RteEventRef=OpEventGetDataIndex_GetDataIndex_PS_NvBlockSwComponentTypeNVBlockDescriptor_RefCys_Certicificate
          OpEventSetDataIndex_SetDataIndex_PS_NvBlockSwComponentTypeNVBlockDescriptor_BsConst_Warning: RteEventRef=OpEventSetDataIndex_SetDataIndex_PS_NvBlockSwComponentTypeNVBlockDescriptor_BsConst_Warning
          OpEventGetDataIndex_GetDataIndex_PS_NvBlockSwComponentTypeNVBlockDescriptor_BsDiag_Dtc: RteEventRef=OpEventGetDataIndex_GetDataIndex_PS_NvBlockSwComponentTypeNVBlockDescriptor_BsDiag_Dtc
          OpEventGetDataIndex_GetDataIndex_PS_NvBlockSwComponentTypeNVBlockDescriptor_BsReten_Odometer: RteEventRef=OpEventGetDataIndex_GetDataIndex_PS_NvBlockSwComponentTypeNVBlockDescriptor_BsReten_Odometer
          OpEventGetDataIndex_GetDataIndex_PS_NvBlockSwComponentTypeNVBlockDescriptor_BsConst_FuelGauge: RteEventRef=OpEventGetDataIndex_GetDataIndex_PS_NvBlockSwComponentTypeNVBlockDescriptor_BsConst_FuelGauge
          OpEventGetDataIndex_GetDataIndex_PS_NvBlockSwComponentTypeNVBlockDescriptor_BsConst_EngOffTimer: RteEventRef=OpEventGetDataIndex_GetDataIndex_PS_NvBlockSwComponentTypeNVBlockDescriptor_BsConst_EngOffTimer
          OpEventGetDataIndex_GetDataIndex_PS_NvBlockSwComponentTypeNVBlockDescriptor_BsShare_SwUpdFotaFinPrint: RteEventRef=OpEventGetDataIndex_GetDataIndex_PS_NvBlockSwComponentTypeNVBlockDescriptor_BsShare_SwUpdFotaFinPrint
          OpEventSetDataIndex_SetDataIndex_PS_NvBlockSwComponentTypeNVBlockDescriptor_BsShare_SwUpdFotaStatus: RteEventRef=OpEventSetDataIndex_SetDataIndex_PS_NvBlockSwComponentTypeNVBlockDescriptor_BsShare_SwUpdFotaStatus
          OpEventSetDataIndex_SetDataIndex_PS_NvBlockSwComponentTypeNVBlockDescriptor_BsRt_SpeedoGauge: RteEventRef=OpEventSetDataIndex_SetDataIndex_PS_NvBlockSwComponentTypeNVBlockDescriptor_BsRt_SpeedoGauge
          OpEventGetDataIndex_GetDataIndex_PS_NvBlockSwComponentTypeNVBlockDescriptor_BsReten_Audio: RteEventRef=OpEventGetDataIndex_GetDataIndex_PS_NvBlockSwComponentTypeNVBlockDescriptor_BsReten_Audio
          OpEventSetDataIndex_SetDataIndex_PS_NvBlockSwComponentTypeNVBlockDescriptor_BsReten_RealTimeClock: RteEventRef=OpEventSetDataIndex_SetDataIndex_PS_NvBlockSwComponentTypeNVBlockDescriptor_BsReten_RealTimeClock
          OpEventGetDataIndex_GetDataIndex_PS_NvBlockSwComponentTypeNVBlockDescriptor_BsConst_Audio: RteEventRef=OpEventGetDataIndex_GetDataIndex_PS_NvBlockSwComponentTypeNVBlockDescriptor_BsConst_Audio
          OpEventGetDataIndex_GetDataIndex_PS_NvBlockSwComponentTypeNVBlockDescriptor_BsConst_TempGauge: RteEventRef=OpEventGetDataIndex_GetDataIndex_PS_NvBlockSwComponentTypeNVBlockDescriptor_BsConst_TempGauge
          OpEventGetDataIndex_GetDataIndex_PS_NvBlockSwComponentTypeNVBlockDescriptor_BsReten_VisDlt: RteEventRef=OpEventGetDataIndex_GetDataIndex_PS_NvBlockSwComponentTypeNVBlockDescriptor_BsReten_VisDlt
          OpEventSetDataIndex_SetDataIndex_PS_NvBlockSwComponentTypeNVBlockDescriptor_RefCys_Certicificate1: RteEventRef=OpEventSetDataIndex_SetDataIndex_PS_NvBlockSwComponentTypeNVBlockDescriptor_RefCys_Certicificate1
          OpEventGetDataIndex_GetDataIndex_PS_NvBlockSwComponentTypeNVBlockDescriptor_BsConst_TripComputer: RteEventRef=OpEventGetDataIndex_GetDataIndex_PS_NvBlockSwComponentTypeNVBlockDescriptor_BsConst_TripComputer
          OpEventSetDataIndex_SetDataIndex_PS_NvBlockSwComponentTypeNVBlockDescriptor_BsRt_TempGauge: RteEventRef=OpEventSetDataIndex_SetDataIndex_PS_NvBlockSwComponentTypeNVBlockDescriptor_BsRt_TempGauge
          OpEventGetDataIndex_GetDataIndex_PS_NvBlockSwComponentTypeNVBlockDescriptor_BsConst_TachoGauge: RteEventRef=OpEventGetDataIndex_GetDataIndex_PS_NvBlockSwComponentTypeNVBlockDescriptor_BsConst_TachoGauge
          OpEventGetDataIndex_GetDataIndex_PS_NvBlockSwComponentTypeNVBlockDescriptor_BsRt_TripComputer: RteEventRef=OpEventGetDataIndex_GetDataIndex_PS_NvBlockSwComponentTypeNVBlockDescriptor_BsRt_TripComputer
          OpEventGetDataIndex_GetDataIndex_PS_NvBlockSwComponentTypeNVBlockDescriptor_BsConst_Power: RteEventRef=OpEventGetDataIndex_GetDataIndex_PS_NvBlockSwComponentTypeNVBlockDescriptor_BsConst_Power
          OpEventSetDataIndex_SetDataIndex_PS_NvBlockSwComponentTypeNVBlockDescriptor_BsReten_Warning: RteEventRef=OpEventSetDataIndex_SetDataIndex_PS_NvBlockSwComponentTypeNVBlockDescriptor_BsReten_Warning
          OpEventGetDataIndex_GetDataIndex_PS_NvBlockSwComponentTypeNVBlockDescriptor_BsConst_RealTimeClock: RteEventRef=OpEventGetDataIndex_GetDataIndex_PS_NvBlockSwComponentTypeNVBlockDescriptor_BsConst_RealTimeClock
          OpEventGetDataIndex_GetDataIndex_PS_NvBlockSwComponentTypeNVBlockDescriptor_BsRt_TempGauge: RteEventRef=OpEventGetDataIndex_GetDataIndex_PS_NvBlockSwComponentTypeNVBlockDescriptor_BsRt_TempGauge
          OpEventSetDataIndex_SetDataIndex_PS_NvBlockSwComponentTypeNVBlockDescriptor_BsFuSa_Warning: RteEventRef=OpEventSetDataIndex_SetDataIndex_PS_NvBlockSwComponentTypeNVBlockDescriptor_BsFuSa_Warning
          OpEventSetDataIndex_SetDataIndex_PS_NvBlockSwComponentTypeNVBlockDescriptor_BsFuSa_Communication: RteEventRef=OpEventSetDataIndex_SetDataIndex_PS_NvBlockSwComponentTypeNVBlockDescriptor_BsFuSa_Communication
          OpEventSetDataIndex_SetDataIndex_PS_NvBlockSwComponentTypeNVBlockDescriptor_BsShare_SwUpdFotaMode: RteEventRef=OpEventSetDataIndex_SetDataIndex_PS_NvBlockSwComponentTypeNVBlockDescriptor_BsShare_SwUpdFotaMode
          OpEventGetDataIndex_GetDataIndex_PS_NvBlockSwComponentTypeNVBlockDescriptor_BsRt_PowerGauge: RteEventRef=OpEventGetDataIndex_GetDataIndex_PS_NvBlockSwComponentTypeNVBlockDescriptor_BsRt_PowerGauge
          OpEventSetDataIndex_SetDataIndex_PS_NvBlockSwComponentTypeNVBlockDescriptor_BsFuSa_Power: RteEventRef=OpEventSetDataIndex_SetDataIndex_PS_NvBlockSwComponentTypeNVBlockDescriptor_BsFuSa_Power
          OpEventSetDataIndex_SetDataIndex_PS_NvBlockSwComponentTypeNVBlockDescriptor_BsRt_CusDlt: RteEventRef=OpEventSetDataIndex_SetDataIndex_PS_NvBlockSwComponentTypeNVBlockDescriptor_BsRt_CusDlt
          OpEventGetDataIndex_GetDataIndex_PS_NvBlockSwComponentTypeNVBlockDescriptor_BsShare_SwUpdFotaStatus: RteEventRef=OpEventGetDataIndex_GetDataIndex_PS_NvBlockSwComponentTypeNVBlockDescriptor_BsShare_SwUpdFotaStatus
          OpEventSetDataIndex_SetDataIndex_PS_NvBlockSwComponentTypeNVBlockDescriptor_BsShare_VisMeet: RteEventRef=OpEventSetDataIndex_SetDataIndex_PS_NvBlockSwComponentTypeNVBlockDescriptor_BsShare_VisMeet
          OpEventGetDataIndex_GetDataIndex_PS_NvBlockSwComponentTypeNVBlockDescriptor_BsFuSa_Audio: RteEventRef=OpEventGetDataIndex_GetDataIndex_PS_NvBlockSwComponentTypeNVBlockDescriptor_BsFuSa_Audio
          OpEventSetDataIndex_SetDataIndex_PS_NvBlockSwComponentTypeNVBlockDescriptor_BsRt_Illumination: RteEventRef=OpEventSetDataIndex_SetDataIndex_PS_NvBlockSwComponentTypeNVBlockDescriptor_BsRt_Illumination
          OpEventSetDataIndex_SetDataIndex_PS_NvBlockSwComponentTypeNVBlockDescriptor_BsReten_Display: RteEventRef=OpEventSetDataIndex_SetDataIndex_PS_NvBlockSwComponentTypeNVBlockDescriptor_BsReten_Display
          OpEventGetDataIndex_GetDataIndex_PS_NvBlockSwComponentTypeNVBlockDescriptor_BsReten_Personalization: RteEventRef=OpEventGetDataIndex_GetDataIndex_PS_NvBlockSwComponentTypeNVBlockDescriptor_BsReten_Personalization
          OpEventGetDataIndex_GetDataIndex_PS_NvBlockSwComponentTypeNVBlockDescriptor_BsFuSa_Warning: RteEventRef=OpEventGetDataIndex_GetDataIndex_PS_NvBlockSwComponentTypeNVBlockDescriptor_BsFuSa_Warning
          OpEventSetDataIndex_SetDataIndex_PS_NvBlockSwComponentTypeNVBlockDescriptor_BsRt_Odometer: RteEventRef=OpEventSetDataIndex_SetDataIndex_PS_NvBlockSwComponentTypeNVBlockDescriptor_BsRt_Odometer
          OpEventSetDataIndex_SetDataIndex_PS_NvBlockSwComponentTypeNVBlockDescriptor_BsReten_Power: RteEventRef=OpEventSetDataIndex_SetDataIndex_PS_NvBlockSwComponentTypeNVBlockDescriptor_BsReten_Power
          OpEventSetDataIndex_SetDataIndex_PS_NvBlockSwComponentTypeNVBlockDescriptor_BsShare_SwUpdFotadecrypt: RteEventRef=OpEventSetDataIndex_SetDataIndex_PS_NvBlockSwComponentTypeNVBlockDescriptor_BsShare_SwUpdFotadecrypt
          OpEventSetDataIndex_SetDataIndex_PS_NvBlockSwComponentTypeNVBlockDescriptor_BsConst_Communication: RteEventRef=OpEventSetDataIndex_SetDataIndex_PS_NvBlockSwComponentTypeNVBlockDescriptor_BsConst_Communication
          OpEventSetDataIndex_SetDataIndex_PS_NvBlockSwComponentTypeNVBlockDescriptor_BsConst_Audio: RteEventRef=OpEventSetDataIndex_SetDataIndex_PS_NvBlockSwComponentTypeNVBlockDescriptor_BsConst_Audio
          OpEventSetDataIndex_SetDataIndex_PS_NvBlockSwComponentTypeNVBlockDescriptor_BsConst_Illumination: RteEventRef=OpEventSetDataIndex_SetDataIndex_PS_NvBlockSwComponentTypeNVBlockDescriptor_BsConst_Illumination
          OpEventSetDataIndex_SetDataIndex_PS_NvBlockSwComponentTypeNVBlockDescriptor_BsReten_Personalization: RteEventRef=OpEventSetDataIndex_SetDataIndex_PS_NvBlockSwComponentTypeNVBlockDescriptor_BsReten_Personalization
          OpEventSetDataIndex_SetDataIndex_PS_NvBlockSwComponentTypeNVBlockDescriptor_BsShare_SwUpdFotaFinPrint: RteEventRef=OpEventSetDataIndex_SetDataIndex_PS_NvBlockSwComponentTypeNVBlockDescriptor_BsShare_SwUpdFotaFinPrint
          OpEventSetDataIndex_SetDataIndex_PS_NvBlockSwComponentTypeNVBlockDescriptor_BsReten_Tripcomputer: RteEventRef=OpEventSetDataIndex_SetDataIndex_PS_NvBlockSwComponentTypeNVBlockDescriptor_BsReten_Tripcomputer
          OpEventGetDataIndex_GetDataIndex_PS_NvBlockSwComponentTypeNVBlockDescriptor_BsFusa_Fota: RteEventRef=OpEventGetDataIndex_GetDataIndex_PS_NvBlockSwComponentTypeNVBlockDescriptor_BsFusa_Fota
          OpEventSetDataIndex_SetDataIndex_PS_NvBlockSwComponentTypeNVBlockDescriptor_BsDiag_Dtc: RteEventRef=OpEventSetDataIndex_SetDataIndex_PS_NvBlockSwComponentTypeNVBlockDescriptor_BsDiag_Dtc
          OpEventSetDataIndex_SetDataIndex_PS_NvBlockSwComponentTypeNVBlockDescriptor_BsFuSa_Audio: RteEventRef=OpEventSetDataIndex_SetDataIndex_PS_NvBlockSwComponentTypeNVBlockDescriptor_BsFuSa_Audio
          OpEventSetDataIndex_SetDataIndex_PS_NvBlockSwComponentTypeNVBlockDescriptor_BsReten_VisDlt: RteEventRef=OpEventSetDataIndex_SetDataIndex_PS_NvBlockSwComponentTypeNVBlockDescriptor_BsReten_VisDlt
          OpEventGetDataIndex_GetDataIndex_PS_NvBlockSwComponentTypeNVBlockDescriptor_BsRt_Warning: RteEventRef=OpEventGetDataIndex_GetDataIndex_PS_NvBlockSwComponentTypeNVBlockDescriptor_BsRt_Warning
          OpEventGetDataIndex_GetDataIndex_PS_NvBlockSwComponentTypeNVBlockDescriptor_BsShare_SwUpdFotadecrypt: RteEventRef=OpEventGetDataIndex_GetDataIndex_PS_NvBlockSwComponentTypeNVBlockDescriptor_BsShare_SwUpdFotadecrypt
          OpEventSetDataIndex_SetDataIndex_PS_NvBlockSwComponentTypeNVBlockDescriptor_BsConst_TempGauge: RteEventRef=OpEventSetDataIndex_SetDataIndex_PS_NvBlockSwComponentTypeNVBlockDescriptor_BsConst_TempGauge
          OpEventGetDataIndex_GetDataIndex_PS_NvBlockSwComponentTypeNVBlockDescriptor_BsCys_Certicificate: RteEventRef=OpEventGetDataIndex_GetDataIndex_PS_NvBlockSwComponentTypeNVBlockDescriptor_BsCys_Certicificate
          OpEventGetDataIndex_GetDataIndex_PS_NvBlockSwComponentTypeNVBlockDescriptor_BsConst_Illumination: RteEventRef=OpEventGetDataIndex_GetDataIndex_PS_NvBlockSwComponentTypeNVBlockDescriptor_BsConst_Illumination
          OpEventSetDataIndex_SetDataIndex_PS_NvBlockSwComponentTypeNVBlockDescriptor_BsConst_RealTimeClock: RteEventRef=OpEventSetDataIndex_SetDataIndex_PS_NvBlockSwComponentTypeNVBlockDescriptor_BsConst_RealTimeClock
          OpEventSetDataIndex_SetDataIndex_PS_NvBlockSwComponentTypeNVBlockDescriptor_BsFuSa_Config: RteEventRef=OpEventSetDataIndex_SetDataIndex_PS_NvBlockSwComponentTypeNVBlockDescriptor_BsFuSa_Config
          OpEventGetDataIndex_GetDataIndex_PS_NvBlockSwComponentTypeNVBlockDescriptor_BsRt_TachoGauge: RteEventRef=OpEventGetDataIndex_GetDataIndex_PS_NvBlockSwComponentTypeNVBlockDescriptor_BsRt_TachoGauge
          OpEventGetDataIndex_GetDataIndex_PS_NvBlockSwComponentTypeNVBlockDescriptor_BsRt_FuelGauge: RteEventRef=OpEventGetDataIndex_GetDataIndex_PS_NvBlockSwComponentTypeNVBlockDescriptor_BsRt_FuelGauge
          OpEventSetDataIndex_SetDataIndex_PS_NvBlockSwComponentTypeNVBlockDescriptor_BsReten_Odometer: RteEventRef=OpEventSetDataIndex_SetDataIndex_PS_NvBlockSwComponentTypeNVBlockDescriptor_BsReten_Odometer
          OpEventGetDataIndex_GetDataIndex_PS_NvBlockSwComponentTypeNVBlockDescriptor_BsDiag_ErrorRecord: RteEventRef=OpEventGetDataIndex_GetDataIndex_PS_NvBlockSwComponentTypeNVBlockDescriptor_BsDiag_ErrorRecord
          OpEventSetDataIndex_SetDataIndex_PS_NvBlockSwComponentTypeNVBlockDescriptor_BsRt_TachoGauge: RteEventRef=OpEventSetDataIndex_SetDataIndex_PS_NvBlockSwComponentTypeNVBlockDescriptor_BsRt_TachoGauge
          OpEventGetDataIndex_GetDataIndex_PS_NvBlockSwComponentTypeNVBlockDescriptor_BsRt_Illumination: RteEventRef=OpEventGetDataIndex_GetDataIndex_PS_NvBlockSwComponentTypeNVBlockDescriptor_BsRt_Illumination
      TmExt_EcuSwComposition: RteSoftwareComponentInstanceRef=TmExt
        6 x RteEventToTaskMapping, all with RteImmediateRestart=false:
          TETmExt_MainFunction: RtePositionInTask=13, RteEventRef=TETmExt_MainFunction, RteMappedToTaskRef=OsTask_MemSer, RteUsedOsEventRef=Rte_Ev_Cyclic_OsTask_MemSer_0_10ms, RteUsedOsAlarmRef=Rte_Al_TE_OsTask_MemSer_0_10ms
          OIE_pp_CS_TmExt_Timer_GetElapsedTime_TmExt_Timer_GetElapsedTimeTrigByTimer_GetElapsedTime: RteEventRef=OIE_pp_CS_TmExt_Timer_GetElapsedTime_TmExt_Timer_GetElapsedTimeTrigByTimer_GetElapsedTime
          OIE_pp_CS_TmExt_Timer_IsElapsed_TmExt_Timer_IsElapsedTrigByTimer_IsElapsed: RteEventRef=OIE_pp_CS_TmExt_Timer_IsElapsed_TmExt_Timer_IsElapsedTrigByTimer_IsElapsed
          OIE_pp_CS_TmExt_Timer_IsStarted_TmExt_Timer_IsStartedTrigByTimer_IsStarted: RteEventRef=OIE_pp_CS_TmExt_Timer_IsStarted_TmExt_Timer_IsStartedTrigByTimer_IsStarted
          OIE_pp_CS_TmExt_Timer_Start_TmExt_Timer_StartTrigByTimer_Start: RteEventRef=OIE_pp_CS_TmExt_Timer_Start_TmExt_Timer_StartTrigByTimer_Start
          OIE_pp_CS_TmExt_Timer_Stop_TmExt_Timer_StopTrigByTimer_Stop: RteEventRef=OIE_pp_CS_TmExt_Timer_Stop_TmExt_Timer_StopTrigByTimer_Stop
      NvMExt_EcuSwComposition: RteSoftwareComponentInstanceRef=NvMExt
        12 x RteEventToTaskMapping, all with RteImmediateRestart=false:
          TENvMExt_MainFunction: RtePositionInTask=6, RteEventRef=TENvMExt_MainFunction, RteMappedToTaskRef=OsTask_MemSer, RteUsedOsEventRef=Rte_Ev_Cyclic_OsTask_MemSer_0_10ms, RteUsedOsAlarmRef=Rte_Al_TE_OsTask_MemSer_0_10ms
          OIE_pp_CS_NvMExt_SleepOperations_NvMExt_CancelSleepTrigByNvMExt_CancelSleep: RteEventRef=OIE_pp_CS_NvMExt_SleepOperations_NvMExt_CancelSleepTrigByNvMExt_CancelSleep
          OIE_pp_CS_NvMExt_GetErrorStatus_NvMExt_GetErrorStatusTrigByNvMExt_GetErrorStatus: RteEventRef=OIE_pp_CS_NvMExt_GetErrorStatus_NvMExt_GetErrorStatusTrigByNvMExt_GetErrorStatus
          OIE_pp_CS_NvmExt_GetPendingStatus_NvMExt_GetPendingStatusTrigByNvMExt_GetPendingStatus: RteEventRef=OIE_pp_CS_NvmExt_GetPendingStatus_NvMExt_GetPendingStatusTrigByNvMExt_GetPendingStatus
          OIE_pp_CS_NvmExtStartReadAll_NvMExt_ReadAllTrigByNvMExt_ReadAll: RteEventRef=OIE_pp_CS_NvmExtStartReadAll_NvMExt_ReadAllTrigByNvMExt_ReadAll
          OIE_pp_CS_NvMExt_ReadBlock_NvMExt_ReadBlockTrigByNvMExt_ReadBlock: RteEventRef=OIE_pp_CS_NvMExt_ReadBlock_NvMExt_ReadBlockTrigByNvMExt_ReadBlock
          OIE_pp_CS_NvMExt_SleepOperations_NvMExt_ReadytoSleepTrigByNvMExt_ReadytoSleep: RteEventRef=OIE_pp_CS_NvMExt_SleepOperations_NvMExt_ReadytoSleepTrigByNvMExt_ReadytoSleep
          OIE_pp_CS_NvMExt_SleepOperations_NvMExt_RequestSleepTrigByNvMExt_RequestSleep: RteEventRef=OIE_pp_CS_NvMExt_SleepOperations_NvMExt_RequestSleepTrigByNvMExt_RequestSleep
          OIE_pp_CS_NvMExt_RestoreBlockDefaults_NvMExt_RestoreBlockDefaultsTrigByNvMExt_RestoreBlockDefaults: RteEventRef=OIE_pp_CS_NvMExt_RestoreBlockDefaults_NvMExt_RestoreBlockDefaultsTrigByNvMExt_RestoreBlockDefaults
          OIE_pp_CS_NvMExt_WriteBlock_NvMExt_WriteBlockTrigByNvMExt_WriteBlock: RteEventRef=OIE_pp_CS_NvMExt_WriteBlock_NvMExt_WriteBlockTrigByNvMExt_WriteBlock
          OIE_pp_CS_NvMExt_GetNvMExtReadAllStatus_NvmExt_GetNvMReadAllStatusTrigByNvmExt_GetNvMReadAllStatus: RteEventRef=OIE_pp_CS_NvMExt_GetNvMExtReadAllStatus_NvmExt_GetNvMReadAllStatusTrigByNvmExt_GetNvMReadAllStatus
          TENvMExt_SpeedupRunnable: RtePositionInTask=0, RteEventRef=TENvMExt_SpeedupRunnable, RteMappedToTaskRef=OsTask_NvmSpeedup, RteUsedOsEventRef=Rte_Ev_Run_NvMExt_NvMExt_SpeedupRunnable, RteUsedOsAlarmRef=Rte_Al_TE_NvMExt_NvMExt_SpeedupRunnable
      EcuMExt_EcuSwComposition: RteSoftwareComponentInstanceRef=EcuMExt
        3 x RteEventToTaskMapping, all with RteImmediateRestart=false:
          TEEcuMExt_MainFunction: RtePositionInTask=1, RteEventRef=TEEcuMExt_MainFunction, RteMappedToTaskRef=OsTask_Mcal, RteUsedOsAlarmRef=Rte_Al_TE_OsTask_Mcal_0_10ms
          OIE_ppCS_EcumExt_ReleaseRUN_EcuMExt_ReleaseRUNTrigByReleaseRUN: RteEventRef=OIE_ppCS_EcumExt_ReleaseRUN_EcuMExt_ReleaseRUNTrigByReleaseRUN
          OIE_ppCS_EcumExt_RequestRUN_EcuMExt_RequestRUNTrigByRequestRUN: RteEventRef=OIE_ppCS_EcumExt_RequestRUN_EcuMExt_RequestRUNTrigByRequestRUN
      IoHwAb_EcuSwComposition: RteSoftwareComponentInstanceRef=IoHwAb
        20 x RteEventToTaskMapping, all with RteImmediateRestart=false:
          OIE_ppIoHwAb_ADC_IoHwAb_GetAsyncRawAdcTrigByGetAsyncRawAdc: RteEventRef=OIE_ppIoHwAb_ADC_IoHwAb_GetAsyncRawAdcTrigByGetAsyncRawAdc
          OIE_ppIoHwAb_Din_IoHwAb_GetAsyncRawInputTrigByGetAsyncRawInput: RteEventRef=OIE_ppIoHwAb_Din_IoHwAb_GetAsyncRawInputTrigByGetAsyncRawInput
          OIE_ppIoHwAb_Pulse_IoHwAb_GetCurrentSignalStatus_PulseInputTrigByGetCurrentSignalStatus_PulseInput: RteEventRef=OIE_ppIoHwAb_Pulse_IoHwAb_GetCurrentSignalStatus_PulseInputTrigByGetCurrentSignalStatus_PulseInput
          OIE_ppIoHwAb_Pulse_IoHwAb_GetCurrentSpeed_PulseInputTrigByGetCurrentSpeed_PulseInput: RteEventRef=OIE_ppIoHwAb_Pulse_IoHwAb_GetCurrentSpeed_PulseInputTrigByGetCurrentSpeed_PulseInput
          OIE_ppIoHwAb_Din_IoHwAb_GetInputGroupTrigByGetInputGroup: RteEventRef=OIE_ppIoHwAb_Din_IoHwAb_GetInputGroupTrigByGetInputGroup
          OIE_ppIoHwAb_ADC_IoHwAb_GetProcessedAdcTrigByGetProcessedAdc: RteEventRef=OIE_ppIoHwAb_ADC_IoHwAb_GetProcessedAdcTrigByGetProcessedAdc
          OIE_ppIoHwAb_Din_IoHwAb_GetProcessedInputTrigByGetProcessedInput: RteEventRef=OIE_ppIoHwAb_Din_IoHwAb_GetProcessedInputTrigByGetProcessedInput
          OIE_ppIoHwAb_Pulse_IoHwAb_GetRollingCount_PulseInputTrigByGetRollingCount_PulseInput: RteEventRef=OIE_ppIoHwAb_Pulse_IoHwAb_GetRollingCount_PulseInputTrigByGetRollingCount_PulseInput
          OIE_ppIoHwAb_ADC_IoHwAb_GetSyncRawAdcTrigByGetSyncRawAdc: RteEventRef=OIE_ppIoHwAb_ADC_IoHwAb_GetSyncRawAdcTrigByGetSyncRawAdc
          OIE_ppIoHwAb_Din_IoHwAb_GetSyncRawInputTrigByGetSyncRawInput: RteEventRef=OIE_ppIoHwAb_Din_IoHwAb_GetSyncRawInputTrigByGetSyncRawInput
          TEIoHwAb_MainFunction: RtePositionInTask=4, RteEventRef=TEIoHwAb_MainFunction, RteMappedToTaskRef=OsTask_Mcal, RteUsedOsAlarmRef=Rte_Al_TE_OsTask_Mcal_0_10ms
          OIE_ppIoHwAb_PWM_IoHwAb_PwmSetDutyTrigByPwmSetDuty: RteEventRef=OIE_ppIoHwAb_PWM_IoHwAb_PwmSetDutyTrigByPwmSetDuty
          OIE_ppIoHwAb_PWM_IoHwAb_PwmSetDutyAndPeriodTrigByPwmSetDutyAndPeriod: RteEventRef=OIE_ppIoHwAb_PWM_IoHwAb_PwmSetDutyAndPeriodTrigByPwmSetDutyAndPeriod
          OIE_ppIoHwAb_PWM_IoHwAb_PwmSetIdealTrigByPwmSetIdeal: RteEventRef=OIE_ppIoHwAb_PWM_IoHwAb_PwmSetIdealTrigByPwmSetIdeal
          OIE_ppIoHwAb_Pulse_IoHwAb_ResetRollingCount_PulseInputTrigByResetRollingCount_PulseInput: RteEventRef=OIE_ppIoHwAb_Pulse_IoHwAb_ResetRollingCount_PulseInputTrigByResetRollingCount_PulseInput
          OIE_ppIoHwAb_DOut_IoHwAb_SetOutputGroupTrigBySetOutputGroup: RteEventRef=OIE_ppIoHwAb_DOut_IoHwAb_SetOutputGroupTrigBySetOutputGroup
          OIE_ppIoHwAb_DOut_IoHwAb_SetOutputPinTrigBySetOutputPin: RteEventRef=OIE_ppIoHwAb_DOut_IoHwAb_SetOutputPinTrigBySetOutputPin
          OIE_ppIoHwAb_Pulse_IoHwAb_Start_Signal_Measurement_PulseInputTrigByStart_Signal_Measurement_PulseInput: RteEventRef=OIE_ppIoHwAb_Pulse_IoHwAb_Start_Signal_Measurement_PulseInputTrigByStart_Signal_Measurement_PulseInput
          OIE_ppIoHwAb_Pulse_IoHwAb_Stop_Signal_Measurement_PulseInputTrigByStop_Signal_Measurement_PulseInput: RteEventRef=OIE_ppIoHwAb_Pulse_IoHwAb_Stop_Signal_Measurement_PulseInputTrigByStop_Signal_Measurement_PulseInput
          OIE_ppIoHwAb_Pulse_IoHwAb_Update_CalibParam_PulseInputTrigByUpdate_CalibParam_PulseInput: RteEventRef=OIE_ppIoHwAb_Pulse_IoHwAb_Update_CalibParam_PulseInputTrigByUpdate_CalibParam_PulseInput
    4 x RteSwComponentType:
      TmExt: RteComponentTypeRef=TmExt, RteImplementationRef=IMPL_TmExt
        ComponentTypeCalibration (RteComponentTypeCalibration): RteCalibrationSupportEnabled=false
      IoHwAb: RteComponentTypeRef=IoHwAb, RteImplementationRef=IMPL_IoHwAb
        ComponentTypeCalibration (RteComponentTypeCalibration): RteCalibrationSupportEnabled=false
      NvMExt: RteComponentTypeRef=NvMExt, RteImplementationRef=IMPL_NvMExt
        ComponentTypeCalibration (RteComponentTypeCalibration): RteCalibrationSupportEnabled=false
      EcuMExt: RteComponentTypeRef=EcuMExt, RteImplementationRef=IMPL_EcuMExt
        ComponentTypeCalibration (RteComponentTypeCalibration): RteCalibrationSupportEnabled=false
    Ea (RteBswModuleInstance): RteBswImplementationRef=Ea_Impl, RteBswModuleConfigurationRef=Ea
      Ea_MainFunctionTimingEvent0 (RteBswEventToTaskMapping):
        RteBswImmediateRestart = false
        RteBswPositionInTask = 1
        RteBswEventRef = Ea_MainFunctionTimingEvent0
        RteBswMappedToTaskRef = OsTask_MemSer
        RteBswUsedOsEventRef = Rte_Ev_Run_Ea_Ea_MainFunction
        RteBswUsedOsAlarmRef = Rte_Al_TE_Ea_Ea_MainFunction
