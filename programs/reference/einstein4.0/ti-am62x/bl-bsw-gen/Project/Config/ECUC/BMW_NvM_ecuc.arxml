AUTOSAR XML (schema 00044)
package /ActiveEcuC
  module config NvM: implementation-config-variant=VARIANT-PRE-COMPILE, module-description=NvM_Impl
    61 x NvMBlockDescriptor, all with NvMBlockCrcType=NVM_CRC16, NvMInitBlockCallback=NULL_PTR, NvMResistantToChangedSw=true, NvMSelectBlockForReadAll=true, NvMUseInitCallback=false, NvMSingleBlockCallback=NULL_PTR, NvMBswMBlockStatusInformation=false, NvMCalcRamBlockCrc=false, NvMNvBlockNum=2, NvMBlockWriteProt=false, NvMRamBlockDataAddress=NULL_PTR, NvMWriteBlockOnce=false, NvMAutomaticBlockLength=false, NvMBlockLengthCheckType=true:
      NvBlockSwComponentTypeNVBlockDescriptor_BsConst_Audio: NvMBlockManagementType=NVM_BLOCK_DATASET, NvMSelectBlockForWriteAll=false, NvMUseJobendCallback=true, NvMBlockUseCrc=false, NvMBlockUseSyncMechanism=true, NvMUseServicePorts=true, NvMNvramBlockIdentifier=19, NvMNvBlockLength=128, NvMRomBlockDataAddress=Rte_NvBlockSwComponentType_NVBlockDescriptor_BsConst_Audio_ROM_NVBlockDescriptor_BsConst_Audio, NvMBlockJobPriority=1, NvMReadRamBlockFromNvCallback=Rte_SetMirror_NvBlockSwComponentType_NVBlockDescriptor_BsConst_Audio, NvMWriteRamBlockToNvCallback=Rte_GetMirror_NvBlockSwComponentType_NVBlockDescriptor_BsConst_Audio, NvMBlockLengthCheck=true, NvMWriteVerification=false, NvMBlockUseSetRamBlockStatus=true  # UC:Derived from NvBlockNeeds
        NvMTargetBlockReference
          NvMFeeRef: NvMNameOfFeeBlock=Fee_BsConst_Audio
      NvBlockSwComponentTypeNVBlockDescriptor_BsConst_Communication: NvMBlockManagementType=NVM_BLOCK_DATASET, NvMSelectBlockForWriteAll=false, NvMUseJobendCallback=true, NvMBlockUseCrc=false, NvMBlockUseSyncMechanism=true, NvMUseServicePorts=true, NvMNvramBlockIdentifier=22, NvMNvBlockLength=64, NvMRomBlockDataAddress=Rte_NvBlockSwComponentType_NVBlockDescriptor_BsConst_Communication_ROM_NVBlockDescriptor_BsConst_Communication, NvMBlockJobPriority=1, NvMReadRamBlockFromNvCallback=Rte_SetMirror_NvBlockSwComponentType_NVBlockDescriptor_BsConst_Communication, NvMWriteRamBlockToNvCallback=Rte_GetMirror_NvBlockSwComponentType_NVBlockDescriptor_BsConst_Communication, NvMBlockLengthCheck=true, NvMWriteVerification=false, NvMBlockUseSetRamBlockStatus=true  # UC:Derived from NvBlockNeeds
        NvMTargetBlockReference
          NvMFeeRef: NvMNameOfFeeBlock=Fee_BsConst_Communication
      NvBlockSwComponentTypeNVBlockDescriptor_BsConst_EngOffTimer: NvMBlockManagementType=NVM_BLOCK_DATASET, NvMSelectBlockForWriteAll=false, NvMUseJobendCallback=true, NvMBlockUseCrc=false, NvMBlockUseSyncMechanism=true, NvMUseServicePorts=true, NvMNvramBlockIdentifier=25, NvMNvBlockLength=32, NvMRomBlockDataAddress=Rte_NvBlockSwComponentType_NVBlockDescriptor_BsConst_EngOffTimer_ROM_NVBlockDescriptor_BsConst_EngOffTimer, NvMBlockJobPriority=1, NvMReadRamBlockFromNvCallback=Rte_SetMirror_NvBlockSwComponentType_NVBlockDescriptor_BsConst_EngOffTimer, NvMWriteRamBlockToNvCallback=Rte_GetMirror_NvBlockSwComponentType_NVBlockDescriptor_BsConst_EngOffTimer, NvMBlockLengthCheck=true, NvMWriteVerification=false, NvMBlockUseSetRamBlockStatus=true  # UC:Derived from NvBlockNeeds
        NvMTargetBlockReference
          NvMFeeRef: NvMNameOfFeeBlock=Fee_BsConst_EngOffTimer
      NvBlockSwComponentTypeNVBlockDescriptor_BsConst_FuelGauge: NvMBlockManagementType=NVM_BLOCK_DATASET, NvMSelectBlockForWriteAll=false, NvMUseJobendCallback=true, NvMBlockUseCrc=false, NvMBlockUseSyncMechanism=true, NvMUseServicePorts=true, NvMNvramBlockIdentifier=13, NvMNvBlockLength=128, NvMRomBlockDataAddress=Rte_NvBlockSwComponentType_NVBlockDescriptor_BsConst_FuelGauge_ROM_NVBlockDescriptor_BsConst_FuelGauge, NvMBlockJobPriority=1, NvMReadRamBlockFromNvCallback=Rte_SetMirror_NvBlockSwComponentType_NVBlockDescriptor_BsConst_FuelGauge, NvMWriteRamBlockToNvCallback=Rte_GetMirror_NvBlockSwComponentType_NVBlockDescriptor_BsConst_FuelGauge, NvMBlockLengthCheck=true, NvMWriteVerification=false, NvMBlockUseSetRamBlockStatus=true  # UC:Derived from NvBlockNeeds
        NvMTargetBlockReference
          NvMFeeRef: NvMNameOfFeeBlock=Fee_BsConst_FuelGauge
      NvBlockSwComponentTypeNVBlockDescriptor_BsConst_Illumination: NvMBlockManagementType=NVM_BLOCK_DATASET, NvMSelectBlockForWriteAll=false, NvMUseJobendCallback=true, NvMBlockUseCrc=false, NvMBlockUseSyncMechanism=true, NvMUseServicePorts=true, NvMNvramBlockIdentifier=18, NvMNvBlockLength=128, NvMRomBlockDataAddress=Rte_NvBlockSwComponentType_NVBlockDescriptor_BsConst_Illumination_ROM_NVBlockDescriptor_BsConst_Illumination, NvMBlockJobPriority=1, NvMReadRamBlockFromNvCallback=Rte_SetMirror_NvBlockSwComponentType_NVBlockDescriptor_BsConst_Illumination, NvMWriteRamBlockToNvCallback=Rte_GetMirror_NvBlockSwComponentType_NVBlockDescriptor_BsConst_Illumination, NvMBlockLengthCheck=true, NvMWriteVerification=false, NvMBlockUseSetRamBlockStatus=true  # UC:Derived from NvBlockNeeds
        NvMTargetBlockReference
          NvMFeeRef: NvMNameOfFeeBlock=Fee_BsConst_Illumination
      NvBlockSwComponentTypeNVBlockDescriptor_BsConst_OilGauge: NvMBlockManagementType=NVM_BLOCK_DATASET, NvMSelectBlockForWriteAll=false, NvMUseJobendCallback=true, NvMBlockUseCrc=false, NvMBlockUseSyncMechanism=true, NvMUseServicePorts=true, NvMNvramBlockIdentifier=16, NvMNvBlockLength=64, NvMRomBlockDataAddress=Rte_NvBlockSwComponentType_NVBlockDescriptor_BsConst_OilGauge_ROM_NVBlockDescriptor_BsConst_OilGauge, NvMBlockJobPriority=1, NvMReadRamBlockFromNvCallback=Rte_SetMirror_NvBlockSwComponentType_NVBlockDescriptor_BsConst_OilGauge, NvMWriteRamBlockToNvCallback=Rte_GetMirror_NvBlockSwComponentType_NVBlockDescriptor_BsConst_OilGauge, NvMBlockLengthCheck=true, NvMWriteVerification=false, NvMBlockUseSetRamBlockStatus=true  # UC:Derived from NvBlockNeeds
        NvMTargetBlockReference
          NvMFeeRef: NvMNameOfFeeBlock=Fee_BsConst_OilGauge
      NvBlockSwComponentTypeNVBlockDescriptor_BsConst_Power: NvMBlockManagementType=NVM_BLOCK_DATASET, NvMSelectBlockForWriteAll=false, NvMUseJobendCallback=true, NvMBlockUseCrc=false, NvMBlockUseSyncMechanism=true, NvMUseServicePorts=true, NvMNvramBlockIdentifier=23, NvMNvBlockLength=32, NvMRomBlockDataAddress=Rte_NvBlockSwComponentType_NVBlockDescriptor_BsConst_Power_ROM_NVBlockDescriptor_BsConst_Power, NvMBlockJobPriority=1, NvMReadRamBlockFromNvCallback=Rte_SetMirror_NvBlockSwComponentType_NVBlockDescriptor_BsConst_Power, NvMWriteRamBlockToNvCallback=Rte_GetMirror_NvBlockSwComponentType_NVBlockDescriptor_BsConst_Power, NvMBlockLengthCheck=true, NvMWriteVerification=false, NvMBlockUseSetRamBlockStatus=true  # UC:Derived from NvBlockNeeds
        NvMTargetBlockReference
          NvMFeeRef: NvMNameOfFeeBlock=Fee_BsConst_Power
      NvBlockSwComponentTypeNVBlockDescriptor_BsConst_PowerGauge: NvMBlockManagementType=NVM_BLOCK_DATASET, NvMSelectBlockForWriteAll=false, NvMUseJobendCallback=true, NvMBlockUseCrc=false, NvMBlockUseSyncMechanism=true, NvMUseServicePorts=true, NvMNvramBlockIdentifier=15, NvMNvBlockLength=64, NvMRomBlockDataAddress=Rte_NvBlockSwComponentType_NVBlockDescriptor_BsConst_PowerGauge_ROM_NVBlockDescriptor_BsConst_PowerGauge, NvMBlockJobPriority=1, NvMReadRamBlockFromNvCallback=Rte_SetMirror_NvBlockSwComponentType_NVBlockDescriptor_BsConst_PowerGauge, NvMWriteRamBlockToNvCallback=Rte_GetMirror_NvBlockSwComponentType_NVBlockDescriptor_BsConst_PowerGauge, NvMBlockLengthCheck=true, NvMWriteVerification=false, NvMBlockUseSetRamBlockStatus=true  # UC:Derived from NvBlockNeeds
        NvMTargetBlockReference
          NvMFeeRef: NvMNameOfFeeBlock=Fee_BsConst_PowerGauge
      NvBlockSwComponentTypeNVBlockDescriptor_BsConst_RealTimeClock: NvMBlockManagementType=NVM_BLOCK_DATASET, NvMSelectBlockForWriteAll=false, NvMUseJobendCallback=true, NvMBlockUseCrc=false, NvMBlockUseSyncMechanism=true, NvMUseServicePorts=true, NvMNvramBlockIdentifier=21, NvMNvBlockLength=48, NvMRomBlockDataAddress=Rte_NvBlockSwComponentType_NVBlockDescriptor_BsConst_RealTimeClock_ROM_NVBlockDescriptor_BsConst_RealTimeClock, NvMBlockJobPriority=1, NvMReadRamBlockFromNvCallback=Rte_SetMirror_NvBlockSwComponentType_NVBlockDescriptor_BsConst_RealTimeClock, NvMWriteRamBlockToNvCallback=Rte_GetMirror_NvBlockSwComponentType_NVBlockDescriptor_BsConst_RealTimeClock, NvMBlockLengthCheck=true, NvMWriteVerification=false, NvMBlockUseSetRamBlockStatus=true  # UC:Derived from NvBlockNeeds
        NvMTargetBlockReference
          NvMFeeRef: NvMNameOfFeeBlock=Fee_BsConst_RealTimeClock
      NvBlockSwComponentTypeNVBlockDescriptor_BsConst_ServiceReminder: NvMBlockManagementType=NVM_BLOCK_DATASET, NvMSelectBlockForWriteAll=false, NvMUseJobendCallback=true, NvMBlockUseCrc=false, NvMBlockUseSyncMechanism=true, NvMUseServicePorts=true, NvMNvramBlockIdentifier=24, NvMNvBlockLength=48, NvMRomBlockDataAddress=Rte_NvBlockSwComponentType_NVBlockDescriptor_BsConst_ServiceReminder_ROM_NVBlockDescriptor_BsConst_ServiceReminder, NvMBlockJobPriority=1, NvMReadRamBlockFromNvCallback=Rte_SetMirror_NvBlockSwComponentType_NVBlockDescriptor_BsConst_ServiceReminder, NvMWriteRamBlockToNvCallback=Rte_GetMirror_NvBlockSwComponentType_NVBlockDescriptor_BsConst_ServiceReminder, NvMBlockLengthCheck=true, NvMWriteVerification=false, NvMBlockUseSetRamBlockStatus=true  # UC:Derived from NvBlockNeeds
        NvMTargetBlockReference
          NvMFeeRef: NvMNameOfFeeBlock=Fee_BsConst_ServiceReminder
      NvBlockSwComponentTypeNVBlockDescriptor_BsConst_SpeedoGauge: NvMBlockManagementType=NVM_BLOCK_DATASET, NvMSelectBlockForWriteAll=false, NvMUseJobendCallback=true, NvMBlockUseCrc=false, NvMBlockUseSyncMechanism=true, NvMUseServicePorts=true, NvMNvramBlockIdentifier=11, NvMNvBlockLength=64, NvMRomBlockDataAddress=Rte_NvBlockSwComponentType_NVBlockDescriptor_BsConst_SpeedoGauge_ROM_NVBlockDescriptor_BsConst_SpeedoGauge, NvMBlockJobPriority=1, NvMReadRamBlockFromNvCallback=Rte_SetMirror_NvBlockSwComponentType_NVBlockDescriptor_BsConst_SpeedoGauge, NvMWriteRamBlockToNvCallback=Rte_GetMirror_NvBlockSwComponentType_NVBlockDescriptor_BsConst_SpeedoGauge, NvMBlockLengthCheck=true, NvMWriteVerification=false, NvMBlockUseSetRamBlockStatus=true  # UC:Derived from NvBlockNeeds
        NvMTargetBlockReference
          NvMFeeRef: NvMNameOfFeeBlock=Fee_BsConst_SpeedoGauge
      NvBlockSwComponentTypeNVBlockDescriptor_BsConst_TachoGauge: NvMBlockManagementType=NVM_BLOCK_DATASET, NvMSelectBlockForWriteAll=false, NvMUseJobendCallback=true, NvMBlockUseCrc=false, NvMBlockUseSyncMechanism=true, NvMUseServicePorts=true, NvMNvramBlockIdentifier=12, NvMNvBlockLength=64, NvMRomBlockDataAddress=Rte_NvBlockSwComponentType_NVBlockDescriptor_BsConst_TachoGauge_ROM_NVBlockDescriptor_BsConst_TachoGauge, NvMBlockJobPriority=1, NvMReadRamBlockFromNvCallback=Rte_SetMirror_NvBlockSwComponentType_NVBlockDescriptor_BsConst_TachoGauge, NvMWriteRamBlockToNvCallback=Rte_GetMirror_NvBlockSwComponentType_NVBlockDescriptor_BsConst_TachoGauge, NvMBlockLengthCheck=true, NvMWriteVerification=false, NvMBlockUseSetRamBlockStatus=true  # UC:Derived from NvBlockNeeds
        NvMTargetBlockReference
          NvMFeeRef: NvMNameOfFeeBlock=Fee_BsConst_TachoGauge
      NvBlockSwComponentTypeNVBlockDescriptor_BsConst_TempGauge: NvMBlockManagementType=NVM_BLOCK_DATASET, NvMSelectBlockForWriteAll=false, NvMUseJobendCallback=true, NvMBlockUseCrc=false, NvMBlockUseSyncMechanism=true, NvMUseServicePorts=true, NvMNvramBlockIdentifier=14, NvMNvBlockLength=64, NvMRomBlockDataAddress=Rte_NvBlockSwComponentType_NVBlockDescriptor_BsConst_TempGauge_ROM_NVBlockDescriptor_BsConst_TempGauge, NvMBlockJobPriority=1, NvMReadRamBlockFromNvCallback=Rte_SetMirror_NvBlockSwComponentType_NVBlockDescriptor_BsConst_TempGauge, NvMWriteRamBlockToNvCallback=Rte_GetMirror_NvBlockSwComponentType_NVBlockDescriptor_BsConst_TempGauge, NvMBlockLengthCheck=true, NvMWriteVerification=false, NvMBlockUseSetRamBlockStatus=true  # UC:Derived from NvBlockNeeds
        NvMTargetBlockReference
          NvMFeeRef: NvMNameOfFeeBlock=Fee_BsConst_TempGauge
      NvBlockSwComponentTypeNVBlockDescriptor_BsConst_TripComputer: NvMBlockManagementType=NVM_BLOCK_DATASET, NvMSelectBlockForWriteAll=false, NvMUseJobendCallback=true, NvMBlockUseCrc=false, NvMBlockUseSyncMechanism=true, NvMUseServicePorts=true, NvMNvramBlockIdentifier=17, NvMNvBlockLength=64, NvMRomBlockDataAddress=Rte_NvBlockSwComponentType_NVBlockDescriptor_BsConst_TripComputer_ROM_NVBlockDescriptor_BsConst_TripComputer, NvMBlockJobPriority=1, NvMReadRamBlockFromNvCallback=Rte_SetMirror_NvBlockSwComponentType_NVBlockDescriptor_BsConst_TripComputer, NvMWriteRamBlockToNvCallback=Rte_GetMirror_NvBlockSwComponentType_NVBlockDescriptor_BsConst_TripComputer, NvMBlockLengthCheck=true, NvMWriteVerification=false, NvMBlockUseSetRamBlockStatus=true  # UC:Derived from NvBlockNeeds
        NvMTargetBlockReference
          NvMFeeRef: NvMNameOfFeeBlock=Fee_BsConst_TripComputer
      NvBlockSwComponentTypeNVBlockDescriptor_BsConst_Warning: NvMBlockManagementType=NVM_BLOCK_DATASET, NvMSelectBlockForWriteAll=false, NvMUseJobendCallback=true, NvMBlockUseCrc=false, NvMBlockUseSyncMechanism=true, NvMUseServicePorts=true, NvMNvramBlockIdentifier=20, NvMNvBlockLength=64, NvMRomBlockDataAddress=Rte_NvBlockSwComponentType_NVBlockDescriptor_BsConst_Warning_ROM_NVBlockDescriptor_BsConst_Warning, NvMBlockJobPriority=1, NvMReadRamBlockFromNvCallback=Rte_SetMirror_NvBlockSwComponentType_NVBlockDescriptor_BsConst_Warning, NvMWriteRamBlockToNvCallback=Rte_GetMirror_NvBlockSwComponentType_NVBlockDescriptor_BsConst_Warning, NvMBlockLengthCheck=true, NvMWriteVerification=false, NvMBlockUseSetRamBlockStatus=true  # UC:Derived from NvBlockNeeds
        NvMTargetBlockReference
          NvMFeeRef: NvMNameOfFeeBlock=Fee_BsConst_Warning
      NvBlockSwComponentTypeNVBlockDescriptor_BsCys_Certicificate: NvMBlockManagementType=NVM_BLOCK_DATASET, NvMSelectBlockForWriteAll=false, NvMUseJobendCallback=true, NvMBlockUseCrc=false, NvMBlockUseSyncMechanism=true, NvMUseServicePorts=true, NvMNvramBlockIdentifier=33, NvMNvBlockLength=64, NvMRomBlockDataAddress=Rte_NvBlockSwComponentType_NVBlockDescriptor_BsCys_Certicificate_ROM_NVBlockDescriptor_BsCys_Certicificate, NvMBlockJobPriority=1, NvMReadRamBlockFromNvCallback=Rte_SetMirror_NvBlockSwComponentType_NVBlockDescriptor_BsCys_Certicificate, NvMWriteRamBlockToNvCallback=Rte_GetMirror_NvBlockSwComponentType_NVBlockDescriptor_BsCys_Certicificate, NvMBlockLengthCheck=true, NvMWriteVerification=false, NvMBlockUseSetRamBlockStatus=true  # UC:Derived from NvBlockNeeds
        NvMTargetBlockReference
          NvMFeeRef: NvMNameOfFeeBlock=Fee_BsCys_Certicificate
      NvBlockSwComponentTypeNVBlockDescriptor_BsDiag_Dtc: NvMBlockManagementType=NVM_BLOCK_DATASET, NvMSelectBlockForWriteAll=false, NvMUseJobendCallback=true, NvMBlockUseCrc=false, NvMBlockUseSyncMechanism=true, NvMUseServicePorts=true, NvMNvramBlockIdentifier=62, NvMNvBlockLength=2048, NvMRomBlockDataAddress=Rte_NvBlockSwComponentType_NVBlockDescriptor_BsDiag_Dtc_ROM_NVBlockDescriptor_BsDiag_Dtc, NvMBlockJobPriority=1, NvMReadRamBlockFromNvCallback=Rte_SetMirror_NvBlockSwComponentType_NVBlockDescriptor_BsDiag_Dtc, NvMWriteRamBlockToNvCallback=Rte_GetMirror_NvBlockSwComponentType_NVBlockDescriptor_BsDiag_Dtc, NvMBlockLengthCheck=true, NvMWriteVerification=false, NvMBlockUseSetRamBlockStatus=true  # UC:Derived from NvBlockNeeds
        NvMTargetBlockReference
          NvMFeeRef: NvMNameOfFeeBlock=Fee_BsDiag_Dtc
      NvBlockSwComponentTypeNVBlockDescriptor_BsDiag_ErrorRecord: NvMBlockManagementType=NVM_BLOCK_DATASET, NvMSelectBlockForWriteAll=false, NvMUseJobendCallback=true, NvMBlockUseCrc=false, NvMBlockUseSyncMechanism=true, NvMUseServicePorts=true, NvMNvramBlockIdentifier=61, NvMNvBlockLength=1024, NvMRomBlockDataAddress=Rte_NvBlockSwComponentType_NVBlockDescriptor_BsDiag_ErrorRecord_ROM_NVBlockDescriptor_BsDiag_ErrorRecord, NvMBlockJobPriority=1, NvMReadRamBlockFromNvCallback=Rte_SetMirror_NvBlockSwComponentType_NVBlockDescriptor_BsDiag_ErrorRecord, NvMWriteRamBlockToNvCallback=Rte_GetMirror_NvBlockSwComponentType_NVBlockDescriptor_BsDiag_ErrorRecord, NvMBlockLengthCheck=true, NvMWriteVerification=false, NvMBlockUseSetRamBlockStatus=true  # UC:Derived from NvBlockNeeds
        NvMTargetBlockReference
          NvMFeeRef: NvMNameOfFeeBlock=Fee_BsDiag_ErrorRecord
      NvBlockSwComponentTypeNVBlockDescriptor_BsFuSa_Audio: NvMBlockManagementType=NVM_BLOCK_DATASET, NvMSelectBlockForWriteAll=false, NvMUseJobendCallback=true, NvMBlockUseCrc=false, NvMBlockUseSyncMechanism=true, NvMUseServicePorts=true, NvMNvramBlockIdentifier=29, NvMNvBlockLength=32, NvMRomBlockDataAddress=Rte_NvBlockSwComponentType_NVBlockDescriptor_BsFuSa_Audio_ROM_NVBlockDescriptor_BsFuSa_Audio, NvMBlockJobPriority=1, NvMReadRamBlockFromNvCallback=Rte_SetMirror_NvBlockSwComponentType_NVBlockDescriptor_BsFuSa_Audio, NvMWriteRamBlockToNvCallback=Rte_GetMirror_NvBlockSwComponentType_NVBlockDescriptor_BsFuSa_Audio, NvMBlockLengthCheck=true, NvMWriteVerification=false, NvMBlockUseSetRamBlockStatus=true  # UC:Derived from NvBlockNeeds
        NvMTargetBlockReference
          NvMFeeRef: NvMNameOfFeeBlock=Fee_BsFuSa_Audio
      NvBlockSwComponentTypeNVBlockDescriptor_BsFuSa_Communication: NvMBlockManagementType=NVM_BLOCK_DATASET, NvMSelectBlockForWriteAll=false, NvMUseJobendCallback=true, NvMBlockUseCrc=false, NvMBlockUseSyncMechanism=true, NvMUseServicePorts=true, NvMNvramBlockIdentifier=30, NvMNvBlockLength=16, NvMRomBlockDataAddress=Rte_NvBlockSwComponentType_NVBlockDescriptor_BsFuSa_Communication_ROM_NVBlockDescriptor_BsFuSa_Communication, NvMBlockJobPriority=1, NvMReadRamBlockFromNvCallback=Rte_SetMirror_NvBlockSwComponentType_NVBlockDescriptor_BsFuSa_Communication, NvMWriteRamBlockToNvCallback=Rte_GetMirror_NvBlockSwComponentType_NVBlockDescriptor_BsFuSa_Communication, NvMBlockLengthCheck=true, NvMWriteVerification=false, NvMBlockUseSetRamBlockStatus=true  # UC:Derived from NvBlockNeeds
        NvMTargetBlockReference
          NvMFeeRef: NvMNameOfFeeBlock=Fee_BsFuSa_Communication
      NvBlockSwComponentTypeNVBlockDescriptor_BsFuSa_Config: NvMBlockManagementType=NVM_BLOCK_DATASET, NvMSelectBlockForWriteAll=false, NvMUseJobendCallback=true, NvMBlockUseCrc=false, NvMBlockUseSyncMechanism=true, NvMUseServicePorts=true, NvMNvramBlockIdentifier=32, NvMNvBlockLength=16, NvMRomBlockDataAddress=Rte_NvBlockSwComponentType_NVBlockDescriptor_BsFuSa_Config_ROM_NVBlockDescriptor_BsFuSa_Config, NvMBlockJobPriority=1, NvMReadRamBlockFromNvCallback=Rte_SetMirror_NvBlockSwComponentType_NVBlockDescriptor_BsFuSa_Config, NvMWriteRamBlockToNvCallback=Rte_GetMirror_NvBlockSwComponentType_NVBlockDescriptor_BsFuSa_Config, NvMBlockLengthCheck=true, NvMWriteVerification=false, NvMBlockUseSetRamBlockStatus=true  # UC:Derived from NvBlockNeeds
        NvMTargetBlockReference
          NvMFeeRef: NvMNameOfFeeBlock=Fee_BsFuSa_Config
      NvBlockSwComponentTypeNVBlockDescriptor_BsFuSa_Display: NvMBlockManagementType=NVM_BLOCK_DATASET, NvMSelectBlockForWriteAll=false, NvMUseJobendCallback=true, NvMBlockUseCrc=false, NvMBlockUseSyncMechanism=true, NvMUseServicePorts=true, NvMNvramBlockIdentifier=28, NvMNvBlockLength=64, NvMRomBlockDataAddress=Rte_NvBlockSwComponentType_NVBlockDescriptor_BsFuSa_Display_ROM_NVBlockDescriptor_BsFuSa_Display, NvMBlockJobPriority=1, NvMReadRamBlockFromNvCallback=Rte_SetMirror_NvBlockSwComponentType_NVBlockDescriptor_BsFuSa_Display, NvMWriteRamBlockToNvCallback=Rte_GetMirror_NvBlockSwComponentType_NVBlockDescriptor_BsFuSa_Display, NvMBlockLengthCheck=true, NvMWriteVerification=false, NvMBlockUseSetRamBlockStatus=true  # UC:Derived from NvBlockNeeds
        NvMTargetBlockReference
          NvMFeeRef: NvMNameOfFeeBlock=Fee_BsFuSa_Display
      NvBlockSwComponentTypeNVBlockDescriptor_BsFuSa_Power: NvMBlockManagementType=NVM_BLOCK_DATASET, NvMSelectBlockForWriteAll=false, NvMUseJobendCallback=true, NvMBlockUseCrc=false, NvMBlockUseSyncMechanism=true, NvMUseServicePorts=true, NvMNvramBlockIdentifier=27, NvMNvBlockLength=48, NvMRomBlockDataAddress=Rte_NvBlockSwComponentType_NVBlockDescriptor_BsFuSa_Power_ROM_NVBlockDescriptor_BsFuSa_Power, NvMBlockJobPriority=1, NvMReadRamBlockFromNvCallback=Rte_SetMirror_NvBlockSwComponentType_NVBlockDescriptor_BsFuSa_Power, NvMWriteRamBlockToNvCallback=Rte_GetMirror_NvBlockSwComponentType_NVBlockDescriptor_BsFuSa_Power, NvMBlockLengthCheck=true, NvMWriteVerification=false, NvMBlockUseSetRamBlockStatus=true  # UC:Derived from NvBlockNeeds
        NvMTargetBlockReference
          NvMFeeRef: NvMNameOfFeeBlock=Fee_BsFuSa_Power
      NvBlockSwComponentTypeNVBlockDescriptor_BsFuSa_Warning: NvMBlockManagementType=NVM_BLOCK_DATASET, NvMSelectBlockForWriteAll=false, NvMUseJobendCallback=true, NvMBlockUseCrc=false, NvMBlockUseSyncMechanism=true, NvMUseServicePorts=true, NvMNvramBlockIdentifier=26, NvMNvBlockLength=32, NvMRomBlockDataAddress=Rte_NvBlockSwComponentType_NVBlockDescriptor_BsFuSa_Warning_ROM_NVBlockDescriptor_BsFuSa_Warning, NvMBlockJobPriority=1, NvMReadRamBlockFromNvCallback=Rte_SetMirror_NvBlockSwComponentType_NVBlockDescriptor_BsFuSa_Warning, NvMWriteRamBlockToNvCallback=Rte_GetMirror_NvBlockSwComponentType_NVBlockDescriptor_BsFuSa_Warning, NvMBlockLengthCheck=true, NvMWriteVerification=false, NvMBlockUseSetRamBlockStatus=true  # UC:Derived from NvBlockNeeds
        NvMTargetBlockReference
          NvMFeeRef: NvMNameOfFeeBlock=Fee_BsFuSa_Warning
      NvBlockSwComponentTypeNVBlockDescriptor_BsFusa_Fota: NvMBlockManagementType=NVM_BLOCK_DATASET, NvMSelectBlockForWriteAll=false, NvMUseJobendCallback=true, NvMBlockUseCrc=false, NvMBlockUseSyncMechanism=true, NvMUseServicePorts=true, NvMNvramBlockIdentifier=31, NvMNvBlockLength=32, NvMRomBlockDataAddress=Rte_NvBlockSwComponentType_NVBlockDescriptor_BsFusa_Fota_ROM_NVBlockDescriptor_BsFusa_Fota, NvMBlockJobPriority=1, NvMReadRamBlockFromNvCallback=Rte_SetMirror_NvBlockSwComponentType_NVBlockDescriptor_BsFusa_Fota, NvMWriteRamBlockToNvCallback=Rte_GetMirror_NvBlockSwComponentType_NVBlockDescriptor_BsFusa_Fota, NvMBlockLengthCheck=true, NvMWriteVerification=false, NvMBlockUseSetRamBlockStatus=true  # UC:Derived from NvBlockNeeds
        NvMTargetBlockReference
          NvMFeeRef: NvMNameOfFeeBlock=Fee_BsFusa_Fota
      NvBlockSwComponentTypeNVBlockDescriptor_BsReten_Audio: NvMBlockManagementType=NVM_BLOCK_DATASET, NvMSelectBlockForWriteAll=false, NvMUseJobendCallback=true, NvMBlockUseCrc=false, NvMBlockUseSyncMechanism=true, NvMUseServicePorts=true, NvMNvramBlockIdentifier=53, NvMNvBlockLength=100, NvMRomBlockDataAddress=Rte_NvBlockSwComponentType_NVBlockDescriptor_BsReten_Audio_ROM_NVBlockDescriptor_BsReten_Audio, NvMBlockJobPriority=1, NvMReadRamBlockFromNvCallback=Rte_SetMirror_NvBlockSwComponentType_NVBlockDescriptor_BsReten_Audio, NvMWriteRamBlockToNvCallback=Rte_GetMirror_NvBlockSwComponentType_NVBlockDescriptor_BsReten_Audio, NvMBlockLengthCheck=true, NvMWriteVerification=false, NvMBlockUseSetRamBlockStatus=true  # UC:Derived from NvBlockNeeds
        NvMTargetBlockReference
          NvMFeeRef: NvMNameOfFeeBlock=Fee_BsReten_Audio
      NvBlockSwComponentTypeNVBlockDescriptor_BsReten_Communication: NvMBlockManagementType=NVM_BLOCK_DATASET, NvMSelectBlockForWriteAll=false, NvMUseJobendCallback=true, NvMBlockUseCrc=false, NvMBlockUseSyncMechanism=true, NvMUseServicePorts=true, NvMNvramBlockIdentifier=56, NvMNvBlockLength=100, NvMRomBlockDataAddress=Rte_NvBlockSwComponentType_NVBlockDescriptor_BsReten_Communication_ROM_NVBlockDescriptor_BsReten_Communication, NvMBlockJobPriority=1, NvMReadRamBlockFromNvCallback=Rte_SetMirror_NvBlockSwComponentType_NVBlockDescriptor_BsReten_Communication, NvMWriteRamBlockToNvCallback=Rte_GetMirror_NvBlockSwComponentType_NVBlockDescriptor_BsReten_Communication, NvMBlockLengthCheck=true, NvMWriteVerification=false, NvMBlockUseSetRamBlockStatus=true  # UC:Derived from NvBlockNeeds
        NvMTargetBlockReference
          NvMFeeRef: NvMNameOfFeeBlock=Fee_BsReten_Communication
      NvBlockSwComponentTypeNVBlockDescriptor_BsReten_Display: NvMBlockManagementType=NVM_BLOCK_DATASET, NvMSelectBlockForWriteAll=false, NvMUseJobendCallback=true, NvMBlockUseCrc=false, NvMBlockUseSyncMechanism=true, NvMUseServicePorts=true, NvMNvramBlockIdentifier=60, NvMNvBlockLength=100, NvMRomBlockDataAddress=Rte_NvBlockSwComponentType_NVBlockDescriptor_BsReten_Display_ROM_NVBlockDescriptor_BsReten_Display, NvMBlockJobPriority=1, NvMReadRamBlockFromNvCallback=Rte_SetMirror_NvBlockSwComponentType_NVBlockDescriptor_BsReten_Display, NvMWriteRamBlockToNvCallback=Rte_GetMirror_NvBlockSwComponentType_NVBlockDescriptor_BsReten_Display, NvMBlockLengthCheck=true, NvMWriteVerification=false, NvMBlockUseSetRamBlockStatus=true  # UC:Derived from NvBlockNeeds
        NvMTargetBlockReference
          NvMFeeRef: NvMNameOfFeeBlock=Fee_BsReten_Display
      NvBlockSwComponentTypeNVBlockDescriptor_BsReten_Gauges: NvMBlockManagementType=NVM_BLOCK_DATASET, NvMSelectBlockForWriteAll=false, NvMUseJobendCallback=true, NvMBlockUseCrc=false, NvMBlockUseSyncMechanism=true, NvMUseServicePorts=true, NvMNvramBlockIdentifier=50, NvMNvBlockLength=100, NvMRomBlockDataAddress=Rte_NvBlockSwComponentType_NVBlockDescriptor_BsReten_Gauges_ROM_NVBlockDescriptor_BsReten_Gauges, NvMBlockJobPriority=1, NvMReadRamBlockFromNvCallback=Rte_SetMirror_NvBlockSwComponentType_NVBlockDescriptor_BsReten_Gauges, NvMWriteRamBlockToNvCallback=Rte_GetMirror_NvBlockSwComponentType_NVBlockDescriptor_BsReten_Gauges, NvMBlockLengthCheck=true, NvMWriteVerification=false, NvMBlockUseSetRamBlockStatus=true  # UC:Derived from NvBlockNeeds
        NvMTargetBlockReference
          NvMFeeRef: NvMNameOfFeeBlock=Fee_BsReten_Gauges
      NvBlockSwComponentTypeNVBlockDescriptor_BsReten_Illumination: NvMBlockManagementType=NVM_BLOCK_DATASET, NvMSelectBlockForWriteAll=false, NvMUseJobendCallback=true, NvMBlockUseCrc=false, NvMBlockUseSyncMechanism=true, NvMUseServicePorts=true, NvMNvramBlockIdentifier=52, NvMNvBlockLength=100, NvMRomBlockDataAddress=Rte_NvBlockSwComponentType_NVBlockDescriptor_BsReten_Illumination_ROM_NVBlockDescriptor_BsReten_Illumination, NvMBlockJobPriority=1, NvMReadRamBlockFromNvCallback=Rte_SetMirror_NvBlockSwComponentType_NVBlockDescriptor_BsReten_Illumination, NvMWriteRamBlockToNvCallback=Rte_GetMirror_NvBlockSwComponentType_NVBlockDescriptor_BsReten_Illumination, NvMBlockLengthCheck=true, NvMWriteVerification=false, NvMBlockUseSetRamBlockStatus=true  # UC:Derived from NvBlockNeeds
        NvMTargetBlockReference
          NvMFeeRef: NvMNameOfFeeBlock=Fee_BsReten_Illumination
      NvBlockSwComponentTypeNVBlockDescriptor_BsReten_Odometer: NvMBlockManagementType=NVM_BLOCK_DATASET, NvMSelectBlockForWriteAll=false, NvMUseJobendCallback=true, NvMBlockUseCrc=false, NvMBlockUseSyncMechanism=true, NvMUseServicePorts=true, NvMNvramBlockIdentifier=49, NvMNvBlockLength=100, NvMRomBlockDataAddress=Rte_NvBlockSwComponentType_NVBlockDescriptor_BsReten_Odometer_ROM_NVBlockDescriptor_BsReten_Odometer, NvMBlockJobPriority=1, NvMReadRamBlockFromNvCallback=Rte_SetMirror_NvBlockSwComponentType_NVBlockDescriptor_BsReten_Odometer, NvMWriteRamBlockToNvCallback=Rte_GetMirror_NvBlockSwComponentType_NVBlockDescriptor_BsReten_Odometer, NvMBlockLengthCheck=true, NvMWriteVerification=false, NvMBlockUseSetRamBlockStatus=true  # UC:Derived from NvBlockNeeds
        NvMTargetBlockReference
          NvMFeeRef: NvMNameOfFeeBlock=Fee_BsReten_Odometer
      NvBlockSwComponentTypeNVBlockDescriptor_BsReten_Personalization: NvMBlockManagementType=NVM_BLOCK_DATASET, NvMSelectBlockForWriteAll=false, NvMUseJobendCallback=true, NvMBlockUseCrc=false, NvMBlockUseSyncMechanism=true, NvMUseServicePorts=true, NvMNvramBlockIdentifier=57, NvMNvBlockLength=100, NvMRomBlockDataAddress=Rte_NvBlockSwComponentType_NVBlockDescriptor_BsReten_Personalization_ROM_NVBlockDescriptor_BsReten_Personalization, NvMBlockJobPriority=1, NvMReadRamBlockFromNvCallback=Rte_SetMirror_NvBlockSwComponentType_NVBlockDescriptor_BsReten_Personalization, NvMWriteRamBlockToNvCallback=Rte_GetMirror_NvBlockSwComponentType_NVBlockDescriptor_BsReten_Personalization, NvMBlockLengthCheck=true, NvMWriteVerification=false, NvMBlockUseSetRamBlockStatus=true  # UC:Derived from NvBlockNeeds
        NvMTargetBlockReference
          NvMFeeRef: NvMNameOfFeeBlock=Fee_BsReten_Personalization
      NvBlockSwComponentTypeNVBlockDescriptor_BsReten_Power: NvMBlockManagementType=NVM_BLOCK_DATASET, NvMSelectBlockForWriteAll=false, NvMUseJobendCallback=true, NvMBlockUseCrc=false, NvMBlockUseSyncMechanism=true, NvMUseServicePorts=true, NvMNvramBlockIdentifier=59, NvMNvBlockLength=100, NvMRomBlockDataAddress=Rte_NvBlockSwComponentType_NVBlockDescriptor_BsReten_Power_ROM_NVBlockDescriptor_BsReten_Power, NvMBlockJobPriority=1, NvMReadRamBlockFromNvCallback=Rte_SetMirror_NvBlockSwComponentType_NVBlockDescriptor_BsReten_Power, NvMWriteRamBlockToNvCallback=Rte_GetMirror_NvBlockSwComponentType_NVBlockDescriptor_BsReten_Power, NvMBlockLengthCheck=true, NvMWriteVerification=false, NvMBlockUseSetRamBlockStatus=true  # UC:Derived from NvBlockNeeds
        NvMTargetBlockReference
          NvMFeeRef: NvMNameOfFeeBlock=Fee_BsReten_Power
      NvBlockSwComponentTypeNVBlockDescriptor_BsReten_RealTimeClock: NvMBlockManagementType=NVM_BLOCK_DATASET, NvMSelectBlockForWriteAll=false, NvMUseJobendCallback=true, NvMBlockUseCrc=false, NvMBlockUseSyncMechanism=true, NvMUseServicePorts=true, NvMNvramBlockIdentifier=55, NvMNvBlockLength=100, NvMRomBlockDataAddress=Rte_NvBlockSwComponentType_NVBlockDescriptor_BsReten_RealTimeClock_ROM_NVBlockDescriptor_BsReten_RealTimeClock, NvMBlockJobPriority=1, NvMReadRamBlockFromNvCallback=Rte_SetMirror_NvBlockSwComponentType_NVBlockDescriptor_BsReten_RealTimeClock, NvMWriteRamBlockToNvCallback=Rte_GetMirror_NvBlockSwComponentType_NVBlockDescriptor_BsReten_RealTimeClock, NvMBlockLengthCheck=true, NvMWriteVerification=false, NvMBlockUseSetRamBlockStatus=true  # UC:Derived from NvBlockNeeds
        NvMTargetBlockReference
          NvMFeeRef: NvMNameOfFeeBlock=Fee_BsReten_RealTimeClock
      NvBlockSwComponentTypeNVBlockDescriptor_BsReten_Tripcomputer: NvMBlockManagementType=NVM_BLOCK_DATASET, NvMSelectBlockForWriteAll=false, NvMUseJobendCallback=true, NvMBlockUseCrc=false, NvMBlockUseSyncMechanism=true, NvMUseServicePorts=true, NvMNvramBlockIdentifier=51, NvMNvBlockLength=100, NvMRomBlockDataAddress=Rte_NvBlockSwComponentType_NVBlockDescriptor_BsReten_Tripcomputer_ROM_NVBlockDescriptor_BsReten_Tripcomputer, NvMBlockJobPriority=1, NvMReadRamBlockFromNvCallback=Rte_SetMirror_NvBlockSwComponentType_NVBlockDescriptor_BsReten_Tripcomputer, NvMWriteRamBlockToNvCallback=Rte_GetMirror_NvBlockSwComponentType_NVBlockDescriptor_BsReten_Tripcomputer, NvMBlockLengthCheck=true, NvMWriteVerification=false, NvMBlockUseSetRamBlockStatus=true  # UC:Derived from NvBlockNeeds
        NvMTargetBlockReference
          NvMFeeRef: NvMNameOfFeeBlock=Fee_BsReten_Tripcomputer
      NvBlockSwComponentTypeNVBlockDescriptor_BsReten_VisDlt: NvMBlockManagementType=NVM_BLOCK_DATASET, NvMSelectBlockForWriteAll=false, NvMUseJobendCallback=true, NvMBlockUseCrc=false, NvMBlockUseSyncMechanism=true, NvMUseServicePorts=true, NvMNvramBlockIdentifier=58, NvMNvBlockLength=256, NvMRomBlockDataAddress=Rte_NvBlockSwComponentType_NVBlockDescriptor_BsReten_VisDlt_ROM_NVBlockDescriptor_BsReten_VisDlt, NvMBlockJobPriority=1, NvMReadRamBlockFromNvCallback=Rte_SetMirror_NvBlockSwComponentType_NVBlockDescriptor_BsReten_VisDlt, NvMWriteRamBlockToNvCallback=Rte_GetMirror_NvBlockSwComponentType_NVBlockDescriptor_BsReten_VisDlt, NvMBlockLengthCheck=true, NvMWriteVerification=false, NvMBlockUseSetRamBlockStatus=true  # UC:Derived from NvBlockNeeds
        NvMTargetBlockReference
          NvMFeeRef: NvMNameOfFeeBlock=Fee_BsReten_VisDlt
      NvBlockSwComponentTypeNVBlockDescriptor_BsReten_Warning: NvMBlockManagementType=NVM_BLOCK_DATASET, NvMSelectBlockForWriteAll=false, NvMUseJobendCallback=true, NvMBlockUseCrc=false, NvMBlockUseSyncMechanism=true, NvMUseServicePorts=true, NvMNvramBlockIdentifier=54, NvMNvBlockLength=100, NvMRomBlockDataAddress=Rte_NvBlockSwComponentType_NVBlockDescriptor_BsReten_Warning_ROM_NVBlockDescriptor_BsReten_Warning, NvMBlockJobPriority=1, NvMReadRamBlockFromNvCallback=Rte_SetMirror_NvBlockSwComponentType_NVBlockDescriptor_BsReten_Warning, NvMWriteRamBlockToNvCallback=Rte_GetMirror_NvBlockSwComponentType_NVBlockDescriptor_BsReten_Warning, NvMBlockLengthCheck=true, NvMWriteVerification=false, NvMBlockUseSetRamBlockStatus=true  # UC:Derived from NvBlockNeeds
        NvMTargetBlockReference
          NvMFeeRef: NvMNameOfFeeBlock=Fee_BsReten_Warning
      NvBlockSwComponentTypeNVBlockDescriptor_BsRt_CusDlt: NvMBlockManagementType=NVM_BLOCK_DATASET, NvMSelectBlockForWriteAll=false, NvMUseJobendCallback=true, NvMBlockUseCrc=false, NvMBlockUseSyncMechanism=true, NvMUseServicePorts=true, NvMNvramBlockIdentifier=48, NvMNvBlockLength=128, NvMRomBlockDataAddress=Rte_NvBlockSwComponentType_NVBlockDescriptor_BsRt_CusDlt_ROM_NVBlockDescriptor_BsRt_CusDlt, NvMBlockJobPriority=1, NvMReadRamBlockFromNvCallback=Rte_SetMirror_NvBlockSwComponentType_NVBlockDescriptor_BsRt_CusDlt, NvMWriteRamBlockToNvCallback=Rte_GetMirror_NvBlockSwComponentType_NVBlockDescriptor_BsRt_CusDlt, NvMBlockLengthCheck=true, NvMWriteVerification=false, NvMBlockUseSetRamBlockStatus=true  # UC:Derived from NvBlockNeeds
        NvMTargetBlockReference
          NvMFeeRef: NvMNameOfFeeBlock=Fee_BsRt_CusDlt
      NvBlockSwComponentTypeNVBlockDescriptor_BsRt_FuelGauge: NvMBlockManagementType=NVM_BLOCK_DATASET, NvMSelectBlockForWriteAll=false, NvMUseJobendCallback=true, NvMBlockUseCrc=false, NvMBlockUseSyncMechanism=true, NvMUseServicePorts=true, NvMNvramBlockIdentifier=39, NvMNvBlockLength=32, NvMRomBlockDataAddress=Rte_NvBlockSwComponentType_NVBlockDescriptor_BsRt_FuelGauge_ROM_NVBlockDescriptor_BsRt_FuelGauge, NvMBlockJobPriority=1, NvMReadRamBlockFromNvCallback=Rte_SetMirror_NvBlockSwComponentType_NVBlockDescriptor_BsRt_FuelGauge, NvMWriteRamBlockToNvCallback=Rte_GetMirror_NvBlockSwComponentType_NVBlockDescriptor_BsRt_FuelGauge, NvMBlockLengthCheck=true, NvMWriteVerification=false, NvMBlockUseSetRamBlockStatus=true  # UC:Derived from NvBlockNeeds
        NvMTargetBlockReference
          NvMFeeRef: NvMNameOfFeeBlock=Fee_BsRt_FuelGauge
      NvBlockSwComponentTypeNVBlockDescriptor_BsRt_Illumination: NvMBlockManagementType=NVM_BLOCK_DATASET, NvMSelectBlockForWriteAll=false, NvMUseJobendCallback=true, NvMBlockUseCrc=false, NvMBlockUseSyncMechanism=true, NvMUseServicePorts=true, NvMNvramBlockIdentifier=47, NvMNvBlockLength=100, NvMRomBlockDataAddress=Rte_NvBlockSwComponentType_NVBlockDescriptor_BsRt_Illumination_ROM_NVBlockDescriptor_BsRt_Illumination, NvMBlockJobPriority=1, NvMReadRamBlockFromNvCallback=Rte_SetMirror_NvBlockSwComponentType_NVBlockDescriptor_BsRt_Illumination, NvMWriteRamBlockToNvCallback=Rte_GetMirror_NvBlockSwComponentType_NVBlockDescriptor_BsRt_Illumination, NvMBlockLengthCheck=true, NvMWriteVerification=false, NvMBlockUseSetRamBlockStatus=true  # UC:Derived from NvBlockNeeds
        NvMTargetBlockReference
          NvMFeeRef: NvMNameOfFeeBlock=Fee_BsRt_Illumination
      NvBlockSwComponentTypeNVBlockDescriptor_BsRt_Odometer: NvMBlockManagementType=NVM_BLOCK_DATASET, NvMSelectBlockForWriteAll=false, NvMUseJobendCallback=true, NvMBlockUseCrc=false, NvMBlockUseSyncMechanism=true, NvMUseServicePorts=true, NvMNvramBlockIdentifier=36, NvMNvBlockLength=128, NvMRomBlockDataAddress=Rte_NvBlockSwComponentType_NVBlockDescriptor_BsRt_Odometer_ROM_NVBlockDescriptor_BsRt_Odometer, NvMBlockJobPriority=1, NvMReadRamBlockFromNvCallback=Rte_SetMirror_NvBlockSwComponentType_NVBlockDescriptor_BsRt_Odometer, NvMWriteRamBlockToNvCallback=Rte_GetMirror_NvBlockSwComponentType_NVBlockDescriptor_BsRt_Odometer, NvMBlockLengthCheck=true, NvMWriteVerification=false, NvMBlockUseSetRamBlockStatus=true  # UC:Derived from NvBlockNeeds
        NvMTargetBlockReference
          NvMFeeRef: NvMNameOfFeeBlock=Fee_BsRt_Odometer
      NvBlockSwComponentTypeNVBlockDescriptor_BsRt_OilGauge: NvMBlockManagementType=NVM_BLOCK_DATASET, NvMSelectBlockForWriteAll=false, NvMUseJobendCallback=true, NvMBlockUseCrc=false, NvMBlockUseSyncMechanism=true, NvMUseServicePorts=true, NvMNvramBlockIdentifier=42, NvMNvBlockLength=8, NvMRomBlockDataAddress=Rte_NvBlockSwComponentType_NVBlockDescriptor_BsRt_OilGauge_ROM_NVBlockDescriptor_BsRt_OilGauge, NvMBlockJobPriority=1, NvMReadRamBlockFromNvCallback=Rte_SetMirror_NvBlockSwComponentType_NVBlockDescriptor_BsRt_OilGauge, NvMWriteRamBlockToNvCallback=Rte_GetMirror_NvBlockSwComponentType_NVBlockDescriptor_BsRt_OilGauge, NvMBlockLengthCheck=true, NvMWriteVerification=false, NvMBlockUseSetRamBlockStatus=true  # UC:Derived from NvBlockNeeds
        NvMTargetBlockReference
          NvMFeeRef: NvMNameOfFeeBlock=Fee_BsRt_OilGauge
      NvBlockSwComponentTypeNVBlockDescriptor_BsRt_Personalization: NvMBlockManagementType=NVM_BLOCK_DATASET, NvMSelectBlockForWriteAll=false, NvMUseJobendCallback=true, NvMBlockUseCrc=false, NvMBlockUseSyncMechanism=true, NvMUseServicePorts=true, NvMNvramBlockIdentifier=46, NvMNvBlockLength=128, NvMRomBlockDataAddress=Rte_NvBlockSwComponentType_NVBlockDescriptor_BsRt_Personalization_ROM_NVBlockDescriptor_BsRt_Personalization, NvMBlockJobPriority=1, NvMReadRamBlockFromNvCallback=Rte_SetMirror_NvBlockSwComponentType_NVBlockDescriptor_BsRt_Personalization, NvMWriteRamBlockToNvCallback=Rte_GetMirror_NvBlockSwComponentType_NVBlockDescriptor_BsRt_Personalization, NvMBlockLengthCheck=true, NvMWriteVerification=false, NvMBlockUseSetRamBlockStatus=true  # UC:Derived from NvBlockNeeds
        NvMTargetBlockReference
          NvMFeeRef: NvMNameOfFeeBlock=Fee_BsRt_Personalization
      NvBlockSwComponentTypeNVBlockDescriptor_BsRt_PowerGauge: NvMBlockManagementType=NVM_BLOCK_DATASET, NvMSelectBlockForWriteAll=false, NvMUseJobendCallback=true, NvMBlockUseCrc=false, NvMBlockUseSyncMechanism=true, NvMUseServicePorts=true, NvMNvramBlockIdentifier=41, NvMNvBlockLength=32, NvMRomBlockDataAddress=Rte_NvBlockSwComponentType_NVBlockDescriptor_BsRt_PowerGauge_ROM_NVBlockDescriptor_BsRt_PowerGauge, NvMBlockJobPriority=1, NvMReadRamBlockFromNvCallback=Rte_SetMirror_NvBlockSwComponentType_NVBlockDescriptor_BsRt_PowerGauge, NvMWriteRamBlockToNvCallback=Rte_GetMirror_NvBlockSwComponentType_NVBlockDescriptor_BsRt_PowerGauge, NvMBlockLengthCheck=true, NvMWriteVerification=false, NvMBlockUseSetRamBlockStatus=true  # UC:Derived from NvBlockNeeds
        NvMTargetBlockReference
          NvMFeeRef: NvMNameOfFeeBlock=Fee_BsRt_PowerGauge
      NvBlockSwComponentTypeNVBlockDescriptor_BsRt_RealTimeClock: NvMBlockManagementType=NVM_BLOCK_DATASET, NvMSelectBlockForWriteAll=false, NvMUseJobendCallback=true, NvMBlockUseCrc=false, NvMBlockUseSyncMechanism=true, NvMUseServicePorts=true, NvMNvramBlockIdentifier=45, NvMNvBlockLength=48, NvMRomBlockDataAddress=Rte_NvBlockSwComponentType_NVBlockDescriptor_BsRt_RealTimeClock_ROM_NVBlockDescriptor_BsRt_RealTimeClock, NvMBlockJobPriority=1, NvMReadRamBlockFromNvCallback=Rte_SetMirror_NvBlockSwComponentType_NVBlockDescriptor_BsRt_RealTimeClock, NvMWriteRamBlockToNvCallback=Rte_GetMirror_NvBlockSwComponentType_NVBlockDescriptor_BsRt_RealTimeClock, NvMBlockLengthCheck=true, NvMWriteVerification=false, NvMBlockUseSetRamBlockStatus=true  # UC:Derived from NvBlockNeeds
        NvMTargetBlockReference
          NvMFeeRef: NvMNameOfFeeBlock=Fee_BsRt_RealTimeClock
      NvBlockSwComponentTypeNVBlockDescriptor_BsRt_SpeedoGauge: NvMBlockManagementType=NVM_BLOCK_DATASET, NvMSelectBlockForWriteAll=false, NvMUseJobendCallback=true, NvMBlockUseCrc=false, NvMBlockUseSyncMechanism=true, NvMUseServicePorts=true, NvMNvramBlockIdentifier=37, NvMNvBlockLength=8, NvMRomBlockDataAddress=Rte_NvBlockSwComponentType_NVBlockDescriptor_BsRt_SpeedoGauge_ROM_NVBlockDescriptor_BsRt_SpeedoGauge, NvMBlockJobPriority=1, NvMReadRamBlockFromNvCallback=Rte_SetMirror_NvBlockSwComponentType_NVBlockDescriptor_BsRt_SpeedoGauge, NvMWriteRamBlockToNvCallback=Rte_GetMirror_NvBlockSwComponentType_NVBlockDescriptor_BsRt_SpeedoGauge, NvMBlockLengthCheck=true, NvMWriteVerification=false, NvMBlockUseSetRamBlockStatus=true  # UC:Derived from NvBlockNeeds
        NvMTargetBlockReference
          NvMFeeRef: NvMNameOfFeeBlock=Fee_BsRt_SpeedoGauge
      NvBlockSwComponentTypeNVBlockDescriptor_BsRt_TachoGauge: NvMBlockManagementType=NVM_BLOCK_DATASET, NvMSelectBlockForWriteAll=false, NvMUseJobendCallback=true, NvMBlockUseCrc=false, NvMBlockUseSyncMechanism=true, NvMUseServicePorts=true, NvMNvramBlockIdentifier=38, NvMNvBlockLength=16, NvMRomBlockDataAddress=Rte_NvBlockSwComponentType_NVBlockDescriptor_BsRt_TachoGauge_ROM_NVBlockDescriptor_BsRt_TachoGauge, NvMBlockJobPriority=1, NvMReadRamBlockFromNvCallback=Rte_SetMirror_NvBlockSwComponentType_NVBlockDescriptor_BsRt_TachoGauge, NvMWriteRamBlockToNvCallback=Rte_GetMirror_NvBlockSwComponentType_NVBlockDescriptor_BsRt_TachoGauge, NvMBlockLengthCheck=true, NvMWriteVerification=false, NvMBlockUseSetRamBlockStatus=true  # UC:Derived from NvBlockNeeds
        NvMTargetBlockReference
          NvMFeeRef: NvMNameOfFeeBlock=Fee_BsRt_TachoGauge
      NvBlockSwComponentTypeNVBlockDescriptor_BsRt_TempGauge: NvMBlockManagementType=NVM_BLOCK_DATASET, NvMSelectBlockForWriteAll=false, NvMUseJobendCallback=true, NvMBlockUseCrc=false, NvMBlockUseSyncMechanism=true, NvMUseServicePorts=true, NvMNvramBlockIdentifier=40, NvMNvBlockLength=32, NvMRomBlockDataAddress=Rte_NvBlockSwComponentType_NVBlockDescriptor_BsRt_TempGauge_ROM_NVBlockDescriptor_BsRt_TempGauge, NvMBlockJobPriority=1, NvMReadRamBlockFromNvCallback=Rte_SetMirror_NvBlockSwComponentType_NVBlockDescriptor_BsRt_TempGauge, NvMWriteRamBlockToNvCallback=Rte_GetMirror_NvBlockSwComponentType_NVBlockDescriptor_BsRt_TempGauge, NvMBlockLengthCheck=true, NvMWriteVerification=false, NvMBlockUseSetRamBlockStatus=true  # UC:Derived from NvBlockNeeds
        NvMTargetBlockReference
          NvMFeeRef: NvMNameOfFeeBlock=Fee_BsRt_TempGauge
      NvBlockSwComponentTypeNVBlockDescriptor_BsRt_TripComputer: NvMBlockManagementType=NVM_BLOCK_DATASET, NvMSelectBlockForWriteAll=false, NvMUseJobendCallback=true, NvMBlockUseCrc=false, NvMBlockUseSyncMechanism=true, NvMUseServicePorts=true, NvMNvramBlockIdentifier=43, NvMNvBlockLength=64, NvMRomBlockDataAddress=Rte_NvBlockSwComponentType_NVBlockDescriptor_BsRt_TripComputer_ROM_NVBlockDescriptor_BsRt_TripComputer, NvMBlockJobPriority=1, NvMReadRamBlockFromNvCallback=Rte_SetMirror_NvBlockSwComponentType_NVBlockDescriptor_BsRt_TripComputer, NvMWriteRamBlockToNvCallback=Rte_GetMirror_NvBlockSwComponentType_NVBlockDescriptor_BsRt_TripComputer, NvMBlockLengthCheck=true, NvMWriteVerification=false, NvMBlockUseSetRamBlockStatus=true  # UC:Derived from NvBlockNeeds
        NvMTargetBlockReference
          NvMFeeRef: NvMNameOfFeeBlock=Fee_BsRt_TripComputer
      NvBlockSwComponentTypeNVBlockDescriptor_BsRt_Warning: NvMBlockManagementType=NVM_BLOCK_DATASET, NvMSelectBlockForWriteAll=false, NvMUseJobendCallback=true, NvMBlockUseCrc=false, NvMBlockUseSyncMechanism=true, NvMUseServicePorts=true, NvMNvramBlockIdentifier=44, NvMNvBlockLength=32, NvMRomBlockDataAddress=Rte_NvBlockSwComponentType_NVBlockDescriptor_BsRt_Warning_ROM_NVBlockDescriptor_BsRt_Warning, NvMBlockJobPriority=1, NvMReadRamBlockFromNvCallback=Rte_SetMirror_NvBlockSwComponentType_NVBlockDescriptor_BsRt_Warning, NvMWriteRamBlockToNvCallback=Rte_GetMirror_NvBlockSwComponentType_NVBlockDescriptor_BsRt_Warning, NvMBlockLengthCheck=true, NvMWriteVerification=false, NvMBlockUseSetRamBlockStatus=true  # UC:Derived from NvBlockNeeds
        NvMTargetBlockReference
          NvMFeeRef: NvMNameOfFeeBlock=Fee_BsRt_Warning
      NvBlockSwComponentTypeNVBlockDescriptor_BsShare_EcuPartNumber: NvMBlockManagementType=NVM_BLOCK_DATASET, NvMSelectBlockForWriteAll=false, NvMUseJobendCallback=true, NvMBlockUseCrc=false, NvMBlockUseSyncMechanism=true, NvMUseServicePorts=true, NvMNvramBlockIdentifier=8, NvMNvBlockLength=128, NvMRomBlockDataAddress=Rte_NvBlockSwComponentType_NVBlockDescriptor_BsShare_EcuPartNumber_ROM_NVBlockDescriptor_BsShare_EcuPartNumber, NvMBlockJobPriority=1, NvMReadRamBlockFromNvCallback=Rte_SetMirror_NvBlockSwComponentType_NVBlockDescriptor_BsShare_EcuPartNumber, NvMWriteRamBlockToNvCallback=Rte_GetMirror_NvBlockSwComponentType_NVBlockDescriptor_BsShare_EcuPartNumber, NvMBlockLengthCheck=true, NvMWriteVerification=false, NvMBlockUseSetRamBlockStatus=true  # UC:Derived from NvBlockNeeds
        NvMTargetBlockReference
          NvMFeeRef: NvMNameOfFeeBlock=Fee_BsShare_EcuPartNumber
      NvBlockSwComponentTypeNVBlockDescriptor_BsShare_SwUpdFotaFinPrint: NvMBlockManagementType=NVM_BLOCK_DATASET, NvMSelectBlockForWriteAll=false, NvMUseJobendCallback=true, NvMBlockUseCrc=false, NvMBlockUseSyncMechanism=true, NvMUseServicePorts=true, NvMNvramBlockIdentifier=5, NvMNvBlockLength=32, NvMRomBlockDataAddress=Rte_NvBlockSwComponentType_NVBlockDescriptor_BsShare_SwUpdFotaFinPrint_ROM_NVBlockDescriptor_BsShare_SwUpdFotaFinPrint, NvMBlockJobPriority=1, NvMReadRamBlockFromNvCallback=Rte_SetMirror_NvBlockSwComponentType_NVBlockDescriptor_BsShare_SwUpdFotaFinPrint, NvMWriteRamBlockToNvCallback=Rte_GetMirror_NvBlockSwComponentType_NVBlockDescriptor_BsShare_SwUpdFotaFinPrint, NvMBlockLengthCheck=true, NvMWriteVerification=false, NvMBlockUseSetRamBlockStatus=true  # UC:Derived from NvBlockNeeds
        NvMTargetBlockReference
          NvMFeeRef: NvMNameOfFeeBlock=Fee_BsShare_SwUpdFotaFinPrint
      NvBlockSwComponentTypeNVBlockDescriptor_BsShare_SwUpdFotaMode: NvMBlockManagementType=NVM_BLOCK_DATASET, NvMSelectBlockForWriteAll=false, NvMUseJobendCallback=true, NvMBlockUseCrc=false, NvMBlockUseSyncMechanism=true, NvMUseServicePorts=true, NvMNvramBlockIdentifier=4, NvMNvBlockLength=16, NvMRomBlockDataAddress=Rte_NvBlockSwComponentType_NVBlockDescriptor_BsShare_SwUpdFotaMode_ROM_NVBlockDescriptor_BsShare_SwUpdFotaMode, NvMBlockJobPriority=1, NvMReadRamBlockFromNvCallback=Rte_SetMirror_NvBlockSwComponentType_NVBlockDescriptor_BsShare_SwUpdFotaMode, NvMWriteRamBlockToNvCallback=Rte_GetMirror_NvBlockSwComponentType_NVBlockDescriptor_BsShare_SwUpdFotaMode, NvMBlockLengthCheck=true, NvMWriteVerification=false, NvMBlockUseSetRamBlockStatus=true  # UC:Derived from NvBlockNeeds
        NvMTargetBlockReference
          NvMFeeRef: NvMNameOfFeeBlock=Fee_BsShare_SwUpdFotaMode
      NvBlockSwComponentTypeNVBlockDescriptor_BsShare_SwUpdFotaStatus: NvMBlockManagementType=NVM_BLOCK_DATASET, NvMSelectBlockForWriteAll=false, NvMUseJobendCallback=true, NvMBlockUseCrc=false, NvMBlockUseSyncMechanism=true, NvMUseServicePorts=true, NvMNvramBlockIdentifier=6, NvMNvBlockLength=48, NvMRomBlockDataAddress=Rte_NvBlockSwComponentType_NVBlockDescriptor_BsShare_SwUpdFotaStatus_ROM_NVBlockDescriptor_BsShare_SwUpdFotaStatus, NvMBlockJobPriority=1, NvMReadRamBlockFromNvCallback=Rte_SetMirror_NvBlockSwComponentType_NVBlockDescriptor_BsShare_SwUpdFotaStatus, NvMWriteRamBlockToNvCallback=Rte_GetMirror_NvBlockSwComponentType_NVBlockDescriptor_BsShare_SwUpdFotaStatus, NvMBlockLengthCheck=true, NvMWriteVerification=false, NvMBlockUseSetRamBlockStatus=true  # UC:Derived from NvBlockNeeds
        NvMTargetBlockReference
          NvMFeeRef: NvMNameOfFeeBlock=Fee_BsShare_SwUpdFotaStatus
      NvBlockSwComponentTypeNVBlockDescriptor_BsShare_SwUpdFotadecrypt: NvMBlockManagementType=NVM_BLOCK_DATASET, NvMSelectBlockForWriteAll=false, NvMUseJobendCallback=true, NvMBlockUseCrc=false, NvMBlockUseSyncMechanism=true, NvMUseServicePorts=true, NvMNvramBlockIdentifier=7, NvMNvBlockLength=64, NvMRomBlockDataAddress=Rte_NvBlockSwComponentType_NVBlockDescriptor_BsShare_SwUpdFotadecrypt_ROM_NVBlockDescriptor_BsShare_SwUpdFotadecrypt, NvMBlockJobPriority=1, NvMReadRamBlockFromNvCallback=Rte_SetMirror_NvBlockSwComponentType_NVBlockDescriptor_BsShare_SwUpdFotadecrypt, NvMWriteRamBlockToNvCallback=Rte_GetMirror_NvBlockSwComponentType_NVBlockDescriptor_BsShare_SwUpdFotadecrypt, NvMBlockLengthCheck=true, NvMWriteVerification=false, NvMBlockUseSetRamBlockStatus=true  # UC:Derived from NvBlockNeeds
        NvMTargetBlockReference
          NvMFeeRef: NvMNameOfFeeBlock=Fee_BsShare_SwUpdFotadecrypt
      NvBlockSwComponentTypeNVBlockDescriptor_BsShare_SwUpdReflash: NvMBlockManagementType=NVM_BLOCK_DATASET, NvMSelectBlockForWriteAll=false, NvMUseJobendCallback=true, NvMBlockUseCrc=false, NvMBlockUseSyncMechanism=true, NvMUseServicePorts=true, NvMNvramBlockIdentifier=2, NvMNvBlockLength=8, NvMRomBlockDataAddress=Rte_NvBlockSwComponentType_NVBlockDescriptor_BsShare_SwUpdReflash_ROM_NVBlockDescriptor_BsShare_SwUpdReflash, NvMBlockJobPriority=1, NvMReadRamBlockFromNvCallback=Rte_SetMirror_NvBlockSwComponentType_NVBlockDescriptor_BsShare_SwUpdReflash, NvMWriteRamBlockToNvCallback=Rte_GetMirror_NvBlockSwComponentType_NVBlockDescriptor_BsShare_SwUpdReflash, NvMBlockLengthCheck=true, NvMWriteVerification=false, NvMBlockUseSetRamBlockStatus=true  # UC:Derived from NvBlockNeeds
        NvMTargetBlockReference
          NvMFeeRef: NvMNameOfFeeBlock=Fee_BsShare_SwUpdReflash
      NvBlockSwComponentTypeNVBlockDescriptor_BsShare_VehicleConfig: NvMBlockManagementType=NVM_BLOCK_DATASET, NvMSelectBlockForWriteAll=false, NvMUseJobendCallback=true, NvMBlockUseCrc=false, NvMBlockUseSyncMechanism=true, NvMUseServicePorts=true, NvMNvramBlockIdentifier=10, NvMNvBlockLength=256, NvMRomBlockDataAddress=Rte_NvBlockSwComponentType_NVBlockDescriptor_BsShare_VehicleConfig_ROM_NVBlockDescriptor_BsShare_VehicleConfig, NvMBlockJobPriority=1, NvMReadRamBlockFromNvCallback=Rte_SetMirror_NvBlockSwComponentType_NVBlockDescriptor_BsShare_VehicleConfig, NvMWriteRamBlockToNvCallback=Rte_GetMirror_NvBlockSwComponentType_NVBlockDescriptor_BsShare_VehicleConfig, NvMBlockLengthCheck=true, NvMWriteVerification=false, NvMBlockUseSetRamBlockStatus=true  # UC:Derived from NvBlockNeeds
        NvMTargetBlockReference
          NvMFeeRef: NvMNameOfFeeBlock=Fee_BsShare_VehicleConfig
      NvBlockSwComponentTypeNVBlockDescriptor_BsShare_VisMeet: NvMBlockManagementType=NVM_BLOCK_DATASET, NvMSelectBlockForWriteAll=false, NvMUseJobendCallback=true, NvMBlockUseCrc=false, NvMBlockUseSyncMechanism=true, NvMUseServicePorts=true, NvMNvramBlockIdentifier=9, NvMNvBlockLength=48, NvMRomBlockDataAddress=Rte_NvBlockSwComponentType_NVBlockDescriptor_BsShare_VisMeet_ROM_NVBlockDescriptor_BsShare_VisMeet, NvMBlockJobPriority=1, NvMReadRamBlockFromNvCallback=Rte_SetMirror_NvBlockSwComponentType_NVBlockDescriptor_BsShare_VisMeet, NvMWriteRamBlockToNvCallback=Rte_GetMirror_NvBlockSwComponentType_NVBlockDescriptor_BsShare_VisMeet, NvMBlockLengthCheck=true, NvMWriteVerification=false, NvMBlockUseSetRamBlockStatus=true  # UC:Derived from NvBlockNeeds
        NvMTargetBlockReference
          NvMFeeRef: NvMNameOfFeeBlock=Fee_BsShare_VisMeet
      NvBlockSwComponentTypeNVBlockDescriptor_RefCys_Certicificate: NvMBlockManagementType=NVM_BLOCK_DATASET, NvMSelectBlockForWriteAll=false, NvMUseJobendCallback=true, NvMBlockUseCrc=false, NvMBlockUseSyncMechanism=true, NvMUseServicePorts=true, NvMNvramBlockIdentifier=34, NvMNvBlockLength=64, NvMRomBlockDataAddress=Rte_NvBlockSwComponentType_NVBlockDescriptor_RefCys_Certicificate_ROM_NVBlockDescriptor_RefCys_Certicificate, NvMBlockJobPriority=1, NvMReadRamBlockFromNvCallback=Rte_SetMirror_NvBlockSwComponentType_NVBlockDescriptor_RefCys_Certicificate, NvMWriteRamBlockToNvCallback=Rte_GetMirror_NvBlockSwComponentType_NVBlockDescriptor_RefCys_Certicificate, NvMBlockLengthCheck=true, NvMWriteVerification=false, NvMBlockUseSetRamBlockStatus=true  # UC:Derived from NvBlockNeeds
        NvMTargetBlockReference
          NvMFeeRef: NvMNameOfFeeBlock=Fee_RefCys_Certicificate
      NvBlockSwComponentTypeNVBlockDescriptor_RefCys_Certicificate1: NvMBlockManagementType=NVM_BLOCK_DATASET, NvMSelectBlockForWriteAll=false, NvMUseJobendCallback=true, NvMBlockUseCrc=false, NvMBlockUseSyncMechanism=true, NvMUseServicePorts=true, NvMNvramBlockIdentifier=35, NvMNvBlockLength=64, NvMRomBlockDataAddress=Rte_NvBlockSwComponentType_NVBlockDescriptor_RefCys_Certicificate1_ROM_NVBlockDescriptor_RefCys_Certicificate1, NvMBlockJobPriority=1, NvMReadRamBlockFromNvCallback=Rte_SetMirror_NvBlockSwComponentType_NVBlockDescriptor_RefCys_Certicificate1, NvMWriteRamBlockToNvCallback=Rte_GetMirror_NvBlockSwComponentType_NVBlockDescriptor_RefCys_Certicificate1, NvMBlockLengthCheck=true, NvMWriteVerification=false, NvMBlockUseSetRamBlockStatus=true  # UC:Derived from NvBlockNeeds
        NvMTargetBlockReference
          NvMFeeRef: NvMNameOfFeeBlock=Fee_RefCys_Certicificate1
      NvBlock_Template: NvMBlockManagementType=NVM_BLOCK_REDUNDANT, NvMSelectBlockForWriteAll=true, NvMUseJobendCallback=false, NvMBlockUseCrc=true, NvMBlockUseSyncMechanism=false, NvMUseServicePorts=false, NvMNvramBlockIdentifier=3, NvMNvBlockLength=2, NvMRomBlockDataAddress=NULL_PTR, NvMBlockJobPriority=127, NvMReadRamBlockFromNvCallback=NULL_PTR, NvMWriteRamBlockToNvCallback=NULL_PTR, NvMBlockLengthCheck=false
        NvMTargetBlockReference
          NvMFeeRef: NvMNameOfFeeBlock=XXX
    NvMCommon:
      NvMDevErrorDetect = true
      NvMVersionInfoApi = false
      NvMApiConfigClass = NVM_API_CONFIG_CLASS_3
      NvMBswMMultiBlockJobStatusInformation = false
      NvMCompiledConfigId = 1
      NvMCrcNumOfBytes = 64
      NvMDatasetSelectionBits = 1
      NvMDrvModeSwitch = flase
      NvMDynamicConfiguration = false
      NvMJobPrioritization = false
      NvMMultiBlockCallback = NvM_MultiBlockJobEndNotification
      NvMPollingMode = false
      NvMSetRamBlockStatusApi = true
      NvMSizeStandardJobQueue = 4
      NvMMaxNoOfWriteRetries = 1
      NvMMainFunctionPeriod = 0.01
      NvMRepairRedundantBlocksApi = true
      NvMUseBlockIdCheck = true
    NvMCommonVendorParams:
      NvMCfgIncludeDem = Dem.h
      NvMSeterror = Dem_ReportErrorStatus
      NvMMultiblockId = MultiBlockRequest
      NvMCrcIntBuffer = true
      NvMKillWriteAllApi = true
      NvMCfgCbkIncludeList = Rte_Cbk.h
      NvMCfgCbkIncludeList = EcuMExt.h
      NvMCfgCbkIncludeList = Rte_Cbk.h
      NvMCfgCbkIncludeList = Dem_Cbk.h
      NvMDevErrorChecks: NvMCfgIncludeDet=Det.h, NvMErrorhook=Det_ReportError, NvMDebugReporting=true
    NvMConfigBlock (NvMBlockDescriptor):
      NvMBlockCrcType = NVM_CRC16
      NvMBlockManagementType = NVM_BLOCK_REDUNDANT
      NvMInitBlockCallback = NULL_PTR
      NvMResistantToChangedSw = true
      NvMSelectBlockForReadAll = true
      NvMSelectBlockForWriteAll = true
      NvMUseInitCallback = false
      NvMUseJobendCallback = false
      NvMSingleBlockCallback = NULL_PTR
      NvMBswMBlockStatusInformation = false
      NvMBlockUseCrc = true
      NvMBlockUseSyncMechanism = false
      NvMCalcRamBlockCrc = false
      NvMUseServicePorts = false
      NvMNvramBlockIdentifier = 1
      NvMNvBlockNum = 2
      NvMNvBlockLength = 2
      NvMRomBlockDataAddress = NULL_PTR
      NvMBlockJobPriority = 127
      NvMBlockWriteProt = false
      NvMRamBlockDataAddress = NULL_PTR
      NvMReadRamBlockFromNvCallback = NULL_PTR
      NvMWriteBlockOnce = false
      NvMWriteRamBlockToNvCallback = NULL_PTR
      NvMAutomaticBlockLength = false
      NvMBlockLengthCheck = false
      NvMBlockLengthCheckType = true
      NvMTargetBlockReference
        NvMFeeRef: NvMNameOfFeeBlock=FeeConfigBlock
    NvmDemEventParameterRefs:
      NVM_E_INTEGRITY_FAILED = NVM_E_INTEGRITY_FAILED
      NVM_E_LOSS_OF_REDUNDANCY = NVM_E_LOSS_OF_REDUNDANCY
      NVM_E_QUEUE_OVERFLOW = NVM_E_QUEUE_OVERFLOW
      NVM_E_REQ_FAILED = NVM_E_REQ_FAILED
      NVM_E_VERIFY_FAILED = NVM_E_VERIFY_FAILED
      NVM_E_WRITE_PROTECTED = NVM_E_WRITE_PROTECTED
      NVM_E_WRONG_BLOCK_ID = NVM_E_WRONG_BLOCK_ID
