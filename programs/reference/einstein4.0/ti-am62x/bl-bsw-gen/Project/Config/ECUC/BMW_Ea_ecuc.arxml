AUTOSAR XML (schema 00044)
package /ActiveEcuC
  module config Ea: implementation-config-variant=VARIANT-PRE-COMPILE, module-description=Ea_Impl
    EaGeneral:
      EaSetModeSupported = true
      EaDevErrorDetect = true
      EaIndex = 0
      EaPollingMode = true
      EaVersionInfoApi = false
      EaVirtualPageSize = 8
      EaNvMCallbackIncludeFile = NvM_Cbk.h
      EaCorrectSingleBitFlips = true
      EaMainFunctionPeriod = 0.005
      EaMainFunctionTriggering = FixedCycleTime
      EaSafeBswChecks = false
    EaBlockConfiguration:
      EaBlockNumber = 2
      EaBlockSize = 8
      EaImmediateData = false
      EaNumberOfWriteCycles = 10000
      EaNumberOfDatasets = 1
      EaNumberOfInstances = 1
      EaVerifyWrittenData = false
      EaBlockId = 0
      EaPartition = (unset)
    EaPublishedInformation: EaBlockOverhead=2, EaMaximumBlockingTime=0, EaPageOverhead=0
    EaPartitionConfiguration: EaPartitionStartAddress=0, EaPartitionSize=256, EaPartitionAddressAlignment=1, EaPartitionWriteAlignment=1, EaPartitionDevice=(unset)
    EaNvBlockSwComponentTypeNVBlockDescriptor_NvMSampleBlock1 (EaBlockConfiguration):
      EaBlockNumber = 4
      EaBlockSize = 8
      EaImmediateData = false
      EaNumberOfWriteCycles = 10000
      EaNumberOfDatasets = 2
      EaNumberOfInstances = 1
      EaVerifyWrittenData = false
      EaBlockId = 0
      EaPartition = (unset)
    EaNvBlockSwComponentTypeNVBlockDescriptor_SampleBlock2 (EaBlockConfiguration):
      EaBlockNumber = 6
      EaBlockSize = 16
      EaImmediateData = false
      EaNumberOfWriteCycles = 10000
      EaNumberOfDatasets = 2
      EaNumberOfInstances = 1
      EaVerifyWrittenData = false
      EaBlockId = 0
      EaPartition = (unset)
