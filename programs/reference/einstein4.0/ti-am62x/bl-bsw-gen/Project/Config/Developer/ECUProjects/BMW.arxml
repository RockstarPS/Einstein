AUTOSAR XML (schema 00044)
package /E40_Platform_System_SystemPackage/Compositions
  composition sw component type E40_Platform_System
    20 x component:
      Test_Comp: type=Test_Comp
      NvBlockSwComponentType: type=NvBlockSwComponentType
      NvMExt: type=NvMExt
      EcuMExt: type=EcuMExt
      TmExt: type=TmExt
      IoHwAb: type=IoHwAb
      MemAbstractStub: type=MemAbstractStub
      EcuAppM: type=EcuAppM
      MemAbstractMdl: type=MemAbstractMdl
      DmnMgr: type=DmnMgr
      SciDrv: type=SciDrv
      UclProxyCdd: type=UclProxyCdd
      CSleepManager: type=CSleepManager
      CBattMdl: type=CBattMdl
      CCDD_EcuPowerM: type=CCDD_EcuPowerM
      Dlt: type=Dlt
      DltExt: type=DltExt
      CDisplayCdd: type=CDisplayCdd
      CBacklightCdd: type=CBacklightCdd
      RtcCdd: type=RtcCdd
    connect NvBlockSwComponentType.BsConst_PowerGauge_Element -> MemAbstractStub.BsConst_PowerGauge_Element
    connect NvBlockSwComponentType.BsFuSa_Audio_Element -> MemAbstractStub.BsFuSa_Audio_Element
    connect NvBlockSwComponentType.BsReten_Odometer_Element -> MemAbstractStub.BsReten_Odometer_Element
    connect NvBlockSwComponentType.BsDiag_ErrorRecord_Element -> MemAbstractStub.BsDiag_ErrorRecord_Element
    connect NvBlockSwComponentType.BsConst_Audio_Element -> MemAbstractStub.BsConst_Audio_Element
    connect NvBlockSwComponentType.BsConst_TempGauge_Element -> MemAbstractStub.BsConst_TempGauge_Element
    connect NvBlockSwComponentType.BsFuSa_Communication_Element -> MemAbstractStub.BsFuSa_Communication_Element
    connect NvBlockSwComponentType.BsRt_CusDlt_Element -> MemAbstractStub.BsRt_CusDlt_Element
    connect NvBlockSwComponentType.BsShare_SwUpdFotaFinPrint_Element -> MemAbstractStub.BsShare_SwUpdFotaFinPrint_Element
    connect NvBlockSwComponentType.BsConst_Power_Element -> MemAbstractStub.BsConst_Power_Element
    connect NvBlockSwComponentType.BsRt_Illumination_Element -> MemAbstractStub.BsRt_Illumination_Element
    connect NvBlockSwComponentType.BsReten_Gauges_Element -> MemAbstractStub.BsReten_Gauges_Element
    connect NvBlockSwComponentType.BsCys_Certicificate_Element -> MemAbstractStub.BsCys_Certicificate_Element
    connect NvBlockSwComponentType.BsConst_Communication_Element -> MemAbstractStub.BsConst_Communication_Element
    connect NvBlockSwComponentType.BsShare_EcuPartNumber_Element -> MemAbstractStub.BsShare_EcuPartNumber_Element
    connect NvBlockSwComponentType.BsShare_SwUpdFotaStatus_Element -> MemAbstractStub.BsShare_SwUpdFotaStatus_Element
    connect NvBlockSwComponentType.RefCys_Certicificate_Element -> MemAbstractStub.RefCys_Certicificate_Element
    connect NvBlockSwComponentType.BsReten_Audio_Element -> MemAbstractStub.BsReten_Audio_Element
    connect NvBlockSwComponentType.BsConst_OilGauge_Element -> MemAbstractStub.BsConst_OilGauge_Element
    connect NvBlockSwComponentType.BsConst_TripComputer_Element -> MemAbstractStub.BsConst_TripComputer_Element
    connect NvBlockSwComponentType.BsConst_FuelGauge_Element -> MemAbstractStub.BsConst_FuelGauge_Element
    connect NvBlockSwComponentType.BsFusa_Fota_Element -> MemAbstractStub.BsFusa_Fota_Element
    connect NvBlockSwComponentType.BsReten_Illumination_Element -> MemAbstractStub.BsReten_Illumination_Element
    connect NvBlockSwComponentType.BsRt_PowerGauge_Element -> MemAbstractStub.BsRt_PowerGauge_Element
    connect NvBlockSwComponentType.BsReten_Tripcomputer_Element -> MemAbstractStub.BsReten_Tripcomputer_Element
    connect NvBlockSwComponentType.BsFuSa_Display_Element -> MemAbstractStub.BsFuSa_Display_Element
    connect NvBlockSwComponentType.BsReten_Power_Element -> MemAbstractStub.BsReten_Power_Element
    connect NvBlockSwComponentType.BsShare_SwUpdReflash_Element -> MemAbstractStub.BsShare_SwUpdReflash_Element
    connect NvBlockSwComponentType.BsRt_Odometer_Element -> MemAbstractStub.BsRt_Odometer_Element
    connect NvBlockSwComponentType.BsShare_SwUpdFotadecrypt_Element -> MemAbstractStub.BsShare_SwUpdFotadecrypt_Element
    connect NvBlockSwComponentType.BsConst_EngOffTimer_Element -> MemAbstractStub.BsConst_EngOffTimer_Element
    connect NvBlockSwComponentType.BsReten_RealTimeClock_Element -> MemAbstractStub.BsReten_RealTimeClock_Element
    connect NvBlockSwComponentType.BsRt_SpeedoGauge_Element -> MemAbstractStub.BsRt_SpeedoGauge_Element
    connect NvBlockSwComponentType.BsReten_Display_Element -> MemAbstractStub.BsReten_Display_Element
    connect NvBlockSwComponentType.BsConst_RealTimeClock_Element -> MemAbstractStub.BsConst_RealTimeClock_Element
    connect NvBlockSwComponentType.BsReten_VisDlt_Element -> MemAbstractStub.BsReten_VisDlt_Element
    connect NvBlockSwComponentType.BsRt_Warning_Element -> MemAbstractStub.BsRt_Warning_Element
    connect NvBlockSwComponentType.BsRt_TripComputer_Element -> MemAbstractStub.BsRt_TripComputer_Element
    connect NvBlockSwComponentType.BsDiag_Dtc_Element -> MemAbstractStub.BsDiag_Dtc_Element
    connect NvBlockSwComponentType.BsConst_Illumination_Element -> MemAbstractStub.BsConst_Illumination_Element
    connect NvBlockSwComponentType.BsShare_VehicleConfig_Element -> MemAbstractStub.BsShare_VehicleConfig_Element
    connect NvBlockSwComponentType.BsRt_Personalization_Element -> MemAbstractStub.BsRt_Personalization_Element
    connect NvBlockSwComponentType.BsFuSa_Config_Element -> MemAbstractStub.BsFuSa_Config_Element
    connect NvBlockSwComponentType.BsRt_TachoGauge_Element -> MemAbstractStub.BsRt_TachoGauge_Element
    connect NvBlockSwComponentType.RefCys_Certicificate1_Element -> MemAbstractStub.RefCys_Certicificate1_Element
    connect NvBlockSwComponentType.BsShare_VisMeet_Element -> MemAbstractStub.BsShare_VisMeet_Element
    connect NvBlockSwComponentType.BsReten_Communication_Element -> MemAbstractStub.BsReten_Communication_Element
    connect NvBlockSwComponentType.BsRt_FuelGauge_Element -> MemAbstractStub.BsRt_FuelGauge_Element
    connect NvBlockSwComponentType.BsConst_Warning_Element -> MemAbstractStub.BsConst_Warning_Element
    connect NvBlockSwComponentType.BsConst_SpeedoGauge_Element -> MemAbstractStub.BsConst_SpeedoGauge_Element
    connect NvBlockSwComponentType.BsReten_Personalization_Element -> MemAbstractStub.BsReten_Personalization_Element
    connect NvBlockSwComponentType.BsRt_RealTimeClock_Element -> MemAbstractStub.BsRt_RealTimeClock_Element
    connect NvBlockSwComponentType.BsConst_TachoGauge_Element -> MemAbstractStub.BsConst_TachoGauge_Element
    connect NvBlockSwComponentType.BsRt_OilGauge_Element -> MemAbstractStub.BsRt_OilGauge_Element
    connect NvBlockSwComponentType.BsConst_ServiceReminder_Element -> MemAbstractStub.BsConst_ServiceReminder_Element
    connect NvBlockSwComponentType.BsFuSa_Power_Element -> MemAbstractStub.BsFuSa_Power_Element
    connect NvBlockSwComponentType.BsFuSa_Warning_Element -> MemAbstractStub.BsFuSa_Warning_Element
    connect NvBlockSwComponentType.BsRt_TempGauge_Element -> MemAbstractStub.BsRt_TempGauge_Element
    connect NvBlockSwComponentType.BsShare_SwUpdFotaMode_Element -> MemAbstractStub.BsShare_SwUpdFotaMode_Element
    connect NvBlockSwComponentType.BsReten_Warning_Element -> MemAbstractStub.BsReten_Warning_Element
    connect IoHwAb.ppIoHwAb_Din -> CBattMdl.rpIoHwAb_Din
    connect IoHwAb.ppIoHwAb_DOut -> CBattMdl.rpIoHwAb_DOut
    connect IoHwAb.ppIoHwAb_ADC -> CBattMdl.rpIoHwAb_ADC
    connect IoHwAb.ppIoHwAb_Din -> CCDD_EcuPowerM.rpIoHwAb_Din
    connect IoHwAb.ppIoHwAb_DOut -> CCDD_EcuPowerM.rpIoHwAb_DOut
    connect IoHwAb.ppIoHwAb_PWM -> CCDD_EcuPowerM.rpIoHwAb_PWM
    connect IoHwAb.ppIoHwAb_ADC -> CCDD_EcuPowerM.rpIoHwAb_ADC
    connect MemAbstractMdl.pp_CS_MemAbsGet -> DltExt.rp_CS_MemAbsGet
    connect MemAbstractMdl.pp_CS_MemAbsSet -> DltExt.rp_CS_MemAbsSet
    connect MemAbstractMdl.pp_CS_MemAbs_NvMWriteStatus -> DltExt.rp_CS_MemAbs_NvMWriteStatus
    connect DmnMgr.ppCS_UclSystemCallbacks -> UclProxyCdd.rCS_UclSystemCallbacks
    connect DmnMgr.pSR_HealthDumpGetHdr -> UclProxyCdd.rSR_HealthDumpGetHdr
    connect DmnMgr.pSR_HealthDumpGetData -> UclProxyCdd.rSR_HealthDumpGetData
    connect DmnMgr.pSR_PowerSystemStateReqChange -> UclProxyCdd.rSR_PowerSystemStateReqChange
    connect UclProxyCdd.pSR_HealthDomainFatalError -> DmnMgr.rSR_HealthDomainFatalError
    connect UclProxyCdd.pSR_HealthDomainHeartbeat -> DmnMgr.rSR_HealthDomainHeartbeat
    connect UclProxyCdd.pSR_HealthDumpData -> DmnMgr.rSR_HealthDumpData
    connect UclProxyCdd.pSR_HealthDumpHdrInfo -> DmnMgr.rSR_HealthDumpHdrInfo
    connect UclProxyCdd.pSR_PowerExtendShutdownTime -> DmnMgr.rSR_PowerExtendShutdownTime
    connect UclProxyCdd.pSR_PowerKeepSystemAwake -> DmnMgr.rSR_PowerKeepSystemAwake
    connect UclProxyCdd.pSR_PowerSystemState -> DmnMgr.rSR_PowerSystemState
    connect UclProxyCdd.ppCS_UclInitShutdown -> DmnMgr.rpCS_UclInitShutdown
    connect DmnMgr.ppSR_DmnInfo -> DmnMgr.rpSR_DmnInfo
    connect CSleepManager.ppSR_SleepStatus -> DmnMgr.rpSR_SleepStatus
    connect DmnMgr.pp_CmpLibCmd_CDmnMgr -> EcuAppM.rp_CmpLibCmd_rp_CmpLibCmd_CDmnMgr
    connect CSleepManager.pp_CmpLibCmd -> EcuAppM.rp_CmpLibCmd_rp_CmpLibCmd_CSleepManager
    connect UclProxyCdd.pp_CmpLibCmd_CUclProxyCdd -> EcuAppM.rp_CmpLibCmd_rp_CmpLibCmd_CUclProxyCdd
    connect CSleepManager.ppSR_SleepStatus -> EcuAppM.rpSR_SleepStatus
    connect EcuAppM.ppCS_EcuAppM -> EcuMExt.rpCS_EcuAppM
package /EndToEndProtections
  end to end protection set EndToEndProtectionSet
package /Systems
  system BMW
    system mapping BMW_MPPNG
    root-software-compositions:
      root sw composition prototype SoftwareArchitecture: software-composition=E40_Platform_System
