AUTOSAR XML (schema 00044)
package /MICROSAR/ComM_swc/ComponentTypes
  service sw component type ComM
    behavior ComMInternalBehavior: data-type-mapping=ComMMode_DataTypeMappingSet, included-data-type-set=data-type=[ComM_InhibitionStatusType, ComM_ModeType, ComM_UserHandleType, NetworkHandleType]
      timing event Timer_ComM_MainFunction_0: start-on-event=ComM_MainFunction_0, period=0.01
      runnable ComM_MainFunction_0: can-be-invoked-concurrently=true
  swc implementation ComMImplementation: behavior=ComMInternalBehavior
    code-descriptors:
      code Default: artifact-descriptors=autosar-engineering-object=category=SWSRC
