AUTOSAR XML (schema 00044)
package /ComponentTypes
  application sw component type SciDrv
    behavior SciDrv_InternalBehavior
      timing event TMT_SciDrv_MainFunction: start-on-event=SciDrv_MainFunction, period=0.01
      runnable SciDrv_MainFunction
  swc implementation SciDrv_Implementation: behavior=SciDrv_InternalBehavior
