AUTOSAR XML (schema 00044)
package /MICROSAR/ComM_swc
  mode declaration group ComMMode: category=ALPHABETIC_ORDER, initial-mode=COMM_NO_COMMUNICATION
    mode COMM_NO_COMMUNICATION
    mode COMM_SILENT_COMMUNICATION
    mode COMM_FULL_COMMUNICATION
package /MICROSAR/ComM_swc/Interfaces
  4 x client server interface, all with is-service=true, service-kind=COM-MANAGER:
    ComM_ChannelLimitation
      operation GetInhibitionStatus: possible-error=ComM_ChannelLimitation/E_NOT_OK
        arg Status: type=ComM_InhibitionStatusType, direction=OUT, server-argument-impl-policy=USE-ARGUMENT-TYPE
      operation LimitChannelToNoComMode: possible-error=ComM_ChannelLimitation/E_NOT_OK
        arg Status: type=boolean, direction=IN, server-argument-impl-policy=USE-ARGUMENT-TYPE
      error E_NOT_OK: error-code=1
    ComM_ChannelWakeUp
      operation GetInhibitionStatus: possible-error=ComM_ChannelWakeUp/E_NOT_OK
        arg Status: type=ComM_InhibitionStatusType, direction=OUT, server-argument-impl-policy=USE-ARGUMENT-TYPE
      operation PreventWakeUp: possible-error=ComM_ChannelWakeUp/E_NOT_OK
        arg Status: type=boolean, direction=IN, server-argument-impl-policy=USE-ARGUMENT-TYPE
      error E_NOT_OK: error-code=1
    ComM_ECUModeLimitation
      4 x operation, all with possible-error=ComM_ECUModeLimitation/E_NOT_OK:
        LimitECUToNoComMode
          arg Status: type=boolean, direction=IN, server-argument-impl-policy=USE-ARGUMENT-TYPE
        ReadInhibitCounter
          arg CounterValue: type=uint16, direction=OUT, server-argument-impl-policy=USE-ARGUMENT-TYPE
        ResetInhibitCounter
        SetECUGroupClassification
          arg Status: type=ComM_InhibitionStatusType, direction=IN, server-argument-impl-policy=USE-ARGUMENT-TYPE
      error E_NOT_OK: error-code=1
    ComM_UserRequest
      4 x operation:
        GetCurrentComMode: possible-error=ComM_UserRequest/E_NOT_OK
          arg ComMode: type=ComM_ModeType, direction=OUT, server-argument-impl-policy=USE-ARGUMENT-TYPE
        GetMaxComMode: possible-error=ComM_UserRequest/E_NOT_OK
          arg ComMode: type=ComM_ModeType, direction=OUT, server-argument-impl-policy=USE-ARGUMENT-TYPE
        GetRequestedComMode: possible-error=ComM_UserRequest/E_NOT_OK
          arg ComMode: type=ComM_ModeType, direction=OUT, server-argument-impl-policy=USE-ARGUMENT-TYPE
        RequestComMode: possible-error=[E_MODE_LIMITATION, ComM_UserRequest/E_NOT_OK]
          arg ComMode: type=ComM_ModeType, direction=IN, server-argument-impl-policy=USE-ARGUMENT-TYPE
      error E_MODE_LIMITATION: error-code=2
      error E_NOT_OK: error-code=1
  mode switch interface ComM_CurrentMode: is-service=true, service-kind=COM-MANAGER
    mode group currentMode: type=ComMMode
package /MICROSAR/EcuM_swc
  mode declaration group EcuM_Mode: initial-mode=EcuM_Mode/STARTUP
    6 x mode:
      STARTUP
      RUN
      POST_RUN
      SLEEP
      WAKE_SLEEP
      SHUTDOWN
package /MICROSAR/EcuM_swc/Interfaces
  client server interface EcuM_ShutdownTarget: is-service=true, service-kind=ECU-MANAGER  # A SW-C can select a shutdown target using this interface.
    5 x operation, all with possible-error=EcuM_ShutdownTarget/E_NOT_OK:
      SelectShutdownTarget  # The SW-C selects the cause corresponding to the next shutdown target.
        arg targetState: type=EcuM_StateType, direction=IN, server-argument-impl-policy=USE-ARGUMENT-TYPE  # The selected shutdown cause.
        arg resetSleepMode: type=EcuM_ModeType, direction=IN, server-argument-impl-policy=USE-ARGUMENT-TYPE  # The sleep mode (if target is ECUM_STATE_SLEEP) or the reset mechanism (if target is ECUM_STATE_RESET) of the shutdown.
      GetShutdownTarget  # Returns the currently selected shutdown target for the next shutdown as set by the operation SelectShutdownTarget.
        arg target: type=EcuM_StateType, direction=OUT, server-argument-impl-policy=USE-ARGUMENT-TYPE  # The shutdown target of the next shutdown.
        arg resetSleepMode: type=EcuM_ModeType, direction=OUT, server-argument-impl-policy=USE-ARGUMENT-TYPE  # The sleep mode (if target is ECUM_STATE_SLEEP) or the reset mechanism (if target is ECUM_STATE_RESET) of the shutdown.
      GetLastShutdownTarget  # Returns the shutdown target of the previous shutdown.
        arg target: type=EcuM_StateType, direction=OUT, server-argument-impl-policy=USE-ARGUMENT-TYPE  # The shutdown target of the previous shutdown.
        arg resetSleepMode: type=EcuM_ModeType, direction=OUT, server-argument-impl-policy=USE-ARGUMENT-TYPE  # The sleep mode (if target is ECUM_STATE_SLEEP) or the reset mechanism (if target is ECUM_STATE_RESET) of the shutdown.
      SelectShutdownCause  # The SW-C selects the cause corresponding to the next shutdown target.
        arg shutdownCause: type=EcuM_ShutdownCauseType, direction=IN, server-argument-impl-policy=USE-ARGUMENT-TYPE  # The selected shutdown cause.
      GetShutdownCause  # Returns the selected shutdown cause as set by the operation SelectShutdownCause.
        arg shutdownCause: type=EcuM_ShutdownCauseType, direction=OUT, server-argument-impl-policy=USE-ARGUMENT-TYPE  # The selected cause of the next shutdown.
    error E_NOT_OK: error-code=1  # The new shutdown target was not set
  client server interface EcuM_BootTarget: is-service=true, service-kind=ECU-MANAGER
    operation SelectBootTarget: possible-error=EcuM_BootTarget/E_NOT_OK  # The SW-C selects a boot target.
      arg BootTarget: type=EcuM_BootTargetType, direction=IN, server-argument-impl-policy=USE-ARGUMENT-TYPE  # The selected boot target.
    operation GetBootTarget: possible-error=EcuM_BootTarget/E_NOT_OK  # Returns the current boot target.
      arg BootTarget: type=EcuM_BootTargetType, direction=OUT, server-argument-impl-policy=USE-ARGUMENT-TYPE  # The currently selected boot target.
    error E_NOT_OK: error-code=1  # The new boot target was not accepted by EcuM
  mode switch interface EcuM_CurrentMode: is-service=true, service-kind=ECU-MANAGER  # Interface to read the current ECU mode
    mode group currentMode: type=EcuM_swc/EcuM_Mode
  client server interface EcuM_StateRequest: is-service=true, service-kind=ECU-MANAGER  # A SW-C which wants to keep the ECU alive shall require the client-server interface EcuM_StateRequest.
    5 x operation, all with possible-error=EcuM_StateRequest/E_NOT_OK:
      ReleasePOSTRUN  # Release of the POST_RUN state.
      ReleaseRUN  # Release of the RUN state.
      RequestPOSTRUN  # Request for the POST_RUN state.
      RequestRUN  # Request for the RUN state.
      GetStateWrapper  # Returns the current module state of the ECUM.
        arg state: type=EcuM_StateType, direction=OUT, server-argument-impl-policy=USE-ARGUMENT-TYPE  # Reference to the actually EcuM state.
    error E_NOT_OK: error-code=1  # The request was not accepted by EcuM, a detailed error condition was sent to DET
package /MICROSAR/BswM_swc
  mode declaration group MDG_Sfd_NvmBlockStatus: category=ALPHABETIC_ORDER, initial-mode=SFD_BLOCKS_NOT_INITIALIZED
    mode SFD_BLOCKS_INITIALIZED
    mode SFD_BLOCKS_NOT_INITIALIZED
package /MICROSAR/BswM_swc/Interfaces
  sender receiver interface BswM_SRI_BswM_MSI_MDG_Sfd_NvmBlockStatus_BswM_MDGP_MDG_Sfd_NvmBlockStatus: is-service=true, service-kind=BASIC-SOFTWARE-MODE-MANAGER
    data requestedMode: type=BswM_MDG_Sfd_NvmBlockStatus
package /E40_Platform_System_SystemPackage/Types
  12 x client server interface:
    TI_Backlight_NotifyDispaly
      operation NotifyDisplayPowerState: possible-error=TI_Backlight_NotifyDispaly/E_NOT_OK
        arg DeviceId: type=EDisplayType, direction=IN, server-argument-impl-policy=USE-ARGUMENT-TYPE
        arg CompletedPowerState: type=EDisplayPowerState, direction=IN, server-argument-impl-policy=USE-ARGUMENT-TYPE
      error E_NOT_OK: error-code=1
    TI_Backlight_Status
      operation GetStatus: possible-error=TI_Backlight_Status/E_NOT_OK
        arg DeviceName: type=EDisplayType, direction=IN, server-argument-impl-policy=USE-ARGUMENT-TYPE
        arg DeviceStatus: type=EDeviceStatus, direction=OUT, server-argument-impl-policy=USE-ARGUMENT-TYPE
      error E_NOT_OK: error-code=1
    TI_Backlight_Service
      operation GetBrightnessValue: possible-error=TI_Backlight_Service/E_NOT_OK
        arg DeviceName: type=EDisplayType, direction=IN, server-argument-impl-policy=USE-ARGUMENT-TYPE
        arg BrightnessPercentValue: type=UInt16, direction=OUT, server-argument-impl-policy=USE-ARGUMENT-TYPE
      operation GetThermalValue: possible-error=TI_Backlight_Service/E_NOT_OK
        arg DeviceName: type=EDisplayType, direction=IN, server-argument-impl-policy=USE-ARGUMENT-TYPE
        arg TempValueInMilliCelsius: type=UInt32, direction=OUT, server-argument-impl-policy=USE-ARGUMENT-TYPE
      operation SetBrightnessValue: possible-error=TI_Backlight_Service/E_NOT_OK
        arg DeviceName: type=EDisplayType, direction=IN, server-argument-impl-policy=USE-ARGUMENT-TYPE
        arg BrightnessPercentValue: type=UInt16, direction=IN, server-argument-impl-policy=USE-ARGUMENT-TYPE
      error E_NOT_OK: error-code=1
    if_CS_ModeOnCommand
      operation Impl_OnCommand: possible-error=if_CS_ModeOnCommand/E_NOT_OK
        arg cmdP: type=ECmpCmd, direction=IN, server-argument-impl-policy=USE-ARGUMENT-TYPE
      error E_NOT_OK: error-code=1
    TI_IOHWAB_SetDout
      operation SetOutputGroup: possible-error=TI_IOHWAB_SetDout/E_NOT_OK
        arg InputId: type=IoHwAb_DOutGroupIdType, direction=IN, server-argument-impl-policy=USE-ARGUMENT-TYPE
        arg OutputGroup: type=UInt32, direction=IN, server-argument-impl-policy=USE-ARGUMENT-TYPE
        arg ErrorStatus: type=IoHwAb_ErrorType, direction=OUT, server-argument-impl-policy=USE-ARGUMENT-TYPE
      operation SetOutputPin: possible-error=TI_IOHWAB_SetDout/E_NOT_OK
        arg InputId: type=IoHwAb_DOutSignalIdType, direction=IN, server-argument-impl-policy=USE-ARGUMENT-TYPE
        arg OutputSignal: type=Boolean, direction=IN, server-argument-impl-policy=USE-ARGUMENT-TYPE
        arg ErrorStatus: type=IoHwAb_ErrorType, direction=OUT, server-argument-impl-policy=USE-ARGUMENT-TYPE
      error E_NOT_OK: error-code=1
    TI_IOHWAB_GetDIn
      4 x operation, all with possible-error=TI_IOHWAB_GetDIn/E_NOT_OK:
        GetAsyncRawInput
          arg InputId: type=IoHwAb_DInSignalIdType, direction=IN, server-argument-impl-policy=USE-ARGUMENT-TYPE
          arg AsyncInput: type=Boolean, direction=OUT, server-argument-impl-policy=USE-ARGUMENT-TYPE
          arg ErrorStatus: type=IoHwAb_ErrorType, direction=OUT, server-argument-impl-policy=USE-ARGUMENT-TYPE
        GetInputGroup
          arg InputId: type=IoHwAb_DInGroupIdType, direction=IN, server-argument-impl-policy=USE-ARGUMENT-TYPE
          arg SyncInput: type=UInt32, direction=OUT, server-argument-impl-policy=USE-ARGUMENT-TYPE
          arg ErrorStatus: type=IoHwAb_ErrorType, direction=OUT, server-argument-impl-policy=USE-ARGUMENT-TYPE
        GetProcessedInput
          arg InputId: type=IoHwAb_DInSignalIdType, direction=IN, server-argument-impl-policy=USE-ARGUMENT-TYPE
          arg InputSignal: type=Boolean, direction=OUT, server-argument-impl-policy=USE-ARGUMENT-TYPE
          arg ErrorStatus: type=IoHwAb_ErrorType, direction=OUT, server-argument-impl-policy=USE-ARGUMENT-TYPE
        GetSyncRawInput
          arg InputId: type=IoHwAb_DInSignalIdType, direction=IN, server-argument-impl-policy=USE-ARGUMENT-TYPE
          arg SyncInput: type=Boolean, direction=OUT, server-argument-impl-policy=USE-ARGUMENT-TYPE
          arg ErrorStatus: type=IoHwAb_ErrorType, direction=OUT, server-argument-impl-policy=USE-ARGUMENT-TYPE
      error E_NOT_OK: error-code=1
    TI_IOHWAB_PWM
      operation PwmSetDuty: possible-error=TI_IOHWAB_PWM/E_NOT_OK
        arg PwmId: type=IoHwAb_PwmSignalIdType, direction=IN, server-argument-impl-policy=USE-ARGUMENT-TYPE
        arg Pwm_Duty: type=UInt16, direction=IN, server-argument-impl-policy=USE-ARGUMENT-TYPE
        arg ErrorStatus: type=IoHwAb_ErrorType, direction=OUT, server-argument-impl-policy=USE-ARGUMENT-TYPE
      operation PwmSetDutyAndPeriod: possible-error=TI_IOHWAB_PWM/E_NOT_OK
        4 x arg, all with server-argument-impl-policy=USE-ARGUMENT-TYPE:
          PwmId: type=IoHwAb_PwmSignalIdType, direction=IN
          Pwm_Period: type=UInt32, direction=IN
          Pwm_Duty: type=UInt16, direction=IN
          ErrorStatus: type=IoHwAb_ErrorType, direction=OUT
      operation PwmSetIdeal: possible-error=TI_IOHWAB_PWM/E_NOT_OK
        arg PwmId: type=IoHwAb_PwmSignalIdType, direction=IN, server-argument-impl-policy=USE-ARGUMENT-TYPE
        arg ErrorStatus: type=IoHwAb_ErrorType, direction=OUT, server-argument-impl-policy=USE-ARGUMENT-TYPE
      error E_NOT_OK: error-code=1
    TI_IOHWAB_GetAdc
      operation GetAsyncRawAdc: possible-error=TI_IOHWAB_GetAdc/E_NOT_OK
        arg AdcId: type=IoHwAb_AdcSignalIdType, direction=IN, server-argument-impl-policy=USE-ARGUMENT-TYPE
        arg AsyncRawAdc: type=UInt16, direction=OUT, server-argument-impl-policy=USE-ARGUMENT-TYPE
        arg ErrorStatus: type=IoHwAb_ErrorType, direction=OUT, server-argument-impl-policy=USE-ARGUMENT-TYPE
      operation GetProcessedAdc: possible-error=TI_IOHWAB_GetAdc/E_NOT_OK
        arg AdcId: type=IoHwAb_AdcSignalIdType, direction=IN, server-argument-impl-policy=USE-ARGUMENT-TYPE
        arg ProcessedAdc: type=SInt32, direction=OUT, server-argument-impl-policy=USE-ARGUMENT-TYPE
        arg ErrorStatus: type=IoHwAb_ErrorType, direction=OUT, server-argument-impl-policy=USE-ARGUMENT-TYPE
      operation GetSyncRawAdc: possible-error=TI_IOHWAB_GetAdc/E_NOT_OK
        arg AdcId: type=IoHwAb_AdcSignalIdType, direction=IN, server-argument-impl-policy=USE-ARGUMENT-TYPE
        arg SyncRawAdc: type=UInt16, direction=OUT, server-argument-impl-policy=USE-ARGUMENT-TYPE
        arg ErrorStatus: type=IoHwAb_ErrorType, direction=OUT, server-argument-impl-policy=USE-ARGUMENT-TYPE
      error E_NOT_OK: error-code=1
    TI_IOHWAB_Pulse
      7 x operation, all with possible-error=TI_IOHWAB_Pulse/E_NOT_OK:
        GetCurrentSignalStatus_PulseInput
          arg PulseInputId: type=eIOPulseInputId, direction=IN, server-argument-impl-policy=USE-ARGUMENT-TYPE
          arg SignalStatus: type=UInt16, direction=OUT, server-argument-impl-policy=USE-ARGUMENT-TYPE
          arg ErrorStatus: type=IoHwAb_ErrorType, direction=OUT, server-argument-impl-policy=USE-ARGUMENT-TYPE
        GetCurrentSpeed_PulseInput
          arg PulseInputId: type=eIOPulseInputId, direction=IN, server-argument-impl-policy=USE-ARGUMENT-TYPE
          arg SpeedVal: type=UInt32, direction=OUT, server-argument-impl-policy=USE-ARGUMENT-TYPE
          arg ErrorStatus: type=IoHwAb_ErrorType, direction=OUT, server-argument-impl-policy=USE-ARGUMENT-TYPE
        GetRollingCount_PulseInput
          arg PulseInputId: type=eIOPulseInputId, direction=IN, server-argument-impl-policy=USE-ARGUMENT-TYPE
          arg EdgeCount: type=UInt8, direction=OUT, server-argument-impl-policy=USE-ARGUMENT-TYPE
          arg ErrorStatus: type=IoHwAb_ErrorType, direction=OUT, server-argument-impl-policy=USE-ARGUMENT-TYPE
        ResetRollingCount_PulseInput
          arg PulseInputId: type=eIOPulseInputId, direction=IN, server-argument-impl-policy=USE-ARGUMENT-TYPE
          arg ErrorStatus: type=IoHwAb_ErrorType, direction=OUT, server-argument-impl-policy=USE-ARGUMENT-TYPE
        Start_Signal_Measurement_PulseInput
          4 x arg, all with server-argument-impl-policy=USE-ARGUMENT-TYPE:
            PulseInputId: type=eIOPulseInputId, direction=IN
            PulseInputChnlCfgParam: type=SPulseInputConfigParam, direction=OUT
            SpdCalParam: type=SSpeedCalcParam, direction=OUT
            ErrorStatus: type=IoHwAb_ErrorType, direction=OUT
        Stop_Signal_Measurement_PulseInput
          arg PulseInputId: type=eIOPulseInputId, direction=IN, server-argument-impl-policy=USE-ARGUMENT-TYPE
          arg ErrorStatus: type=IoHwAb_ErrorType, direction=OUT, server-argument-impl-policy=USE-ARGUMENT-TYPE
        Update_CalibParam_PulseInput
          arg PulseInputId: type=eIOPulseInputId, direction=IN, server-argument-impl-policy=USE-ARGUMENT-TYPE
          arg SpdCalParam: type=SSpeedCalcParam, direction=OUT, server-argument-impl-policy=USE-ARGUMENT-TYPE
          arg ErrorStatus: type=IoHwAb_ErrorType, direction=OUT, server-argument-impl-policy=USE-ARGUMENT-TYPE
      error E_NOT_OK: error-code=1
    TI_Display_I2cSeqCallback
      operation I2cSeqEndCallback
    TI_Display_GammaCorrection
      operation GetGammaCorrectionStatus
        arg GmaCrStatus: type=EGammaCorrectionStatus, direction=OUT, server-argument-impl-policy=USE-ARGUMENT-TYPE
      operation SetGammaCorrection: possible-error=TI_Display_GammaCorrection/E_NOT_OK
        arg GmaSetPtr: type=UInt8, direction=OUT, server-argument-impl-policy=USE-ARGUMENT-TYPE
        arg datalength: type=UInt8, direction=IN, server-argument-impl-policy=USE-ARGUMENT-TYPE
      error E_NOT_OK: error-code=1
    TI_Display_Status
      operation GetStatus: possible-error=TI_Display_Status/E_NOT_OK
        arg DeviceId: type=EDisplayType, direction=IN, server-argument-impl-policy=USE-ARGUMENT-TYPE
        arg DeviceStatus: type=EDisplayCddStatus, direction=OUT, server-argument-impl-policy=USE-ARGUMENT-TYPE
        arg DisplayPowerState: type=EDisplayPowerState, direction=OUT, server-argument-impl-policy=USE-ARGUMENT-TYPE
      operation SetState: possible-error=TI_Display_Status/E_NOT_OK
        arg DeviceID: type=EDisplayType, direction=IN, server-argument-impl-policy=USE-ARGUMENT-TYPE
        arg PowerState: type=EDisplayPowerState, direction=IN, server-argument-impl-policy=USE-ARGUMENT-TYPE
      error E_NOT_OK: error-code=1
  sender receiver interface If_SR_SleepStatus
    data SleepManager_SleepStatus: type=UInt8
  7 x client server interface:
    if_CS_EcuAppM
      operation EcuAppM_SetWakeupSources
        arg WakeupSource: type=UInt32, direction=IN, server-argument-impl-policy=USE-ARGUMENT-TYPE
      operation Init
    TI_EcuMExt_ReleaseRUN
      operation ReleaseRUN: possible-error=TI_EcuMExt_ReleaseRUN/E_NOT_OK
        arg user: type=EcuM_UserType, direction=IN, server-argument-impl-policy=USE-ARGUMENT-TYPE
      error E_NOT_OK: error-code=1
    TI_EcuMExt_RequestRUN
      operation RequestRUN: possible-error=TI_EcuMExt_RequestRUN/E_NOT_OK
        arg user: type=EcuM_UserType, direction=IN, server-argument-impl-policy=USE-ARGUMENT-TYPE
      error E_NOT_OK: error-code=1
    if_CS_MemAbsGet
      60 x operation, all with possible-error=if_CS_MemAbsGet/E_NOT_OK:
        Get_BsConst_Audio_Element
          arg Ptr: type=Arr_u8_128, direction=OUT, server-argument-impl-policy=USE-ARGUMENT-TYPE
        Get_BsConst_Communication_Element
          arg Ptr: type=Arr_u8_64, direction=OUT, server-argument-impl-policy=USE-ARGUMENT-TYPE
        Get_BsConst_EngOffTimer_Element
          arg Ptr: type=Arr_u8_32, direction=OUT, server-argument-impl-policy=USE-ARGUMENT-TYPE
        Get_BsConst_FuelGauge_Element
          arg Ptr: type=Arr_u8_128, direction=OUT, server-argument-impl-policy=USE-ARGUMENT-TYPE
        Get_BsConst_Illumination_Element
          arg Ptr: type=Arr_u8_128, direction=OUT, server-argument-impl-policy=USE-ARGUMENT-TYPE
        Get_BsConst_OilGauge_Element
          arg Ptr: type=Arr_u8_64, direction=OUT, server-argument-impl-policy=USE-ARGUMENT-TYPE
        Get_BsConst_PowerGauge_Element
          arg Ptr: type=Arr_u8_64, direction=OUT, server-argument-impl-policy=USE-ARGUMENT-TYPE
        Get_BsConst_Power_Element
          arg Ptr: type=Arr_u8_32, direction=OUT, server-argument-impl-policy=USE-ARGUMENT-TYPE
        Get_BsConst_RealTimeClock_Element
          arg Ptr: type=Arr_u8_48, direction=OUT, server-argument-impl-policy=USE-ARGUMENT-TYPE
        Get_BsConst_ServiceReminder_Element
          arg Ptr: type=Arr_u8_48, direction=OUT, server-argument-impl-policy=USE-ARGUMENT-TYPE
        Get_BsConst_SpeedoGauge_Element
          arg Ptr: type=Arr_u8_64, direction=OUT, server-argument-impl-policy=USE-ARGUMENT-TYPE
        Get_BsConst_TachoGauge_Element
          arg Ptr: type=Arr_u8_64, direction=OUT, server-argument-impl-policy=USE-ARGUMENT-TYPE
        Get_BsConst_TempGauge_Element
          arg Ptr: type=Arr_u8_64, direction=OUT, server-argument-impl-policy=USE-ARGUMENT-TYPE
        Get_BsConst_TripComputer_Element
          arg Ptr: type=Arr_u8_64, direction=OUT, server-argument-impl-policy=USE-ARGUMENT-TYPE
        Get_BsConst_Warning_Element
          arg Ptr: type=Arr_u8_64, direction=OUT, server-argument-impl-policy=USE-ARGUMENT-TYPE
        Get_BsCys_Certicificate_Element
          arg Ptr: type=Arr_u8_64, direction=OUT, server-argument-impl-policy=USE-ARGUMENT-TYPE
        Get_BsDiag_Dtc_Element
          arg Ptr: type=Arr_u8_2048, direction=OUT, server-argument-impl-policy=USE-ARGUMENT-TYPE
        Get_BsDiag_ErrorRecord_Element
          arg Ptr: type=Arr_u8_1024, direction=OUT, server-argument-impl-policy=USE-ARGUMENT-TYPE
        Get_BsFuSa_Audio_Element
          arg Ptr: type=Arr_u8_32, direction=OUT, server-argument-impl-policy=USE-ARGUMENT-TYPE
        Get_BsFuSa_Communication_Element
          arg Ptr: type=Arr_u8_16, direction=OUT, server-argument-impl-policy=USE-ARGUMENT-TYPE
        Get_BsFuSa_Config_Element
          arg Ptr: type=Arr_u8_16, direction=OUT, server-argument-impl-policy=USE-ARGUMENT-TYPE
        Get_BsFuSa_Display_Element
          arg Ptr: type=Arr_u8_64, direction=OUT, server-argument-impl-policy=USE-ARGUMENT-TYPE
        Get_BsFuSa_Power_Element
          arg Ptr: type=Arr_u8_48, direction=OUT, server-argument-impl-policy=USE-ARGUMENT-TYPE
        Get_BsFuSa_Warning_Element
          arg Ptr: type=Arr_u8_32, direction=OUT, server-argument-impl-policy=USE-ARGUMENT-TYPE
        Get_BsFusa_Fota_Element
          arg Ptr: type=Arr_u8_32, direction=OUT, server-argument-impl-policy=USE-ARGUMENT-TYPE
        Get_BsReten_Audio_Element
          arg Ptr: type=Arr_u8_100, direction=OUT, server-argument-impl-policy=USE-ARGUMENT-TYPE
        Get_BsReten_Communication_Element
          arg Ptr: type=Arr_u8_100, direction=OUT, server-argument-impl-policy=USE-ARGUMENT-TYPE
        Get_BsReten_Display_Element
          arg Ptr: type=Arr_u8_100, direction=OUT, server-argument-impl-policy=USE-ARGUMENT-TYPE
        Get_BsReten_Gauges_Element
          arg Ptr: type=Arr_u8_100, direction=OUT, server-argument-impl-policy=USE-ARGUMENT-TYPE
        Get_BsReten_Illumination_Element
          arg Ptr: type=Arr_u8_100, direction=OUT, server-argument-impl-policy=USE-ARGUMENT-TYPE
        Get_BsReten_Odometer_Element
          arg Ptr: type=Arr_u8_100, direction=OUT, server-argument-impl-policy=USE-ARGUMENT-TYPE
        Get_BsReten_Personalization_Element
          arg Ptr: type=Arr_u8_100, direction=OUT, server-argument-impl-policy=USE-ARGUMENT-TYPE
        Get_BsReten_Power_Element
          arg Ptr: type=Arr_u8_100, direction=OUT, server-argument-impl-policy=USE-ARGUMENT-TYPE
        Get_BsReten_RealTimeClock_Element
          arg Ptr: type=Arr_u8_100, direction=OUT, server-argument-impl-policy=USE-ARGUMENT-TYPE
        Get_BsReten_Tripcomputer_Element
          arg Ptr: type=Arr_u8_100, direction=OUT, server-argument-impl-policy=USE-ARGUMENT-TYPE
        Get_BsReten_VisDlt_Element
          arg Ptr: type=Arr_u8_256, direction=OUT, server-argument-impl-policy=USE-ARGUMENT-TYPE
        Get_BsReten_Warning_Element
          arg Ptr: type=Arr_u8_100, direction=OUT, server-argument-impl-policy=USE-ARGUMENT-TYPE
        Get_BsRt_CusDlt_Element
          arg Ptr: type=Arr_u8_128, direction=OUT, server-argument-impl-policy=USE-ARGUMENT-TYPE
        Get_BsRt_FuelGauge_Element
          arg Ptr: type=Arr_u8_32, direction=OUT, server-argument-impl-policy=USE-ARGUMENT-TYPE
        Get_BsRt_Illumination_Element
          arg Ptr: type=Arr_u8_100, direction=OUT, server-argument-impl-policy=USE-ARGUMENT-TYPE
        Get_BsRt_Odometer_Element
          arg Ptr: type=Arr_u8_128, direction=OUT, server-argument-impl-policy=USE-ARGUMENT-TYPE
        Get_BsRt_OilGauge_Element
          arg Ptr: type=Arr_u8_8, direction=OUT, server-argument-impl-policy=USE-ARGUMENT-TYPE
        Get_BsRt_Personalization_Element
          arg Ptr: type=Arr_u8_128, direction=OUT, server-argument-impl-policy=USE-ARGUMENT-TYPE
        Get_BsRt_PowerGauge_Element
          arg Ptr: type=Arr_u8_32, direction=OUT, server-argument-impl-policy=USE-ARGUMENT-TYPE
        Get_BsRt_RealTimeClock_Element
          arg Ptr: type=Arr_u8_48, direction=OUT, server-argument-impl-policy=USE-ARGUMENT-TYPE
        Get_BsRt_SpeedoGauge_Element
          arg Ptr: type=Arr_u8_8, direction=OUT, server-argument-impl-policy=USE-ARGUMENT-TYPE
        Get_BsRt_TachoGauge_Element
          arg Ptr: type=Arr_u8_16, direction=OUT, server-argument-impl-policy=USE-ARGUMENT-TYPE
        Get_BsRt_TempGauge_Element
          arg Ptr: type=Arr_u8_32, direction=OUT, server-argument-impl-policy=USE-ARGUMENT-TYPE
        Get_BsRt_TripComputer_Element
          arg Ptr: type=Arr_u8_64, direction=OUT, server-argument-impl-policy=USE-ARGUMENT-TYPE
        Get_BsRt_Warning_Element
          arg Ptr: type=Arr_u8_32, direction=OUT, server-argument-impl-policy=USE-ARGUMENT-TYPE
        Get_BsShare_EcuPartNumber_Element
          arg Ptr: type=Arr_u8_128, direction=OUT, server-argument-impl-policy=USE-ARGUMENT-TYPE
        Get_BsShare_SwUpdFotaFinPrint_Element
          arg Ptr: type=Arr_u8_32, direction=OUT, server-argument-impl-policy=USE-ARGUMENT-TYPE
        Get_BsShare_SwUpdFotaMode_Element
          arg Ptr: type=Arr_u8_16, direction=OUT, server-argument-impl-policy=USE-ARGUMENT-TYPE
        Get_BsShare_SwUpdFotaStatus_Element
          arg Ptr: type=Arr_u8_48, direction=OUT, server-argument-impl-policy=USE-ARGUMENT-TYPE
        Get_BsShare_SwUpdFotadecrypt_Element
          arg Ptr: type=Arr_u8_64, direction=OUT, server-argument-impl-policy=USE-ARGUMENT-TYPE
        Get_BsShare_SwUpdReflash_Element
          arg Ptr: type=Arr_u8_8, direction=OUT, server-argument-impl-policy=USE-ARGUMENT-TYPE
        Get_BsShare_VehicleConfig_Element
          arg Ptr: type=Arr_u8_256, direction=OUT, server-argument-impl-policy=USE-ARGUMENT-TYPE
        Get_BsShare_VisMeet_Element
          arg Ptr: type=Arr_u8_48, direction=OUT, server-argument-impl-policy=USE-ARGUMENT-TYPE
        Get_RefCys_Certicificate1_Element
          arg Ptr: type=Arr_u8_64, direction=OUT, server-argument-impl-policy=USE-ARGUMENT-TYPE
        Get_RefCys_Certicificate_Element
          arg Ptr: type=Arr_u8_64, direction=OUT, server-argument-impl-policy=USE-ARGUMENT-TYPE
      error E_NOT_OK: error-code=1
    if_CS_MemAbsGetDefault
      operation Get_Default_SampleElement1: possible-error=if_CS_MemAbsGetDefault/E_NOT_OK
        arg Ptr: type=Arr_u8_8, direction=OUT, server-argument-impl-policy=USE-ARGUMENT-TYPE
      operation Get_Default_SampleElement2: possible-error=if_CS_MemAbsGetDefault/E_NOT_OK
        arg Ptr: type=Arr_u8_16, direction=OUT, server-argument-impl-policy=USE-ARGUMENT-TYPE
      error E_NOT_OK: error-code=1
    if_CS_MemAbsSet
      60 x operation:
        Set_BsConst_Audio_Element
          arg BsConst_Audio_Element: type=Arr_u8_128, direction=IN, server-argument-impl-policy=USE-ARGUMENT-TYPE
        Set_BsConst_Communication_Element
          arg BsConst_Communication_Element: type=Arr_u8_64, direction=IN, server-argument-impl-policy=USE-ARGUMENT-TYPE
        Set_BsConst_EngOffTimer_Element
          arg BsConst_EngOffTimer_Element: type=Arr_u8_32, direction=IN, server-argument-impl-policy=USE-ARGUMENT-TYPE
        Set_BsConst_FuelGauge_Element
          arg BsConst_FuelGauge_Element: type=Arr_u8_128, direction=IN, server-argument-impl-policy=USE-ARGUMENT-TYPE
        Set_BsConst_Illumination_Element
          arg BsConst_Illumination_Element: type=Arr_u8_128, direction=IN, server-argument-impl-policy=USE-ARGUMENT-TYPE
        Set_BsConst_OilGauge_Element
          arg BsConst_OilGauge_Element: type=Arr_u8_64, direction=IN, server-argument-impl-policy=USE-ARGUMENT-TYPE
        Set_BsConst_PowerGauge_Element
          arg BsConst_PowerGauge_Element: type=Arr_u8_64, direction=IN, server-argument-impl-policy=USE-ARGUMENT-TYPE
        Set_BsConst_Power_Element
          arg BsConst_Power_Element: type=Arr_u8_32, direction=IN, server-argument-impl-policy=USE-ARGUMENT-TYPE
        Set_BsConst_RealTimeClock_Element
          arg BsConst_RealTimeClock_Element: type=Arr_u8_48, direction=IN, server-argument-impl-policy=USE-ARGUMENT-TYPE
        Set_BsConst_ServiceReminder_Element
          arg BsConst_ServiceReminder_Element: type=Arr_u8_48, direction=IN, server-argument-impl-policy=USE-ARGUMENT-TYPE
        Set_BsConst_SpeedoGauge_Element
          arg BsConst_SpeedoGauge_Element: type=Arr_u8_64, direction=IN, server-argument-impl-policy=USE-ARGUMENT-TYPE
        Set_BsConst_TachoGauge_Element
          arg BsConst_TachoGauge_Element: type=Arr_u8_64, direction=IN, server-argument-impl-policy=USE-ARGUMENT-TYPE
        Set_BsConst_TempGauge_Element
          arg BsConst_TempGauge_Element: type=Arr_u8_64, direction=IN, server-argument-impl-policy=USE-ARGUMENT-TYPE
        Set_BsConst_TripComputer_Element
          arg BsConst_TripComputer_Element: type=Arr_u8_64, direction=IN, server-argument-impl-policy=USE-ARGUMENT-TYPE
        Set_BsConst_Warning_Element
          arg BsConst_Warning_Element: type=Arr_u8_64, direction=IN, server-argument-impl-policy=USE-ARGUMENT-TYPE
        Set_BsCys_Certicificate_Element
          arg BsCys_Certicificate_Element: type=Arr_u8_64, direction=IN, server-argument-impl-policy=USE-ARGUMENT-TYPE
        Set_BsDiag_Dtc_Element
          arg BsDiag_Dtc_Element: type=Arr_u8_2048, direction=IN, server-argument-impl-policy=USE-ARGUMENT-TYPE
        Set_BsDiag_ErrorRecord_Element
          arg BsDiag_ErrorRecord_Element: type=Arr_u8_1024, direction=IN, server-argument-impl-policy=USE-ARGUMENT-TYPE
        Set_BsFuSa_Audio_Element
          arg BsFuSa_Audio_Element: type=Arr_u8_32, direction=IN, server-argument-impl-policy=USE-ARGUMENT-TYPE
        Set_BsFuSa_Communication_Element
          arg BsFuSa_Communication_Element: type=Arr_u8_16, direction=IN, server-argument-impl-policy=USE-ARGUMENT-TYPE
        Set_BsFuSa_Config_Element
          arg BsFuSa_Config_Element: type=Arr_u8_16, direction=IN, server-argument-impl-policy=USE-ARGUMENT-TYPE
        Set_BsFuSa_Display_Element
          arg BsFuSa_Display_Element: type=Arr_u8_64, direction=IN, server-argument-impl-policy=USE-ARGUMENT-TYPE
        Set_BsFuSa_Power_Element
          arg BsFuSa_Power_Element: type=Arr_u8_48, direction=IN, server-argument-impl-policy=USE-ARGUMENT-TYPE
        Set_BsFuSa_Warning_Element
          arg BsFuSa_Warning_Element: type=Arr_u8_32, direction=IN, server-argument-impl-policy=USE-ARGUMENT-TYPE
        Set_BsFusa_Fota_Element
          arg BsFusa_Fota_Element: type=Arr_u8_32, direction=IN, server-argument-impl-policy=USE-ARGUMENT-TYPE
        Set_BsReten_Audio_Element
          arg BsReten_Audio_Element: type=Arr_u8_100, direction=IN, server-argument-impl-policy=USE-ARGUMENT-TYPE
        Set_BsReten_Communication_Element
          arg BsReten_Communication_Element: type=Arr_u8_100, direction=IN, server-argument-impl-policy=USE-ARGUMENT-TYPE
        Set_BsReten_Display_Element
          arg BsReten_Display_Element: type=Arr_u8_100, direction=IN, server-argument-impl-policy=USE-ARGUMENT-TYPE
        Set_BsReten_Gauges_Element
          arg BsReten_Gauges_Element: type=Arr_u8_100, direction=IN, server-argument-impl-policy=USE-ARGUMENT-TYPE
        Set_BsReten_Illumination_Element
          arg BsReten_Illumination_Element: type=Arr_u8_100, direction=IN, server-argument-impl-policy=USE-ARGUMENT-TYPE
        Set_BsReten_Odometer_Element
          arg BsReten_Odometer_Element: type=Arr_u8_100, direction=IN, server-argument-impl-policy=USE-ARGUMENT-TYPE
        Set_BsReten_Personalization_Element
          arg BsReten_Personalization_Element: type=Arr_u8_100, direction=IN, server-argument-impl-policy=USE-ARGUMENT-TYPE
        Set_BsReten_Power_Element
          arg BsReten_Power_Element: type=Arr_u8_100, direction=IN, server-argument-impl-policy=USE-ARGUMENT-TYPE
        Set_BsReten_RealTimeClock_Element
          arg BsReten_RealTimeClock_Element: type=Arr_u8_100, direction=IN, server-argument-impl-policy=USE-ARGUMENT-TYPE
        Set_BsReten_Tripcomputer_Element
          arg BsReten_Tripcomputer_Element: type=Arr_u8_100, direction=IN, server-argument-impl-policy=USE-ARGUMENT-TYPE
        Set_BsReten_VisDlt_Element
          arg BsReten_VisDlt_Element: type=Arr_u8_256, direction=IN, server-argument-impl-policy=USE-ARGUMENT-TYPE
        Set_BsReten_Warning_Element
          arg BsReten_Warning_Element: type=Arr_u8_100, direction=IN, server-argument-impl-policy=USE-ARGUMENT-TYPE
        Set_BsRt_CusDlt_Element
          arg BsRt_CusDlt_Element: type=Arr_u8_128, direction=IN, server-argument-impl-policy=USE-ARGUMENT-TYPE
        Set_BsRt_FuelGauge_Element
          arg BsRt_FuelGauge_Element: type=Arr_u8_32, direction=IN, server-argument-impl-policy=USE-ARGUMENT-TYPE
        Set_BsRt_Illumination_Element
          arg BsRt_Illumination_Element: type=Arr_u8_100, direction=IN, server-argument-impl-policy=USE-ARGUMENT-TYPE
        Set_BsRt_Odometer_Element
          arg BsRt_Odometer_Element: type=Arr_u8_128, direction=IN, server-argument-impl-policy=USE-ARGUMENT-TYPE
        Set_BsRt_OilGauge_Element
          arg BsRt_OilGauge_Element: type=Arr_u8_8, direction=IN, server-argument-impl-policy=USE-ARGUMENT-TYPE
        Set_BsRt_Personalization_Element
          arg BsRt_Personalization_Element: type=Arr_u8_128, direction=IN, server-argument-impl-policy=USE-ARGUMENT-TYPE
        Set_BsRt_PowerGauge_Element
          arg BsRt_PowerGauge_Element: type=Arr_u8_32, direction=IN, server-argument-impl-policy=USE-ARGUMENT-TYPE
        Set_BsRt_RealTimeClock_Element
          arg BsRt_RealTimeClock_Element: type=Arr_u8_48, direction=IN, server-argument-impl-policy=USE-ARGUMENT-TYPE
        Set_BsRt_SpeedoGauge_Element
          arg BsRt_SpeedoGauge_Element: type=Arr_u8_8, direction=IN, server-argument-impl-policy=USE-ARGUMENT-TYPE
        Set_BsRt_TachoGauge_Element
          arg BsRt_TachoGauge_Element: type=Arr_u8_16, direction=IN, server-argument-impl-policy=USE-ARGUMENT-TYPE
        Set_BsRt_TempGauge_Element
          arg BsRt_TempGauge_Element: type=Arr_u8_32, direction=IN, server-argument-impl-policy=USE-ARGUMENT-TYPE
        Set_BsRt_TripComputer_Element
          arg BsRt_TripComputer_Element: type=Arr_u8_64, direction=IN, server-argument-impl-policy=USE-ARGUMENT-TYPE
        Set_BsRt_Warning_Element
          arg BsRt_Warning_Element: type=Arr_u8_32, direction=IN, server-argument-impl-policy=USE-ARGUMENT-TYPE
        Set_BsShare_EcuPartNumber_Element
          arg BsShare_EcuPartNumber_Element: type=Arr_u8_128, direction=IN, server-argument-impl-policy=USE-ARGUMENT-TYPE
        Set_BsShare_SwUpdFotaFinPrint_Element
          arg BsShare_SwUpdFotaFinPrint_Element: type=Arr_u8_32, direction=IN, server-argument-impl-policy=USE-ARGUMENT-TYPE
        Set_BsShare_SwUpdFotaMode_Element
          arg BsShare_SwUpdFotaMode_Element: type=Arr_u8_16, direction=IN, server-argument-impl-policy=USE-ARGUMENT-TYPE
        Set_BsShare_SwUpdFotaStatus_Element
          arg BsShare_SwUpdFotaStatus_Element: type=Arr_u8_48, direction=IN, server-argument-impl-policy=USE-ARGUMENT-TYPE
        Set_BsShare_SwUpdFotadecrypt_Element
          arg BsShare_SwUpdFotadecrypt_Element: type=Arr_u8_64, direction=IN, server-argument-impl-policy=USE-ARGUMENT-TYPE
        Set_BsShare_SwUpdReflash_Element
          arg BsShare_SwUpdReflash_Element: type=Arr_u8_8, direction=IN, server-argument-impl-policy=USE-ARGUMENT-TYPE
        Set_BsShare_VehicleConfig_Element
          arg BsShare_VehicleConfig_Element: type=Arr_u8_256, direction=IN, server-argument-impl-policy=USE-ARGUMENT-TYPE
        Set_BsShare_VisMeet_Element
          arg BsShare_VisMeet_Element: type=Arr_u8_48, direction=IN, server-argument-impl-policy=USE-ARGUMENT-TYPE
        Set_RefCys_Certicificate1_Element
          arg RefCys_Certicificate1_Element: type=Arr_u8_64, direction=IN, server-argument-impl-policy=USE-ARGUMENT-TYPE
        Set_RefCys_Certicificate_Element
          arg RefCys_Certicificate_Element: type=Arr_u8_64, direction=IN, server-argument-impl-policy=USE-ARGUMENT-TYPE
    if_CS_MemAbs_NvMWriteStatus
      operation NvmWriteStatus: possible-error=if_CS_MemAbs_NvMWriteStatus/E_NOT_OK
      error E_NOT_OK: error-code=1
  sender receiver interface if_SR_JobStatus
    60 x data, all with type=UInt8:
      JobStatus_BsConst_Audio_Element
      JobStatus_BsConst_Communication_Element
      JobStatus_BsConst_EngOffTimer_Element
      JobStatus_BsConst_FuelGauge_Element
      JobStatus_BsConst_Illumination_Element
      JobStatus_BsConst_OilGauge_Element
      JobStatus_BsConst_PowerGauge_Element
      JobStatus_BsConst_Power_Element
      JobStatus_BsConst_RealTimeClock_Element
      JobStatus_BsConst_ServiceReminder_Element
      JobStatus_BsConst_SpeedoGauge_Element
      JobStatus_BsConst_TachoGauge_Element
      JobStatus_BsConst_TempGauge_Element
      JobStatus_BsConst_TripComputer_Element
      JobStatus_BsConst_Warning_Element
      JobStatus_BsCys_Certicificate_Element
      JobStatus_BsDiag_Dtc_Element
      JobStatus_BsDiag_ErrorRecord_Element
      JobStatus_BsFuSa_Audio_Element
      JobStatus_BsFuSa_Communication_Element
      JobStatus_BsFuSa_Config_Element
      JobStatus_BsFuSa_Display_Element
      JobStatus_BsFuSa_Power_Element
      JobStatus_BsFuSa_Warning_Element
      JobStatus_BsFusa_Fota_Element
      JobStatus_BsReten_Audio_Element
      JobStatus_BsReten_Communication_Element
      JobStatus_BsReten_Display_Element
      JobStatus_BsReten_Gauges_Element
      JobStatus_BsReten_Illumination_Element
      JobStatus_BsReten_Odometer_Element
      JobStatus_BsReten_Personalization_Element
      JobStatus_BsReten_Power_Element
      JobStatus_BsReten_RealTimeClock_Element
      JobStatus_BsReten_Tripcomputer_Element
      JobStatus_BsReten_VisDlt_Element
      JobStatus_BsReten_Warning_Element
      JobStatus_BsRt_CusDlt_Element
      JobStatus_BsRt_FuelGauge_Element
      JobStatus_BsRt_Illumination_Element
      JobStatus_BsRt_Odometer_Element
      JobStatus_BsRt_OilGauge_Element
      JobStatus_BsRt_Personalization_Element
      JobStatus_BsRt_PowerGauge_Element
      JobStatus_BsRt_RealTimeClock_Element
      JobStatus_BsRt_SpeedoGauge_Element
      JobStatus_BsRt_TachoGauge_Element
      JobStatus_BsRt_TempGauge_Element
      JobStatus_BsRt_TripComputer_Element
      JobStatus_BsRt_Warning_Element
      JobStatus_BsShare_EcuPartNumber_Element
      JobStatus_BsShare_SwUpdFotaFinPrint_Element
      JobStatus_BsShare_SwUpdFotaMode_Element
      JobStatus_BsShare_SwUpdFotaStatus_Element
      JobStatus_BsShare_SwUpdFotadecrypt_Element
      JobStatus_BsShare_SwUpdReflash_Element
      JobStatus_BsShare_VehicleConfig_Element
      JobStatus_BsShare_VisMeet_Element
      JobStatus_RefCys_Certicificate1_Element
      JobStatus_RefCys_Certicificate_Element
  8 x client server interface:
    TI_NvMExt_GetErrorStatus
      operation NvMExt_GetErrorStatus: possible-error=TI_NvMExt_GetErrorStatus/E_NOT_OK
        arg NvmBlockId: type=NvM_BlockIdType, direction=IN, server-argument-impl-policy=USE-ARGUMENT-TYPE
        arg RequestResultPtr: type=NvM_RequestResultType, direction=INOUT, server-argument-impl-policy=USE-ARGUMENT-TYPE
      error E_NOT_OK: error-code=1
    TI_NvMExt_GetReadAllStatus
      operation NvmExt_GetNvMReadAllStatus
        arg Status: type=Boolean, direction=OUT, server-argument-impl-policy=USE-ARGUMENT-TYPE
    TI_NvMExt_ReadBlock
      operation NvMExt_ReadBlock: possible-error=TI_NvMExt_ReadBlock/E_NOT_OK
        arg NvmBlockId: type=NvM_BlockIdType, direction=IN, server-argument-impl-policy=USE-ARGUMENT-TYPE
        arg NvMDstPtr: type=UInt8, direction=INOUT, server-argument-impl-policy=USE-ARGUMENT-TYPE
      error E_NOT_OK: error-code=1
    TI_NvMExt_RestoreBlockDefaults
      operation NvMExt_RestoreBlockDefaults: possible-error=TI_NvMExt_RestoreBlockDefaults/E_NOT_OK
        arg NvmBlockId: type=NvM_BlockIdType, direction=IN, server-argument-impl-policy=USE-ARGUMENT-TYPE
        arg NvMDstPtr: type=UInt8, direction=INOUT, server-argument-impl-policy=USE-ARGUMENT-TYPE
      error E_NOT_OK: error-code=1
    TI_NvMExt_SleepOperations
      operation NvMExt_CancelSleep: possible-error=TI_NvMExt_SleepOperations/E_NOT_OK
      operation NvMExt_ReadytoSleep: possible-error=TI_NvMExt_SleepOperations/E_NOT_OK
      operation NvMExt_RequestSleep: possible-error=TI_NvMExt_SleepOperations/E_NOT_OK
      error E_NOT_OK: error-code=1
    TI_NvMExt_WriteBlock
      operation NvMExt_WriteBlock: possible-error=TI_NvMExt_WriteBlock/E_NOT_OK
        arg NvmBlockId: type=NvM_BlockIdType, direction=IN, server-argument-impl-policy=USE-ARGUMENT-TYPE
        arg NvM_SrcPtr: type=UInt8, direction=INOUT, server-argument-impl-policy=USE-ARGUMENT-TYPE
      error E_NOT_OK: error-code=1
    TI_NvmExt_StartNvmReadAll
      operation NvMExt_ReadAll
    TI_NvmExt_GetPendingStatus
      operation NvMExt_GetPendingStatus: possible-error=TI_NvmExt_GetPendingStatus/E_NOT_OK
        arg NvmBlockID: type=UInt8, direction=IN, server-argument-impl-policy=USE-ARGUMENT-TYPE
        arg Status: type=UInt8, direction=OUT, server-argument-impl-policy=USE-ARGUMENT-TYPE
      error E_NOT_OK: error-code=1
  sender receiver interface TI_NvMExt_WakeupStatus
    data WakeupFlag: type=Boolean
  5 x client server interface:
    TI_If_TmExt_Timer_GetElapsedTime
      operation Timer_GetElapsedTime
        arg hTimer: type=HTimer, direction=IN, server-argument-impl-policy=USE-ARGUMENT-TYPE
        arg ElapsedTime: type=UInt32, direction=OUT, server-argument-impl-policy=USE-ARGUMENT-TYPE
    TI_If_TmExt_Timer_IsElapsed
      operation Timer_IsElapsed
        arg hTimer: type=HTimer, direction=IN, server-argument-impl-policy=USE-ARGUMENT-TYPE
        arg Timeout: type=UInt32, direction=IN, server-argument-impl-policy=USE-ARGUMENT-TYPE
        arg IsElapsed: type=Boolean, direction=OUT, server-argument-impl-policy=USE-ARGUMENT-TYPE
    TI_If_TmExt_Timer_IsStarted
      operation Timer_IsStarted
        arg hTimer: type=HTimer, direction=IN, server-argument-impl-policy=USE-ARGUMENT-TYPE
        arg IsStarted: type=Boolean, direction=OUT, server-argument-impl-policy=USE-ARGUMENT-TYPE
    TI_If_TmExt_Timer_Start
      operation Timer_Start
        arg hTimer: type=HTimer, direction=IN, server-argument-impl-policy=USE-ARGUMENT-TYPE
    TI_If_TmExt_Timer_Stop
      operation Timer_Stop
        arg hTimer: type=HTimer, direction=IN, server-argument-impl-policy=USE-ARGUMENT-TYPE
  sender receiver interface HealthDumpGetData_Q
    data HealthDumpGetDataData: sw-impl-policy=QUEUED, type=SHealthDumpGetData
  sender receiver interface HealthDumpGetHdr_Q
    data HealthDumpGetHdrData: sw-impl-policy=QUEUED, type=SHealthDumpGetHdr
  sender receiver interface PowerSystemStateReqChange
    data PowerSystemStateReqChangeData: type=SPowerSystemStateReqChange
  client server interface if_CS_DmnSystemStateChange
    operation DmnSystemStateChangeReq: possible-error=if_CS_DmnSystemStateChange/E_NOT_OK
      arg DmnId: type=EDomainId, direction=IN, server-argument-impl-policy=USE-ARGUMENT-TYPE
      arg DmnState: type=ESystemState, direction=IN, server-argument-impl-policy=USE-ARGUMENT-TYPE
    operation DmnSystemStateChangeStatus
      arg DmnId: type=EDomainId, direction=IN, server-argument-impl-policy=USE-ARGUMENT-TYPE
      arg DmnStatus: type=EDmnChangeReqStatus_t, direction=OUT, server-argument-impl-policy=USE-ARGUMENT-TYPE
    error E_NOT_OK: error-code=1
  client server interface if_CS_DmnMonitoring
    operation StartDomainMonitoring: possible-error=if_CS_DmnMonitoring/E_NOT_OK
      arg DmnID: type=EDomainId, direction=IN, server-argument-impl-policy=USE-ARGUMENT-TYPE
    operation StopDomainMonitoring: possible-error=if_CS_DmnMonitoring/E_NOT_OK
      arg DmnID: type=EDomainId, direction=IN, server-argument-impl-policy=USE-ARGUMENT-TYPE
    error E_NOT_OK: error-code=1
  client server interface UclSystemCallbacks
    operation ErrorNotification
      arg DLInst: type=UInt8, direction=IN, server-argument-impl-policy=USE-ARGUMENT-TYPE
      arg ErrorCode: type=SInt32, direction=IN, server-argument-impl-policy=USE-ARGUMENT-TYPE
    operation LinkStatusChanged
      arg DLInst: type=UInt8, direction=IN, server-argument-impl-policy=USE-ARGUMENT-TYPE
      arg Status: type=SInt32, direction=IN, server-argument-impl-policy=USE-ARGUMENT-TYPE
  8 x sender receiver interface:
    if_SR_DmnInfo
      data SDmnStatus: type=SDmnStatus
    HealthDomainFatalError_Q
      data HealthDomainFatalErrorData: sw-impl-policy=QUEUED, type=SHealthDomainFatalError
    HealthDomainHeartbeat_Q
      data HealthDomainHeartbeatData: sw-impl-policy=QUEUED, type=SHealthDomainHeartbeat
    HealthDumpData_Q
      data HealthDumpDataData: sw-impl-policy=QUEUED, type=SHealthDumpData
    HealthDumpHdrInfo_Q
      data HealthDumpHdrInfoData: sw-impl-policy=QUEUED, type=SHealthDumpHdrInfo
    PowerExtendShutdownTime_Q
      data PowerExtendShutdownTimeData: sw-impl-policy=QUEUED, type=SPowerExtendShutdownTime
    PowerKeepSystemAwake_Q
      data PowerKeepSystemAwakeData: sw-impl-policy=QUEUED, type=SPowerKeepSystemAwake
    PowerSystemState
      data PowerSystemStateData: type=SPowerSystemState
  client server interface UclInitShutdown
    operation Impl_Initialize: possible-error=UclInitShutdown/E_NOT_OK
    operation Impl_Shutdown: possible-error=UclInitShutdown/E_NOT_OK
    error E_NOT_OK: error-code=1
  7 x sender receiver interface:
    HealthEventRecord_Q
      data HealthEventRecordData: sw-impl-policy=QUEUED, type=SHealthEventRecord
    DiagDIDRequest_Q
      data DiagDIDRequestData: sw-impl-policy=QUEUED, type=SDiagDIDRequest
    DiagIOCtrlRequest_Q
      data DiagIOCtrlRequestData: sw-impl-policy=QUEUED, type=SDiagIOCtrlRequest
    DiagRoutineRequest_Q
      data DiagRoutineRequestData: sw-impl-policy=QUEUED, type=SDiagRoutineRequest
    IgnState_Q
      data IgnStateData: sw-impl-policy=QUEUED, type=SIgnState
    TI_BattMdl_AVP
      14 x data, all with type=Boolean:
        HVP0Flag
        HVSD{0..4}Flag
        LVP0Flag
        LVP1Flag
        LVSD{0..4}Flag
        SVPFlag
    TI_BattMdl_Voltage
      data OverVoltageInterruptFlag: type=Boolean
  29 x client server interface:
    TI_EcuPowerM
      operation EcuPowerM_GetDeviceStatus: possible-error=TI_EcuPowerM/E_NOT_OK
        arg device: type=UInt8, direction=IN, server-argument-impl-policy=USE-ARGUMENT-TYPE
        arg status: type=UInt8, direction=OUT, server-argument-impl-policy=USE-ARGUMENT-TYPE
      operation EcuPowerM_RequestPower: possible-error=TI_EcuPowerM/E_NOT_OK
        arg device: type=UInt8, direction=IN, server-argument-impl-policy=USE-ARGUMENT-TYPE
        arg request: type=UInt8, direction=IN, server-argument-impl-policy=USE-ARGUMENT-TYPE
      error E_NOT_OK: error-code=1
    If_CS_Dlt_DetForwardErrorTrace
      operation DetForwardErrorTrace
        4 x arg, all with direction=IN, server-argument-impl-policy=USE-ARGUMENT-TYPE:
          moduleId: type=UInt16
          instanceId: type=UInt8
          apiId: type=UInt8
          errorId: type=UInt8
    If_CS_Dlt_GetDefaultLogLevel
      operation GetDefaultLogLevel: possible-error=If_CS_Dlt_GetDefaultLogLevel/E_NOT_OK
        arg defaultLogLevel: type=Dlt_MessageLogLevelType, direction=OUT, server-argument-impl-policy=USE-ARGUMENT-TYPE
      error E_NOT_OK: error-code=1
    If_CS_Dlt_GetDefaultTraceStatus
      operation GetDefaultTraceStatus: possible-error=If_CS_Dlt_GetDefaultTraceStatus/E_NOT_OK
        arg logChannelName: type=Dlt_LogChannelNameType, direction=IN, server-argument-impl-policy=USE-ARGUMENT-TYPE
        arg traceStatus: type=Boolean, direction=OUT, server-argument-impl-policy=USE-ARGUMENT-TYPE
      error E_NOT_OK: error-code=1
    If_CS_Dlt_GetLogChannelNames
      operation GetLogChannelNames: possible-error=If_CS_Dlt_GetLogChannelNames/E_NOT_OK
        arg numberOfLogChannels: type=UInt8, direction=OUT, server-argument-impl-policy=USE-ARGUMENT-TYPE
        arg logChannelNames: type=Dlt_LogChannelNameType, direction=OUT, server-argument-impl-policy=USE-ARGUMENT-TYPE
      error E_NOT_OK: error-code=1
    If_CS_Dlt_GetLogChannelThreshold
      operation GetLogChannelThreshold: possible-error=If_CS_Dlt_GetLogChannelThreshold/E_NOT_OK
        arg logChannelName: type=Dlt_LogChannelNameType, direction=IN, server-argument-impl-policy=USE-ARGUMENT-TYPE
        arg logChannelThreshold: type=Dlt_MessageLogLevelType, direction=OUT, server-argument-impl-policy=USE-ARGUMENT-TYPE
        arg traceStatus: type=Boolean, direction=OUT, server-argument-impl-policy=USE-ARGUMENT-TYPE
      error E_NOT_OK: error-code=1
    If_CS_Dlt_GetLogInfo
      operation GetLogInfo: possible-error=If_CS_Dlt_GetLogInfo/E_NOT_OK
        5 x arg, all with server-argument-impl-policy=USE-ARGUMENT-TYPE:
          options: type=UInt8, direction=IN
          appId: type=Dlt_ApplicationIDType, direction=IN
          contextId: type=Dlt_ContextIDType, direction=IN
          status: type=UInt8, direction=OUT
          logInfo: type=Dlt_LogInfoType, direction=OUT
      error E_NOT_OK: error-code=1
    If_CS_Dlt_GetTraceStatus
      operation GetTraceStatus: possible-error=If_CS_Dlt_GetTraceStatus/E_NOT_OK
        arg appId: type=Dlt_ApplicationIDType, direction=IN, server-argument-impl-policy=USE-ARGUMENT-TYPE
        arg contextId: type=Dlt_ContextIDType, direction=IN, server-argument-impl-policy=USE-ARGUMENT-TYPE
        arg traceStatus: type=Boolean, direction=OUT, server-argument-impl-policy=USE-ARGUMENT-TYPE
      error E_NOT_OK: error-code=1
    If_CS_Dlt_InjectCall_SESSION
      operation InjectCall_SESSION
        5 x arg, all with server-argument-impl-policy=USE-ARGUMENT-TYPE:
          appId: type=Dlt_ApplicationIDType, direction=IN
          contextId: type=Dlt_ContextIDType, direction=IN
          serviceId: type=UInt32, direction=IN
          dataLength: type=UInt32, direction=IN
          data: type=UInt8, direction=OUT
    If_CS_Dlt_RegisterContext
      operation RegisterContext: possible-error=If_CS_Dlt_RegisterContext/E_NOT_OK
        7 x arg, all with server-argument-impl-policy=USE-ARGUMENT-TYPE:
          logmsg_session_id: type=Dlt_SessionIDType, direction=IN
          logmsg_app_id: type=Dlt_ApplicationIDType, direction=IN
          logmsg_context_id: type=Dlt_ContextIDType, direction=IN
          logmsg_app_description: type=UInt8, direction=OUT
          logmsg_len_app_description: type=UInt8, direction=IN
          logmsg_context_description: type=UInt8, direction=OUT
          logmsg_len_context_description: type=UInt8, direction=IN
      error E_NOT_OK: error-code=1
    If_CS_Dlt_ResetToFactoryDefault
      operation ResetToFactoryDefault: possible-error=If_CS_Dlt_ResetToFactoryDefault/E_NOT_OK
      error E_NOT_OK: error-code=1
    If_CS_Dlt_SendLogMessage
      operation SendLogMessage: possible-error=If_CS_Dlt_SendLogMessage/E_NOT_OK
        4 x arg, all with server-argument-impl-policy=USE-ARGUMENT-TYPE:
          msg_session_id: type=Dlt_SessionIDType, direction=IN
          msg_log_info: type=Dlt_MessageLogInfoType, direction=OUT
          msg_logData: type=UInt8, direction=OUT
          msg_datalength: type=UInt16, direction=IN
      error E_NOT_OK: error-code=1
    If_CS_Dlt_SendTraceMessage
      operation SendTraceMessage: possible-error=If_CS_Dlt_SendTraceMessage/E_NOT_OK
        4 x arg, all with server-argument-impl-policy=USE-ARGUMENT-TYPE:
          sessionId: type=Dlt_SessionIDType, direction=IN
          traceInfo: type=Dlt_MessageTraceInfoType, direction=OUT
          traceData: type=UInt8, direction=OUT
          traceDataLength: type=UInt16, direction=IN
      error E_NOT_OK: error-code=1
    If_CS_Dlt_SetDefaultLogLevel
      operation SetDefaultLogLevel: possible-error=If_CS_Dlt_SetDefaultLogLevel/E_NOT_OK
        arg newLogLevel: type=Dlt_MessageLogLevelType, direction=IN, server-argument-impl-policy=USE-ARGUMENT-TYPE
      error E_NOT_OK: error-code=1
    If_CS_Dlt_SetDefaultTraceStatus
      operation SetDefaultTraceStatus: possible-error=If_CS_Dlt_SetDefaultTraceStatus/E_NOT_OK
        arg newTraceStatus: type=Boolean, direction=IN, server-argument-impl-policy=USE-ARGUMENT-TYPE
        arg logChannelName: type=Dlt_LogChannelNameType, direction=IN, server-argument-impl-policy=USE-ARGUMENT-TYPE
      error E_NOT_OK: error-code=1
    If_CS_Dlt_SetLogChannelAssignment
      operation SetLogChannelAssignment: possible-error=If_CS_Dlt_SetLogChannelAssignment/E_NOT_OK
        4 x arg, all with direction=IN, server-argument-impl-policy=USE-ARGUMENT-TYPE:
          appId: type=Dlt_ApplicationIDType
          contextId: type=Dlt_ContextIDType
          logChannelName: type=Dlt_LogChannelNameType
          addRemoveOp: type=Dlt_AssignmentOperation
      error E_NOT_OK: error-code=1
    If_CS_Dlt_SetLogChannelThreshold
      operation SetLogChannelThreshold: possible-error=If_CS_Dlt_SetLogChannelThreshold/E_NOT_OK
        arg logChannelName: type=Dlt_LogChannelNameType, direction=IN, server-argument-impl-policy=USE-ARGUMENT-TYPE
        arg newThreshold: type=Dlt_MessageLogLevelType, direction=IN, server-argument-impl-policy=USE-ARGUMENT-TYPE
        arg newTraceStatus: type=Boolean, direction=IN, server-argument-impl-policy=USE-ARGUMENT-TYPE
      error E_NOT_OK: error-code=1
    If_CS_Dlt_SetLogLevel
      operation SetLogLevel: possible-error=If_CS_Dlt_SetLogLevel/E_NOT_OK
        arg appId: type=Dlt_ApplicationIDType, direction=IN, server-argument-impl-policy=USE-ARGUMENT-TYPE
        arg contextId: type=Dlt_ContextIDType, direction=IN, server-argument-impl-policy=USE-ARGUMENT-TYPE
        arg newLogLevel: type=Dlt_MessageLogLevelType, direction=IN, server-argument-impl-policy=USE-ARGUMENT-TYPE
      error E_NOT_OK: error-code=1
    If_CS_Dlt_SetMessageFiltering
      operation SetMessageFiltering: possible-error=If_CS_Dlt_SetMessageFiltering/E_NOT_OK
        arg MessageFilteringStatus: type=Boolean, direction=IN, server-argument-impl-policy=USE-ARGUMENT-TYPE
      error E_NOT_OK: error-code=1
    If_CS_Dlt_SetTraceStatus
      operation SetTraceStatus: possible-error=If_CS_Dlt_SetTraceStatus/E_NOT_OK
        arg appId: type=Dlt_ApplicationIDType, direction=IN, server-argument-impl-policy=USE-ARGUMENT-TYPE
        arg contextId: type=Dlt_ContextIDType, direction=IN, server-argument-impl-policy=USE-ARGUMENT-TYPE
        arg newTraceStatus: type=Boolean, direction=IN, server-argument-impl-policy=USE-ARGUMENT-TYPE
      error E_NOT_OK: error-code=1
    If_CS_Dlt_StoreConfiguration
      operation StoreConfiguration: possible-error=If_CS_Dlt_StoreConfiguration/E_NOT_OK
      error E_NOT_OK: error-code=1
    If_CS_Dlt_UnregisterContext
      operation UnregisterContext: possible-error=If_CS_Dlt_UnregisterContext/E_NOT_OK
        arg message_session_id: type=Dlt_SessionIDType, direction=IN, server-argument-impl-policy=USE-ARGUMENT-TYPE
        arg message_app_id: type=Dlt_ApplicationIDType, direction=IN, server-argument-impl-policy=USE-ARGUMENT-TYPE
        arg message_context_id: type=Dlt_ContextIDType, direction=IN, server-argument-impl-policy=USE-ARGUMENT-TYPE
      error E_NOT_OK: error-code=1
    If_CS_DltExt_SendLogMessage
      operation SendLogMessage: possible-error=If_CS_DltExt_SendLogMessage/E_NOT_OK
        arg message: type=tDlt_MessageFormat, direction=OUT, server-argument-impl-policy=USE-ARGUMENT-TYPE
      error E_NOT_OK: error-code=1
    If_CS_SetCounterToDefault
      operation SetCounterToDefault
    If_CS_SetLogsToDefault
      operation SetLogsToDefault
    TI_EcuMExt_GetResetReason
      operation EcuMExt_GetResetReason
        arg ResetReason: type=EcuMExt_ResetType, direction=OUT, server-argument-impl-policy=USE-ARGUMENT-TYPE
    if_CS_TIRtcServices
      4 x operation, all with possible-error=if_CS_TIRtcServices/E_NOT_OK:
        RtcCdd_ClearAlarm
        RtcCdd_GetTime
          arg p_time: type=Rtc_TimeType, direction=OUT, server-argument-impl-policy=USE-ARGUMENT-TYPE
        RtcCdd_SetAlarm
          arg p_alarm: type=Rtc_AlarmType, direction=IN, server-argument-impl-policy=USE-ARGUMENT-TYPE
        RtcCdd_SetTime
          arg p_time: type=Rtc_TimeType, direction=IN, server-argument-impl-policy=USE-ARGUMENT-TYPE
      error E_NOT_OK: error-code=1
    if_CS_TIBattMdl
      operation BattMdl_GetSvpState
      operation BattMdl_OverVoltageISRFlagProcess
    if_CS_SndCdd_AmpDiag
      operation GetSpeaker_status: possible-error=if_CS_SndCdd_AmpDiag/E_NOT_OK
        arg SpkrState: type=UInt8, direction=OUT, server-argument-impl-policy=USE-ARGUMENT-TYPE
        arg SpkrDiagStatus: type=UInt8, direction=OUT, server-argument-impl-policy=USE-ARGUMENT-TYPE
      operation SpkrAmp_Recovery: possible-error=if_CS_SndCdd_AmpDiag/E_NOT_OK
      error E_NOT_OK: error-code=1
package /Predefined_DEV/PortInterfaces
  43 x client server interface:
    NvMNotifyInitBlock: is-service=true
      operation InitBlock
    NvSWC_NvMNotifyInitBlock
      operation InitBlock
    NvMAdministration: is-service=true
      operation SetBlockProtection: possible-error=NvMAdministration/E_NOT_OK
        arg ProtectionEnabled: type=boolean, direction=IN, server-argument-impl-policy=USE-ARGUMENT-TYPE
      error E_NOT_OK: error-code=1
    NvSWC_NvMAdministration
      operation SetBlockProtection: possible-error=NvSWC_NvMAdministration/E_NOT_OK
        arg ProtectionEnabled: type=boolean, direction=IN, server-argument-impl-policy=USE-ARGUMENT-TYPE
      error E_NOT_OK: error-code=1
    NvMService: is-service=true
      operation GetErrorStatus: possible-error=NvMService/E_NOT_OK
        arg ErrorStatus: type=NvM_RequestResultType, direction=OUT, server-argument-impl-policy=USE-ARGUMENT-TYPE
      error E_NOT_OK: error-code=1
    NvMService_AC2: is-service=true
      operation GetErrorStatus: possible-error=NvMService_AC2/E_NOT_OK
        arg ErrorStatus: type=NvM_RequestResultType, direction=OUT, server-argument-impl-policy=USE-ARGUMENT-TYPE
      operation ReadBlock: possible-error=NvMService_AC2/E_NOT_OK
        arg DstPtr: type=dtRef_VOID, direction=IN, server-argument-impl-policy=USE-ARGUMENT-TYPE
      operation WriteBlock: possible-error=NvMService_AC2/E_NOT_OK
        arg SrcPtr: type=dtRef_const_VOID, direction=IN, server-argument-impl-policy=USE-ARGUMENT-TYPE
      error E_NOT_OK: error-code=1
    NvMService_AC2_Defs: is-service=true
      4 x operation, all with possible-error=NvMService_AC2_Defs/E_NOT_OK:
        GetErrorStatus
          arg ErrorStatus: type=NvM_RequestResultType, direction=OUT, server-argument-impl-policy=USE-ARGUMENT-TYPE
        ReadBlock
          arg DstPtr: type=dtRef_VOID, direction=IN, server-argument-impl-policy=USE-ARGUMENT-TYPE
        RestoreBlockDefaults
          arg DstPtr: type=dtRef_VOID, direction=IN, server-argument-impl-policy=USE-ARGUMENT-TYPE
        WriteBlock
          arg SrcPtr: type=dtRef_const_VOID, direction=IN, server-argument-impl-policy=USE-ARGUMENT-TYPE
      error E_NOT_OK: error-code=1
    NvMService_AC2_DS: is-service=true
      5 x operation, all with possible-error=NvMService_AC2_DS/E_NOT_OK:
        GetDataIndex
          arg DataIndex: type=uint8, direction=OUT, server-argument-impl-policy=USE-ARGUMENT-TYPE
        GetErrorStatus
          arg ErrorStatus: type=NvM_RequestResultType, direction=OUT, server-argument-impl-policy=USE-ARGUMENT-TYPE
        ReadBlock
          arg DstPtr: type=dtRef_VOID, direction=IN, server-argument-impl-policy=USE-ARGUMENT-TYPE
        SetDataIndex
          arg DataIndex: type=uint8, direction=IN, server-argument-impl-policy=USE-ARGUMENT-TYPE
        WriteBlock
          arg SrcPtr: type=dtRef_const_VOID, direction=IN, server-argument-impl-policy=USE-ARGUMENT-TYPE
      error E_NOT_OK: error-code=1
    NvMService_AC2_DS_Defs: is-service=true
      6 x operation, all with possible-error=NvMService_AC2_DS_Defs/E_NOT_OK:
        GetDataIndex
          arg DataIndex: type=uint8, direction=OUT, server-argument-impl-policy=USE-ARGUMENT-TYPE
        GetErrorStatus
          arg ErrorStatus: type=NvM_RequestResultType, direction=OUT, server-argument-impl-policy=USE-ARGUMENT-TYPE
        ReadBlock
          arg DstPtr: type=dtRef_VOID, direction=IN, server-argument-impl-policy=USE-ARGUMENT-TYPE
        RestoreBlockDefaults
          arg DstPtr: type=dtRef_VOID, direction=IN, server-argument-impl-policy=USE-ARGUMENT-TYPE
        SetDataIndex
          arg DataIndex: type=uint8, direction=IN, server-argument-impl-policy=USE-ARGUMENT-TYPE
        WriteBlock
          arg SrcPtr: type=dtRef_const_VOID, direction=IN, server-argument-impl-policy=USE-ARGUMENT-TYPE
      error E_NOT_OK: error-code=1
    NvMService_AC2_SRBS: is-service=true
      4 x operation, all with possible-error=NvMService_AC2_SRBS/E_NOT_OK:
        GetErrorStatus
          arg ErrorStatus: type=NvM_RequestResultType, direction=OUT, server-argument-impl-policy=USE-ARGUMENT-TYPE
        ReadBlock
          arg DstPtr: type=dtRef_VOID, direction=IN, server-argument-impl-policy=USE-ARGUMENT-TYPE
        SetRamBlockStatus
          arg RamBlockStatus: type=boolean, direction=IN, server-argument-impl-policy=USE-ARGUMENT-TYPE
        WriteBlock
          arg SrcPtr: type=dtRef_const_VOID, direction=IN, server-argument-impl-policy=USE-ARGUMENT-TYPE
      error E_NOT_OK: error-code=1
    NvMService_AC2_SRBS_Defs: is-service=true
      5 x operation, all with possible-error=NvMService_AC2_SRBS_Defs/E_NOT_OK:
        GetErrorStatus
          arg ErrorStatus: type=NvM_RequestResultType, direction=OUT, server-argument-impl-policy=USE-ARGUMENT-TYPE
        ReadBlock
          arg DstPtr: type=dtRef_VOID, direction=IN, server-argument-impl-policy=USE-ARGUMENT-TYPE
        RestoreBlockDefaults
          arg DstPtr: type=dtRef_VOID, direction=IN, server-argument-impl-policy=USE-ARGUMENT-TYPE
        SetRamBlockStatus
          arg RamBlockStatus: type=boolean, direction=IN, server-argument-impl-policy=USE-ARGUMENT-TYPE
        WriteBlock
          arg SrcPtr: type=dtRef_const_VOID, direction=IN, server-argument-impl-policy=USE-ARGUMENT-TYPE
      error E_NOT_OK: error-code=1
    NvMService_AC2_SRBS_DS: is-service=true
      6 x operation, all with possible-error=NvMService_AC2_SRBS_DS/E_NOT_OK:
        GetDataIndex
          arg DataIndex: type=uint8, direction=OUT, server-argument-impl-policy=USE-ARGUMENT-TYPE
        GetErrorStatus
          arg ErrorStatus: type=NvM_RequestResultType, direction=OUT, server-argument-impl-policy=USE-ARGUMENT-TYPE
        ReadBlock
          arg DstPtr: type=dtRef_VOID, direction=IN, server-argument-impl-policy=USE-ARGUMENT-TYPE
        SetDataIndex
          arg DataIndex: type=uint8, direction=IN, server-argument-impl-policy=USE-ARGUMENT-TYPE
        SetRamBlockStatus
          arg RamBlockStatus: type=boolean, direction=IN, server-argument-impl-policy=USE-ARGUMENT-TYPE
        WriteBlock
          arg SrcPtr: type=dtRef_const_VOID, direction=IN, server-argument-impl-policy=USE-ARGUMENT-TYPE
      error E_NOT_OK: error-code=1
    NvMService_AC2_SRBS_DS_Defs: is-service=true
      7 x operation, all with possible-error=NvMService_AC2_SRBS_DS_Defs/E_NOT_OK:
        GetDataIndex
          arg DataIndex: type=uint8, direction=OUT, server-argument-impl-policy=USE-ARGUMENT-TYPE
        GetErrorStatus
          arg ErrorStatus: type=NvM_RequestResultType, direction=OUT, server-argument-impl-policy=USE-ARGUMENT-TYPE
        ReadBlock
          arg DstPtr: type=dtRef_VOID, direction=IN, server-argument-impl-policy=USE-ARGUMENT-TYPE
        RestoreBlockDefaults
          arg DstPtr: type=dtRef_VOID, direction=IN, server-argument-impl-policy=USE-ARGUMENT-TYPE
        SetDataIndex
          arg DataIndex: type=uint8, direction=IN, server-argument-impl-policy=USE-ARGUMENT-TYPE
        SetRamBlockStatus
          arg RamBlockStatus: type=boolean, direction=IN, server-argument-impl-policy=USE-ARGUMENT-TYPE
        WriteBlock
          arg SrcPtr: type=dtRef_const_VOID, direction=IN, server-argument-impl-policy=USE-ARGUMENT-TYPE
      error E_NOT_OK: error-code=1
    NvMService_AC3: is-service=true
      5 x operation, all with possible-error=NvMService_AC3/E_NOT_OK:
        EraseBlock
        GetErrorStatus
          arg ErrorStatus: type=NvM_RequestResultType, direction=OUT, server-argument-impl-policy=USE-ARGUMENT-TYPE
        InvalidateNvBlock
        ReadBlock
          arg DstPtr: type=dtRef_VOID, direction=IN, server-argument-impl-policy=USE-ARGUMENT-TYPE
        WriteBlock
          arg SrcPtr: type=dtRef_const_VOID, direction=IN, server-argument-impl-policy=USE-ARGUMENT-TYPE
      error E_NOT_OK: error-code=1
    NvMService_AC3_Defs: is-service=true
      6 x operation, all with possible-error=NvMService_AC3_Defs/E_NOT_OK:
        EraseBlock
        GetErrorStatus
          arg ErrorStatus: type=NvM_RequestResultType, direction=OUT, server-argument-impl-policy=USE-ARGUMENT-TYPE
        InvalidateNvBlock
        ReadBlock
          arg DstPtr: type=dtRef_VOID, direction=IN, server-argument-impl-policy=USE-ARGUMENT-TYPE
        RestoreBlockDefaults
          arg DstPtr: type=dtRef_VOID, direction=IN, server-argument-impl-policy=USE-ARGUMENT-TYPE
        WriteBlock
          arg SrcPtr: type=dtRef_const_VOID, direction=IN, server-argument-impl-policy=USE-ARGUMENT-TYPE
      error E_NOT_OK: error-code=1
    NvMService_AC3_DS: is-service=true
      7 x operation, all with possible-error=NvMService_AC3_DS/E_NOT_OK:
        EraseBlock
        GetDataIndex
          arg DataIndex: type=uint8, direction=OUT, server-argument-impl-policy=USE-ARGUMENT-TYPE
        GetErrorStatus
          arg ErrorStatus: type=NvM_RequestResultType, direction=OUT, server-argument-impl-policy=USE-ARGUMENT-TYPE
        InvalidateNvBlock
        ReadBlock
          arg DstPtr: type=dtRef_VOID, direction=IN, server-argument-impl-policy=USE-ARGUMENT-TYPE
        SetDataIndex
          arg DataIndex: type=uint8, direction=IN, server-argument-impl-policy=USE-ARGUMENT-TYPE
        WriteBlock
          arg SrcPtr: type=dtRef_const_VOID, direction=IN, server-argument-impl-policy=USE-ARGUMENT-TYPE
      error E_NOT_OK: error-code=1
    NvMService_AC3_DS_Defs: is-service=true
      8 x operation, all with possible-error=NvMService_AC3_DS_Defs/E_NOT_OK:
        EraseBlock
        GetDataIndex
          arg DataIndex: type=uint8, direction=OUT, server-argument-impl-policy=USE-ARGUMENT-TYPE
        GetErrorStatus
          arg ErrorStatus: type=NvM_RequestResultType, direction=OUT, server-argument-impl-policy=USE-ARGUMENT-TYPE
        InvalidateNvBlock
        ReadBlock
          arg DstPtr: type=dtRef_VOID, direction=IN, server-argument-impl-policy=USE-ARGUMENT-TYPE
        RestoreBlockDefaults
          arg DstPtr: type=dtRef_VOID, direction=IN, server-argument-impl-policy=USE-ARGUMENT-TYPE
        SetDataIndex
          arg DataIndex: type=uint8, direction=IN, server-argument-impl-policy=USE-ARGUMENT-TYPE
        WriteBlock
          arg SrcPtr: type=dtRef_const_VOID, direction=IN, server-argument-impl-policy=USE-ARGUMENT-TYPE
      error E_NOT_OK: error-code=1
    NvMService_AC3_SRBS: is-service=true
      6 x operation, all with possible-error=NvMService_AC3_SRBS/E_NOT_OK:
        EraseBlock
        GetErrorStatus
          arg ErrorStatus: type=NvM_RequestResultType, direction=OUT, server-argument-impl-policy=USE-ARGUMENT-TYPE
        InvalidateNvBlock
        ReadBlock
          arg DstPtr: type=dtRef_VOID, direction=IN, server-argument-impl-policy=USE-ARGUMENT-TYPE
        SetRamBlockStatus
          arg RamBlockStatus: type=boolean, direction=IN, server-argument-impl-policy=USE-ARGUMENT-TYPE
        WriteBlock
          arg SrcPtr: type=dtRef_const_VOID, direction=IN, server-argument-impl-policy=USE-ARGUMENT-TYPE
      error E_NOT_OK: error-code=1
    NvMService_AC3_SRBS_Defs: is-service=true
      7 x operation, all with possible-error=NvMService_AC3_SRBS_Defs/E_NOT_OK:
        EraseBlock
        GetErrorStatus
          arg ErrorStatus: type=NvM_RequestResultType, direction=OUT, server-argument-impl-policy=USE-ARGUMENT-TYPE
        InvalidateNvBlock
        ReadBlock
          arg DstPtr: type=dtRef_VOID, direction=IN, server-argument-impl-policy=USE-ARGUMENT-TYPE
        RestoreBlockDefaults
          arg DstPtr: type=dtRef_VOID, direction=IN, server-argument-impl-policy=USE-ARGUMENT-TYPE
        SetRamBlockStatus
          arg RamBlockStatus: type=boolean, direction=IN, server-argument-impl-policy=USE-ARGUMENT-TYPE
        WriteBlock
          arg SrcPtr: type=dtRef_const_VOID, direction=IN, server-argument-impl-policy=USE-ARGUMENT-TYPE
      error E_NOT_OK: error-code=1
    NvMService_AC3_SRBS_DS: is-service=true
      8 x operation, all with possible-error=NvMService_AC3_SRBS_DS/E_NOT_OK:
        EraseBlock
        GetDataIndex
          arg DataIndex: type=uint8, direction=OUT, server-argument-impl-policy=USE-ARGUMENT-TYPE
        GetErrorStatus
          arg ErrorStatus: type=NvM_RequestResultType, direction=OUT, server-argument-impl-policy=USE-ARGUMENT-TYPE
        InvalidateNvBlock
        ReadBlock
          arg DstPtr: type=dtRef_VOID, direction=IN, server-argument-impl-policy=USE-ARGUMENT-TYPE
        SetDataIndex
          arg DataIndex: type=uint8, direction=IN, server-argument-impl-policy=USE-ARGUMENT-TYPE
        SetRamBlockStatus
          arg RamBlockStatus: type=boolean, direction=IN, server-argument-impl-policy=USE-ARGUMENT-TYPE
        WriteBlock
          arg SrcPtr: type=dtRef_const_VOID, direction=IN, server-argument-impl-policy=USE-ARGUMENT-TYPE
      error E_NOT_OK: error-code=1
    NvMService_AC3_SRBS_DS_Defs: is-service=true
      9 x operation, all with possible-error=NvMService_AC3_SRBS_DS_Defs/E_NOT_OK:
        EraseBlock
        GetDataIndex
          arg DataIndex: type=uint8, direction=OUT, server-argument-impl-policy=USE-ARGUMENT-TYPE
        GetErrorStatus
          arg ErrorStatus: type=NvM_RequestResultType, direction=OUT, server-argument-impl-policy=USE-ARGUMENT-TYPE
        InvalidateNvBlock
        ReadBlock
          arg DstPtr: type=dtRef_VOID, direction=IN, server-argument-impl-policy=USE-ARGUMENT-TYPE
        RestoreBlockDefaults
          arg DstPtr: type=dtRef_VOID, direction=IN, server-argument-impl-policy=USE-ARGUMENT-TYPE
        SetDataIndex
          arg DataIndex: type=uint8, direction=IN, server-argument-impl-policy=USE-ARGUMENT-TYPE
        SetRamBlockStatus
          arg RamBlockStatus: type=boolean, direction=IN, server-argument-impl-policy=USE-ARGUMENT-TYPE
        WriteBlock
          arg SrcPtr: type=dtRef_const_VOID, direction=IN, server-argument-impl-policy=USE-ARGUMENT-TYPE
      error E_NOT_OK: error-code=1
    NvMService_SRBS: is-service=true
      operation GetErrorStatus: possible-error=NvMService_SRBS/E_NOT_OK
        arg ErrorStatus: type=NvM_RequestResultType, direction=OUT, server-argument-impl-policy=USE-ARGUMENT-TYPE
      operation SetRamBlockStatus: possible-error=NvMService_SRBS/E_NOT_OK
        arg RamBlockStatus: type=boolean, direction=IN, server-argument-impl-policy=USE-ARGUMENT-TYPE
      error E_NOT_OK: error-code=1
    NvSWC_NvMService
      operation GetErrorStatus: possible-error=NvSWC_NvMService/E_NOT_OK
        arg ErrorStatus: type=NvM_RequestResultType, direction=OUT, server-argument-impl-policy=USE-ARGUMENT-TYPE
      error E_NOT_OK: error-code=1
    NvSWC_NvMService_AC2
      operation GetErrorStatus: possible-error=NvSWC_NvMService_AC2/E_NOT_OK
        arg ErrorStatus: type=NvM_RequestResultType, direction=OUT, server-argument-impl-policy=USE-ARGUMENT-TYPE
      operation ReadBlock: possible-error=NvSWC_NvMService_AC2/E_NOT_OK
        arg DstPtr: type=dtRef_VOID, direction=IN, server-argument-impl-policy=USE-ARGUMENT-TYPE
      operation WriteBlock: possible-error=NvSWC_NvMService_AC2/E_NOT_OK
        arg SrcPtr: type=dtRef_const_VOID, direction=IN, server-argument-impl-policy=USE-ARGUMENT-TYPE
      error E_NOT_OK: error-code=1
    NvSWC_NvMService_AC2_Defs
      4 x operation, all with possible-error=NvSWC_NvMService_AC2_Defs/E_NOT_OK:
        GetErrorStatus
          arg ErrorStatus: type=NvM_RequestResultType, direction=OUT, server-argument-impl-policy=USE-ARGUMENT-TYPE
        ReadBlock
          arg DstPtr: type=dtRef_VOID, direction=IN, server-argument-impl-policy=USE-ARGUMENT-TYPE
        RestoreBlockDefaults
          arg DstPtr: type=dtRef_VOID, direction=IN, server-argument-impl-policy=USE-ARGUMENT-TYPE
        WriteBlock
          arg SrcPtr: type=dtRef_const_VOID, direction=IN, server-argument-impl-policy=USE-ARGUMENT-TYPE
      error E_NOT_OK: error-code=1
    NvSWC_NvMService_AC2_DS
      5 x operation, all with possible-error=NvSWC_NvMService_AC2_DS/E_NOT_OK:
        GetDataIndex
          arg DataIndex: type=uint8, direction=OUT, server-argument-impl-policy=USE-ARGUMENT-TYPE
        GetErrorStatus
          arg ErrorStatus: type=NvM_RequestResultType, direction=OUT, server-argument-impl-policy=USE-ARGUMENT-TYPE
        ReadBlock
          arg DstPtr: type=dtRef_VOID, direction=IN, server-argument-impl-policy=USE-ARGUMENT-TYPE
        SetDataIndex
          arg DataIndex: type=uint8, direction=IN, server-argument-impl-policy=USE-ARGUMENT-TYPE
        WriteBlock
          arg SrcPtr: type=dtRef_const_VOID, direction=IN, server-argument-impl-policy=USE-ARGUMENT-TYPE
      error E_NOT_OK: error-code=1
    NvSWC_NvMService_AC2_DS_Defs
      6 x operation, all with possible-error=NvSWC_NvMService_AC2_DS_Defs/E_NOT_OK:
        GetDataIndex
          arg DataIndex: type=uint8, direction=OUT, server-argument-impl-policy=USE-ARGUMENT-TYPE
        GetErrorStatus
          arg ErrorStatus: type=NvM_RequestResultType, direction=OUT, server-argument-impl-policy=USE-ARGUMENT-TYPE
        ReadBlock
          arg DstPtr: type=dtRef_VOID, direction=IN, server-argument-impl-policy=USE-ARGUMENT-TYPE
        RestoreBlockDefaults
          arg DstPtr: type=dtRef_VOID, direction=IN, server-argument-impl-policy=USE-ARGUMENT-TYPE
        SetDataIndex
          arg DataIndex: type=uint8, direction=IN, server-argument-impl-policy=USE-ARGUMENT-TYPE
        WriteBlock
          arg SrcPtr: type=dtRef_const_VOID, direction=IN, server-argument-impl-policy=USE-ARGUMENT-TYPE
      error E_NOT_OK: error-code=1
    NvSWC_NvMService_AC2_SRBS
      4 x operation, all with possible-error=NvSWC_NvMService_AC2_SRBS/E_NOT_OK:
        GetErrorStatus
          arg ErrorStatus: type=NvM_RequestResultType, direction=OUT, server-argument-impl-policy=USE-ARGUMENT-TYPE
        ReadBlock
          arg DstPtr: type=dtRef_VOID, direction=IN, server-argument-impl-policy=USE-ARGUMENT-TYPE
        SetRamBlockStatus
          arg RamBlockStatus: type=boolean, direction=IN, server-argument-impl-policy=USE-ARGUMENT-TYPE
        WriteBlock
          arg SrcPtr: type=dtRef_const_VOID, direction=IN, server-argument-impl-policy=USE-ARGUMENT-TYPE
      error E_NOT_OK: error-code=1
    NvSWC_NvMService_AC2_SRBS_Defs
      5 x operation, all with possible-error=NvSWC_NvMService_AC2_SRBS_Defs/E_NOT_OK:
        GetErrorStatus
          arg ErrorStatus: type=NvM_RequestResultType, direction=OUT, server-argument-impl-policy=USE-ARGUMENT-TYPE
        ReadBlock
          arg DstPtr: type=dtRef_VOID, direction=IN, server-argument-impl-policy=USE-ARGUMENT-TYPE
        RestoreBlockDefaults
          arg DstPtr: type=dtRef_VOID, direction=IN, server-argument-impl-policy=USE-ARGUMENT-TYPE
        SetRamBlockStatus
          arg RamBlockStatus: type=boolean, direction=IN, server-argument-impl-policy=USE-ARGUMENT-TYPE
        WriteBlock
          arg SrcPtr: type=dtRef_const_VOID, direction=IN, server-argument-impl-policy=USE-ARGUMENT-TYPE
      error E_NOT_OK: error-code=1
    NvSWC_NvMService_AC2_SRBS_DS
      6 x operation, all with possible-error=NvSWC_NvMService_AC2_SRBS_DS/E_NOT_OK:
        GetDataIndex
          arg DataIndex: type=uint8, direction=OUT, server-argument-impl-policy=USE-ARGUMENT-TYPE
        GetErrorStatus
          arg ErrorStatus: type=NvM_RequestResultType, direction=OUT, server-argument-impl-policy=USE-ARGUMENT-TYPE
        ReadBlock
          arg DstPtr: type=dtRef_VOID, direction=IN, server-argument-impl-policy=USE-ARGUMENT-TYPE
        SetDataIndex
          arg DataIndex: type=uint8, direction=IN, server-argument-impl-policy=USE-ARGUMENT-TYPE
        SetRamBlockStatus
          arg RamBlockStatus: type=boolean, direction=IN, server-argument-impl-policy=USE-ARGUMENT-TYPE
        WriteBlock
          arg SrcPtr: type=dtRef_const_VOID, direction=IN, server-argument-impl-policy=USE-ARGUMENT-TYPE
      error E_NOT_OK: error-code=1
    NvSWC_NvMService_AC2_SRBS_DS_Defs
      7 x operation, all with possible-error=NvSWC_NvMService_AC2_SRBS_DS_Defs/E_NOT_OK:
        GetDataIndex
          arg DataIndex: type=uint8, direction=OUT, server-argument-impl-policy=USE-ARGUMENT-TYPE
        GetErrorStatus
          arg ErrorStatus: type=NvM_RequestResultType, direction=OUT, server-argument-impl-policy=USE-ARGUMENT-TYPE
        ReadBlock
          arg DstPtr: type=dtRef_VOID, direction=IN, server-argument-impl-policy=USE-ARGUMENT-TYPE
        RestoreBlockDefaults
          arg DstPtr: type=dtRef_VOID, direction=IN, server-argument-impl-policy=USE-ARGUMENT-TYPE
        SetDataIndex
          arg DataIndex: type=uint8, direction=IN, server-argument-impl-policy=USE-ARGUMENT-TYPE
        SetRamBlockStatus
          arg RamBlockStatus: type=boolean, direction=IN, server-argument-impl-policy=USE-ARGUMENT-TYPE
        WriteBlock
          arg SrcPtr: type=dtRef_const_VOID, direction=IN, server-argument-impl-policy=USE-ARGUMENT-TYPE
      error E_NOT_OK: error-code=1
    NvSWC_NvMService_AC3
      5 x operation, all with possible-error=NvSWC_NvMService_AC3/E_NOT_OK:
        EraseBlock
        GetErrorStatus
          arg ErrorStatus: type=NvM_RequestResultType, direction=OUT, server-argument-impl-policy=USE-ARGUMENT-TYPE
        InvalidateNvBlock
        ReadBlock
          arg DstPtr: type=dtRef_VOID, direction=IN, server-argument-impl-policy=USE-ARGUMENT-TYPE
        WriteBlock
          arg SrcPtr: type=dtRef_const_VOID, direction=IN, server-argument-impl-policy=USE-ARGUMENT-TYPE
      error E_NOT_OK: error-code=1
    NvSWC_NvMService_AC3_Defs
      6 x operation, all with possible-error=NvSWC_NvMService_AC3_Defs/E_NOT_OK:
        EraseBlock
        GetErrorStatus
          arg ErrorStatus: type=NvM_RequestResultType, direction=OUT, server-argument-impl-policy=USE-ARGUMENT-TYPE
        InvalidateNvBlock
        ReadBlock
          arg DstPtr: type=dtRef_VOID, direction=IN, server-argument-impl-policy=USE-ARGUMENT-TYPE
        RestoreBlockDefaults
          arg DstPtr: type=dtRef_VOID, direction=IN, server-argument-impl-policy=USE-ARGUMENT-TYPE
        WriteBlock
          arg SrcPtr: type=dtRef_const_VOID, direction=IN, server-argument-impl-policy=USE-ARGUMENT-TYPE
      error E_NOT_OK: error-code=1
    NvSWC_NvMService_AC3_DS
      7 x operation, all with possible-error=NvSWC_NvMService_AC3_DS/E_NOT_OK:
        EraseBlock
        GetDataIndex
          arg DataIndex: type=uint8, direction=OUT, server-argument-impl-policy=USE-ARGUMENT-TYPE
        GetErrorStatus
          arg ErrorStatus: type=NvM_RequestResultType, direction=OUT, server-argument-impl-policy=USE-ARGUMENT-TYPE
        InvalidateNvBlock
        ReadBlock
          arg DstPtr: type=dtRef_VOID, direction=IN, server-argument-impl-policy=USE-ARGUMENT-TYPE
        SetDataIndex
          arg DataIndex: type=uint8, direction=IN, server-argument-impl-policy=USE-ARGUMENT-TYPE
        WriteBlock
          arg SrcPtr: type=dtRef_const_VOID, direction=IN, server-argument-impl-policy=USE-ARGUMENT-TYPE
      error E_NOT_OK: error-code=1
    NvSWC_NvMService_AC3_DS_Defs
      8 x operation, all with possible-error=NvSWC_NvMService_AC3_DS_Defs/E_NOT_OK:
        EraseBlock
        GetDataIndex
          arg DataIndex: type=uint8, direction=OUT, server-argument-impl-policy=USE-ARGUMENT-TYPE
        GetErrorStatus
          arg ErrorStatus: type=NvM_RequestResultType, direction=OUT, server-argument-impl-policy=USE-ARGUMENT-TYPE
        InvalidateNvBlock
        ReadBlock
          arg DstPtr: type=dtRef_VOID, direction=IN, server-argument-impl-policy=USE-ARGUMENT-TYPE
        RestoreBlockDefaults
          arg DstPtr: type=dtRef_VOID, direction=IN, server-argument-impl-policy=USE-ARGUMENT-TYPE
        SetDataIndex
          arg DataIndex: type=uint8, direction=IN, server-argument-impl-policy=USE-ARGUMENT-TYPE
        WriteBlock
          arg SrcPtr: type=dtRef_const_VOID, direction=IN, server-argument-impl-policy=USE-ARGUMENT-TYPE
      error E_NOT_OK: error-code=1
    NvSWC_NvMService_AC3_SRBS
      6 x operation, all with possible-error=NvSWC_NvMService_AC3_SRBS/E_NOT_OK:
        EraseBlock
        GetErrorStatus
          arg ErrorStatus: type=NvM_RequestResultType, direction=OUT, server-argument-impl-policy=USE-ARGUMENT-TYPE
        InvalidateNvBlock
        ReadBlock
          arg DstPtr: type=dtRef_VOID, direction=IN, server-argument-impl-policy=USE-ARGUMENT-TYPE
        SetRamBlockStatus
          arg RamBlockStatus: type=boolean, direction=IN, server-argument-impl-policy=USE-ARGUMENT-TYPE
        WriteBlock
          arg SrcPtr: type=dtRef_const_VOID, direction=IN, server-argument-impl-policy=USE-ARGUMENT-TYPE
      error E_NOT_OK: error-code=1
    NvSWC_NvMService_AC3_SRBS_Defs
      7 x operation, all with possible-error=NvSWC_NvMService_AC3_SRBS_Defs/E_NOT_OK:
        EraseBlock
        GetErrorStatus
          arg ErrorStatus: type=NvM_RequestResultType, direction=OUT, server-argument-impl-policy=USE-ARGUMENT-TYPE
        InvalidateNvBlock
        ReadBlock
          arg DstPtr: type=dtRef_VOID, direction=IN, server-argument-impl-policy=USE-ARGUMENT-TYPE
        RestoreBlockDefaults
          arg DstPtr: type=dtRef_VOID, direction=IN, server-argument-impl-policy=USE-ARGUMENT-TYPE
        SetRamBlockStatus
          arg RamBlockStatus: type=boolean, direction=IN, server-argument-impl-policy=USE-ARGUMENT-TYPE
        WriteBlock
          arg SrcPtr: type=dtRef_const_VOID, direction=IN, server-argument-impl-policy=USE-ARGUMENT-TYPE
      error E_NOT_OK: error-code=1
    NvSWC_NvMService_AC3_SRBS_DS
      8 x operation, all with possible-error=NvSWC_NvMService_AC3_SRBS_DS/E_NOT_OK:
        EraseBlock
        GetDataIndex
          arg DataIndex: type=uint8, direction=OUT, server-argument-impl-policy=USE-ARGUMENT-TYPE
        GetErrorStatus
          arg ErrorStatus: type=NvM_RequestResultType, direction=OUT, server-argument-impl-policy=USE-ARGUMENT-TYPE
        InvalidateNvBlock
        ReadBlock
          arg DstPtr: type=dtRef_VOID, direction=IN, server-argument-impl-policy=USE-ARGUMENT-TYPE
        SetDataIndex
          arg DataIndex: type=uint8, direction=IN, server-argument-impl-policy=USE-ARGUMENT-TYPE
        SetRamBlockStatus
          arg RamBlockStatus: type=boolean, direction=IN, server-argument-impl-policy=USE-ARGUMENT-TYPE
        WriteBlock
          arg SrcPtr: type=dtRef_const_VOID, direction=IN, server-argument-impl-policy=USE-ARGUMENT-TYPE
      error E_NOT_OK: error-code=1
    NvSWC_NvMService_AC3_SRBS_DS_Defs
      9 x operation, all with possible-error=NvSWC_NvMService_AC3_SRBS_DS_Defs/E_NOT_OK:
        EraseBlock
        GetDataIndex
          arg DataIndex: type=uint8, direction=OUT, server-argument-impl-policy=USE-ARGUMENT-TYPE
        GetErrorStatus
          arg ErrorStatus: type=NvM_RequestResultType, direction=OUT, server-argument-impl-policy=USE-ARGUMENT-TYPE
        InvalidateNvBlock
        ReadBlock
          arg DstPtr: type=dtRef_VOID, direction=IN, server-argument-impl-policy=USE-ARGUMENT-TYPE
        RestoreBlockDefaults
          arg DstPtr: type=dtRef_VOID, direction=IN, server-argument-impl-policy=USE-ARGUMENT-TYPE
        SetDataIndex
          arg DataIndex: type=uint8, direction=IN, server-argument-impl-policy=USE-ARGUMENT-TYPE
        SetRamBlockStatus
          arg RamBlockStatus: type=boolean, direction=IN, server-argument-impl-policy=USE-ARGUMENT-TYPE
        WriteBlock
          arg SrcPtr: type=dtRef_const_VOID, direction=IN, server-argument-impl-policy=USE-ARGUMENT-TYPE
      error E_NOT_OK: error-code=1
    NvSWC_NvMService_SRBS
      operation GetErrorStatus: possible-error=NvSWC_NvMService_SRBS/E_NOT_OK
        arg ErrorStatus: type=NvM_RequestResultType, direction=OUT, server-argument-impl-policy=USE-ARGUMENT-TYPE
      operation SetRamBlockStatus: possible-error=NvSWC_NvMService_SRBS/E_NOT_OK
        arg RamBlockStatus: type=boolean, direction=IN, server-argument-impl-policy=USE-ARGUMENT-TYPE
      error E_NOT_OK: error-code=1
    NvMNotifyJobFinished: is-service=true
      operation JobFinished
        arg ServiceId: type=NvM_ServiceIdType, direction=IN, server-argument-impl-policy=USE-ARGUMENT-TYPE
        arg JobResult: type=NvM_RequestResultType, direction=IN, server-argument-impl-policy=USE-ARGUMENT-TYPE
    NvSWC_NvMNotifyJobFinished
      operation JobFinished
        arg ServiceId: type=NvM_ServiceIdType, direction=IN, server-argument-impl-policy=USE-ARGUMENT-TYPE
        arg JobResult: type=NvM_RequestResultType, direction=IN, server-argument-impl-policy=USE-ARGUMENT-TYPE
    CallbackDTCStatusChange: is-service=true, service-kind=DIAGNOSTIC-EVENT-MANAGER
      operation DTCStatusChanged: possible-error=CallbackDTCStatusChange/E_NOT_OK
        arg DTC: type=uint32, direction=IN, server-argument-impl-policy=USE-ARGUMENT-TYPE
        arg DTCStatusOld: type=Dem_UdsStatusByteType, direction=IN, server-argument-impl-policy=USE-ARGUMENT-TYPE
        arg DTCStatusNew: type=Dem_UdsStatusByteType, direction=IN, server-argument-impl-policy=USE-ARGUMENT-TYPE
      error E_NOT_OK: error-code=1
package /ARRoot/If
  62 x nv data interface:
    SampleElement1
      nv-datas:
        data Value: type=Arr_u8_8
    SampleElement2
      nv-datas:
        data Value: type=Arr_u8_16
    BsConst_Audio_Element
      nv-datas:
        data Value: type=Arr_u8_128
    BsConst_Communication_Element
      nv-datas:
        data Value: type=Arr_u8_64
    BsConst_EngOffTimer_Element
      nv-datas:
        data Value: type=Arr_u8_32
    BsConst_FuelGauge_Element
      nv-datas:
        data Value: type=Arr_u8_128
    BsConst_Illumination_Element
      nv-datas:
        data Value: type=Arr_u8_128
    BsConst_OilGauge_Element
      nv-datas:
        data Value: type=Arr_u8_64
    BsConst_PowerGauge_Element
      nv-datas:
        data Value: type=Arr_u8_64
    BsConst_Power_Element
      nv-datas:
        data Value: type=Arr_u8_32
    BsConst_RealTimeClock_Element
      nv-datas:
        data Value: type=Arr_u8_48
    BsConst_ServiceReminder_Element
      nv-datas:
        data Value: type=Arr_u8_48
    BsConst_SpeedoGauge_Element
      nv-datas:
        data Value: type=Arr_u8_64
    BsConst_TachoGauge_Element
      nv-datas:
        data Value: type=Arr_u8_64
    BsConst_TempGauge_Element
      nv-datas:
        data Value: type=Arr_u8_64
    BsConst_TripComputer_Element
      nv-datas:
        data Value: type=Arr_u8_64
    BsConst_Warning_Element
      nv-datas:
        data Value: type=Arr_u8_64
    BsCys_Certicificate_Element
      nv-datas:
        data Value: type=Arr_u8_64
    BsDiag_Dtc_Element
      nv-datas:
        data Value: type=Arr_u8_2048
    BsDiag_ErrorRecord_Element
      nv-datas:
        data Value: type=Arr_u8_1024
    BsFuSa_Audio_Element
      nv-datas:
        data Value: type=Arr_u8_32
    BsFuSa_Communication_Element
      nv-datas:
        data Value: type=Arr_u8_16
    BsFuSa_Config_Element
      nv-datas:
        data Value: type=Arr_u8_16
    BsFuSa_Display_Element
      nv-datas:
        data Value: type=Arr_u8_64
    BsFuSa_Power_Element
      nv-datas:
        data Value: type=Arr_u8_48
    BsFuSa_Warning_Element
      nv-datas:
        data Value: type=Arr_u8_32
    BsFusa_Fota_Element
      nv-datas:
        data Value: type=Arr_u8_32
    BsReten_Audio_Element
      nv-datas:
        data Value: type=Arr_u8_100
    BsReten_Communication_Element
      nv-datas:
        data Value: type=Arr_u8_100
    BsReten_Display_Element
      nv-datas:
        data Value: type=Arr_u8_100
    BsReten_Gauges_Element
      nv-datas:
        data Value: type=Arr_u8_100
    BsReten_Illumination_Element
      nv-datas:
        data Value: type=Arr_u8_100
    BsReten_Odometer_Element
      nv-datas:
        data Value: type=Arr_u8_100
    BsReten_Personalization_Element
      nv-datas:
        data Value: type=Arr_u8_100
    BsReten_Power_Element
      nv-datas:
        data Value: type=Arr_u8_100
    BsReten_RealTimeClock_Element
      nv-datas:
        data Value: type=Arr_u8_100
    BsReten_Tripcomputer_Element
      nv-datas:
        data Value: type=Arr_u8_100
    BsReten_VisDlt_Element
      nv-datas:
        data Value: type=Arr_u8_256
    BsReten_Warning_Element
      nv-datas:
        data Value: type=Arr_u8_100
    BsRt_CusDlt_Element
      nv-datas:
        data Value: type=Arr_u8_128
    BsRt_FuelGauge_Element
      nv-datas:
        data Value: type=Arr_u8_32
    BsRt_Illumination_Element
      nv-datas:
        data Value: type=Arr_u8_100
    BsRt_Odometer_Element
      nv-datas:
        data Value: type=Arr_u8_128
    BsRt_OilGauge_Element
      nv-datas:
        data Value: type=Arr_u8_8
    BsRt_Personalization_Element
      nv-datas:
        data Value: type=Arr_u8_128
    BsRt_PowerGauge_Element
      nv-datas:
        data Value: type=Arr_u8_32
    BsRt_RealTimeClock_Element
      nv-datas:
        data Value: type=Arr_u8_48
    BsRt_SpeedoGauge_Element
      nv-datas:
        data Value: type=Arr_u8_8
    BsRt_TachoGauge_Element
      nv-datas:
        data Value: type=Arr_u8_16
    BsRt_TempGauge_Element
      nv-datas:
        data Value: type=Arr_u8_32
    BsRt_TripComputer_Element
      nv-datas:
        data Value: type=Arr_u8_64
    BsRt_Warning_Element
      nv-datas:
        data Value: type=Arr_u8_32
    BsShare_EcuPartNumber_Element
      nv-datas:
        data Value: type=Arr_u8_128
    BsShare_SwUpdFotaFinPrint_Element
      nv-datas:
        data Value: type=Arr_u8_32
    BsShare_SwUpdFotaMode_Element
      nv-datas:
        data Value: type=Arr_u8_16
    BsShare_SwUpdFotaStatus_Element
      nv-datas:
        data Value: type=Arr_u8_48
    BsShare_SwUpdFotadecrypt_Element
      nv-datas:
        data Value: type=Arr_u8_64
    BsShare_SwUpdReflash_Element
      nv-datas:
        data Value: type=Arr_u8_8
    BsShare_VehicleConfig_Element
      nv-datas:
        data Value: type=Arr_u8_256
    BsShare_VisMeet_Element
      nv-datas:
        data Value: type=Arr_u8_48
    RefCys_Certicificate1_Element
      nv-datas:
        data Value: type=Arr_u8_64
    RefCys_Certicificate_Element
      nv-datas:
        data Value: type=Arr_u8_64
package /AUTOSAR_SfdA/SfdA/ModeDeclarationGroups
  mode declaration group MDG_SfdAModes: category=ALPHABETIC_ORDER, initial-mode=UNINIT
    mode UNINIT
    mode INIT
  mode declaration group MDG_SfdARoles: category=EXPLICIT_ORDER, initial-mode=SFDC_NO_ROLE, on-transition-value=255
    7 x mode:
      SFDC_NO_ROLE: value=0
      SFD_ROLE_EPTI: value=1
      SFD_ROLE_BASIC: value=2
      SFD_ROLE_EXTENDED: value=3
      SFD_ROLE_SUPERUSER: value=4
      SFD_ROLE_PRODUCTION: value=5
      SFD_ROLE_OTA: value=6
package /AUTOSAR_SfdA/SfdA/PortInterfaces
  mode switch interface SfdA_CurMode: is-service=true
    mode group MG_SfdAMode: type=MDG_SfdAModes
  mode switch interface SfdA_CurRole: is-service=true
    mode group MG_SfdARole: type=MDG_SfdARoles
  sender receiver interface SfdA_RequestRole: is-service=true
    data Role: type=SfdA_RequestRoleType
package /PortInterfaces
  client server interface EcuM_StateRequest: is-service=true
    4 x operation, all with possible-error=EcuM_StateRequest/E_NOT_OK:
      ReleasePOSTRUN
        arg user: type=EcuM_UserType, direction=IN, server-argument-impl-policy=USE-ARGUMENT-TYPE
      ReleaseRUN
        arg user: type=EcuM_UserType, direction=IN, server-argument-impl-policy=USE-ARGUMENT-TYPE
      RequestPOSTRUN
        arg user: type=EcuM_UserType, direction=IN, server-argument-impl-policy=USE-ARGUMENT-TYPE
      RequestRUN
        arg user: type=EcuM_UserType, direction=IN, server-argument-impl-policy=USE-ARGUMENT-TYPE
    error E_NOT_OK: error-code=1
  client server interface if_ICTRL_Diag_GetVersionInfo
    operation getversionInfo
      arg arg: type=Std_VersionInfoType, direction=INOUT, server-argument-impl-policy=USE-ARGUMENT-TYPE
  sender receiver interface RequestPOSTRUN
    data Request: type=Ivd_RequestPostRun
package /ZARXML_PORT_IF
  13 x sender receiver interface:
    HealthDumpGetHdr
      data HealthDumpGetHdrData: type=SHealthDumpGetHdr
    HealthDumpGetData
      data HealthDumpGetDataData: type=SHealthDumpGetData
    PowerSystemStateReqChange
      data PowerSystemStateReqChangeData: type=SPowerSystemStateReqChange
    IgnState
      data IgnStateData: type=SIgnState
    EnetRegReq
      data EnetRegReqData: type=SEnetRegReq
    HealthDomainHeartbeat
      data HealthDomainHeartbeatData: type=SHealthDomainHeartbeat
    HealthDomainFatalError
      data HealthDomainFatalErrorData: type=SHealthDomainFatalError
    HealthDumpHdrInfo
      data HealthDumpHdrInfoData: type=SHealthDumpHdrInfo
    PowerSystemState
      data PowerSystemStateData: type=SPowerSystemState
    PowerExtendShutdownTime
      data PowerExtendShutdownTimeData: type=SPowerExtendShutdownTime
    HealthEventRecord
      data HealthEventRecordData: type=SHealthEventRecord
    EnetRegResp
      data EnetRegRespData: type=SEnetRegResp
    DisplayCurrentState
      data DisplayCurrentStateData: type=SDisplayCurrentState
  client server interface UclInitShutdown
    operation Initialize: possible-error=UclInitShutdown/E_OK
    operation Shutdown: possible-error=UclInitShutdown/E_OK
    error E_OK: error-code=0
  client server interface UclCmplibCmd
    operation OnCommand: possible-error=UclCmplibCmd/E_OK
      arg Cmd: type=uint8, direction=IN, server-argument-impl-policy=USE-ARGUMENT-TYPE
    error E_OK: error-code=0
  client server interface UclSystemCallbacks
    operation ErrorNotification
      arg DLInst: type=uint8, direction=IN, server-argument-impl-policy=USE-ARGUMENT-TYPE
      arg ErrorCode: type=sint32, direction=IN, server-argument-impl-policy=USE-ARGUMENT-TYPE
    operation LinkStatusChanged
      arg DLInst: type=uint8, direction=IN, server-argument-impl-policy=USE-ARGUMENT-TYPE
      arg Status: type=sint32, direction=IN, server-argument-impl-policy=USE-ARGUMENT-TYPE
  sender receiver interface UclTxStatuses
package /AUTOSAR_EcuM/ModeDeclarationGroups
  mode declaration group EcuM_Mode: category=ALPHABETIC_ORDER, initial-mode=EcuM_Mode/STARTUP
    6 x mode:
      POST_RUN
      RUN
      SHUTDOWN
      SLEEP
      STARTUP
      WAKE_SLEEP
package /AUTOSAR_EcuM/PortInterfaces
  mode switch interface EcuM_CurrentMode: is-service=true
    mode group currentMode: type=ModeDeclarationGroups/EcuM_Mode
