AUTOSAR XML (schema 00044)
package /E40_Platform_System_SystemPackage/Components
  90 x constant specification:
    CSleepManagerSleepManager_SleepStatusValue0: value-spec=CSleepManagerSleepManager_SleepStatusValue0:0
    EcuAppMSleepManager_SleepStatusValue0: value-spec=EcuAppMSleepManager_SleepStatusValue0:0
    MemAbstractMdlJobStatus_NVM_DG_13_Airbag_Fdbk_IC_sts_BOOLValue0: value-spec=MemAbstractMdlJobStatus_NVM_DG_13_Airbag_Fdbk_IC_sts_BOOLValue0:0
    MemAbstractMdlJobStatus_NVM_DG_16_vehicle_type_U8Value0: value-spec=MemAbstractMdlJobStatus_NVM_DG_16_vehicle_type_U8Value0:0
    MemAbstractMdlJobStatus_NVM_Diag_config_var_16_padding_U8AValue0: value-spec=MemAbstractMdlJobStatus_NVM_Diag_config_var_16_padding_U8AValue0:0
    MemAbstractMdlJobStatus_NVM_Diag_config_var_5_padding_U8AValue0: value-spec=MemAbstractMdlJobStatus_NVM_Diag_config_var_5_padding_U8AValue0:0
    NvMExtWakeupFlagValue0: value-spec=NvMExtWakeupFlagValue0:false
    MemAbstractMdlJobStatus_SampleElement1Value0: value-spec=MemAbstractMdlJobStatus_SampleElement1Value0:0
    MemAbstractMdlJobStatus_SampleElement2Value0: value-spec=MemAbstractMdlJobStatus_SampleElement2Value0:0
    MemAbstractMdlJobStatus_BsConst_Audio_ElementValue0: value-spec=MemAbstractMdlJobStatus_BsConst_Audio_ElementValue0:0
    MemAbstractMdlJobStatus_BsConst_Communication_ElementValue0: value-spec=MemAbstractMdlJobStatus_BsConst_Communication_ElementValue0:0
    MemAbstractMdlJobStatus_BsConst_EngOffTimer_ElementValue0: value-spec=MemAbstractMdlJobStatus_BsConst_EngOffTimer_ElementValue0:0
    MemAbstractMdlJobStatus_BsConst_FuelGauge_ElementValue0: value-spec=MemAbstractMdlJobStatus_BsConst_FuelGauge_ElementValue0:0
    MemAbstractMdlJobStatus_BsConst_Illumination_ElementValue0: value-spec=MemAbstractMdlJobStatus_BsConst_Illumination_ElementValue0:0
    MemAbstractMdlJobStatus_BsConst_OilGauge_ElementValue0: value-spec=MemAbstractMdlJobStatus_BsConst_OilGauge_ElementValue0:0
    MemAbstractMdlJobStatus_BsConst_PowerGauge_ElementValue0: value-spec=MemAbstractMdlJobStatus_BsConst_PowerGauge_ElementValue0:0
    MemAbstractMdlJobStatus_BsConst_Power_ElementValue0: value-spec=MemAbstractMdlJobStatus_BsConst_Power_ElementValue0:0
    MemAbstractMdlJobStatus_BsConst_RealTimeClock_ElementValue0: value-spec=MemAbstractMdlJobStatus_BsConst_RealTimeClock_ElementValue0:0
    MemAbstractMdlJobStatus_BsConst_ServiceReminder_ElementValue0: value-spec=MemAbstractMdlJobStatus_BsConst_ServiceReminder_ElementValue0:0
    MemAbstractMdlJobStatus_BsConst_SpeedoGauge_ElementValue0: value-spec=MemAbstractMdlJobStatus_BsConst_SpeedoGauge_ElementValue0:0
    MemAbstractMdlJobStatus_BsConst_TachoGauge_ElementValue0: value-spec=MemAbstractMdlJobStatus_BsConst_TachoGauge_ElementValue0:0
    MemAbstractMdlJobStatus_BsConst_TempGauge_ElementValue0: value-spec=MemAbstractMdlJobStatus_BsConst_TempGauge_ElementValue0:0
    MemAbstractMdlJobStatus_BsConst_TripComputer_ElementValue0: value-spec=MemAbstractMdlJobStatus_BsConst_TripComputer_ElementValue0:0
    MemAbstractMdlJobStatus_BsConst_Warning_ElementValue0: value-spec=MemAbstractMdlJobStatus_BsConst_Warning_ElementValue0:0
    MemAbstractMdlJobStatus_BsCys_Certicificate_ElementValue0: value-spec=MemAbstractMdlJobStatus_BsCys_Certicificate_ElementValue0:0
    MemAbstractMdlJobStatus_BsDiag_Dtc_ElementValue0: value-spec=MemAbstractMdlJobStatus_BsDiag_Dtc_ElementValue0:0
    MemAbstractMdlJobStatus_BsDiag_ErrorRecord_ElementValue0: value-spec=MemAbstractMdlJobStatus_BsDiag_ErrorRecord_ElementValue0:0
    MemAbstractMdlJobStatus_BsFuSa_Audio_ElementValue0: value-spec=MemAbstractMdlJobStatus_BsFuSa_Audio_ElementValue0:0
    MemAbstractMdlJobStatus_BsFuSa_Communication_ElementValue0: value-spec=MemAbstractMdlJobStatus_BsFuSa_Communication_ElementValue0:0
    MemAbstractMdlJobStatus_BsFuSa_Config_ElementValue0: value-spec=MemAbstractMdlJobStatus_BsFuSa_Config_ElementValue0:0
    MemAbstractMdlJobStatus_BsFuSa_Display_ElementValue0: value-spec=MemAbstractMdlJobStatus_BsFuSa_Display_ElementValue0:0
    MemAbstractMdlJobStatus_BsFuSa_Power_ElementValue0: value-spec=MemAbstractMdlJobStatus_BsFuSa_Power_ElementValue0:0
    MemAbstractMdlJobStatus_BsFuSa_Warning_ElementValue0: value-spec=MemAbstractMdlJobStatus_BsFuSa_Warning_ElementValue0:0
    MemAbstractMdlJobStatus_BsFusa_Fota_ElementValue0: value-spec=MemAbstractMdlJobStatus_BsFusa_Fota_ElementValue0:0
    MemAbstractMdlJobStatus_BsReten_Audio_ElementValue0: value-spec=MemAbstractMdlJobStatus_BsReten_Audio_ElementValue0:0
    MemAbstractMdlJobStatus_BsReten_Communication_ElementValue0: value-spec=MemAbstractMdlJobStatus_BsReten_Communication_ElementValue0:0
    MemAbstractMdlJobStatus_BsReten_Display_ElementValue0: value-spec=MemAbstractMdlJobStatus_BsReten_Display_ElementValue0:0
    MemAbstractMdlJobStatus_BsReten_Gauges_ElementValue0: value-spec=MemAbstractMdlJobStatus_BsReten_Gauges_ElementValue0:0
    MemAbstractMdlJobStatus_BsReten_Illumination_ElementValue0: value-spec=MemAbstractMdlJobStatus_BsReten_Illumination_ElementValue0:0
    MemAbstractMdlJobStatus_BsReten_Odometer_ElementValue0: value-spec=MemAbstractMdlJobStatus_BsReten_Odometer_ElementValue0:0
    MemAbstractMdlJobStatus_BsReten_Personalization_ElementValue0: value-spec=MemAbstractMdlJobStatus_BsReten_Personalization_ElementValue0:0
    MemAbstractMdlJobStatus_BsReten_Power_ElementValue0: value-spec=MemAbstractMdlJobStatus_BsReten_Power_ElementValue0:0
    MemAbstractMdlJobStatus_BsReten_RealTimeClock_ElementValue0: value-spec=MemAbstractMdlJobStatus_BsReten_RealTimeClock_ElementValue0:0
    MemAbstractMdlJobStatus_BsReten_Tripcomputer_ElementValue0: value-spec=MemAbstractMdlJobStatus_BsReten_Tripcomputer_ElementValue0:0
    MemAbstractMdlJobStatus_BsReten_VisDlt_ElementValue0: value-spec=MemAbstractMdlJobStatus_BsReten_VisDlt_ElementValue0:0
    MemAbstractMdlJobStatus_BsReten_Warning_ElementValue0: value-spec=MemAbstractMdlJobStatus_BsReten_Warning_ElementValue0:0
    MemAbstractMdlJobStatus_BsRt_CusDlt_ElementValue0: value-spec=MemAbstractMdlJobStatus_BsRt_CusDlt_ElementValue0:0
    MemAbstractMdlJobStatus_BsRt_FuelGauge_ElementValue0: value-spec=MemAbstractMdlJobStatus_BsRt_FuelGauge_ElementValue0:0
    MemAbstractMdlJobStatus_BsRt_Illumination_ElementValue0: value-spec=MemAbstractMdlJobStatus_BsRt_Illumination_ElementValue0:0
    MemAbstractMdlJobStatus_BsRt_Odometer_ElementValue0: value-spec=MemAbstractMdlJobStatus_BsRt_Odometer_ElementValue0:0
    MemAbstractMdlJobStatus_BsRt_OilGauge_ElementValue0: value-spec=MemAbstractMdlJobStatus_BsRt_OilGauge_ElementValue0:0
    MemAbstractMdlJobStatus_BsRt_Personalization_ElementValue0: value-spec=MemAbstractMdlJobStatus_BsRt_Personalization_ElementValue0:0
    MemAbstractMdlJobStatus_BsRt_PowerGauge_ElementValue0: value-spec=MemAbstractMdlJobStatus_BsRt_PowerGauge_ElementValue0:0
    MemAbstractMdlJobStatus_BsRt_RealTimeClock_ElementValue0: value-spec=MemAbstractMdlJobStatus_BsRt_RealTimeClock_ElementValue0:0
    MemAbstractMdlJobStatus_BsRt_SpeedoGauge_ElementValue0: value-spec=MemAbstractMdlJobStatus_BsRt_SpeedoGauge_ElementValue0:0
    MemAbstractMdlJobStatus_BsRt_TachoGauge_ElementValue0: value-spec=MemAbstractMdlJobStatus_BsRt_TachoGauge_ElementValue0:0
    MemAbstractMdlJobStatus_BsRt_TempGauge_ElementValue0: value-spec=MemAbstractMdlJobStatus_BsRt_TempGauge_ElementValue0:0
    MemAbstractMdlJobStatus_BsRt_TripComputer_ElementValue0: value-spec=MemAbstractMdlJobStatus_BsRt_TripComputer_ElementValue0:0
    MemAbstractMdlJobStatus_BsRt_Warning_ElementValue0: value-spec=MemAbstractMdlJobStatus_BsRt_Warning_ElementValue0:0
    MemAbstractMdlJobStatus_BsShare_EcuPartNumber_ElementValue0: value-spec=MemAbstractMdlJobStatus_BsShare_EcuPartNumber_ElementValue0:0
    MemAbstractMdlJobStatus_BsShare_SwUpdFotaFinPrint_ElementValue0: value-spec=MemAbstractMdlJobStatus_BsShare_SwUpdFotaFinPrint_ElementValue0:0
    MemAbstractMdlJobStatus_BsShare_SwUpdFotaMode_ElementValue0: value-spec=MemAbstractMdlJobStatus_BsShare_SwUpdFotaMode_ElementValue0:0
    MemAbstractMdlJobStatus_BsShare_SwUpdFotaStatus_ElementValue0: value-spec=MemAbstractMdlJobStatus_BsShare_SwUpdFotaStatus_ElementValue0:0
    MemAbstractMdlJobStatus_BsShare_SwUpdFotadecrypt_ElementValue0: value-spec=MemAbstractMdlJobStatus_BsShare_SwUpdFotadecrypt_ElementValue0:0
    MemAbstractMdlJobStatus_BsShare_SwUpdReflash_ElementValue0: value-spec=MemAbstractMdlJobStatus_BsShare_SwUpdReflash_ElementValue0:0
    MemAbstractMdlJobStatus_BsShare_VehicleConfig_ElementValue0: value-spec=MemAbstractMdlJobStatus_BsShare_VehicleConfig_ElementValue0:0
    MemAbstractMdlJobStatus_BsShare_VisMeet_ElementValue0: value-spec=MemAbstractMdlJobStatus_BsShare_VisMeet_ElementValue0:0
    MemAbstractMdlJobStatus_RefCys_Certicificate1_ElementValue0: value-spec=MemAbstractMdlJobStatus_RefCys_Certicificate1_ElementValue0:0
    MemAbstractMdlJobStatus_RefCys_Certicificate_ElementValue0: value-spec=MemAbstractMdlJobStatus_RefCys_Certicificate_ElementValue0:0
    DmnMgrPowerSystemStateReqChangeDataValue0: value-spec={short-label=DmnMgrPowerSystemStateReqChangeDataValue0, fields=[DmnMgrPowerSystemStateReqChangeDataValue_0:0, DmnMgrPowerSystemStateReqChangeDataValue_1:0]}
    DmnMgrSDmnStatusValue0: value-spec={short-label=DmnMgrSDmnStatusValue0, fields=[DmnMgrSDmnStatusValue_0:0, DmnMgrSDmnStatusValue_1:0, DmnMgrSDmnStatusValue_2:0, DmnMgrSDmnStatusValue_3:0, DmnMgrSDmnStatusValue_4:0, DmnMgrSDmnStatusValue_5:0]}
    DmnMgrPowerSystemStateDataValue0: value-spec={short-label=DmnMgrPowerSystemStateDataValue0, fields=[DmnMgrPowerSystemStateDataValue_0:0, DmnMgrPowerSystemStateDataValue_1:0]}
    DmnMgrSleepManager_SleepStatusValue0: value-spec=DmnMgrSleepManager_SleepStatusValue0:0
    UclProxyCddPowerSystemStateDataValue0: value-spec={short-label=UclProxyCddPowerSystemStateDataValue0, fields=[UclProxyCddPowerSystemStateDataValue_0:0, UclProxyCddPowerSystemStateDataValue_1:0]}
    UclProxyCddPowerSystemStateReqChangeDataValue0: value-spec={short-label=UclProxyCddPowerSystemStateReqChangeDataValue0, fields=[UclProxyCddPowerSystemStateReqChangeDataValue_0:0, UclProxyCddPowerSystemStateReqChangeDataValue_1:0]}
    CBattMdlHVP0FlagValue0: value-spec=CBattMdlHVP0FlagValue0:false
    CBattMdlHVSD{0..4}FlagValue0: value-spec=CBattMdlHVSD{0..4}FlagValue0:false
    CBattMdlLVP0FlagValue0: value-spec=CBattMdlLVP0FlagValue0:false
    CBattMdlLVP1FlagValue0: value-spec=CBattMdlLVP1FlagValue0:false
    CBattMdlLVSD{0..4}FlagValue0: value-spec=CBattMdlLVSD{0..4}FlagValue0:false
    CBattMdlSVPFlagValue0: value-spec=CBattMdlSVPFlagValue0:false
    CBattMdlOverVoltageInterruptFlagValue0: value-spec=CBattMdlOverVoltageInterruptFlagValue0:false
