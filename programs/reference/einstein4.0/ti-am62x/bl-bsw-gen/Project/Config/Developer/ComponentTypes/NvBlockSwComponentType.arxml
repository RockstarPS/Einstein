AUTOSAR XML (schema 00044)
package /ComponentTypes
  nv block sw component type NvBlockSwComponentType
    60 x provide/require port:
      BsConst_Audio_Element: nv-provide-com-spec{ram-block-init-value=128 x 0, rom-block-init-value=128 x 0, variable=Value}, nv-require-com-spec{init-value=128 x 0, variable=Value}, provided-required-interface=BsConst_Audio_Element
      BsConst_Communication_Element: nv-provide-com-spec{ram-block-init-value=64 x 0, rom-block-init-value=64 x 0, variable=Value}, nv-require-com-spec{init-value=64 x 0, variable=Value}, provided-required-interface=BsConst_Communication_Element
      BsConst_EngOffTimer_Element: nv-provide-com-spec{ram-block-init-value=32 x 0, rom-block-init-value=32 x 0, variable=Value}, nv-require-com-spec{init-value=32 x 0, variable=Value}, provided-required-interface=BsConst_EngOffTimer_Element
      BsConst_FuelGauge_Element: nv-provide-com-spec{ram-block-init-value=128 x 0, rom-block-init-value=128 x 0, variable=Value}, nv-require-com-spec{init-value=128 x 0, variable=Value}, provided-required-interface=BsConst_FuelGauge_Element
      BsConst_Illumination_Element: nv-provide-com-spec{ram-block-init-value=128 x 0, rom-block-init-value=128 x 0, variable=Value}, nv-require-com-spec{init-value=128 x 0, variable=Value}, provided-required-interface=BsConst_Illumination_Element
      BsConst_OilGauge_Element: nv-provide-com-spec{ram-block-init-value=64 x 0, rom-block-init-value=64 x 0, variable=Value}, nv-require-com-spec{init-value=64 x 0, variable=Value}, provided-required-interface=BsConst_OilGauge_Element
      BsConst_PowerGauge_Element: nv-provide-com-spec{ram-block-init-value=64 x 0, rom-block-init-value=64 x 0, variable=Value}, nv-require-com-spec{init-value=64 x 0, variable=Value}, provided-required-interface=BsConst_PowerGauge_Element
      BsConst_Power_Element: nv-provide-com-spec{ram-block-init-value=32 x 0, rom-block-init-value=32 x 0, variable=Value}, nv-require-com-spec{init-value=32 x 0, variable=Value}, provided-required-interface=BsConst_Power_Element
      BsConst_RealTimeClock_Element: nv-provide-com-spec{ram-block-init-value=48 x 0, rom-block-init-value=48 x 0, variable=Value}, nv-require-com-spec{init-value=48 x 0, variable=Value}, provided-required-interface=BsConst_RealTimeClock_Element
      BsConst_ServiceReminder_Element: nv-provide-com-spec{ram-block-init-value=48 x 0, rom-block-init-value=48 x 0, variable=Value}, nv-require-com-spec{init-value=48 x 0, variable=Value}, provided-required-interface=BsConst_ServiceReminder_Element
      BsConst_SpeedoGauge_Element: nv-provide-com-spec{ram-block-init-value=64 x 0, rom-block-init-value=64 x 0, variable=Value}, nv-require-com-spec{init-value=64 x 0, variable=Value}, provided-required-interface=BsConst_SpeedoGauge_Element
      BsConst_TachoGauge_Element: nv-provide-com-spec{ram-block-init-value=64 x 0, rom-block-init-value=64 x 0, variable=Value}, nv-require-com-spec{init-value=64 x 0, variable=Value}, provided-required-interface=BsConst_TachoGauge_Element
      BsConst_TempGauge_Element: nv-provide-com-spec{ram-block-init-value=64 x 0, rom-block-init-value=64 x 0, variable=Value}, nv-require-com-spec{init-value=64 x 0, variable=Value}, provided-required-interface=BsConst_TempGauge_Element
      BsConst_TripComputer_Element: nv-provide-com-spec{ram-block-init-value=64 x 0, rom-block-init-value=64 x 0, variable=Value}, nv-require-com-spec{init-value=64 x 0, variable=Value}, provided-required-interface=BsConst_TripComputer_Element
      BsConst_Warning_Element: nv-provide-com-spec{ram-block-init-value=64 x 0, rom-block-init-value=64 x 0, variable=Value}, nv-require-com-spec{init-value=64 x 0, variable=Value}, provided-required-interface=BsConst_Warning_Element
      BsCys_Certicificate_Element: nv-provide-com-spec{ram-block-init-value=64 x 0, rom-block-init-value=64 x 0, variable=Value}, nv-require-com-spec{init-value=64 x 0, variable=Value}, provided-required-interface=BsCys_Certicificate_Element
      BsDiag_Dtc_Element: nv-provide-com-spec{ram-block-init-value=2048 x 0, rom-block-init-value=2048 x 0, variable=Value}, nv-require-com-spec{init-value=2048 x 0, variable=Value}, provided-required-interface=BsDiag_Dtc_Element
      BsDiag_ErrorRecord_Element: nv-provide-com-spec{ram-block-init-value=1024 x 0, rom-block-init-value=1024 x 0, variable=Value}, nv-require-com-spec{init-value=1024 x 0, variable=Value}, provided-required-interface=BsDiag_ErrorRecord_Element
      BsFuSa_Audio_Element: nv-provide-com-spec{ram-block-init-value=32 x 0, rom-block-init-value=32 x 0, variable=Value}, nv-require-com-spec{init-value=32 x 0, variable=Value}, provided-required-interface=BsFuSa_Audio_Element
      BsFuSa_Communication_Element: nv-provide-com-spec{ram-block-init-value=16 x 0, rom-block-init-value=16 x 0, variable=Value}, nv-require-com-spec{init-value=16 x 0, variable=Value}, provided-required-interface=BsFuSa_Communication_Element
      BsFuSa_Config_Element: nv-provide-com-spec{ram-block-init-value=16 x 0, rom-block-init-value=16 x 0, variable=Value}, nv-require-com-spec{init-value=16 x 0, variable=Value}, provided-required-interface=BsFuSa_Config_Element
      BsFuSa_Display_Element: nv-provide-com-spec{ram-block-init-value=64 x 0, rom-block-init-value=64 x 0, variable=Value}, nv-require-com-spec{init-value=64 x 0, variable=Value}, provided-required-interface=BsFuSa_Display_Element
      BsFuSa_Power_Element: nv-provide-com-spec{ram-block-init-value=48 x 0, rom-block-init-value=48 x 0, variable=Value}, nv-require-com-spec{init-value=48 x 0, variable=Value}, provided-required-interface=BsFuSa_Power_Element
      BsFuSa_Warning_Element: nv-provide-com-spec{ram-block-init-value=32 x 0, rom-block-init-value=32 x 0, variable=Value}, nv-require-com-spec{init-value=32 x 0, variable=Value}, provided-required-interface=BsFuSa_Warning_Element
      BsFusa_Fota_Element: nv-provide-com-spec{ram-block-init-value=32 x 0, rom-block-init-value=32 x 0, variable=Value}, nv-require-com-spec{init-value=32 x 0, variable=Value}, provided-required-interface=BsFusa_Fota_Element
      BsReten_Audio_Element: nv-provide-com-spec{ram-block-init-value=100 x 0, rom-block-init-value=100 x 0, variable=Value}, nv-require-com-spec{init-value=100 x 0, variable=Value}, provided-required-interface=BsReten_Audio_Element
      BsReten_Communication_Element: nv-provide-com-spec{ram-block-init-value=100 x 0, rom-block-init-value=100 x 0, variable=Value}, nv-require-com-spec{init-value=100 x 0, variable=Value}, provided-required-interface=BsReten_Communication_Element
      BsReten_Display_Element: nv-provide-com-spec{ram-block-init-value=100 x 0, rom-block-init-value=100 x 0, variable=Value}, nv-require-com-spec{init-value=100 x 0, variable=Value}, provided-required-interface=BsReten_Display_Element
      BsReten_Gauges_Element: nv-provide-com-spec{ram-block-init-value=100 x 0, rom-block-init-value=100 x 0, variable=Value}, nv-require-com-spec{init-value=100 x 0, variable=Value}, provided-required-interface=BsReten_Gauges_Element
      BsReten_Illumination_Element: nv-provide-com-spec{ram-block-init-value=100 x 0, rom-block-init-value=100 x 0, variable=Value}, nv-require-com-spec{init-value=100 x 0, variable=Value}, provided-required-interface=BsReten_Illumination_Element
      BsReten_Odometer_Element: nv-provide-com-spec{ram-block-init-value=100 x 0, rom-block-init-value=100 x 0, variable=Value}, nv-require-com-spec{init-value=100 x 0, variable=Value}, provided-required-interface=BsReten_Odometer_Element
      BsReten_Personalization_Element: nv-provide-com-spec{ram-block-init-value=100 x 0, rom-block-init-value=100 x 0, variable=Value}, nv-require-com-spec{init-value=100 x 0, variable=Value}, provided-required-interface=BsReten_Personalization_Element
      BsReten_Power_Element: nv-provide-com-spec{ram-block-init-value=100 x 0, rom-block-init-value=100 x 0, variable=Value}, nv-require-com-spec{init-value=100 x 0, variable=Value}, provided-required-interface=BsReten_Power_Element
      BsReten_RealTimeClock_Element: nv-provide-com-spec{ram-block-init-value=100 x 0, rom-block-init-value=100 x 0, variable=Value}, nv-require-com-spec{init-value=100 x 0, variable=Value}, provided-required-interface=BsReten_RealTimeClock_Element
      BsReten_Tripcomputer_Element: nv-provide-com-spec{ram-block-init-value=100 x 0, rom-block-init-value=100 x 0, variable=Value}, nv-require-com-spec{init-value=100 x 0, variable=Value}, provided-required-interface=BsReten_Tripcomputer_Element
      BsReten_VisDlt_Element: nv-provide-com-spec{ram-block-init-value=256 x 0, rom-block-init-value=256 x 0, variable=Value}, nv-require-com-spec{init-value=256 x 0, variable=Value}, provided-required-interface=BsReten_VisDlt_Element
      BsReten_Warning_Element: nv-provide-com-spec{ram-block-init-value=100 x 0, rom-block-init-value=100 x 0, variable=Value}, nv-require-com-spec{init-value=100 x 0, variable=Value}, provided-required-interface=BsReten_Warning_Element
      BsRt_CusDlt_Element: nv-provide-com-spec{ram-block-init-value=128 x 0, rom-block-init-value=128 x 0, variable=Value}, nv-require-com-spec{init-value=128 x 0, variable=Value}, provided-required-interface=BsRt_CusDlt_Element
      BsRt_FuelGauge_Element: nv-provide-com-spec{ram-block-init-value=32 x 0, rom-block-init-value=32 x 0, variable=Value}, nv-require-com-spec{init-value=32 x 0, variable=Value}, provided-required-interface=BsRt_FuelGauge_Element
      BsRt_Illumination_Element: nv-provide-com-spec{ram-block-init-value=100 x 0, rom-block-init-value=100 x 0, variable=Value}, nv-require-com-spec{init-value=100 x 0, variable=Value}, provided-required-interface=BsRt_Illumination_Element
      BsRt_Odometer_Element: nv-provide-com-spec{ram-block-init-value=128 x 0, rom-block-init-value=128 x 0, variable=Value}, nv-require-com-spec{init-value=128 x 0, variable=Value}, provided-required-interface=BsRt_Odometer_Element
      BsRt_OilGauge_Element: nv-provide-com-spec{ram-block-init-value=8 x 0, rom-block-init-value=8 x 0, variable=Value}, nv-require-com-spec{init-value=8 x 0, variable=Value}, provided-required-interface=BsRt_OilGauge_Element
      BsRt_Personalization_Element: nv-provide-com-spec{ram-block-init-value=128 x 0, rom-block-init-value=128 x 0, variable=Value}, nv-require-com-spec{init-value=128 x 0, variable=Value}, provided-required-interface=BsRt_Personalization_Element
      BsRt_PowerGauge_Element: nv-provide-com-spec{ram-block-init-value=32 x 0, rom-block-init-value=32 x 0, variable=Value}, nv-require-com-spec{init-value=32 x 0, variable=Value}, provided-required-interface=BsRt_PowerGauge_Element
      BsRt_RealTimeClock_Element: nv-provide-com-spec{ram-block-init-value=48 x 0, rom-block-init-value=48 x 0, variable=Value}, nv-require-com-spec{init-value=48 x 0, variable=Value}, provided-required-interface=BsRt_RealTimeClock_Element
      BsRt_SpeedoGauge_Element: nv-provide-com-spec{ram-block-init-value=8 x 0, rom-block-init-value=8 x 0, variable=Value}, nv-require-com-spec{init-value=8 x 0, variable=Value}, provided-required-interface=BsRt_SpeedoGauge_Element
      BsRt_TachoGauge_Element: nv-provide-com-spec{ram-block-init-value=16 x 0, rom-block-init-value=16 x 0, variable=Value}, nv-require-com-spec{init-value=16 x 0, variable=Value}, provided-required-interface=BsRt_TachoGauge_Element
      BsRt_TempGauge_Element: nv-provide-com-spec{ram-block-init-value=32 x 0, rom-block-init-value=32 x 0, variable=Value}, nv-require-com-spec{init-value=32 x 0, variable=Value}, provided-required-interface=BsRt_TempGauge_Element
      BsRt_TripComputer_Element: nv-provide-com-spec{ram-block-init-value=64 x 0, rom-block-init-value=64 x 0, variable=Value}, nv-require-com-spec{init-value=64 x 0, variable=Value}, provided-required-interface=BsRt_TripComputer_Element
      BsRt_Warning_Element: nv-provide-com-spec{ram-block-init-value=32 x 0, rom-block-init-value=32 x 0, variable=Value}, nv-require-com-spec{init-value=32 x 0, variable=Value}, provided-required-interface=BsRt_Warning_Element
      BsShare_EcuPartNumber_Element: nv-provide-com-spec{ram-block-init-value=128 x 0, rom-block-init-value=128 x 0, variable=Value}, nv-require-com-spec{init-value=128 x 0, variable=Value}, provided-required-interface=BsShare_EcuPartNumber_Element
      BsShare_SwUpdFotaFinPrint_Element: nv-provide-com-spec{ram-block-init-value=32 x 0, rom-block-init-value=32 x 0, variable=Value}, nv-require-com-spec{init-value=32 x 0, variable=Value}, provided-required-interface=BsShare_SwUpdFotaFinPrint_Element
      BsShare_SwUpdFotaMode_Element: nv-provide-com-spec{ram-block-init-value=16 x 0, rom-block-init-value=16 x 0, variable=Value}, nv-require-com-spec{init-value=16 x 0, variable=Value}, provided-required-interface=BsShare_SwUpdFotaMode_Element
      BsShare_SwUpdFotaStatus_Element: nv-provide-com-spec{ram-block-init-value=48 x 0, rom-block-init-value=48 x 0, variable=Value}, nv-require-com-spec{init-value=48 x 0, variable=Value}, provided-required-interface=BsShare_SwUpdFotaStatus_Element
      BsShare_SwUpdFotadecrypt_Element: nv-provide-com-spec{ram-block-init-value=64 x 0, rom-block-init-value=64 x 0, variable=Value}, nv-require-com-spec{init-value=64 x 0, variable=Value}, provided-required-interface=BsShare_SwUpdFotadecrypt_Element
      BsShare_SwUpdReflash_Element: nv-provide-com-spec{ram-block-init-value=8 x 0, rom-block-init-value=8 x 0, variable=Value}, nv-require-com-spec{init-value=8 x 0, variable=Value}, provided-required-interface=BsShare_SwUpdReflash_Element
      BsShare_VehicleConfig_Element: nv-provide-com-spec{ram-block-init-value=256 x 0, rom-block-init-value=256 x 0, variable=Value}, nv-require-com-spec{init-value=256 x 0, variable=Value}, provided-required-interface=BsShare_VehicleConfig_Element
      BsShare_VisMeet_Element: nv-provide-com-spec{ram-block-init-value=48 x 0, rom-block-init-value=48 x 0, variable=Value}, nv-require-com-spec{init-value=48 x 0, variable=Value}, provided-required-interface=BsShare_VisMeet_Element
      RefCys_Certicificate1_Element: nv-provide-com-spec{ram-block-init-value=64 x 0, rom-block-init-value=64 x 0, variable=Value}, nv-require-com-spec{init-value=64 x 0, variable=Value}, provided-required-interface=RefCys_Certicificate1_Element
      RefCys_Certicificate_Element: nv-provide-com-spec{ram-block-init-value=64 x 0, rom-block-init-value=64 x 0, variable=Value}, nv-require-com-spec{init-value=64 x 0, variable=Value}, provided-required-interface=RefCys_Certicificate_Element
    behavior NvBlockSwComponentType_InternalBehavior
      60 x data received event, all with start-on-event=NvBlockSwComponentTypeRunnable:
        DRT_NvBlockSwComponentTypeRunnable_BsConst_Audio_Element_Value: data=BsConst_Audio_Element.Value
        DRT_NvBlockSwComponentTypeRunnable_BsConst_Communication_Element_Value: data=BsConst_Communication_Element.Value
        DRT_NvBlockSwComponentTypeRunnable_BsConst_EngOffTimer_Element_Value: data=BsConst_EngOffTimer_Element.Value
        DRT_NvBlockSwComponentTypeRunnable_BsConst_FuelGauge_Element_Value: data=BsConst_FuelGauge_Element.Value
        DRT_NvBlockSwComponentTypeRunnable_BsConst_Illumination_Element_Value: data=BsConst_Illumination_Element.Value
        DRT_NvBlockSwComponentTypeRunnable_BsConst_OilGauge_Element_Value: data=BsConst_OilGauge_Element.Value
        DRT_NvBlockSwComponentTypeRunnable_BsConst_PowerGauge_Element_Value: data=BsConst_PowerGauge_Element.Value
        DRT_NvBlockSwComponentTypeRunnable_BsConst_Power_Element_Value: data=BsConst_Power_Element.Value
        DRT_NvBlockSwComponentTypeRunnable_BsConst_RealTimeClock_Element_Value: data=BsConst_RealTimeClock_Element.Value
        DRT_NvBlockSwComponentTypeRunnable_BsConst_ServiceReminder_Element_Value: data=BsConst_ServiceReminder_Element.Value
        DRT_NvBlockSwComponentTypeRunnable_BsConst_SpeedoGauge_Element_Value: data=BsConst_SpeedoGauge_Element.Value
        DRT_NvBlockSwComponentTypeRunnable_BsConst_TachoGauge_Element_Value: data=BsConst_TachoGauge_Element.Value
        DRT_NvBlockSwComponentTypeRunnable_BsConst_TempGauge_Element_Value: data=BsConst_TempGauge_Element.Value
        DRT_NvBlockSwComponentTypeRunnable_BsConst_TripComputer_Element_Value: data=BsConst_TripComputer_Element.Value
        DRT_NvBlockSwComponentTypeRunnable_BsConst_Warning_Element_Value: data=BsConst_Warning_Element.Value
        DRT_NvBlockSwComponentTypeRunnable_BsCys_Certicificate_Element_Value: data=BsCys_Certicificate_Element.Value
        DRT_NvBlockSwComponentTypeRunnable_BsDiag_Dtc_Element_Value: data=BsDiag_Dtc_Element.Value
        DRT_NvBlockSwComponentTypeRunnable_BsDiag_ErrorRecord_Element_Value: data=BsDiag_ErrorRecord_Element.Value
        DRT_NvBlockSwComponentTypeRunnable_BsFuSa_Audio_Element_Value: data=BsFuSa_Audio_Element.Value
        DRT_NvBlockSwComponentTypeRunnable_BsFuSa_Communication_Element_Value: data=BsFuSa_Communication_Element.Value
        DRT_NvBlockSwComponentTypeRunnable_BsFuSa_Config_Element_Value: data=BsFuSa_Config_Element.Value
        DRT_NvBlockSwComponentTypeRunnable_BsFuSa_Display_Element_Value: data=BsFuSa_Display_Element.Value
        DRT_NvBlockSwComponentTypeRunnable_BsFuSa_Power_Element_Value: data=BsFuSa_Power_Element.Value
        DRT_NvBlockSwComponentTypeRunnable_BsFuSa_Warning_Element_Value: data=BsFuSa_Warning_Element.Value
        DRT_NvBlockSwComponentTypeRunnable_BsFusa_Fota_Element_Value: data=BsFusa_Fota_Element.Value
        DRT_NvBlockSwComponentTypeRunnable_BsReten_Audio_Element_Value: data=BsReten_Audio_Element.Value
        DRT_NvBlockSwComponentTypeRunnable_BsReten_Communication_Element_Value: data=BsReten_Communication_Element.Value
        DRT_NvBlockSwComponentTypeRunnable_BsReten_Display_Element_Value: data=BsReten_Display_Element.Value
        DRT_NvBlockSwComponentTypeRunnable_BsReten_Gauges_Element_Value: data=BsReten_Gauges_Element.Value
        DRT_NvBlockSwComponentTypeRunnable_BsReten_Illumination_Element_Value: data=BsReten_Illumination_Element.Value
        DRT_NvBlockSwComponentTypeRunnable_BsReten_Odometer_Element_Value: data=BsReten_Odometer_Element.Value
        DRT_NvBlockSwComponentTypeRunnable_BsReten_Personalization_Element_Value: data=BsReten_Personalization_Element.Value
        DRT_NvBlockSwComponentTypeRunnable_BsReten_Power_Element_Value: data=BsReten_Power_Element.Value
        DRT_NvBlockSwComponentTypeRunnable_BsReten_RealTimeClock_Element_Value: data=BsReten_RealTimeClock_Element.Value
        DRT_NvBlockSwComponentTypeRunnable_BsReten_Tripcomputer_Element_Value: data=BsReten_Tripcomputer_Element.Value
        DRT_NvBlockSwComponentTypeRunnable_BsReten_VisDlt_Element_Value: data=BsReten_VisDlt_Element.Value
        DRT_NvBlockSwComponentTypeRunnable_BsReten_Warning_Element_Value: data=BsReten_Warning_Element.Value
        DRT_NvBlockSwComponentTypeRunnable_BsRt_CusDlt_Element_Value: data=BsRt_CusDlt_Element.Value
        DRT_NvBlockSwComponentTypeRunnable_BsRt_FuelGauge_Element_Value: data=BsRt_FuelGauge_Element.Value
        DRT_NvBlockSwComponentTypeRunnable_BsRt_Illumination_Element_Value: data=BsRt_Illumination_Element.Value
        DRT_NvBlockSwComponentTypeRunnable_BsRt_Odometer_Element_Value: data=BsRt_Odometer_Element.Value
        DRT_NvBlockSwComponentTypeRunnable_BsRt_OilGauge_Element_Value: data=BsRt_OilGauge_Element.Value
        DRT_NvBlockSwComponentTypeRunnable_BsRt_Personalization_Element_Value: data=BsRt_Personalization_Element.Value
        DRT_NvBlockSwComponentTypeRunnable_BsRt_PowerGauge_Element_Value: data=BsRt_PowerGauge_Element.Value
        DRT_NvBlockSwComponentTypeRunnable_BsRt_RealTimeClock_Element_Value: data=BsRt_RealTimeClock_Element.Value
        DRT_NvBlockSwComponentTypeRunnable_BsRt_SpeedoGauge_Element_Value: data=BsRt_SpeedoGauge_Element.Value
        DRT_NvBlockSwComponentTypeRunnable_BsRt_TachoGauge_Element_Value: data=BsRt_TachoGauge_Element.Value
        DRT_NvBlockSwComponentTypeRunnable_BsRt_TempGauge_Element_Value: data=BsRt_TempGauge_Element.Value
        DRT_NvBlockSwComponentTypeRunnable_BsRt_TripComputer_Element_Value: data=BsRt_TripComputer_Element.Value
        DRT_NvBlockSwComponentTypeRunnable_BsRt_Warning_Element_Value: data=BsRt_Warning_Element.Value
        DRT_NvBlockSwComponentTypeRunnable_BsShare_EcuPartNumber_Element_Value: data=BsShare_EcuPartNumber_Element.Value
        DRT_NvBlockSwComponentTypeRunnable_BsShare_SwUpdFotaFinPrint_Element_Value: data=BsShare_SwUpdFotaFinPrint_Element.Value
        DRT_NvBlockSwComponentTypeRunnable_BsShare_SwUpdFotaMode_Element_Value: data=BsShare_SwUpdFotaMode_Element.Value
        DRT_NvBlockSwComponentTypeRunnable_BsShare_SwUpdFotaStatus_Element_Value: data=BsShare_SwUpdFotaStatus_Element.Value
        DRT_NvBlockSwComponentTypeRunnable_BsShare_SwUpdFotadecrypt_Element_Value: data=BsShare_SwUpdFotadecrypt_Element.Value
        DRT_NvBlockSwComponentTypeRunnable_BsShare_SwUpdReflash_Element_Value: data=BsShare_SwUpdReflash_Element.Value
        DRT_NvBlockSwComponentTypeRunnable_BsShare_VehicleConfig_Element_Value: data=BsShare_VehicleConfig_Element.Value
        DRT_NvBlockSwComponentTypeRunnable_BsShare_VisMeet_Element_Value: data=BsShare_VisMeet_Element.Value
        DRT_NvBlockSwComponentTypeRunnable_RefCys_Certicificate1_Element_Value: data=RefCys_Certicificate1_Element.Value
        DRT_NvBlockSwComponentTypeRunnable_RefCys_Certicificate_Element_Value: data=RefCys_Certicificate_Element.Value
      runnable NvBlockSwComponentTypeRunnable
    60 x nv block descriptor, all with support-dirty-flag=true:
      NVBlockDescriptor_BsConst_Audio: nv-block-data-mapping{nv-ram-block-element=autosar-variable-in-impl-datatype={root-variable-data-prototype=RAM_NVBlockDescriptor_BsConst_Audio, target-data-prototype=BsConst_Audio_Element}, written-read-nv-data=BsConst_Audio_Element.Value}
        nv block needs NVNeed_NVBlockDescriptor: n-data-sets=2, ram-block-status-control=API, reliability=NO-PROTECTION, restore-at-start=true, store-at-shutdown=false, store-immediate=true, write-verification=false
        ram block RAM_NVBlockDescriptor_BsConst_Audio: type=NV_Data_BsConst_Audio, init-value=fields=BsConst_Audio_Element:128 x 0
        rom block ROM_NVBlockDescriptor_BsConst_Audio: sw-calibration-access=READ-WRITE, type=NV_Data_BsConst_Audio, init-value=fields=BsConst_Audio_Element:128 x 0
      NVBlockDescriptor_BsConst_Communication: nv-block-data-mapping{nv-ram-block-element=autosar-variable-in-impl-datatype={root-variable-data-prototype=RAM_NVBlockDescriptor_BsConst_Communication, target-data-prototype=BsConst_Communication_Element}, written-read-nv-data=BsConst_Communication_Element.Value}
        nv block needs NVNeed_NVBlockDescriptor: n-data-sets=2, ram-block-status-control=API, reliability=NO-PROTECTION, restore-at-start=true, store-at-shutdown=false, store-immediate=true, write-verification=false
        ram block RAM_NVBlockDescriptor_BsConst_Communication: type=NV_Data_BsConst_Communication, init-value=fields=BsConst_Communication_Element:64 x 0
        rom block ROM_NVBlockDescriptor_BsConst_Communication: sw-calibration-access=READ-WRITE, type=NV_Data_BsConst_Communication, init-value=fields=BsConst_Communication_Element:64 x 0
      NVBlockDescriptor_BsConst_EngOffTimer: nv-block-data-mapping{nv-ram-block-element=autosar-variable-in-impl-datatype={root-variable-data-prototype=RAM_NVBlockDescriptor_BsConst_EngOffTimer, target-data-prototype=BsConst_EngOffTimer_Element}, written-read-nv-data=BsConst_EngOffTimer_Element.Value}
        nv block needs NVNeed_NVBlockDescriptor: n-data-sets=2, ram-block-status-control=API, reliability=NO-PROTECTION, restore-at-start=true, store-at-shutdown=false, store-immediate=true, write-verification=false
        ram block RAM_NVBlockDescriptor_BsConst_EngOffTimer: type=NV_Data_BsConst_EngOffTimer, init-value=fields=BsConst_EngOffTimer_Element:32 x 0
        rom block ROM_NVBlockDescriptor_BsConst_EngOffTimer: sw-calibration-access=READ-WRITE, type=NV_Data_BsConst_EngOffTimer, init-value=fields=BsConst_EngOffTimer_Element:32 x 0
      NVBlockDescriptor_BsConst_FuelGauge: nv-block-data-mapping{nv-ram-block-element=autosar-variable-in-impl-datatype={root-variable-data-prototype=RAM_NVBlockDescriptor_BsConst_FuelGauge, target-data-prototype=BsConst_FuelGauge_Element}, written-read-nv-data=BsConst_FuelGauge_Element.Value}
        nv block needs NVNeed_NVBlockDescriptor: n-data-sets=2, ram-block-status-control=API, reliability=NO-PROTECTION, restore-at-start=true, store-at-shutdown=false, store-immediate=true, write-verification=false
        ram block RAM_NVBlockDescriptor_BsConst_FuelGauge: type=NV_Data_BsConst_FuelGauge, init-value=fields=BsConst_FuelGauge_Element:128 x 0
        rom block ROM_NVBlockDescriptor_BsConst_FuelGauge: sw-calibration-access=READ-WRITE, type=NV_Data_BsConst_FuelGauge, init-value=fields=BsConst_FuelGauge_Element:128 x 0
      NVBlockDescriptor_BsConst_Illumination: nv-block-data-mapping{nv-ram-block-element=autosar-variable-in-impl-datatype={root-variable-data-prototype=RAM_NVBlockDescriptor_BsConst_Illumination, target-data-prototype=BsConst_Illumination_Element}, written-read-nv-data=BsConst_Illumination_Element.Value}
        nv block needs NVNeed_NVBlockDescriptor: n-data-sets=2, ram-block-status-control=API, reliability=NO-PROTECTION, restore-at-start=true, store-at-shutdown=false, store-immediate=true, write-verification=false
        ram block RAM_NVBlockDescriptor_BsConst_Illumination: type=NV_Data_BsConst_Illumination, init-value=fields=BsConst_Illumination_Element:128 x 0
        rom block ROM_NVBlockDescriptor_BsConst_Illumination: sw-calibration-access=READ-WRITE, type=NV_Data_BsConst_Illumination, init-value=fields=BsConst_Illumination_Element:128 x 0
      NVBlockDescriptor_BsConst_OilGauge: nv-block-data-mapping{nv-ram-block-element=autosar-variable-in-impl-datatype={root-variable-data-prototype=RAM_NVBlockDescriptor_BsConst_OilGauge, target-data-prototype=BsConst_OilGauge_Element}, written-read-nv-data=BsConst_OilGauge_Element.Value}
        nv block needs NVNeed_NVBlockDescriptor: n-data-sets=2, ram-block-status-control=API, reliability=NO-PROTECTION, restore-at-start=true, store-at-shutdown=false, store-immediate=true, write-verification=false
        ram block RAM_NVBlockDescriptor_BsConst_OilGauge: type=NV_Data_BsConst_OilGauge, init-value=fields=BsConst_OilGauge_Element:64 x 0
        rom block ROM_NVBlockDescriptor_BsConst_OilGauge: sw-calibration-access=READ-WRITE, type=NV_Data_BsConst_OilGauge, init-value=fields=BsConst_OilGauge_Element:64 x 0
      NVBlockDescriptor_BsConst_Power: nv-block-data-mapping{nv-ram-block-element=autosar-variable-in-impl-datatype={root-variable-data-prototype=RAM_NVBlockDescriptor_BsConst_Power, target-data-prototype=BsConst_Power_Element}, written-read-nv-data=BsConst_Power_Element.Value}
        nv block needs NVNeed_NVBlockDescriptor: n-data-sets=2, ram-block-status-control=API, reliability=NO-PROTECTION, restore-at-start=true, store-at-shutdown=false, store-immediate=true, write-verification=false
        ram block RAM_NVBlockDescriptor_BsConst_Power: type=NV_Data_BsConst_Power, init-value=fields=BsConst_Power_Element:32 x 0
        rom block ROM_NVBlockDescriptor_BsConst_Power: sw-calibration-access=READ-WRITE, type=NV_Data_BsConst_Power, init-value=fields=BsConst_Power_Element:32 x 0
      NVBlockDescriptor_BsConst_PowerGauge: nv-block-data-mapping{nv-ram-block-element=autosar-variable-in-impl-datatype={root-variable-data-prototype=RAM_NVBlockDescriptor_BsConst_PowerGauge, target-data-prototype=BsConst_PowerGauge_Element}, written-read-nv-data=BsConst_PowerGauge_Element.Value}
        nv block needs NVNeed_NVBlockDescriptor: n-data-sets=2, ram-block-status-control=API, reliability=NO-PROTECTION, restore-at-start=true, store-at-shutdown=false, store-immediate=true, write-verification=false
        ram block RAM_NVBlockDescriptor_BsConst_PowerGauge: type=NV_Data_BsConst_PowerGauge, init-value=fields=BsConst_PowerGauge_Element:64 x 0
        rom block ROM_NVBlockDescriptor_BsConst_PowerGauge: sw-calibration-access=READ-WRITE, type=NV_Data_BsConst_PowerGauge, init-value=fields=BsConst_PowerGauge_Element:64 x 0
      NVBlockDescriptor_BsConst_RealTimeClock: nv-block-data-mapping{nv-ram-block-element=autosar-variable-in-impl-datatype={root-variable-data-prototype=RAM_NVBlockDescriptor_BsConst_RealTimeClock, target-data-prototype=BsConst_RealTimeClock_Element}, written-read-nv-data=BsConst_RealTimeClock_Element.Value}
        nv block needs NVNeed_NVBlockDescriptor: n-data-sets=2, ram-block-status-control=API, reliability=NO-PROTECTION, restore-at-start=true, store-at-shutdown=false, store-immediate=true, write-verification=false
        ram block RAM_NVBlockDescriptor_BsConst_RealTimeClock: type=NV_Data_BsConst_RealTimeClock, init-value=fields=BsConst_RealTimeClock_Element:48 x 0
        rom block ROM_NVBlockDescriptor_BsConst_RealTimeClock: sw-calibration-access=READ-WRITE, type=NV_Data_BsConst_RealTimeClock, init-value=fields=BsConst_RealTimeClock_Element:48 x 0
      NVBlockDescriptor_BsConst_ServiceReminder: nv-block-data-mapping{nv-ram-block-element=autosar-variable-in-impl-datatype={root-variable-data-prototype=RAM_NVBlockDescriptor_BsConst_ServiceReminder, target-data-prototype=BsConst_ServiceReminder_Element}, written-read-nv-data=BsConst_ServiceReminder_Element.Value}
        nv block needs NVNeed_NVBlockDescriptor: n-data-sets=2, ram-block-status-control=API, reliability=NO-PROTECTION, restore-at-start=true, store-at-shutdown=false, store-immediate=true, write-verification=false
        ram block RAM_NVBlockDescriptor_BsConst_ServiceReminder: type=NV_Data_BsConst_ServiceReminder, init-value=fields=BsConst_ServiceReminder_Element:48 x 0
        rom block ROM_NVBlockDescriptor_BsConst_ServiceReminder: sw-calibration-access=READ-WRITE, type=NV_Data_BsConst_ServiceReminder, init-value=fields=BsConst_ServiceReminder_Element:48 x 0
      NVBlockDescriptor_BsConst_SpeedoGauge: nv-block-data-mapping{nv-ram-block-element=autosar-variable-in-impl-datatype={root-variable-data-prototype=RAM_NVBlockDescriptor_BsConst_SpeedoGauge, target-data-prototype=BsConst_SpeedoGauge_Element}, written-read-nv-data=BsConst_SpeedoGauge_Element.Value}
        nv block needs NVNeed_NVBlockDescriptor: n-data-sets=2, ram-block-status-control=API, reliability=NO-PROTECTION, restore-at-start=true, store-at-shutdown=false, store-immediate=true, write-verification=false
        ram block RAM_NVBlockDescriptor_BsConst_SpeedoGauge: type=NV_Data_BsConst_SpeedoGauge, init-value=fields=BsConst_SpeedoGauge_Element:64 x 0
        rom block ROM_NVBlockDescriptor_BsConst_SpeedoGauge: sw-calibration-access=READ-WRITE, type=NV_Data_BsConst_SpeedoGauge, init-value=fields=BsConst_SpeedoGauge_Element:64 x 0
      NVBlockDescriptor_BsConst_TachoGauge: nv-block-data-mapping{nv-ram-block-element=autosar-variable-in-impl-datatype={root-variable-data-prototype=RAM_NVBlockDescriptor_BsConst_TachoGauge, target-data-prototype=BsConst_TachoGauge_Element}, written-read-nv-data=BsConst_TachoGauge_Element.Value}
        nv block needs NVNeed_NVBlockDescriptor: n-data-sets=2, ram-block-status-control=API, reliability=NO-PROTECTION, restore-at-start=true, store-at-shutdown=false, store-immediate=true, write-verification=false
        ram block RAM_NVBlockDescriptor_BsConst_TachoGauge: type=NV_Data_BsConst_TachoGauge, init-value=fields=BsConst_TachoGauge_Element:64 x 0
        rom block ROM_NVBlockDescriptor_BsConst_TachoGauge: sw-calibration-access=READ-WRITE, type=NV_Data_BsConst_TachoGauge, init-value=fields=BsConst_TachoGauge_Element:64 x 0
      NVBlockDescriptor_BsConst_TempGauge: nv-block-data-mapping{nv-ram-block-element=autosar-variable-in-impl-datatype={root-variable-data-prototype=RAM_NVBlockDescriptor_BsConst_TempGauge, target-data-prototype=BsConst_TempGauge_Element}, written-read-nv-data=BsConst_TempGauge_Element.Value}
        nv block needs NVNeed_NVBlockDescriptor: n-data-sets=2, ram-block-status-control=API, reliability=NO-PROTECTION, restore-at-start=true, store-at-shutdown=false, store-immediate=true, write-verification=false
        ram block RAM_NVBlockDescriptor_BsConst_TempGauge: type=NV_Data_BsConst_TempGauge, init-value=fields=BsConst_TempGauge_Element:64 x 0
        rom block ROM_NVBlockDescriptor_BsConst_TempGauge: sw-calibration-access=READ-WRITE, type=NV_Data_BsConst_TempGauge, init-value=fields=BsConst_TempGauge_Element:64 x 0
      NVBlockDescriptor_BsConst_TripComputer: nv-block-data-mapping{nv-ram-block-element=autosar-variable-in-impl-datatype={root-variable-data-prototype=RAM_NVBlockDescriptor_BsConst_TripComputer, target-data-prototype=BsConst_TripComputer_Element}, written-read-nv-data=BsConst_TripComputer_Element.Value}
        nv block needs NVNeed_NVBlockDescriptor: n-data-sets=2, ram-block-status-control=API, reliability=NO-PROTECTION, restore-at-start=true, store-at-shutdown=false, store-immediate=true, write-verification=false
        ram block RAM_NVBlockDescriptor_BsConst_TripComputer: type=NV_Data_BsConst_TripComputer, init-value=fields=BsConst_TripComputer_Element:64 x 0
        rom block ROM_NVBlockDescriptor_BsConst_TripComputer: sw-calibration-access=READ-WRITE, type=NV_Data_BsConst_TripComputer, init-value=fields=BsConst_TripComputer_Element:64 x 0
      NVBlockDescriptor_BsConst_Warning: nv-block-data-mapping{nv-ram-block-element=autosar-variable-in-impl-datatype={root-variable-data-prototype=RAM_NVBlockDescriptor_BsConst_Warning, target-data-prototype=BsConst_Warning_Element}, written-read-nv-data=BsConst_Warning_Element.Value}
        nv block needs NVNeed_NVBlockDescriptor: n-data-sets=2, ram-block-status-control=API, reliability=NO-PROTECTION, restore-at-start=true, store-at-shutdown=false, store-immediate=true, write-verification=false
        ram block RAM_NVBlockDescriptor_BsConst_Warning: type=NV_Data_BsConst_Warning, init-value=fields=BsConst_Warning_Element:64 x 0
        rom block ROM_NVBlockDescriptor_BsConst_Warning: sw-calibration-access=READ-WRITE, type=NV_Data_BsConst_Warning, init-value=fields=BsConst_Warning_Element:64 x 0
      NVBlockDescriptor_BsCys_Certicificate: nv-block-data-mapping{nv-ram-block-element=autosar-variable-in-impl-datatype={root-variable-data-prototype=RAM_NVBlockDescriptor_BsCys_Certicificate, target-data-prototype=BsCys_Certicificate_Element}, written-read-nv-data=BsCys_Certicificate_Element.Value}
        nv block needs NVNeed_NVBlockDescriptor: n-data-sets=2, ram-block-status-control=API, reliability=NO-PROTECTION, restore-at-start=true, store-at-shutdown=false, store-immediate=true, write-verification=false
        ram block RAM_NVBlockDescriptor_BsCys_Certicificate: type=NV_Data_BsCys_Certicificate, init-value=fields=BsCys_Certicificate_Element:64 x 0
        rom block ROM_NVBlockDescriptor_BsCys_Certicificate: sw-calibration-access=READ-WRITE, type=NV_Data_BsCys_Certicificate, init-value=fields=BsCys_Certicificate_Element:64 x 0
      NVBlockDescriptor_BsDiag_Dtc: nv-block-data-mapping{nv-ram-block-element=autosar-variable-in-impl-datatype={root-variable-data-prototype=RAM_NVBlockDescriptor_BsDiag_Dtc, target-data-prototype=BsDiag_Dtc_Element}, written-read-nv-data=BsDiag_Dtc_Element.Value}
        nv block needs NVNeed_NVBlockDescriptor: n-data-sets=2, ram-block-status-control=API, reliability=NO-PROTECTION, restore-at-start=true, store-at-shutdown=false, store-immediate=true, write-verification=false
        ram block RAM_NVBlockDescriptor_BsDiag_Dtc: type=NV_Data_BsDiag_Dtc, init-value=fields=BsDiag_Dtc_Element:2048 x 0
        rom block ROM_NVBlockDescriptor_BsDiag_Dtc: sw-calibration-access=READ-WRITE, type=NV_Data_BsDiag_Dtc, init-value=fields=BsDiag_Dtc_Element:2048 x 0
      NVBlockDescriptor_BsDiag_ErrorRecord: nv-block-data-mapping{nv-ram-block-element=autosar-variable-in-impl-datatype={root-variable-data-prototype=RAM_NVBlockDescriptor_BsDiag_ErrorRecord, target-data-prototype=BsDiag_ErrorRecord_Element}, written-read-nv-data=BsDiag_ErrorRecord_Element.Value}
        nv block needs NVNeed_NVBlockDescriptor: n-data-sets=2, ram-block-status-control=API, reliability=NO-PROTECTION, restore-at-start=true, store-at-shutdown=false, store-immediate=true, write-verification=false
        ram block RAM_NVBlockDescriptor_BsDiag_ErrorRecord: type=NV_Data_BsDiag_ErrorRecord, init-value=fields=BsDiag_ErrorRecord_Element:1024 x 0
        rom block ROM_NVBlockDescriptor_BsDiag_ErrorRecord: sw-calibration-access=READ-WRITE, type=NV_Data_BsDiag_ErrorRecord, init-value=fields=BsDiag_ErrorRecord_Element:1024 x 0
      NVBlockDescriptor_BsFuSa_Audio: nv-block-data-mapping{nv-ram-block-element=autosar-variable-in-impl-datatype={root-variable-data-prototype=RAM_NVBlockDescriptor_BsFuSa_Audio, target-data-prototype=BsFuSa_Audio_Element}, written-read-nv-data=BsFuSa_Audio_Element.Value}
        nv block needs NVNeed_NVBlockDescriptor: n-data-sets=2, ram-block-status-control=API, reliability=NO-PROTECTION, restore-at-start=true, store-at-shutdown=false, store-immediate=true, write-verification=false
        ram block RAM_NVBlockDescriptor_BsFuSa_Audio: type=NV_Data_BsFuSa_Audio, init-value=fields=BsFuSa_Audio_Element:32 x 0
        rom block ROM_NVBlockDescriptor_BsFuSa_Audio: sw-calibration-access=READ-WRITE, type=NV_Data_BsFuSa_Audio, init-value=fields=BsFuSa_Audio_Element:32 x 0
      NVBlockDescriptor_BsFuSa_Communication: nv-block-data-mapping{nv-ram-block-element=autosar-variable-in-impl-datatype={root-variable-data-prototype=RAM_NVBlockDescriptor_BsFuSa_Communication, target-data-prototype=BsFuSa_Communication_Element}, written-read-nv-data=BsFuSa_Communication_Element.Value}
        nv block needs NVNeed_NVBlockDescriptor: n-data-sets=2, ram-block-status-control=API, reliability=NO-PROTECTION, restore-at-start=true, store-at-shutdown=false, store-immediate=true, write-verification=false
        ram block RAM_NVBlockDescriptor_BsFuSa_Communication: type=NV_Data_BsFuSa_Communication, init-value=fields=BsFuSa_Communication_Element:16 x 0
        rom block ROM_NVBlockDescriptor_BsFuSa_Communication: sw-calibration-access=READ-WRITE, type=NV_Data_BsFuSa_Communication, init-value=fields=BsFuSa_Communication_Element:16 x 0
      NVBlockDescriptor_BsFuSa_Config: nv-block-data-mapping{nv-ram-block-element=autosar-variable-in-impl-datatype={root-variable-data-prototype=RAM_NVBlockDescriptor_BsFuSa_Config, target-data-prototype=BsFuSa_Config_Element}, written-read-nv-data=BsFuSa_Config_Element.Value}
        nv block needs NVNeed_NVBlockDescriptor: n-data-sets=2, ram-block-status-control=API, reliability=NO-PROTECTION, restore-at-start=true, store-at-shutdown=false, store-immediate=true, write-verification=false
        ram block RAM_NVBlockDescriptor_BsFuSa_Config: type=NV_Data_BsFuSa_Config, init-value=fields=BsFuSa_Config_Element:16 x 0
        rom block ROM_NVBlockDescriptor_BsFuSa_Config: sw-calibration-access=READ-WRITE, type=NV_Data_BsFuSa_Config, init-value=fields=BsFuSa_Config_Element:16 x 0
      NVBlockDescriptor_BsFuSa_Display: nv-block-data-mapping{nv-ram-block-element=autosar-variable-in-impl-datatype={root-variable-data-prototype=RAM_NVBlockDescriptor_BsFuSa_Display, target-data-prototype=BsFuSa_Display_Element}, written-read-nv-data=BsFuSa_Display_Element.Value}
        nv block needs NVNeed_NVBlockDescriptor: n-data-sets=2, ram-block-status-control=API, reliability=NO-PROTECTION, restore-at-start=true, store-at-shutdown=false, store-immediate=true, write-verification=false
        ram block RAM_NVBlockDescriptor_BsFuSa_Display: type=NV_Data_BsFuSa_Display, init-value=fields=BsFuSa_Display_Element:64 x 0
        rom block ROM_NVBlockDescriptor_BsFuSa_Display: sw-calibration-access=READ-WRITE, type=NV_Data_BsFuSa_Display, init-value=fields=BsFuSa_Display_Element:64 x 0
      NVBlockDescriptor_BsFuSa_Power: nv-block-data-mapping{nv-ram-block-element=autosar-variable-in-impl-datatype={root-variable-data-prototype=RAM_NVBlockDescriptor_BsFuSa_Power, target-data-prototype=BsFuSa_Power_Element}, written-read-nv-data=BsFuSa_Power_Element.Value}
        nv block needs NVNeed_NVBlockDescriptor: n-data-sets=2, ram-block-status-control=API, reliability=NO-PROTECTION, restore-at-start=true, store-at-shutdown=false, store-immediate=true, write-verification=false
        ram block RAM_NVBlockDescriptor_BsFuSa_Power: type=NV_Data_BsFuSa_Power, init-value=fields=BsFuSa_Power_Element:48 x 0
        rom block ROM_NVBlockDescriptor_BsFuSa_Power: sw-calibration-access=READ-WRITE, type=NV_Data_BsFuSa_Power, init-value=fields=BsFuSa_Power_Element:48 x 0
      NVBlockDescriptor_BsFuSa_Warning: nv-block-data-mapping{nv-ram-block-element=autosar-variable-in-impl-datatype={root-variable-data-prototype=RAM_NVBlockDescriptor_BsFuSa_Warning, target-data-prototype=BsFuSa_Warning_Element}, written-read-nv-data=BsFuSa_Warning_Element.Value}
        nv block needs NVNeed_NVBlockDescriptor: n-data-sets=2, ram-block-status-control=API, reliability=NO-PROTECTION, restore-at-start=true, store-at-shutdown=false, store-immediate=true, write-verification=false
        ram block RAM_NVBlockDescriptor_BsFuSa_Warning: type=NV_Data_BsFuSa_Warning, init-value=fields=BsFuSa_Warning_Element:32 x 0
        rom block ROM_NVBlockDescriptor_BsFuSa_Warning: sw-calibration-access=READ-WRITE, type=NV_Data_BsFuSa_Warning, init-value=fields=BsFuSa_Warning_Element:32 x 0
      NVBlockDescriptor_BsFusa_Fota: nv-block-data-mapping{nv-ram-block-element=autosar-variable-in-impl-datatype={root-variable-data-prototype=RAM_NVBlockDescriptor_BsFusa_Fota, target-data-prototype=BsFusa_Fota_Element}, written-read-nv-data=BsFusa_Fota_Element.Value}
        nv block needs NVNeed_NVBlockDescriptor: n-data-sets=2, ram-block-status-control=API, reliability=NO-PROTECTION, restore-at-start=true, store-at-shutdown=false, store-immediate=true, write-verification=false
        ram block RAM_NVBlockDescriptor_BsFusa_Fota: type=NV_Data_BsFusa_Fota, init-value=fields=BsFusa_Fota_Element:32 x 0
        rom block ROM_NVBlockDescriptor_BsFusa_Fota: sw-calibration-access=READ-WRITE, type=NV_Data_BsFusa_Fota, init-value=fields=BsFusa_Fota_Element:32 x 0
      NVBlockDescriptor_BsReten_Audio: nv-block-data-mapping{nv-ram-block-element=autosar-variable-in-impl-datatype={root-variable-data-prototype=RAM_NVBlockDescriptor_BsReten_Audio, target-data-prototype=BsReten_Audio_Element}, written-read-nv-data=BsReten_Audio_Element.Value}
        nv block needs NVNeed_NVBlockDescriptor: n-data-sets=2, ram-block-status-control=API, reliability=NO-PROTECTION, restore-at-start=true, store-at-shutdown=false, store-immediate=true, write-verification=false
        ram block RAM_NVBlockDescriptor_BsReten_Audio: type=NV_Data_BsReten_Audio, init-value=fields=BsReten_Audio_Element:100 x 0
        rom block ROM_NVBlockDescriptor_BsReten_Audio: sw-calibration-access=READ-WRITE, type=NV_Data_BsReten_Audio, init-value=fields=BsReten_Audio_Element:100 x 0
      NVBlockDescriptor_BsReten_Communication: nv-block-data-mapping{nv-ram-block-element=autosar-variable-in-impl-datatype={root-variable-data-prototype=RAM_NVBlockDescriptor_BsReten_Communication, target-data-prototype=BsReten_Communication_Element}, written-read-nv-data=BsReten_Communication_Element.Value}
        nv block needs NVNeed_NVBlockDescriptor: n-data-sets=2, ram-block-status-control=API, reliability=NO-PROTECTION, restore-at-start=true, store-at-shutdown=false, store-immediate=true, write-verification=false
        ram block RAM_NVBlockDescriptor_BsReten_Communication: type=NV_Data_BsReten_Communication, init-value=fields=BsReten_Communication_Element:100 x 0
        rom block ROM_NVBlockDescriptor_BsReten_Communication: sw-calibration-access=READ-WRITE, type=NV_Data_BsReten_Communication, init-value=fields=BsReten_Communication_Element:100 x 0
      NVBlockDescriptor_BsReten_Display: nv-block-data-mapping{nv-ram-block-element=autosar-variable-in-impl-datatype={root-variable-data-prototype=RAM_NVBlockDescriptor_BsReten_Display, target-data-prototype=BsReten_Display_Element}, written-read-nv-data=BsReten_Display_Element.Value}
        nv block needs NVNeed_NVBlockDescriptor: n-data-sets=2, ram-block-status-control=API, reliability=NO-PROTECTION, restore-at-start=true, store-at-shutdown=false, store-immediate=true, write-verification=false
        ram block RAM_NVBlockDescriptor_BsReten_Display: type=NV_Data_BsReten_Display, init-value=fields=BsReten_Display_Element:100 x 0
        rom block ROM_NVBlockDescriptor_BsReten_Display: sw-calibration-access=READ-WRITE, type=NV_Data_BsReten_Display, init-value=fields=BsReten_Display_Element:100 x 0
      NVBlockDescriptor_BsReten_Gauges: nv-block-data-mapping{nv-ram-block-element=autosar-variable-in-impl-datatype={root-variable-data-prototype=RAM_NVBlockDescriptor_BsReten_Gauges, target-data-prototype=BsReten_Gauges_Element}, written-read-nv-data=BsReten_Gauges_Element.Value}
        nv block needs NVNeed_NVBlockDescriptor: n-data-sets=2, ram-block-status-control=API, reliability=NO-PROTECTION, restore-at-start=true, store-at-shutdown=false, store-immediate=true, write-verification=false
        ram block RAM_NVBlockDescriptor_BsReten_Gauges: type=NV_Data_BsReten_Gauges, init-value=fields=BsReten_Gauges_Element:100 x 0
        rom block ROM_NVBlockDescriptor_BsReten_Gauges: sw-calibration-access=READ-WRITE, type=NV_Data_BsReten_Gauges, init-value=fields=BsReten_Gauges_Element:100 x 0
      NVBlockDescriptor_BsReten_Illumination: nv-block-data-mapping{nv-ram-block-element=autosar-variable-in-impl-datatype={root-variable-data-prototype=RAM_NVBlockDescriptor_BsReten_Illumination, target-data-prototype=BsReten_Illumination_Element}, written-read-nv-data=BsReten_Illumination_Element.Value}
        nv block needs NVNeed_NVBlockDescriptor: n-data-sets=2, ram-block-status-control=API, reliability=NO-PROTECTION, restore-at-start=true, store-at-shutdown=false, store-immediate=true, write-verification=false
        ram block RAM_NVBlockDescriptor_BsReten_Illumination: type=NV_Data_BsReten_Illumination, init-value=fields=BsReten_Illumination_Element:100 x 0
        rom block ROM_NVBlockDescriptor_BsReten_Illumination: sw-calibration-access=READ-WRITE, type=NV_Data_BsReten_Illumination, init-value=fields=BsReten_Illumination_Element:100 x 0
      NVBlockDescriptor_BsReten_Odometer: nv-block-data-mapping{nv-ram-block-element=autosar-variable-in-impl-datatype={root-variable-data-prototype=RAM_NVBlockDescriptor_BsReten_Odometer, target-data-prototype=BsReten_Odometer_Element}, written-read-nv-data=BsReten_Odometer_Element.Value}
        nv block needs NVNeed_NVBlockDescriptor: n-data-sets=2, ram-block-status-control=API, reliability=NO-PROTECTION, restore-at-start=true, store-at-shutdown=false, store-immediate=true, write-verification=false
        ram block RAM_NVBlockDescriptor_BsReten_Odometer: type=NV_Data_BsReten_Odometer, init-value=fields=BsReten_Odometer_Element:100 x 0
        rom block ROM_NVBlockDescriptor_BsReten_Odometer: sw-calibration-access=READ-WRITE, type=NV_Data_BsReten_Odometer, init-value=fields=BsReten_Odometer_Element:100 x 0
      NVBlockDescriptor_BsReten_Personalization: nv-block-data-mapping{nv-ram-block-element=autosar-variable-in-impl-datatype={root-variable-data-prototype=RAM_NVBlockDescriptor_BsReten_Personalization, target-data-prototype=BsReten_Personalization_Element}, written-read-nv-data=BsReten_Personalization_Element.Value}
        nv block needs NVNeed_NVBlockDescriptor: n-data-sets=2, ram-block-status-control=API, reliability=NO-PROTECTION, restore-at-start=true, store-at-shutdown=false, store-immediate=true, write-verification=false
        ram block RAM_NVBlockDescriptor_BsReten_Personalization: type=NV_Data_BsReten_Personalization, init-value=fields=BsReten_Personalization_Element:100 x 0
        rom block ROM_NVBlockDescriptor_BsReten_Personalization: sw-calibration-access=READ-WRITE, type=NV_Data_BsReten_Personalization, init-value=fields=BsReten_Personalization_Element:100 x 0
      NVBlockDescriptor_BsReten_Power: nv-block-data-mapping{nv-ram-block-element=autosar-variable-in-impl-datatype={root-variable-data-prototype=RAM_NVBlockDescriptor_BsReten_Power, target-data-prototype=BsReten_Power_Element}, written-read-nv-data=BsReten_Power_Element.Value}
        nv block needs NVNeed_NVBlockDescriptor: n-data-sets=2, ram-block-status-control=API, reliability=NO-PROTECTION, restore-at-start=true, store-at-shutdown=false, store-immediate=true, write-verification=false
        ram block RAM_NVBlockDescriptor_BsReten_Power: type=NV_Data_BsReten_Power, init-value=fields=BsReten_Power_Element:100 x 0
        rom block ROM_NVBlockDescriptor_BsReten_Power: sw-calibration-access=READ-WRITE, type=NV_Data_BsReten_Power, init-value=fields=BsReten_Power_Element:100 x 0
      NVBlockDescriptor_BsReten_RealTimeClock: nv-block-data-mapping{nv-ram-block-element=autosar-variable-in-impl-datatype={root-variable-data-prototype=RAM_NVBlockDescriptor_BsReten_RealTimeClock, target-data-prototype=BsReten_RealTimeClock_Element}, written-read-nv-data=BsReten_RealTimeClock_Element.Value}
        nv block needs NVNeed_NVBlockDescriptor: n-data-sets=2, ram-block-status-control=API, reliability=NO-PROTECTION, restore-at-start=true, store-at-shutdown=false, store-immediate=true, write-verification=false
        ram block RAM_NVBlockDescriptor_BsReten_RealTimeClock: type=NV_Data_BsReten_RealTimeClock, init-value=fields=BsReten_RealTimeClock_Element:100 x 0
        rom block ROM_NVBlockDescriptor_BsReten_RealTimeClock: sw-calibration-access=READ-WRITE, type=NV_Data_BsReten_RealTimeClock, init-value=fields=BsReten_RealTimeClock_Element:100 x 0
      NVBlockDescriptor_BsReten_Tripcomputer: nv-block-data-mapping{nv-ram-block-element=autosar-variable-in-impl-datatype={root-variable-data-prototype=RAM_NVBlockDescriptor_BsReten_Tripcomputer, target-data-prototype=BsReten_Tripcomputer_Element}, written-read-nv-data=BsReten_Tripcomputer_Element.Value}
        nv block needs NVNeed_NVBlockDescriptor: n-data-sets=2, ram-block-status-control=API, reliability=NO-PROTECTION, restore-at-start=true, store-at-shutdown=false, store-immediate=true, write-verification=false
        ram block RAM_NVBlockDescriptor_BsReten_Tripcomputer: type=NV_Data_BsReten_Tripcomputer, init-value=fields=BsReten_Tripcomputer_Element:100 x 0
        rom block ROM_NVBlockDescriptor_BsReten_Tripcomputer: sw-calibration-access=READ-WRITE, type=NV_Data_BsReten_Tripcomputer, init-value=fields=BsReten_Tripcomputer_Element:100 x 0
      NVBlockDescriptor_BsReten_VisDlt: nv-block-data-mapping{nv-ram-block-element=autosar-variable-in-impl-datatype={root-variable-data-prototype=RAM_NVBlockDescriptor_BsReten_VisDlt, target-data-prototype=BsReten_VisDlt_Element}, written-read-nv-data=BsReten_VisDlt_Element.Value}
        nv block needs NVNeed_NVBlockDescriptor: n-data-sets=2, ram-block-status-control=API, reliability=NO-PROTECTION, restore-at-start=true, store-at-shutdown=false, store-immediate=true, write-verification=false
        ram block RAM_NVBlockDescriptor_BsReten_VisDlt: type=NV_Data_BsReten_VisDlt, init-value=fields=BsReten_VisDlt_Element:256 x 0
        rom block ROM_NVBlockDescriptor_BsReten_VisDlt: sw-calibration-access=READ-WRITE, type=NV_Data_BsReten_VisDlt, init-value=fields=BsReten_VisDlt_Element:256 x 0
      NVBlockDescriptor_BsReten_Warning: nv-block-data-mapping{nv-ram-block-element=autosar-variable-in-impl-datatype={root-variable-data-prototype=RAM_NVBlockDescriptor_BsReten_Warning, target-data-prototype=BsReten_Warning_Element}, written-read-nv-data=BsReten_Warning_Element.Value}
        nv block needs NVNeed_NVBlockDescriptor: n-data-sets=2, ram-block-status-control=API, reliability=NO-PROTECTION, restore-at-start=true, store-at-shutdown=false, store-immediate=true, write-verification=false
        ram block RAM_NVBlockDescriptor_BsReten_Warning: type=NV_Data_BsReten_Warning, init-value=fields=BsReten_Warning_Element:100 x 0
        rom block ROM_NVBlockDescriptor_BsReten_Warning: sw-calibration-access=READ-WRITE, type=NV_Data_BsReten_Warning, init-value=fields=BsReten_Warning_Element:100 x 0
      NVBlockDescriptor_BsRt_CusDlt: nv-block-data-mapping{nv-ram-block-element=autosar-variable-in-impl-datatype={root-variable-data-prototype=RAM_NVBlockDescriptor_BsRt_CusDlt, target-data-prototype=BsRt_CusDlt_Element}, written-read-nv-data=BsRt_CusDlt_Element.Value}
        nv block needs NVNeed_NVBlockDescriptor: n-data-sets=2, ram-block-status-control=API, reliability=NO-PROTECTION, restore-at-start=true, store-at-shutdown=false, store-immediate=true, write-verification=false
        ram block RAM_NVBlockDescriptor_BsRt_CusDlt: type=NV_Data_BsRt_CusDlt, init-value=fields=BsRt_CusDlt_Element:128 x 0
        rom block ROM_NVBlockDescriptor_BsRt_CusDlt: sw-calibration-access=READ-WRITE, type=NV_Data_BsRt_CusDlt, init-value=fields=BsRt_CusDlt_Element:128 x 0
      NVBlockDescriptor_BsRt_FuelGauge: nv-block-data-mapping{nv-ram-block-element=autosar-variable-in-impl-datatype={root-variable-data-prototype=RAM_NVBlockDescriptor_BsRt_FuelGauge, target-data-prototype=BsRt_FuelGauge_Element}, written-read-nv-data=BsRt_FuelGauge_Element.Value}
        nv block needs NVNeed_NVBlockDescriptor: n-data-sets=2, ram-block-status-control=API, reliability=NO-PROTECTION, restore-at-start=true, store-at-shutdown=false, store-immediate=true, write-verification=false
        ram block RAM_NVBlockDescriptor_BsRt_FuelGauge: type=NV_Data_BsRt_FuelGauge, init-value=fields=BsRt_FuelGauge_Element:32 x 0
        rom block ROM_NVBlockDescriptor_BsRt_FuelGauge: sw-calibration-access=READ-WRITE, type=NV_Data_BsRt_FuelGauge, init-value=fields=BsRt_FuelGauge_Element:32 x 0
      NVBlockDescriptor_BsRt_Illumination: nv-block-data-mapping{nv-ram-block-element=autosar-variable-in-impl-datatype={root-variable-data-prototype=RAM_NVBlockDescriptor_BsRt_Illumination, target-data-prototype=BsRt_Illumination_Element}, written-read-nv-data=BsRt_Illumination_Element.Value}
        nv block needs NVNeed_NVBlockDescriptor: n-data-sets=2, ram-block-status-control=API, reliability=NO-PROTECTION, restore-at-start=true, store-at-shutdown=false, store-immediate=true, write-verification=false
        ram block RAM_NVBlockDescriptor_BsRt_Illumination: type=NV_Data_BsRt_Illumination, init-value=fields=BsRt_Illumination_Element:100 x 0
        rom block ROM_NVBlockDescriptor_BsRt_Illumination: sw-calibration-access=READ-WRITE, type=NV_Data_BsRt_Illumination, init-value=fields=BsRt_Illumination_Element:100 x 0
      NVBlockDescriptor_BsRt_Odometer: nv-block-data-mapping{nv-ram-block-element=autosar-variable-in-impl-datatype={root-variable-data-prototype=RAM_NVBlockDescriptor_BsRt_Odometer, target-data-prototype=BsRt_Odometer_Element}, written-read-nv-data=BsRt_Odometer_Element.Value}
        nv block needs NVNeed_NVBlockDescriptor: n-data-sets=2, ram-block-status-control=API, reliability=NO-PROTECTION, restore-at-start=true, store-at-shutdown=false, store-immediate=true, write-verification=false
        ram block RAM_NVBlockDescriptor_BsRt_Odometer: type=NV_Data_BsRt_Odometer, init-value=fields=BsRt_Odometer_Element:128 x 0
        rom block ROM_NVBlockDescriptor_BsRt_Odometer: sw-calibration-access=READ-WRITE, type=NV_Data_BsRt_Odometer, init-value=fields=BsRt_Odometer_Element:128 x 0
      NVBlockDescriptor_BsRt_OilGauge: nv-block-data-mapping{nv-ram-block-element=autosar-variable-in-impl-datatype={root-variable-data-prototype=RAM_NVBlockDescriptor_BsRt_OilGauge, target-data-prototype=BsRt_OilGauge_Element}, written-read-nv-data=BsRt_OilGauge_Element.Value}
        nv block needs NVNeed_NVBlockDescriptor: n-data-sets=2, ram-block-status-control=API, reliability=NO-PROTECTION, restore-at-start=true, store-at-shutdown=false, store-immediate=true, write-verification=false
        ram block RAM_NVBlockDescriptor_BsRt_OilGauge: type=NV_Data_BsRt_OilGauge, init-value=fields=BsRt_OilGauge_Element:8 x 0
        rom block ROM_NVBlockDescriptor_BsRt_OilGauge: sw-calibration-access=READ-WRITE, type=NV_Data_BsRt_OilGauge, init-value=fields=BsRt_OilGauge_Element:8 x 0
      NVBlockDescriptor_BsRt_Personalization: nv-block-data-mapping{nv-ram-block-element=autosar-variable-in-impl-datatype={root-variable-data-prototype=RAM_NVBlockDescriptor_BsRt_Personalization, target-data-prototype=BsRt_Personalization_Element}, written-read-nv-data=BsRt_Personalization_Element.Value}
        nv block needs NVNeed_NVBlockDescriptor: n-data-sets=2, ram-block-status-control=API, reliability=NO-PROTECTION, restore-at-start=true, store-at-shutdown=false, store-immediate=true, write-verification=false
        ram block RAM_NVBlockDescriptor_BsRt_Personalization: type=NV_Data_BsRt_Personalization, init-value=fields=BsRt_Personalization_Element:128 x 0
        rom block ROM_NVBlockDescriptor_BsRt_Personalization: sw-calibration-access=READ-WRITE, type=NV_Data_BsRt_Personalization, init-value=fields=BsRt_Personalization_Element:128 x 0
      NVBlockDescriptor_BsRt_PowerGauge: nv-block-data-mapping{nv-ram-block-element=autosar-variable-in-impl-datatype={root-variable-data-prototype=RAM_NVBlockDescriptor_BsRt_PowerGauge, target-data-prototype=BsRt_PowerGauge_Element}, written-read-nv-data=BsRt_PowerGauge_Element.Value}
        nv block needs NVNeed_NVBlockDescriptor: n-data-sets=2, ram-block-status-control=API, reliability=NO-PROTECTION, restore-at-start=true, store-at-shutdown=false, store-immediate=true, write-verification=false
        ram block RAM_NVBlockDescriptor_BsRt_PowerGauge: type=NV_Data_BsRt_PowerGauge, init-value=fields=BsRt_PowerGauge_Element:32 x 0
        rom block ROM_NVBlockDescriptor_BsRt_PowerGauge: sw-calibration-access=READ-WRITE, type=NV_Data_BsRt_PowerGauge, init-value=fields=BsRt_PowerGauge_Element:32 x 0
      NVBlockDescriptor_BsRt_RealTimeClock: nv-block-data-mapping{nv-ram-block-element=autosar-variable-in-impl-datatype={root-variable-data-prototype=RAM_NVBlockDescriptor_BsRt_RealTimeClock, target-data-prototype=BsRt_RealTimeClock_Element}, written-read-nv-data=BsRt_RealTimeClock_Element.Value}
        nv block needs NVNeed_NVBlockDescriptor: n-data-sets=2, ram-block-status-control=API, reliability=NO-PROTECTION, restore-at-start=true, store-at-shutdown=false, store-immediate=true, write-verification=false
        ram block RAM_NVBlockDescriptor_BsRt_RealTimeClock: type=NV_Data_BsRt_RealTimeClock, init-value=fields=BsRt_RealTimeClock_Element:48 x 0
        rom block ROM_NVBlockDescriptor_BsRt_RealTimeClock: sw-calibration-access=READ-WRITE, type=NV_Data_BsRt_RealTimeClock, init-value=fields=BsRt_RealTimeClock_Element:48 x 0
      NVBlockDescriptor_BsRt_SpeedoGauge: nv-block-data-mapping{nv-ram-block-element=autosar-variable-in-impl-datatype={root-variable-data-prototype=RAM_NVBlockDescriptor_BsRt_SpeedoGauge, target-data-prototype=BsRt_SpeedoGauge_Element}, written-read-nv-data=BsRt_SpeedoGauge_Element.Value}
        nv block needs NVNeed_NVBlockDescriptor: n-data-sets=2, ram-block-status-control=API, reliability=NO-PROTECTION, restore-at-start=true, store-at-shutdown=false, store-immediate=true, write-verification=false
        ram block RAM_NVBlockDescriptor_BsRt_SpeedoGauge: type=NV_Data_BsRt_SpeedoGauge, init-value=fields=BsRt_SpeedoGauge_Element:8 x 0
        rom block ROM_NVBlockDescriptor_BsRt_SpeedoGauge: sw-calibration-access=READ-WRITE, type=NV_Data_BsRt_SpeedoGauge, init-value=fields=BsRt_SpeedoGauge_Element:8 x 0
      NVBlockDescriptor_BsRt_TachoGauge: nv-block-data-mapping{nv-ram-block-element=autosar-variable-in-impl-datatype={root-variable-data-prototype=RAM_NVBlockDescriptor_BsRt_TachoGauge, target-data-prototype=BsRt_TachoGauge_Element}, written-read-nv-data=BsRt_TachoGauge_Element.Value}
        nv block needs NVNeed_NVBlockDescriptor: n-data-sets=2, ram-block-status-control=API, reliability=NO-PROTECTION, restore-at-start=true, store-at-shutdown=false, store-immediate=true, write-verification=false
        ram block RAM_NVBlockDescriptor_BsRt_TachoGauge: type=NV_Data_BsRt_TachoGauge, init-value=fields=BsRt_TachoGauge_Element:16 x 0
        rom block ROM_NVBlockDescriptor_BsRt_TachoGauge: sw-calibration-access=READ-WRITE, type=NV_Data_BsRt_TachoGauge, init-value=fields=BsRt_TachoGauge_Element:16 x 0
      NVBlockDescriptor_BsRt_TempGauge: nv-block-data-mapping{nv-ram-block-element=autosar-variable-in-impl-datatype={root-variable-data-prototype=RAM_NVBlockDescriptor_BsRt_TempGauge, target-data-prototype=BsRt_TempGauge_Element}, written-read-nv-data=BsRt_TempGauge_Element.Value}
        nv block needs NVNeed_NVBlockDescriptor: n-data-sets=2, ram-block-status-control=API, reliability=NO-PROTECTION, restore-at-start=true, store-at-shutdown=false, store-immediate=true, write-verification=false
        ram block RAM_NVBlockDescriptor_BsRt_TempGauge: type=NV_Data_BsRt_TempGauge, init-value=fields=BsRt_TempGauge_Element:32 x 0
        rom block ROM_NVBlockDescriptor_BsRt_TempGauge: sw-calibration-access=READ-WRITE, type=NV_Data_BsRt_TempGauge, init-value=fields=BsRt_TempGauge_Element:32 x 0
      NVBlockDescriptor_BsRt_TripComputer: nv-block-data-mapping{nv-ram-block-element=autosar-variable-in-impl-datatype={root-variable-data-prototype=RAM_NVBlockDescriptor_BsRt_TripComputer, target-data-prototype=BsRt_TripComputer_Element}, written-read-nv-data=BsRt_TripComputer_Element.Value}
        nv block needs NVNeed_NVBlockDescriptor: n-data-sets=2, ram-block-status-control=API, reliability=NO-PROTECTION, restore-at-start=true, store-at-shutdown=false, store-immediate=true, write-verification=false
        ram block RAM_NVBlockDescriptor_BsRt_TripComputer: type=NV_Data_BsRt_TripComputer, init-value=fields=BsRt_TripComputer_Element:64 x 0
        rom block ROM_NVBlockDescriptor_BsRt_TripComputer: sw-calibration-access=READ-WRITE, type=NV_Data_BsRt_TripComputer, init-value=fields=BsRt_TripComputer_Element:64 x 0
      NVBlockDescriptor_BsRt_Warning: nv-block-data-mapping{nv-ram-block-element=autosar-variable-in-impl-datatype={root-variable-data-prototype=RAM_NVBlockDescriptor_BsRt_Warning, target-data-prototype=BsRt_Warning_Element}, written-read-nv-data=BsRt_Warning_Element.Value}
        nv block needs NVNeed_NVBlockDescriptor: n-data-sets=2, ram-block-status-control=API, reliability=NO-PROTECTION, restore-at-start=true, store-at-shutdown=false, store-immediate=true, write-verification=false
        ram block RAM_NVBlockDescriptor_BsRt_Warning: type=NV_Data_BsRt_Warning, init-value=fields=BsRt_Warning_Element:32 x 0
        rom block ROM_NVBlockDescriptor_BsRt_Warning: sw-calibration-access=READ-WRITE, type=NV_Data_BsRt_Warning, init-value=fields=BsRt_Warning_Element:32 x 0
      NVBlockDescriptor_BsShare_EcuPartNumber: nv-block-data-mapping{nv-ram-block-element=autosar-variable-in-impl-datatype={root-variable-data-prototype=RAM_NVBlockDescriptor_BsShare_EcuPartNumber, target-data-prototype=BsShare_EcuPartNumber_Element}, written-read-nv-data=BsShare_EcuPartNumber_Element.Value}
        nv block needs NVNeed_NVBlockDescriptor: n-data-sets=2, ram-block-status-control=API, reliability=NO-PROTECTION, restore-at-start=true, store-at-shutdown=false, store-immediate=true, write-verification=false
        ram block RAM_NVBlockDescriptor_BsShare_EcuPartNumber: type=NV_Data_BsShare_EcuPartNumber, init-value=fields=BsShare_EcuPartNumber_Element:128 x 0
        rom block ROM_NVBlockDescriptor_BsShare_EcuPartNumber: sw-calibration-access=READ-WRITE, type=NV_Data_BsShare_EcuPartNumber, init-value=fields=BsShare_EcuPartNumber_Element:128 x 0
      NVBlockDescriptor_BsShare_SwUpdFotaFinPrint: nv-block-data-mapping{nv-ram-block-element=autosar-variable-in-impl-datatype={root-variable-data-prototype=RAM_NVBlockDescriptor_BsShare_SwUpdFotaFinPrint, target-data-prototype=BsShare_SwUpdFotaFinPrint_Element}, written-read-nv-data=BsShare_SwUpdFotaFinPrint_Element.Value}
        nv block needs NVNeed_NVBlockDescriptor: n-data-sets=2, ram-block-status-control=API, reliability=NO-PROTECTION, restore-at-start=true, store-at-shutdown=false, store-immediate=true, write-verification=false
        ram block RAM_NVBlockDescriptor_BsShare_SwUpdFotaFinPrint: type=NV_Data_BsShare_SwUpdFotaFinPrint, init-value=fields=BsShare_SwUpdFotaFinPrint_Element:32 x 0
        rom block ROM_NVBlockDescriptor_BsShare_SwUpdFotaFinPrint: sw-calibration-access=READ-WRITE, type=NV_Data_BsShare_SwUpdFotaFinPrint, init-value=fields=BsShare_SwUpdFotaFinPrint_Element:32 x 0
      NVBlockDescriptor_BsShare_SwUpdFotaMode: nv-block-data-mapping{nv-ram-block-element=autosar-variable-in-impl-datatype={root-variable-data-prototype=RAM_NVBlockDescriptor_BsShare_SwUpdFotaMode, target-data-prototype=BsShare_SwUpdFotaMode_Element}, written-read-nv-data=BsShare_SwUpdFotaMode_Element.Value}
        nv block needs NVNeed_NVBlockDescriptor: n-data-sets=2, ram-block-status-control=API, reliability=NO-PROTECTION, restore-at-start=true, store-at-shutdown=false, store-immediate=true, write-verification=false
        ram block RAM_NVBlockDescriptor_BsShare_SwUpdFotaMode: type=NV_Data_BsShare_SwUpdFotaMode, init-value=fields=BsShare_SwUpdFotaMode_Element:16 x 0
        rom block ROM_NVBlockDescriptor_BsShare_SwUpdFotaMode: sw-calibration-access=READ-WRITE, type=NV_Data_BsShare_SwUpdFotaMode, init-value=fields=BsShare_SwUpdFotaMode_Element:16 x 0
      NVBlockDescriptor_BsShare_SwUpdFotaStatus: nv-block-data-mapping{nv-ram-block-element=autosar-variable-in-impl-datatype={root-variable-data-prototype=RAM_NVBlockDescriptor_BsShare_SwUpdFotaStatus, target-data-prototype=BsShare_SwUpdFotaStatus_Element}, written-read-nv-data=BsShare_SwUpdFotaStatus_Element.Value}
        nv block needs NVNeed_NVBlockDescriptor: n-data-sets=2, ram-block-status-control=API, reliability=NO-PROTECTION, restore-at-start=true, store-at-shutdown=false, store-immediate=true, write-verification=false
        ram block RAM_NVBlockDescriptor_BsShare_SwUpdFotaStatus: type=NV_Data_BsShare_SwUpdFotaStatus, init-value=fields=BsShare_SwUpdFotaStatus_Element:48 x 0
        rom block ROM_NVBlockDescriptor_BsShare_SwUpdFotaStatus: sw-calibration-access=READ-WRITE, type=NV_Data_BsShare_SwUpdFotaStatus, init-value=fields=BsShare_SwUpdFotaStatus_Element:48 x 0
      NVBlockDescriptor_BsShare_SwUpdFotadecrypt: nv-block-data-mapping{nv-ram-block-element=autosar-variable-in-impl-datatype={root-variable-data-prototype=RAM_NVBlockDescriptor_BsShare_SwUpdFotadecrypt, target-data-prototype=BsShare_SwUpdFotadecrypt_Element}, written-read-nv-data=BsShare_SwUpdFotadecrypt_Element.Value}
        nv block needs NVNeed_NVBlockDescriptor: n-data-sets=2, ram-block-status-control=API, reliability=NO-PROTECTION, restore-at-start=true, store-at-shutdown=false, store-immediate=true, write-verification=false
        ram block RAM_NVBlockDescriptor_BsShare_SwUpdFotadecrypt: type=NV_Data_BsShare_SwUpdFotadecrypt, init-value=fields=BsShare_SwUpdFotadecrypt_Element:64 x 0
        rom block ROM_NVBlockDescriptor_BsShare_SwUpdFotadecrypt: sw-calibration-access=READ-WRITE, type=NV_Data_BsShare_SwUpdFotadecrypt, init-value=fields=BsShare_SwUpdFotadecrypt_Element:64 x 0
      NVBlockDescriptor_BsShare_SwUpdReflash: nv-block-data-mapping{nv-ram-block-element=autosar-variable-in-impl-datatype={root-variable-data-prototype=RAM_NVBlockDescriptor_BsShare_SwUpdReflash, target-data-prototype=BsShare_SwUpdReflash_Element}, written-read-nv-data=BsShare_SwUpdReflash_Element.Value}
        nv block needs NVNeed_NVBlockDescriptor: n-data-sets=2, ram-block-status-control=API, reliability=NO-PROTECTION, restore-at-start=true, store-at-shutdown=false, store-immediate=true, write-verification=false
        ram block RAM_NVBlockDescriptor_BsShare_SwUpdReflash: type=NV_Data_BsShare_SwUpdReflash, init-value=fields=BsShare_SwUpdReflash_Element:8 x 0
        rom block ROM_NVBlockDescriptor_BsShare_SwUpdReflash: sw-calibration-access=READ-WRITE, type=NV_Data_BsShare_SwUpdReflash, init-value=fields=BsShare_SwUpdReflash_Element:8 x 0
      NVBlockDescriptor_BsShare_VehicleConfig: nv-block-data-mapping{nv-ram-block-element=autosar-variable-in-impl-datatype={root-variable-data-prototype=RAM_NVBlockDescriptor_BsShare_VehicleConfig, target-data-prototype=BsShare_VehicleConfig_Element}, written-read-nv-data=BsShare_VehicleConfig_Element.Value}
        nv block needs NVNeed_NVBlockDescriptor: n-data-sets=2, ram-block-status-control=API, reliability=NO-PROTECTION, restore-at-start=true, store-at-shutdown=false, store-immediate=true, write-verification=false
        ram block RAM_NVBlockDescriptor_BsShare_VehicleConfig: type=NV_Data_BsShare_VehicleConfig, init-value=fields=BsShare_VehicleConfig_Element:256 x 0
        rom block ROM_NVBlockDescriptor_BsShare_VehicleConfig: sw-calibration-access=READ-WRITE, type=NV_Data_BsShare_VehicleConfig, init-value=fields=BsShare_VehicleConfig_Element:256 x 0
      NVBlockDescriptor_BsShare_VisMeet: nv-block-data-mapping{nv-ram-block-element=autosar-variable-in-impl-datatype={root-variable-data-prototype=RAM_NVBlockDescriptor_BsShare_VisMeet, target-data-prototype=BsShare_VisMeet_Element}, written-read-nv-data=BsShare_VisMeet_Element.Value}
        nv block needs NVNeed_NVBlockDescriptor: n-data-sets=2, ram-block-status-control=API, reliability=NO-PROTECTION, restore-at-start=true, store-at-shutdown=false, store-immediate=true, write-verification=false
        ram block RAM_NVBlockDescriptor_BsShare_VisMeet: type=NV_Data_BsShare_VisMeet, init-value=fields=BsShare_VisMeet_Element:48 x 0
        rom block ROM_NVBlockDescriptor_BsShare_VisMeet: sw-calibration-access=READ-WRITE, type=NV_Data_BsShare_VisMeet, init-value=fields=BsShare_VisMeet_Element:48 x 0
      NVBlockDescriptor_RefCys_Certicificate: nv-block-data-mapping{nv-ram-block-element=autosar-variable-in-impl-datatype={root-variable-data-prototype=RAM_NVBlockDescriptor_RefCys_Certicificate, target-data-prototype=RefCys_Certicificate_Element}, written-read-nv-data=RefCys_Certicificate_Element.Value}
        nv block needs NVNeed_NVBlockDescriptor: n-data-sets=2, ram-block-status-control=API, reliability=NO-PROTECTION, restore-at-start=true, store-at-shutdown=false, store-immediate=true, write-verification=false
        ram block RAM_NVBlockDescriptor_RefCys_Certicificate: type=NV_Data_RefCys_Certicificate, init-value=fields=RefCys_Certicificate_Element:64 x 0
        rom block ROM_NVBlockDescriptor_RefCys_Certicificate: sw-calibration-access=READ-WRITE, type=NV_Data_RefCys_Certicificate, init-value=fields=RefCys_Certicificate_Element:64 x 0
      NVBlockDescriptor_RefCys_Certicificate1: nv-block-data-mapping{nv-ram-block-element=autosar-variable-in-impl-datatype={root-variable-data-prototype=RAM_NVBlockDescriptor_RefCys_Certicificate1, target-data-prototype=RefCys_Certicificate1_Element}, written-read-nv-data=RefCys_Certicificate1_Element.Value}
        nv block needs NVNeed_NVBlockDescriptor: n-data-sets=2, ram-block-status-control=API, reliability=NO-PROTECTION, restore-at-start=true, store-at-shutdown=false, store-immediate=true, write-verification=false
        ram block RAM_NVBlockDescriptor_RefCys_Certicificate1: type=NV_Data_RefCys_Certicificate1, init-value=fields=RefCys_Certicificate1_Element:64 x 0
        rom block ROM_NVBlockDescriptor_RefCys_Certicificate1: sw-calibration-access=READ-WRITE, type=NV_Data_RefCys_Certicificate1, init-value=fields=RefCys_Certicificate1_Element:64 x 0
  swc implementation NvBlockSwComponentType_Implementation: behavior=NvBlockSwComponentType_InternalBehavior
    code-descriptors:
      code Default: artifact-descriptors=autosar-engineering-object=category=SWSRC
