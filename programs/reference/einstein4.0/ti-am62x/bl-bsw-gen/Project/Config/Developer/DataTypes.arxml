AUTOSAR XML (schema 00044)
standard types defined: uint8, uint16, uint32, sint32, boolean, UInt16, UInt32, Boolean, SInt32, UInt8, uint64, sint8, sint16, sint64, float32, float64
package /MICROSAR/ComM_swc
  data type mapping set ComMMode_DataTypeMappingSet: mode-request-type-map{implementation-data-type=ComM_ModeType, mode-group=ComMMode}  # Data Mapping for the Mode Declaration Group ComMMode.
package /MICROSAR/ComM_swc/DataTypes
  4 x impl type, all with category=TYPE_REFERENCE, implementation-data-type=uint8:
    ComM_InhibitionStatusType: range raw 0..255
    ComM_ModeType: compu {0=COMM_NO_COMMUNICATION, 1=COMM_SILENT_COMMUNICATION, 2=COMM_FULL_COMMUNICATION}, range raw 0..3
    ComM_UserHandleType: range raw 0..255
    NetworkHandleType: range raw 0..255, type-emitter=ComM
package /MICROSAR/EcuM_swc
  data type mapping set EcuMMode_DataTypeMappingSet: mode-request-type-map{implementation-data-type=EcuM_StateType, mode-group=EcuM_Mode}  # Data Mapping for the Mode Declaration Group EcuMMode.
package /MICROSAR/EcuM_swc/DataTypes
  6 x impl type, all with category=TYPE_REFERENCE:
    EcuM_UserType: compu {0=EcuMConf_EcuMFixedUserConfig_EcuMUserConfig_CTRL_App}, range raw 0..255, implementation-data-type=uint8  # Unique value for each user
    EcuM_StateType: compu {80=ECUM_STATE_SLEEP, 128=ECUM_STATE_OFF, 144=ECUM_STATE_RESET}, range raw 0..144, implementation-data-type=uint8
    EcuM_ModeType: compu {2=EcuMConf_EcuMResetMode_ECUM_RESET_IO, 0=EcuMConf_EcuMResetMode_ECUM_RESET_MCU, 3=EcuMConf_EcuMResetMode_ECUM_RESET_WAKEUP, 1=EcuMConf_EcuMResetMode_ECUM_RESET_WDG}, range raw 0..3, implementation-data-type=uint8  # ECU State Manager states.
    EcuM_TimeType: range raw 0..4294967295, implementation-data-type=uint32
    EcuM_ShutdownCauseType: compu {0=EcuMConf_EcuMShutdownCause_ECUM_CAUSE_UNKNOWN, 3=EcuMConf_EcuMShutdownCause_ECUM_CAUSE_DCM, 1=EcuMConf_EcuMShutdownCause_ECUM_CAUSE_ECU_STATE, 2=EcuMConf_EcuMShutdownCause_ECUM_CAUSE_WDGM}, range raw 0..3, implementation-data-type=uint8  # This type describes the cause for a shutdown by the ECU State Manager. It can be extended by configuration.
    EcuM_BootTargetType: compu {0=ECUM_BOOT_TARGET_APP, 1=ECUM_BOOT_TARGET_OEM_BOOTLOADER, 2=ECUM_BOOT_TARGET_SYS_BOOTLOADER}, range raw 0..2, implementation-data-type=uint8  # This type represents the boot targets the ECU Manager module can be configured with. The default boot target is ECUM_BOOT_TARGET_OEM_BOOTLOADER.
package /MICROSAR/BswM_swc
  data type mapping set BswMMappingSet  # Contains Mapping for ModeDeclarations Groups which are provided by BswM.
    mode-request-type-maps:
      implementation-data-type=uint8, mode-group=EcuM_Mode
      implementation-data-type=uint8, mode-group=MDG_SfdAModes
      implementation-data-type=SfdA_RequestRoleType, mode-group=MDG_SfdARoles
      implementation-data-type=BswM_MDG_Sfd_NvmBlockStatus, mode-group=MDG_Sfd_NvmBlockStatus
package /MICROSAR/BswM_swc/DataTypes
  impl type BswM_MDG_Sfd_NvmBlockStatus: compu {1=SFD_BLOCKS_INITIALIZED, 0=SFD_BLOCKS_NOT_INITIALIZED}, range raw 0..255, implementation-data-type=uint8  # Unique value for each user
package /E40_Platform_System_SystemPackage/Types
  30 x impl type:
    EDisplayType: category=VALUE, base-type=DataTypes/uint8, compu {0=e_Display10Inch, 1=e_DisplayMaxDevice}, range raw 0..1
    EDisplayPowerState: category=VALUE, base-type=DataTypes/uint8, compu {0=eDisplayIdle, 1=eDisplayPowerON, 2=eDisplayNormal, 3=eDisplayPowerOFF, 4=eDisplayFault_Handle, 5=eDisplayMaxPowerState}, range raw 0..5
    EDeviceStatus: category=VALUE, base-type=DataTypes/uint8, compu {0=eDeviceNotReady, 1=eDeviceInitialized, 2=eDeviceReady, 3=eDeviceBusy, 4=eDeviceFault, 5=eDeviceMaxState}, range raw 0..5
    ECmpCmd: category=VALUE, base-type=DataTypes/uint8, compu {0=eCmpCmd_Init, 1=eCmpCmd_DeInit, 2=eCmpCmd_Activate, 3=eCmpCmd_DeActivate}, range raw 0..3
    IoHwAb_DOutGroupIdType: category=VALUE, base-type=DataTypes/sint32, compu {0=eIO_DOutGroupIdCount}, range raw -2147483647..2147483647
    IoHwAb_ErrorType: category=VALUE, base-type=DataTypes/uint8, compu {2=E_NO_ERROR, 3=E_ERROR, 4=E_ADC_ERROR, 5=E_DOUT_ID_INVALID, 6=E_DIN_ID_INVALID, 7=E_ADC_ID_INVALID, 8=IOHWAB_E_ADC_ERROR, 9=IOHWAB_E_ADC_ID_INVALID, 10=IOHWAB_E_ERROR, 11=IOHWAB_E_DOUT_ID_INVALID, 12=IOHWAB_E_NO_ERROR, 13=IOHWAB_E_DIN_ID_INVALID}, range raw 2..13
    IoHwAb_DOutSignalIdType:
      category=VALUE
      base-type=DataTypes/uint8
      compu {0=eIO_DOUT_DO_5VSW2_3V3_EN, 1=eIO_DOUT_PARK_BRAKE_TT_OUT, 2=eIO_DOUT_DO_SYC1, 3=eIO_DOUT_SEAT_BELT_TT_MCUOUT, 4=eIO_DOUT_TURN_LEFT_TT_MCUOUT, 5=eIO_DOUT_DO_LCD_BL_PWR_EN, 6=eIO_DOUT_DO_3V3_DISP_SW_EN, 7=eIO_DOUT_AMP_SHTD, 8=eIO_DOUT_FUEL_RHEO_SUP_EN, 9=eIO_DOUT_DO_LCD_STBYB, 10=eIO_DOUT_SBATT2_EN, 11=eIO_DOUT_BRAKE_TT_MCUOUT, 12=eIO_DOUT_AIRBAG_TT_MCUOUT, 13=eIO_DOUT_TURN_RIGHT_TT_MCUOUT, 14=eIO_DOUT_DO_SMPS_5V_SW_EN, 15=eIO_DOUT_PCS_OFF_TT_MCUOUT, 16=eIO_DOUT_ABS_TT_MCUOUT, 17=eIO_DOUT_SLIP_TT_MCUOUT, 18=eIO_DOUT_VCS_OFF_TT_MCUOUT, 19=eIO_DOUT_ECB_EPB_TT_MCUOUT, 20=eIO_DOUT_Flasher_FL_RL_OUT, 21=eIO_DOUT_Flasher_DEN1, 22=eIO_DOUT_Flasher_DSEL1, 23=eIO_DOUT_Flasher_FR_RR_OUT, 24=eIO_DOUT_DO_LCD_RST, 25=eIO_DOUT_DO_SMPS_1V2_EN, 26=eIO_DO_MAX, 27=eIO_DOUT_DO_DISP_RESET, 28=eIO_DOUT_DO_DISP_STBY, 29=eIO_DOUT_DO_TFT_BL_EN, 30=eIO_DOUT_DO_PWM_DIMMING, 31=eIO_DOUT_DO_RTC_INTN, 32=eIO_DOUT_DO_SOC_PWR_LATCH, 33=eIO_DOUT_DO_1V2_EN, 34=eIO_DOUT_DO_EN_5V, 35=eIO_DOUT_DO_ENET_EN, 36=eIO_DOUT_DO_LIN_NSLP}
      range raw 0..36
    IoHwAb_DInSignalIdType:
      category=VALUE
      base-type=DataTypes/uint8
      compu {0=eIO_DIN_DI_AL_HAZARD, 1=eIO_DIN_DI_AH_IGNITION, 2=eIO_DIN_DI_SMPS_3V3_PG, 3=eIO_DIN_STOP_LAMP_MCU, 4=eIO_DIN_DI_AL_BRAKE_LEVEL, 5=eIO_DIN_DI_AL_OIL_W, 6=eIO_DIN_DI_AL_DRV_SEAT_BUCKLE, 7=eIO_DIN_DI_AL_WASHER_LEVEL_SW, 8=eIO_DIN_ODO_TripKnobInput, 9=eIO_DIN_DI_AL_VACUUM, 10=eIO_DIN_DI_LCD_BL_PWR_FAULT, 11=eIO_DIN_DI_AL_FUEL_LID_EFI_ECU, 12=eIO_DIN_DI_TT_SHIFT_ERR, 13=eIO_DIN_MAX, 14=eIO_DIN_DI_PMIC_INTN, 15=eIO_DIN_DI_MCU_PORZ}
      range raw 0..15
    IoHwAb_DInGroupIdType: category=VALUE, base-type=DataTypes/sint32, compu {0=eIO_DInGroupIdCount}, range raw -2147483647..2147483647
    IoHwAb_PwmSignalIdType: category=VALUE, base-type=DataTypes/uint8, compu {0=eIO_PWM_MCU_BUZZER_AMPLCTRL, 1=eIO_PWM_HIGH_BEAM_TT_MCUOUT, 2=eIO_PWM_FUEL_TEMP_GAUG_TEXT_PWM_OUT, 3=eIO_PWM_PWM_OUT_ILL2, 4=eIO_PWM_PWM_OUT_ILL1, 5=eIO_PWM_BG_Dimming_PWM, 6=eIO_PWM_PWM_GREEN_TT_DIMMING, 7=eIO_PWM_CXPI_CLK, 8=eIO_PWM_PWM_LCD_BL_DIMMING, 9=eIO_PWM_MAX}, range raw 0..9
    IoHwAb_AdcSignalIdType:
      category=VALUE
      base-type=DataTypes/uint8
      compu {16=eIO_ADC_ADC_FUEL_5V_MON, 17=eIO_ADC_ADC_FUEL_MAIN, 2=eIO_ADC_IGN_AD, 3=eIO_ADC_FUEL_SEND_SUB_MICRO_AD, 4=eIO_ADC_AI_BATTERY, 5=eIO_ADC_AI_LCD_NTC, 6=eIO_ADC_AI_TEMP_RTC, 7=eIO_ADC_Flasher_Diag_sense_1, 8=eIO_ADC_STR_SW2_ADIN, 9=eIO_ADC_STR_SW1_ADIN, 10=eIO_ADC_RHEO_SW_IN_ADIN, 11=eIO_ADC_ADC_RHEO_5V_MON_ADIN, 12=eIO_ADC_Flasher_Diag_sense_2, 13=eIO_ADC_AdcChannel_Vdb, 14=eIO_ADC_AdcChannel_Vtemp, 15=eIO_ADC_MAX, 0=eIO_ADC_AI_SAMPLE_1, 1=eIO_ADC_AI_SAMPLE_2}
      range raw 0..17
    eIOPulseInputId: category=VALUE, base-type=DataTypes/sint32, compu {0=eIOPulseInputIdCount}, range raw -2147483647..2147483647
    EGammaCorrectionStatus: category=VALUE, base-type=DataTypes/uint8, compu {0=eDisplayCdd_GammaCorrection_None, 1=eDisplayCdd_GammaCorrection_OnGoing, 2=eDisplayCdd_GammaCorrection_Success, 3=eDisplayCdd_GammaCorrection_Failure}, range raw 0..3
    EDisplayCddStatus: category=VALUE, base-type=DataTypes/uint8, compu {0=eDisplayNotReady, 1=eDisplayReady, 2=eDisplayBusy, 3=eDisplayFaultHandle, 4=eDisplayMaxStatus}, range raw 0..4
    Nvm_U8ArrType_3: category=ARRAY
      element ArrayElement: category=VALUE, array-size=3, array-size-semantics=FIXED-SIZE, base-type=DataTypes/uint8
    NvM_BlockIdType: category=VALUE, base-type=DataTypes/uint16, range raw 0..65535
    NvM_RequestResultType: category=VALUE, base-type=DataTypes/uint8, range raw 0..255
    HTimer:
      category=VALUE
      base-type=DataTypes/uint8
      compu {0=eWarningMask_Timerhandle, 1=eOWC_Timerhandle, 2=eNWD_Timerhandle, 3=eWarningBulbCheckMask_Timerhandle, 4=eInitWarning_TimerHandle, 5=eInitChimeTimerHandle, 6=eProgrammingTimerHandle, 7=eStubCounter_TimerHanlde, 8=eModeMgrDisplayPowerDownUp, 9=eModeMgrDisplayFaultAction, 10=eModeMgrDomanResetAction, 11=eModeMgrPowerFaultAction, 12=eEtm4SecTimer, 13=eEtm1200msecTimer, 14=eEtm3SecTimer, 15=eCallbackTimerOdoMdl, 16=eThrottleTimerOdoMdl, 17=eChangeupCallbackTimerodoMdl, 18=eTimerVehicleState, 19=eTimerVariantConfig, 20=WARNING_DISPLAY_TIMER_ID, 21=WARNING_HOLD_TIMER_ID, 22=WARNING_CYCLE_TIMER_ID, 23=WARNING_DISPLAYHOLD_TIMER_ID, 24=WARNING_ACK_TIMER_ID, 25=eTimerHandle_Sleep, 26=eInStartCount_TimerHandle, 27=eVehicleModeCount_TimerHandle, 28=e10secTimer, 29=e3secTimer, 30=e30secTimer, 31=e2_6secTimer, 32=eDcmApp5secTimer, 33=eDcmApp1secTimer, 34=eLidopen_OFFTimer, 35=eLidopen_ONTimer, 36=POPUP_DISPLAY_TIMER_ID, 37=POPUP_GRP_TAB_TIMER_ID, 38=eDrvRec5_6Timer, 39=eDrvRec3_6Timer, 40=eIDS_1SecTimer, 41=eIDS3_1SecTimer, 42=eIDS_3SecTimer, 43=ePerDispSet100msTimer, 44=eDrvRec1_2secTimer, 45=eDrvRec0_8secTimer, 46=eHMI_Initial_Blank_timer_ID, 47=eHMI_Fade_in_delay_timer_ID, 48=eKM6secTimer, 49=eKM5_8secTimer, 50=eKM0_6secTimer, 51=eKM0_2secTimer, 52=eIgnCANMode_3SecTimer, 53=eDem2_6secTimer, 54=eDem5secTimer, 55=e2FRheo5secTimer, 56=e2FSTSW5secTimer, 57=eLSTM3_Timer, 58=eLSTM4_Timer, 59=eDem_AFS_5sec_Timer, 60=WARNING_MSGTIMEOUT_1SEC_TIMER_ID, 61=eDCMApp_30Sec_Timer, 62=WRN_ACK_REDISPLAY_TIMER_ID, 63=eMenuScrollStart1sTimer, 64=eType4_6secTimer, 65=eDcmApp_0_35secTimer, 66=eDcmApp_0_35_1secTimer, 67=eRemoteCarFindCtrlStateTimer, 68=eBrake_Red_100msecTimer, 69=eStreeingSw_ReleaseTimer, 70=POPUP_SETTING_TIMER_ID, 71=eMenu100msTimer, 72=eBuzzerMiddleEast_6secs, 73=eBuzzerMiddleEast_6secs_2, 74=eMaxNumof16BitTimers, 75=eSleepMaxTimer, 76=eRentACarTimer, 77=eDoorWarn_Timer, 78=eSample32BitTimer, 79=eTimerMax}
      range raw 0..79
    SPulseInputConfigParam: category=STRUCTURE
      16 x element, all with category=TYPE_REFERENCE:
        MissingRecoveryTimeoutInMicroSec: implementation-data-type=UInt32
        ValidPeriodMinInMicroSec: implementation-data-type=UInt32
        ValidPeriodMaxInMicroSec: implementation-data-type=UInt32
        HystLimitForPeriodMinInMicroSec: implementation-data-type=UInt32
        HystRcvryForPeriodMinInMicroSec: implementation-data-type=UInt32
        HystLimitForPeriodMaxInMicroSec: implementation-data-type=UInt32
        HystRcvryForPeriodMaxInMicroSec: implementation-data-type=UInt32
        ValidDutyMinInPercentage: implementation-data-type=UInt16
        ValidDutyMaxInPercentage: implementation-data-type=UInt16
        HystLimitForDutyMinInPercentage: implementation-data-type=UInt16
        HystRcvryForDutyMinInPercentage: implementation-data-type=UInt16
        HystLimitForDutyMaxInPercentage: implementation-data-type=UInt16
        HystRcvryForDutyMaxInPercentage: implementation-data-type=UInt16
        InValidTimeoutInMilliSec: implementation-data-type=UInt16
        InValidRecoveryTimeoutInMilliSec: implementation-data-type=UInt16
        MissingTimeoutInMilliSec: implementation-data-type=UInt16
    SSpeedCalcParam: category=STRUCTURE
      element Pulses_Per_Revolution: implementation-data-type=UInt32
      element Revolutions_Per_Unit: implementation-data-type=UInt32
      element Tuning_Factor: implementation-data-type=UInt32
    Arr_u8_8: category=ARRAY
      element ArrayElement: category=VALUE, array-size=8, array-size-semantics=FIXED-SIZE, base-type=DataTypes/uint8
    Arr_u8_16: category=ARRAY
      element ArrayElement: category=VALUE, array-size=16, array-size-semantics=FIXED-SIZE, base-type=DataTypes/uint8
    Arr_u8_128: category=ARRAY
      element ArrayElement: category=VALUE, array-size=128, array-size-semantics=FIXED-SIZE, base-type=DataTypes/uint8
    Arr_u8_64: category=ARRAY
      element ArrayElement: category=VALUE, array-size=64, array-size-semantics=FIXED-SIZE, base-type=DataTypes/uint8
    Arr_u8_32: category=ARRAY
      element ArrayElement: category=VALUE, array-size=32, array-size-semantics=FIXED-SIZE, base-type=DataTypes/uint8
    Arr_u8_48: category=ARRAY
      element ArrayElement: category=VALUE, array-size=48, array-size-semantics=FIXED-SIZE, base-type=DataTypes/uint8
    Arr_u8_2048: category=ARRAY
      element ArrayElement: category=VALUE, array-size=2048, array-size-semantics=FIXED-SIZE, base-type=DataTypes/uint8
    Arr_u8_1024: category=ARRAY
      element ArrayElement: category=VALUE, array-size=1024, array-size-semantics=FIXED-SIZE, base-type=DataTypes/uint8
    Arr_u8_100: category=ARRAY
      element ArrayElement: category=VALUE, array-size=100, array-size-semantics=FIXED-SIZE, base-type=DataTypes/uint8
    Arr_u8_256: category=ARRAY
      element ArrayElement: category=VALUE, array-size=256, array-size-semantics=FIXED-SIZE, base-type=DataTypes/uint8
  29 x impl type:
    ESystemState: category=VALUE, base-type=DataTypes/uint8, compu {0=ESystemState_Off, 1=ESystemState_Startup, 2=ESystemState_Up, 3=ESystemState_FullRun, 4=ESystemState_PrepareShutdown, 5=ESystemState_Minimal, 6=ESystemState_Shutdown, 7=ESystemState_Last}, range raw 0..7
    EDomainId: category=VALUE, base-type=DataTypes/uint8, compu {0=EDomainId_VP, 1=EDomainId_Cluster, 2=EDomainId_IVI, 3=EDomainId_Last}, range raw 0..3
    SPowerSystemStateReqChange: category=STRUCTURE
      element state: implementation-data-type=Types/ESystemState
      element domainId: implementation-data-type=Types/EDomainId
    EDmnChangeReqStatus_t: category=VALUE, base-type=DataTypes/uint8, compu {0=EDmnChangeReqStatus_NoReq, 1=EDmnChangeReqStatus_WaitAwakeTime, 2=EDmnChangeReqStatus_WaitShutdonwTime, 3=EDmnChangeReqStatus_PrevReqPending, 4=EDmnChangeReqStatus_ReqSucceed, 5=EDmnChangeReqStatus_ReqFail, 6=EDmnChangeReqStatus_ReqTimedOut, 7=EDmnChangeReqStatus_DmnNotReady}, range raw 0..7
    EUclLinkState_t: category=VALUE, base-type=DataTypes/uint8, compu {0=EUclLinkState_Not_Rcvd, 1=EUclLinkState_Down, 2=EUclLinkState_Up, 3=EUclLinkState_Last}, range raw 0..3
    EDmnHealthState_t: category=VALUE, base-type=DataTypes/uint8, compu {0=EDmnHealth_Active, 1=EDmnHealth_UCL_Fatal_Error, 2=EDmnHealth_HB_Miss, 3=EDmnHealth_Fatal_Error, 4=EDmnHealth_Rcvd_Inv_SeqCnt, 5=EDmnHealth_First_HB_Rcv_Time_Expired, 6=EDmnHealth_First_LinkUp_Time_Expired, 7=EDmnHealth_Shutdown_Time_Expired, 8=EDmnHealth_Last}, range raw 0..8
    EDmnOverallState_t: category=VALUE, base-type=DataTypes/uint8, compu {0=DMN_NOT_READY, 1=DMN_READY}, range raw 0..1
    data_u8_32: category=ARRAY
      element ArrayElement: category=VALUE, array-size=32, array-size-semantics=FIXED-SIZE, base-type=DataTypes/uint8
    SPowerSystemState: category=STRUCTURE
      element domainId: implementation-data-type=Types/EDomainId
      element state: implementation-data-type=Types/ESystemState
    data_u8_8: category=ARRAY
      element ArrayElement: category=VALUE, array-size=8, array-size-semantics=FIXED-SIZE, base-type=DataTypes/uint8
    EDidType: category=VALUE, base-type=DataTypes/uint8, compu {0=EDidType_Read, 1=EDidType_Write, 2=EDidType_Last}, range raw 0..2
    data_u8_256: category=ARRAY
      element ArrayElement: category=VALUE, array-size=256, array-size-semantics=FIXED-SIZE, base-type=DataTypes/uint8
    EIOCtrlOptType: category=VALUE, base-type=DataTypes/uint8, compu {0=EIOCtrlOptType_returnControlToECU, 1=EIOCtrlOptType_resetToDefault, 2=EIOCtrlOptType_freezeCurrentState, 3=EIOCtrlOptType_shortTermAdjustment, 4=EIOCtrlOptType_Last}, range raw 0..4
    ERoutineType: category=VALUE, base-type=DataTypes/uint8, compu {0=ERoutineType_Start, 1=ERoutineType_Stop, 2=ERoutineType_QueryResults, 3=ERoutineType_Last}, range raw 0..3
    EIgnitionStatus: category=VALUE, base-type=DataTypes/uint8, compu {0=EIgnitionStatus_Off, 1=EIgnitionStatus_Acc, 2=EIgnitionStatus_Start, 3=EIgnitionStatus_Run, 4=EIgnitionStatus_Last}, range raw 0..4
    SIgnState: category=STRUCTURE
      element state: implementation-data-type=Types/EIgnitionStatus
    SDiagDIDRequest: category=STRUCTURE
      4 x element, all with category=TYPE_REFERENCE:
        did: implementation-data-type=UInt16
        didType: implementation-data-type=EDidType
        dataLen: implementation-data-type=UInt16
        data: implementation-data-type=data_u8_256
    SDiagIOCtrlRequest: category=STRUCTURE
      4 x element, all with category=TYPE_REFERENCE:
        did: implementation-data-type=UInt16
        optionCtrl: implementation-data-type=EIOCtrlOptType
        dataLen: implementation-data-type=UInt16
        data: implementation-data-type=data_u8_256
    SDiagRoutineRequest: category=STRUCTURE
      4 x element, all with category=TYPE_REFERENCE:
        routineId: implementation-data-type=UInt16
        routineType: implementation-data-type=ERoutineType
        dataLen: implementation-data-type=UInt16
        data: implementation-data-type=data_u8_256
    SHealthDomainFatalError: category=STRUCTURE
      element domainId: implementation-data-type=Types/EDomainId
      element compldx: implementation-data-type=UInt32
    SHealthDomainHeartbeat: category=STRUCTURE
      element domainId: implementation-data-type=Types/EDomainId
      element seqCnt: implementation-data-type=UInt32
    SHealthDumpData: category=STRUCTURE
      element chunkSize: implementation-data-type=UInt32
      element data: implementation-data-type=Types/data_u8_32
    SHealthDumpHdrInfo: category=STRUCTURE
      element fileSize: implementation-data-type=UInt32
    SPowerExtendShutdownTime: category=STRUCTURE
      element domainId: implementation-data-type=Types/EDomainId
      element timeoutMs: implementation-data-type=UInt32
    SPowerKeepSystemAwake: category=STRUCTURE
      element domainId: implementation-data-type=Types/EDomainId
      element timeoutMs: implementation-data-type=UInt32
    SDmnStatus: category=STRUCTURE
      6 x element, all with category=TYPE_REFERENCE:
        dmnId: implementation-data-type=Types/EDomainId
        linkStatus: implementation-data-type=EUclLinkState_t
        uclErrCode: implementation-data-type=SInt32
        dmnHealthState: implementation-data-type=EDmnHealthState_t
        state: implementation-data-type=Types/ESystemState
        dmnStatus: implementation-data-type=EDmnOverallState_t
    SHealthDumpGetData: category=STRUCTURE
      element reserved: implementation-data-type=UInt8
    SHealthDumpGetHdr: category=STRUCTURE
      element encrypt: implementation-data-type=UInt8
    SHealthEventRecord: category=STRUCTURE
      element recordType: implementation-data-type=UInt8
      element recordLen: implementation-data-type=UInt8
      element recordData: implementation-data-type=Types/data_u8_8
  21 x impl type:
    Dlt_MessageLogLevelType: category=VALUE, base-type=DataTypes/uint8, compu {0=DLT_LOG_OFF, 1=DLT_LOG_FATAL, 2=DLT_LOG_ERROR, 3=DLT_LOG_WARN, 4=DLT_LOG_INFO, 5=DLT_LOG_VERBOSE}, range raw 0..5
    Dlt_LogChannelNameType: category=VALUE, base-type=DataTypes/uint8, range raw 0..255
    Dlt_ApplicationIDType: category=VALUE, base-type=DataTypes/uint8, range raw 0..255
    Dlt_ContextIDType: category=VALUE, base-type=DataTypes/uint8, range raw 0..255
    Dlt_SessionIDType: category=VALUE, base-type=DataTypes/uint32, range raw 0..4294967295
    Dlt_MessageArgumentCount: category=VALUE, base-type=DataTypes/uint16, range raw 0..65535
    Dlt_MessageOptionsType: category=VALUE, base-type=DataTypes/uint8, range raw 0..255
    Dlt_MessageLogInfoType: category=STRUCTURE
      5 x element, all with category=TYPE_REFERENCE:
        arg_count: implementation-data-type=Dlt_MessageArgumentCount
        log_level: implementation-data-type=Dlt_MessageLogLevelType
        options: implementation-data-type=Dlt_MessageOptionsType
        context_id: implementation-data-type=Dlt_ContextIDType
        app_id: implementation-data-type=Dlt_ApplicationIDType
    Dlt_MessageTraceType: category=VALUE, base-type=DataTypes/uint8, compu {1=DLT_TRACE_VARIABLE, 0=DLT_TRACE_FUNCTION_IN, 1=DLT_TRACE_FUNCTION_OUT, 2=DLT_TRACE_STATE, 3=DLT_TRACE_VFB}, range raw 0..3
    Dlt_MessageTraceInfoType: category=STRUCTURE
      4 x element, all with category=TYPE_REFERENCE:
        traceInfo: implementation-data-type=Dlt_MessageTraceType
        option: implementation-data-type=Dlt_MessageOptionsType
        context: implementation-data-type=Dlt_ContextIDType
        appId: implementation-data-type=Dlt_ApplicationIDType
    Dlt_AssignmentOperation: category=VALUE, base-type=DataTypes/uint8, compu {1=DLT_ASSIGN_ADD, 0=DLT_ASSIGN_REMOVE}, range raw 0..1
    data_uint8_8: category=ARRAY
      element ArrayElement: category=VALUE, array-size=8, array-size-semantics=FIXED-SIZE, base-type=DataTypes/uint8
    EcuMExt_ResetType: category=VALUE, base-type=DataTypes/uint8, range raw 0..255
    Dlt_ContextIdInfoType: category=STRUCTURE
      5 x element, all with category=TYPE_REFERENCE:
        contextId: implementation-data-type=Dlt_ContextIDType
        logLevel: implementation-data-type=Dlt_MessageLogLevelType
        traceStatus: implementation-data-type=UInt8
        lenContextDescription: implementation-data-type=UInt16
        contextDesc: implementation-data-type=UInt8
    Dlt_ApplicationIdInfoType: category=STRUCTURE
      5 x element, all with category=TYPE_REFERENCE:
        appId: implementation-data-type=Dlt_ApplicationIDType
        contextIdCount: implementation-data-type=UInt16
        contextInfoList: implementation-data-type=Dlt_ContextIdInfoType
        appDescLen: implementation-data-type=UInt16
        appDesc: implementation-data-type=UInt8
    Dlt_LogInfoType: category=STRUCTURE
      element appIdCount: implementation-data-type=UInt16
      element appIdInfo: implementation-data-type=Dlt_ApplicationIdInfoType
    tDlt_BH_MessageFormat: category=STRUCTURE
      6 x element, all with category=TYPE_REFERENCE:
        HeaderType: implementation-data-type=UInt32
        MessageCount: implementation-data-type=UInt8
        MessageLen: implementation-data-type=UInt16
        MessageInfo: implementation-data-type=UInt8
        no_of_arguments: implementation-data-type=UInt8
        LogMessage_Timestamp: implementation-data-type=UInt32
    tDlt_MessageFormat: category=STRUCTURE
      element BaseHeader: implementation-data-type=tDlt_BH_MessageFormat
      element PayLoad: implementation-data-type=data_uint8_8
    uint8_Ref: category=VALUE, base-type=DataTypes/uint8, range raw 0..255
    Rtc_TimeType: category=STRUCTURE
      7 x element, all with category=TYPE_REFERENCE:
        year: implementation-data-type=UInt16
        month: implementation-data-type=UInt8
        week: implementation-data-type=UInt8
        day: implementation-data-type=UInt8
        hour: implementation-data-type=UInt8
        minute: implementation-data-type=UInt8
        second: implementation-data-type=UInt8
    Rtc_AlarmType: category=STRUCTURE
      element day: implementation-data-type=UInt8
      element minute: implementation-data-type=UInt8
      element hour: implementation-data-type=UInt8
  8 x impl type:
    EChimeID: category=VALUE, base-type=DataTypes/uint8, compu {0=NO_CHIME_ID, 1=MAX_CHIME_ID}, range raw 0..1
    EChimeStatus: category=VALUE, base-type=DataTypes/uint16, range raw 0..65535
    ELastToneStatus: category=VALUE, base-type=DataTypes/boolean, range raw 0..1
    ESndToneInterruptableType: category=VALUE, base-type=DataTypes/uint8, compu {0=eSndToneInterruptableType_NotInterruptible, 1=eSndToneInterruptableType_Interruptible}, range raw 0..1
    EChimeType: category=VALUE, base-type=DataTypes/uint8, compu {0=eChimeEvent, 15=eChimeContinuous}, range raw 0..15
    ESndInterruptType: category=VALUE, base-type=DataTypes/uint8, compu {0=eSndCdd_InterruptType_None, 1=eSndCdd_InterruptType_TypeA, 2=eSndCdd_InterruptType_TypeB, 3=eSndCdd_InterruptType_TypeDA, 4=eSndCdd_InterruptType_TypeDB, 5=eSndCdd_InterruptType_Immidiate, 6=eSndCdd_InterruptType_Tone, 7=eSndCdd_InterruptType_SoundUnit, 8=eSndCdd_InterruptType_TypeC, 9=eSndCdd_InterruptType_TypeD}, range raw 0..9
    SSndCddChimeData: category=STRUCTURE
      element ChannelId: implementation-data-type=UInt8
      element ChimeType: implementation-data-type=EChimeType
      element DynamicDeadTime: implementation-data-type=UInt16
    EcuM_UserType: category=VALUE, base-type=DataTypes/uint8, range raw 0..255
package /E40_Platform_System_SystemPackage/Types/DataConstrs
  range UInt16_DataConstraint: raw 0..65535
  range UInt32_DataConstraint: raw 0..4294967295
  range Boolean_DataConstraint: raw 0..1
  range SInt32_DataConstraint: raw -2147483648..2147483647
  range UInt8_DataConstraint: raw 0..255
package /Predefined_DEV/ImplementationDataTypes
  impl type NvM_RequestResultType: compu {0=NVM_REQ_OK, 1=NVM_REQ_NOT_OK, 2=NVM_REQ_PENDING, 3=NVM_REQ_INTEGRITY_FAILED, 4=NVM_REQ_BLOCK_SKIPPED, 5=NVM_REQ_NV_INVALIDATED, 6=NVM_REQ_CANCELED, 7=NVM_REQ_REDUNDANCY_FAILED, 8=NVM_REQ_RESTORED_FROM_ROM}, implementation-data-type=uint8
  impl type NvM_ServiceIdType: compu {6=NVM_READ_BLOCK, 7=NVM_WRITE_BLOCK, 8=NVM_RESTORE_BLOCK_DEFAULTS, 9=NVM_ERASE_BLOCK, 11=NVM_INVALIDATE_NV_BLOCK, 12=NVM_READ_ALL}, implementation-data-type=uint8
  impl type Dem_UdsStatusByteType: compu {mask 1: 1=DEM_UDS_STATUS_TF, mask 2: 2=DEM_UDS_STATUS_TFTOC, mask 4: 4=DEM_UDS_STATUS_PDTC, mask 8: 8=DEM_UDS_STATUS_CDTC, mask 16: 16=DEM_UDS_STATUS_TNCSLC, mask 32: 32=DEM_UDS_STATUS_TFSLC, mask 64: 64=DEM_UDS_STATUS_TNCTOC, mask 128: 128=DEM_UDS_STATUS_WIR}, range raw 0..255, implementation-data-type=uint8
package /ZARXML_DATA_TYPES
  impl type EDomainId: compu {0=EDomainId_VP, 1=EDomainId_Cluster, 2=EDomainId_IVI, 3=EDomainId_Last}, implementation-data-type=uint8
  impl type ESystemState: compu {0=ESystemState_Off, 1=ESystemState_Startup, 2=ESystemState_Up, 3=ESystemState_FullRun, 4=ESystemState_PrepareShutdown, 5=ESystemState_Minimal, 6=ESystemState_Shutdown, 7=ESystemState_Meet, 8=ESystemState_Last}, implementation-data-type=uint8
  impl type EIgnitionStatus: compu {0=EIgnitionStatus_Off, 1=EIgnitionStatus_Acc, 2=EIgnitionStatus_Start, 3=EIgnitionStatus_Run, 4=EIgnitionStatus_Last}, implementation-data-type=uint8
  impl type EnetReqCmd_t: compu {1=EnetReqType_Reset, 2=EnetReqType_linkStatus, 3=EnetReqType_SqiVal, 4=EnetReqType_WorstSqiVal, 5=EnetReqType_BestSqiVal, 6=EnetReqType_FaultStatus, 7=EnetReqType_CableStatus, 8=EnetReqType_masterSlaveStatus, 9=EnetReqType_Last}, implementation-data-type=uint8
  impl type EnetReqMode_t: compu {0=EnetReqMode_Read, 1=EnetReqMode_Write, 2=EnetReqMode_Last}, implementation-data-type=uint8
  impl type data_u8_8: category=ARRAY
    element Element: array-size=8, array-size-semantics=FIXED-SIZE, implementation-data-type=uint8
  impl type data_u8_32: category=ARRAY
    element Element: array-size=32, array-size-semantics=FIXED-SIZE, implementation-data-type=uint8
  14 x impl type:
    EDisplayStatus: compu {0=EDisplayState_Off, 1=EDisplayState_On, 2=EDisplayState_Error, 3=EDisplayState_Disconnected, 4=EDisplayState_Last}, implementation-data-type=uint8
    SHealthDumpGetHdr: category=STRUCTURE
      element encrypt: implementation-data-type=uint8
    SHealthDumpGetData: category=STRUCTURE
      element reserved: implementation-data-type=uint8
    SPowerSystemStateReqChange: category=STRUCTURE
      element domainId: implementation-data-type=ZARXML_DATA_TYPES/EDomainId
      element state: implementation-data-type=ZARXML_DATA_TYPES/ESystemState
    SIgnState: category=STRUCTURE
      element state: implementation-data-type=ZARXML_DATA_TYPES/EIgnitionStatus
    SEnetRegReq: category=STRUCTURE
      4 x element, all with category=TYPE_REFERENCE:
        cmd: implementation-data-type=EnetReqCmd_t
        mode: implementation-data-type=EnetReqMode_t
        dataLen: implementation-data-type=uint8
        data: implementation-data-type=ZARXML_DATA_TYPES/data_u8_8
    SHealthDomainHeartbeat: category=STRUCTURE
      element domainId: implementation-data-type=uint8
      element seqCnt: implementation-data-type=uint32
    SHealthDomainFatalError: category=STRUCTURE
      element domainId: implementation-data-type=uint8
      element compldx: implementation-data-type=uint32
    SHealthDumpHdrInfo: category=STRUCTURE
      element fileSize: implementation-data-type=uint32
    SPowerSystemState: category=STRUCTURE
      element domainId: implementation-data-type=ZARXML_DATA_TYPES/EDomainId
      element state: implementation-data-type=ZARXML_DATA_TYPES/ESystemState
    SPowerExtendShutdownTime: category=STRUCTURE
      element domainId: implementation-data-type=ZARXML_DATA_TYPES/EDomainId
      element timeoutMs: implementation-data-type=uint32
    SHealthEventRecord: category=STRUCTURE
      element recordType: implementation-data-type=uint8
      element recordLen: implementation-data-type=uint8
      element recordData: implementation-data-type=ZARXML_DATA_TYPES/data_u8_8
    SEnetRegResp: category=STRUCTURE
      element cmd: implementation-data-type=EnetReqCmd_t
      element respLen: implementation-data-type=uint8
      element response: implementation-data-type=ZARXML_DATA_TYPES/data_u8_32
    SDisplayCurrentState: category=STRUCTURE
      element displayId: implementation-data-type=uint32
      element state: implementation-data-type=EDisplayStatus
package /ARRoot/Types
  62 x impl type, all with category=STRUCTURE, sw-calibration-access=READ-ONLY:
    NV_Data_NvMSampleBlock1
      element SampleElement1: implementation-data-type=Arr_u8_8
    NV_Data_SampleBlock2
      element SampleElement2: implementation-data-type=Arr_u8_16
    NV_Data_BsConst_Audio
      element BsConst_Audio_Element: implementation-data-type=Arr_u8_128
    NV_Data_BsConst_Communication
      element BsConst_Communication_Element: implementation-data-type=Arr_u8_64
    NV_Data_BsConst_EngOffTimer
      element BsConst_EngOffTimer_Element: implementation-data-type=Arr_u8_32
    NV_Data_BsConst_FuelGauge
      element BsConst_FuelGauge_Element: implementation-data-type=Arr_u8_128
    NV_Data_BsConst_Illumination
      element BsConst_Illumination_Element: implementation-data-type=Arr_u8_128
    NV_Data_BsConst_OilGauge
      element BsConst_OilGauge_Element: implementation-data-type=Arr_u8_64
    NV_Data_BsConst_Power
      element BsConst_Power_Element: implementation-data-type=Arr_u8_32
    NV_Data_BsConst_PowerGauge
      element BsConst_PowerGauge_Element: implementation-data-type=Arr_u8_64
    NV_Data_BsConst_RealTimeClock
      element BsConst_RealTimeClock_Element: implementation-data-type=Arr_u8_48
    NV_Data_BsConst_ServiceReminder
      element BsConst_ServiceReminder_Element: implementation-data-type=Arr_u8_48
    NV_Data_BsConst_SpeedoGauge
      element BsConst_SpeedoGauge_Element: implementation-data-type=Arr_u8_64
    NV_Data_BsConst_TachoGauge
      element BsConst_TachoGauge_Element: implementation-data-type=Arr_u8_64
    NV_Data_BsConst_TempGauge
      element BsConst_TempGauge_Element: implementation-data-type=Arr_u8_64
    NV_Data_BsConst_TripComputer
      element BsConst_TripComputer_Element: implementation-data-type=Arr_u8_64
    NV_Data_BsConst_Warning
      element BsConst_Warning_Element: implementation-data-type=Arr_u8_64
    NV_Data_BsCys_Certicificate
      element BsCys_Certicificate_Element: implementation-data-type=Arr_u8_64
    NV_Data_BsDiag_Dtc
      element BsDiag_Dtc_Element: implementation-data-type=Arr_u8_2048
    NV_Data_BsDiag_ErrorRecord
      element BsDiag_ErrorRecord_Element: implementation-data-type=Arr_u8_1024
    NV_Data_BsFuSa_Audio
      element BsFuSa_Audio_Element: implementation-data-type=Arr_u8_32
    NV_Data_BsFuSa_Communication
      element BsFuSa_Communication_Element: implementation-data-type=Arr_u8_16
    NV_Data_BsFuSa_Config
      element BsFuSa_Config_Element: implementation-data-type=Arr_u8_16
    NV_Data_BsFuSa_Display
      element BsFuSa_Display_Element: implementation-data-type=Arr_u8_64
    NV_Data_BsFuSa_Power
      element BsFuSa_Power_Element: implementation-data-type=Arr_u8_48
    NV_Data_BsFuSa_Warning
      element BsFuSa_Warning_Element: implementation-data-type=Arr_u8_32
    NV_Data_BsFusa_Fota
      element BsFusa_Fota_Element: implementation-data-type=Arr_u8_32
    NV_Data_BsReten_Audio
      element BsReten_Audio_Element: implementation-data-type=Arr_u8_100
    NV_Data_BsReten_Communication
      element BsReten_Communication_Element: implementation-data-type=Arr_u8_100
    NV_Data_BsReten_Display
      element BsReten_Display_Element: implementation-data-type=Arr_u8_100
    NV_Data_BsReten_Gauges
      element BsReten_Gauges_Element: implementation-data-type=Arr_u8_100
    NV_Data_BsReten_Illumination
      element BsReten_Illumination_Element: implementation-data-type=Arr_u8_100
    NV_Data_BsReten_Odometer
      element BsReten_Odometer_Element: implementation-data-type=Arr_u8_100
    NV_Data_BsReten_Personalization
      element BsReten_Personalization_Element: implementation-data-type=Arr_u8_100
    NV_Data_BsReten_Power
      element BsReten_Power_Element: implementation-data-type=Arr_u8_100
    NV_Data_BsReten_RealTimeClock
      element BsReten_RealTimeClock_Element: implementation-data-type=Arr_u8_100
    NV_Data_BsReten_Tripcomputer
      element BsReten_Tripcomputer_Element: implementation-data-type=Arr_u8_100
    NV_Data_BsReten_VisDlt
      element BsReten_VisDlt_Element: implementation-data-type=Arr_u8_256
    NV_Data_BsReten_Warning
      element BsReten_Warning_Element: implementation-data-type=Arr_u8_100
    NV_Data_BsRt_CusDlt
      element BsRt_CusDlt_Element: implementation-data-type=Arr_u8_128
    NV_Data_BsRt_FuelGauge
      element BsRt_FuelGauge_Element: implementation-data-type=Arr_u8_32
    NV_Data_BsRt_Illumination
      element BsRt_Illumination_Element: implementation-data-type=Arr_u8_100
    NV_Data_BsRt_Odometer
      element BsRt_Odometer_Element: implementation-data-type=Arr_u8_128
    NV_Data_BsRt_OilGauge
      element BsRt_OilGauge_Element: implementation-data-type=Arr_u8_8
    NV_Data_BsRt_Personalization
      element BsRt_Personalization_Element: implementation-data-type=Arr_u8_128
    NV_Data_BsRt_PowerGauge
      element BsRt_PowerGauge_Element: implementation-data-type=Arr_u8_32
    NV_Data_BsRt_RealTimeClock
      element BsRt_RealTimeClock_Element: implementation-data-type=Arr_u8_48
    NV_Data_BsRt_SpeedoGauge
      element BsRt_SpeedoGauge_Element: implementation-data-type=Arr_u8_8
    NV_Data_BsRt_TachoGauge
      element BsRt_TachoGauge_Element: implementation-data-type=Arr_u8_16
    NV_Data_BsRt_TempGauge
      element BsRt_TempGauge_Element: implementation-data-type=Arr_u8_32
    NV_Data_BsRt_TripComputer
      element BsRt_TripComputer_Element: implementation-data-type=Arr_u8_64
    NV_Data_BsRt_Warning
      element BsRt_Warning_Element: implementation-data-type=Arr_u8_32
    NV_Data_BsShare_EcuPartNumber
      element BsShare_EcuPartNumber_Element: implementation-data-type=Arr_u8_128
    NV_Data_BsShare_SwUpdFotaFinPrint
      element BsShare_SwUpdFotaFinPrint_Element: implementation-data-type=Arr_u8_32
    NV_Data_BsShare_SwUpdFotaMode
      element BsShare_SwUpdFotaMode_Element: implementation-data-type=Arr_u8_16
    NV_Data_BsShare_SwUpdFotaStatus
      element BsShare_SwUpdFotaStatus_Element: implementation-data-type=Arr_u8_48
    NV_Data_BsShare_SwUpdFotadecrypt
      element BsShare_SwUpdFotadecrypt_Element: implementation-data-type=Arr_u8_64
    NV_Data_BsShare_SwUpdReflash
      element BsShare_SwUpdReflash_Element: implementation-data-type=Arr_u8_8
    NV_Data_BsShare_VehicleConfig
      element BsShare_VehicleConfig_Element: implementation-data-type=Arr_u8_256
    NV_Data_BsShare_VisMeet
      element BsShare_VisMeet_Element: implementation-data-type=Arr_u8_48
    NV_Data_RefCys_Certicificate
      element RefCys_Certicificate_Element: implementation-data-type=Arr_u8_64
    NV_Data_RefCys_Certicificate1
      element RefCys_Certicificate1_Element: implementation-data-type=Arr_u8_64
package /DataTypes
  impl type Ivd_RequestPostRun: compu {0=IVD_REQUESTPOSTRUN_REQUESTED, 1=IVD_REQUESTPOSTRUN_RELEASED}, range raw 0..1, implementation-data-type=uint8, type-emitter=RTE
package /AUTOSAR_Std/ImplementationDataTypes
  impl type Std_VersionInfoType: category=STRUCTURE, sw-calibration-access=READ-ONLY, type-emitter=HEADER_FILE  # This type shall be used to request the version of a BSW module using the "ModuleName"_GetVersionInfo() function.
    5 x element, all with category=TYPE_REFERENCE:
      vendorID: implementation-data-type=uint16
      moduleID: implementation-data-type=uint16
      sw_major_version: implementation-data-type=uint8
      sw_minor_version: implementation-data-type=uint8
      sw_patch_version: implementation-data-type=uint8
package /Vw_Fpk_System_SystemPackage/Types/DataConstrs
  range UInt8_DataConstraint: raw 0..255
package /AUTOSAR_SfdA/SfdA/ImplementationDataTypes
  impl type SfdA_RequestRoleType: compu {0=SFDC_NO_ROLE, 1=SFD_ROLE_EPTI, 2=SFD_ROLE_BASIC, 3=SFD_ROLE_EXTENDED, 4=SFD_ROLE_SUPERUSER, 5=SFD_ROLE_PRODUCTION, 6=SFD_ROLE_OTA}, implementation-data-type=uint8
