AUTOSAR XML (schema 4-0-3)
package /DaVinci_Project
  module config Rte
    4 x RteBswModuleInstance:
      Dcm
        Dcm_MainFunctionTimingEvent0 (RteBswEventToTaskMapping): RteBswUsedOsEventRef=Rte_Ev_Cyclic2_OsTask_Diagnostics_0_10ms, RteBswUsedOsAlarmRef=Os/Rte_Al_TE2_OsTask_Diagnostics_0_10ms
      Dem
        Dem_MasterMainFunctionTimingEvent0 (RteBswEventToTaskMapping): RteBswUsedOsEventRef=Rte_Ev_Cyclic2_OsTask_Diagnostics_0_10ms, RteBswUsedOsAlarmRef=Os/Rte_Al_TE2_OsTask_Diagnostics_0_10ms
        Dem_SatelliteMainFunctionTimingEvent0 (RteBswEventToTaskMapping): RteBswUsedOsEventRef=Rte_Ev_Cyclic2_OsTask_Diagnostics_0_10ms, RteBswUsedOsAlarmRef=Os/Rte_Al_TE2_OsTask_Diagnostics_0_10ms
      Ea
        Ea_MainFunctionTimingEvent0 (RteBswEventToTaskMapping): RteBswUsedOsEventRef=Rte_Ev_Run_Ea_Ea_MainFunction, RteBswUsedOsAlarmRef=Os/Rte_Al_TE_Ea_Ea_MainFunction
      NvM
        NvM_MainFunctionTimingEvent0 (RteBswEventToTaskMapping): RteBswUsedOsEventRef=Rte_Ev_Cyclic2_OsTask_MemSer_0_10ms, RteBswUsedOsAlarmRef=Os/Rte_Al_TE2_OsTask_MemSer_0_10ms
    26 x RteSwComponentInstance:
      CBacklightCdd_EcuSwComposition
        TECBacklightCdd_Impl_MainFunction (RteEventToTaskMapping): RteUsedOsEventRef=Rte_Ev_Cyclic_OsTask_CddFun_0_10ms, RteUsedOsAlarmRef=Os/Rte_Al_TE_OsTask_CddFun_0_10ms
      CBattMdl_EcuSwComposition
        TECBattMdl_Impl_MainFunction (RteEventToTaskMapping): RteUsedOsEventRef=Rte_Ev_Cyclic_OsTask_CddFun_0_5ms, RteUsedOsAlarmRef=Os/Rte_Al_TE_OsTask_CddFun_0_5ms
      CCDD_EcuPowerM_EcuSwComposition
        TECCDD_EcuPowerM_Impl_MainFunction (RteEventToTaskMapping): RteUsedOsEventRef=Rte_Ev_Cyclic_OsTask_CddFun_0_5ms, RteUsedOsAlarmRef=Os/Rte_Al_TE_OsTask_CddFun_0_5ms
      CDisplayCdd_EcuSwComposition
        TECDisplayCdd_Impl_MainFunction (RteEventToTaskMapping): RteUsedOsEventRef=Rte_Ev_Cyclic_OsTask_CddFun_0_10ms, RteUsedOsAlarmRef=Os/Rte_Al_TE_OsTask_CddFun_0_10ms
      CRtcCdd_EcuSwComposition
        TECRtcCdd_Impl_MainFunction (RteEventToTaskMapping): RteUsedOsEventRef=Rte_Ev_Cyclic_OsTask_CddFun_0_10ms, RteUsedOsAlarmRef=Os/Rte_Al_TE_OsTask_CddFun_0_10ms
      CSleepManager_EcuSwComposition
        TECSleepManager_Impl_MainFunction (RteEventToTaskMapping): RteUsedOsEventRef=Rte_Ev_Cyclic_OsTask_MemSer_0_10ms, RteUsedOsAlarmRef=Os/Rte_Al_TE_OsTask_MemSer_0_10ms
      ComM_EcuSwComposition
        Timer_ComM_MainFunction_0 (RteEventToTaskMapping): RteUsedOsAlarmRef=Os/Rte_Al_TE_OsTask_CANFun_0_10ms
      DemMaster_0_EcuSwComposition
        Timer_Dem_MasterMainFunction (RteEventToTaskMapping): RteUsedOsEventRef=Rte_Ev_Cyclic2_OsTask_Diagnostics_0_10ms, RteUsedOsAlarmRef=Os/Rte_Al_TE2_OsTask_Diagnostics_0_10ms
      DemSatellite_0_EcuSwComposition
        Timer_Dem_SatelliteMainFunction (RteEventToTaskMapping): RteUsedOsEventRef=Rte_Ev_Cyclic2_OsTask_Diagnostics_0_10ms, RteUsedOsAlarmRef=Os/Rte_Al_TE2_OsTask_Diagnostics_0_10ms
      Dlt_EcuSwComposition
        TEDlt_MainFunction (RteEventToTaskMapping): RteUsedOsEventRef=Rte_Ev_Cyclic_OsTask_Diagnostics_0_100ms, RteUsedOsAlarmRef=Os/Rte_Al_TE_OsTask_Diagnostics_0_100ms
      DltExt_EcuSwComposition
        TEDltExt_MainFunction (RteEventToTaskMapping): RteUsedOsEventRef=Rte_Ev_Cyclic_OsTask_Diagnostics_0_100ms, RteUsedOsAlarmRef=Os/Rte_Al_TE_OsTask_Diagnostics_0_100ms
      DmnMgr_EcuSwComposition
        8 x RteEventToTaskMapping:
          TECDmnMgr_Impl_MainFunction: RteUsedOsEventRef=Rte_Ev_Cyclic_OsTask_MemSer_0_10ms, RteUsedOsAlarmRef=Os/Rte_Al_TE_OsTask_MemSer_0_10ms
          DREDmnMgr_MonitorDmnExtendShutdownTimeTrigByPowerExtendShutdownTimeData: RteUsedOsEventRef=Rte_Ev_Run_DmnMgr_DmnMgr_MonitorDmnExtendShutdownTime
          DREDmnMgr_MonitorDmnHealthDumpDataTrigByHealthDumpDataData: RteUsedOsEventRef=Rte_Ev_Run_DmnMgr_DmnMgr_MonitorDmnHealthDumpData
          DREDmnMgr_MonitorDmnHealthDumpHdrInfoTrigByHealthDumpHdrInfoData: RteUsedOsEventRef=Rte_Ev_Run_DmnMgr_DmnMgr_MonitorDmnHealthDumpHdrInfo
          DREDmnMgr_MonitorDmnHealthFatalErrorTrigByHealthDomainFatalErrorData: RteUsedOsEventRef=Rte_Ev_Run_DmnMgr_DmnMgr_MonitorDmnHealthFatalError
          DREDmnMgr_MonitorDmnHeartBeatTrigByHealthDomainHeartbeatData: RteUsedOsEventRef=Rte_Ev_Run_DmnMgr_DmnMgr_MonitorDmnHeartBeat
          DREDmnMgr_MonitorDmnKeepSystemAwakeTrigByPowerKeepSystemAwakeData: RteUsedOsEventRef=Rte_Ev_Run_DmnMgr_DmnMgr_MonitorDmnKeepSystemAwake
          DREDmnMgr_MonitorDmnPowerSystemStateTrigByPowerSystemStateData: RteUsedOsEventRef=Rte_Ev_Run_DmnMgr_DmnMgr_MonitorDmnPowerSystemState
      EcuAppM_EcuSwComposition
        TEEcuAppM_MainFunction (RteEventToTaskMapping): RteUsedOsAlarmRef=Os/Rte_Al_TE_OsTask_Mcal_0_10ms
      EcuM_EcuSwComposition
        Timer_EcuM_MainFunction (RteEventToTaskMapping): RteUsedOsAlarmRef=Os/Rte_Al_TE_OsTask_Mcal_0_10ms
      EcuMExt_EcuSwComposition
        TEEcuMExt_MainFunction (RteEventToTaskMapping): RteUsedOsAlarmRef=Os/Rte_Al_TE_OsTask_Mcal_0_10ms
      IoHwAb_EcuSwComposition
        TEIoHwAb_MainFunction (RteEventToTaskMapping): RteUsedOsAlarmRef=Os/Rte_Al_TE_OsTask_Mcal_0_10ms
      MemAbstractMdl_EcuSwComposition
        TEMemAbstractMdl_MainFunction (RteEventToTaskMapping): RteUsedOsEventRef=Rte_Ev_Cyclic_OsTask_MemSer_0_10ms, RteUsedOsAlarmRef=Os/Rte_Al_TE_OsTask_MemSer_0_10ms
      MemAbstractStub_EcuSwComposition
        TMT_MemAbstract_MainFunction (RteEventToTaskMapping): RteUsedOsEventRef=Rte_Ev_Cyclic_OsTask_MemSer_0_10ms, RteUsedOsAlarmRef=Os/Rte_Al_TE_OsTask_MemSer_0_10ms
      NvM_EcuSwComposition
        Timer_NvM_MainFunction (RteEventToTaskMapping): RteUsedOsEventRef=Rte_Ev_Cyclic2_OsTask_MemSer_0_10ms, RteUsedOsAlarmRef=Os/Rte_Al_TE2_OsTask_MemSer_0_10ms
      NvMExt_EcuSwComposition
        TENvMExt_MainFunction (RteEventToTaskMapping): RteUsedOsEventRef=Rte_Ev_Cyclic_OsTask_MemSer_0_10ms, RteUsedOsAlarmRef=Os/Rte_Al_TE_OsTask_MemSer_0_10ms
        TENvMExt_SpeedupRunnable (RteEventToTaskMapping): RteUsedOsEventRef=Rte_Ev_Run_NvMExt_NvMExt_SpeedupRunnable, RteUsedOsAlarmRef=Os/Rte_Al_TE_NvMExt_NvMExt_SpeedupRunnable
      Os_OsCore0_swc_EcuSwComposition
      SciDrv_EcuSwComposition
        TMT_SciDrv_MainFunction (RteEventToTaskMapping): RteUsedOsAlarmRef=Os/Rte_Al_TE_OsTask_Mcal_0_10ms
      Test_Comp_EcuSwComposition
        24 x RteEventToTaskMapping:
          TMT_AppTaskStubRunnable: RteUsedOsAlarmRef=Os/Rte_Al_TE_Test_Comp_AppTaskStubRunnable
          TMT_AudioTaskStubRunnable: RteUsedOsAlarmRef=Os/Rte_Al_TE_Test_Comp_AudioTaskStubRunnable
          TMT_CanSM_MainFunction: RteUsedOsAlarmRef=Os/Rte_Al_TE_OsTask_CANFun_0_10ms
          TMT_CddTaskStubRunnable: RteUsedOsEventRef=Rte_Ev_Cyclic_OsTask_CddFun_0_5ms, RteUsedOsAlarmRef=Os/Rte_Al_TE_OsTask_CddFun_0_5ms
          TMT_Com_MainFunctionRx: RteUsedOsAlarmRef=Os/Rte_Al_TE_OsTask_CANFun_0_10ms
          TMT_Com_MainFunctionTx: RteUsedOsAlarmRef=Os/Rte_Al_TE_OsTask_CANFun_0_10ms
          TMT_EepDrv_MainFunction: RteUsedOsEventRef=Rte_Ev_Cyclic_OsTask_MemSer_0_10ms, RteUsedOsAlarmRef=Os/Rte_Al_TE_OsTask_MemSer_0_10ms
          TMT_EthIf_MainFunctionState: RteUsedOsAlarmRef=Os/Rte_Al_TE_OsTask_EthFun_0_10ms
          TMT_EthSM_MainFunction: RteUsedOsAlarmRef=Os/Rte_Al_TE_OsTask_EthFun_0_10ms
          TMT_FotaTaskStubRunnable: RteUsedOsAlarmRef=Os/Rte_Al_TE_Test_Comp_FotaTaskStubRunnable
          TMT_GaugeTaskStubRunnable: RteUsedOsAlarmRef=Os/Rte_Al_TE_Test_Comp_GaugeTaskStubRunnable
          TMT_GraphicsTaskStubRunnable: RteUsedOsEventRef=Rte_Ev_Run_Test_Comp_GraphicsTaskStubRunnable, RteUsedOsAlarmRef=Os/Rte_Al_TE_Test_Comp_GraphicsTaskStubRunnable
          TMT_I2c_MainFunction: RteUsedOsAlarmRef=Os/Rte_Al_TE_OsTask_Mcal_0_10ms
          TMT_IndTaskStubRunnable: RteUsedOsAlarmRef=Os/Rte_Al_TE_Test_Comp_IndTaskStubRunnable
          TMT_IoExp_MainFunction: RteUsedOsAlarmRef=Os/Rte_Al_TE_Test_Comp_IoExp_MainFunction
          TMT_LinTaskStubRunnable: RteUsedOsAlarmRef=Os/Rte_Al_TE_Test_Comp_LinTaskStubRunnable
          TMT_SoAd_MainFunction: RteUsedOsAlarmRef=Os/Rte_Al_TE_OsTask_EthFun_0_10ms
          TMT_Spi_MainFunction_Handling: RteUsedOsEventRef=Rte_Ev_Cyclic_OsTask_MemSer_0_10ms, RteUsedOsAlarmRef=Os/Rte_Al_TE_OsTask_MemSer_0_10ms
          TMT_TcpIp_MainFunction: RteUsedOsAlarmRef=Os/Rte_Al_TE_OsTask_EthFun_0_10ms
          TMT_Test_Comp_MainFunction: RteUsedOsEventRef=Rte_Ev_Cyclic_OsTask_MemSer_0_10ms, RteUsedOsAlarmRef=Os/Rte_Al_TE_OsTask_MemSer_0_10ms
          TMT_TripTaskStubRunnable: RteUsedOsAlarmRef=Os/Rte_Al_TE_Test_Comp_TripTaskStubRunnable
          TMT_TxRxIpcMessage: RteUsedOsAlarmRef=Os/Rte_Al_TE_Test_Comp_TxRxIpcMessage
          TMT_WarnTaskStubRunnable: RteUsedOsAlarmRef=Os/Rte_Al_TE_Test_Comp_WarnTaskStubRunnable
          TMT_WdgMgntTaskStubRunnable: RteUsedOsAlarmRef=Os/Rte_Al_TE_Test_Comp_WdgMgntTaskStubRunnable
      TmExt_EcuSwComposition
        TETmExt_MainFunction (RteEventToTaskMapping): RteUsedOsEventRef=Rte_Ev_Cyclic_OsTask_MemSer_0_10ms, RteUsedOsAlarmRef=Os/Rte_Al_TE_OsTask_MemSer_0_10ms
      UclProxyCdd_EcuSwComposition
        4 x RteEventToTaskMapping:
          TECUclProxyCdd_Impl_MainFunction: RteUsedOsEventRef=Rte_Ev_Run_UclProxyCdd_CUclProxyCdd_Impl_MainFunction, RteUsedOsAlarmRef=Os/Rte_Al_TE_UclProxyCdd_CUclProxyCdd_Impl_MainFunction
          DREOnDre_HealthDumpGetDataTrigByHealthDumpGetDataData: RteUsedOsEventRef=Rte_Ev_Run_UclProxyCdd_OnDre_HealthDumpGetData
          DREOnDre_HealthDumpGetHdrTrigByHealthDumpGetHdrData: RteUsedOsEventRef=Rte_Ev_Run_UclProxyCdd_OnDre_HealthDumpGetHdr
          DREOnDre_PowerSystemStateReqChangeTrigByPowerSystemStateReqChangeData: RteUsedOsEventRef=Rte_Ev_Run_UclProxyCdd_OnDre_PowerSystemStateReqChange
      NvBlockSwComponentType_EcuSwComposition
        60 x RteNvRamAllocation:
          NvmBlock_NvBlockSwComponentType_NVNeed_NVBlockDescriptor_055: RteNvmRomBlockLocationSymbol=Rte_NvBlockSwComponentType_NVBlockDescriptor_BsConst_Audio_ROM_NVBlockDescriptor_BsConst_Audio, RteNvmBlockRef=NvBlockSwComponentTypeNVBlockDescriptor_BsConst_Audio
          NvmBlock_NvBlockSwComponentType_NVNeed_NVBlockDescriptor_029: RteNvmRomBlockLocationSymbol=Rte_NvBlockSwComponentType_NVBlockDescriptor_BsConst_Communication_ROM_NVBlockDescriptor_BsConst_Communication, RteNvmBlockRef=NvBlockSwComponentTypeNVBlockDescriptor_BsConst_Communication
          NvmBlock_NvBlockSwComponentType_NVNeed_NVBlockDescriptor_038: RteNvmRomBlockLocationSymbol=Rte_NvBlockSwComponentType_NVBlockDescriptor_BsConst_EngOffTimer_ROM_NVBlockDescriptor_BsConst_EngOffTimer, RteNvmBlockRef=NvBlockSwComponentTypeNVBlockDescriptor_BsConst_EngOffTimer
          NvmBlock_NvBlockSwComponentType_NVNeed_NVBlockDescriptor_048: RteNvmRomBlockLocationSymbol=Rte_NvBlockSwComponentType_NVBlockDescriptor_BsConst_FuelGauge_ROM_NVBlockDescriptor_BsConst_FuelGauge, RteNvmBlockRef=NvBlockSwComponentTypeNVBlockDescriptor_BsConst_FuelGauge
          NvmBlock_NvBlockSwComponentType_NVNeed_NVBlockDescriptor_052: RteNvmRomBlockLocationSymbol=Rte_NvBlockSwComponentType_NVBlockDescriptor_BsConst_Illumination_ROM_NVBlockDescriptor_BsConst_Illumination, RteNvmBlockRef=NvBlockSwComponentTypeNVBlockDescriptor_BsConst_Illumination
          NvmBlock_NvBlockSwComponentType_NVNeed_NVBlockDescriptor_037: RteNvmRomBlockLocationSymbol=Rte_NvBlockSwComponentType_NVBlockDescriptor_BsConst_OilGauge_ROM_NVBlockDescriptor_BsConst_OilGauge, RteNvmBlockRef=NvBlockSwComponentTypeNVBlockDescriptor_BsConst_OilGauge
          NvmBlock_NvBlockSwComponentType_NVNeed_NVBlockDescriptor_030: RteNvmRomBlockLocationSymbol=Rte_NvBlockSwComponentType_NVBlockDescriptor_BsConst_Power_ROM_NVBlockDescriptor_BsConst_Power, RteNvmBlockRef=NvBlockSwComponentTypeNVBlockDescriptor_BsConst_Power
          NvmBlock_NvBlockSwComponentType_NVNeed_NVBlockDescriptor_036: RteNvmRomBlockLocationSymbol=Rte_NvBlockSwComponentType_NVBlockDescriptor_BsConst_PowerGauge_ROM_NVBlockDescriptor_BsConst_PowerGauge, RteNvmBlockRef=NvBlockSwComponentTypeNVBlockDescriptor_BsConst_PowerGauge
          NvmBlock_NvBlockSwComponentType_NVNeed_NVBlockDescriptor_034: RteNvmRomBlockLocationSymbol=Rte_NvBlockSwComponentType_NVBlockDescriptor_BsConst_RealTimeClock_ROM_NVBlockDescriptor_BsConst_RealTimeClock, RteNvmBlockRef=NvBlockSwComponentTypeNVBlockDescriptor_BsConst_RealTimeClock
          NvmBlock_NvBlockSwComponentType_NVNeed_NVBlockDescriptor_009: RteNvmRomBlockLocationSymbol=Rte_NvBlockSwComponentType_NVBlockDescriptor_BsConst_ServiceReminder_ROM_NVBlockDescriptor_BsConst_ServiceReminder, RteNvmBlockRef=NvBlockSwComponentTypeNVBlockDescriptor_BsConst_ServiceReminder
          NvmBlock_NvBlockSwComponentType_NVNeed_NVBlockDescriptor_027: RteNvmRomBlockLocationSymbol=Rte_NvBlockSwComponentType_NVBlockDescriptor_BsConst_SpeedoGauge_ROM_NVBlockDescriptor_BsConst_SpeedoGauge, RteNvmBlockRef=NvBlockSwComponentTypeNVBlockDescriptor_BsConst_SpeedoGauge
          NvmBlock_NvBlockSwComponentType_NVNeed_NVBlockDescriptor_023: RteNvmRomBlockLocationSymbol=Rte_NvBlockSwComponentType_NVBlockDescriptor_BsConst_TachoGauge_ROM_NVBlockDescriptor_BsConst_TachoGauge, RteNvmBlockRef=NvBlockSwComponentTypeNVBlockDescriptor_BsConst_TachoGauge
          NvmBlock_NvBlockSwComponentType_NVNeed_NVBlockDescriptor_047: RteNvmRomBlockLocationSymbol=Rte_NvBlockSwComponentType_NVBlockDescriptor_BsConst_TempGauge_ROM_NVBlockDescriptor_BsConst_TempGauge, RteNvmBlockRef=NvBlockSwComponentTypeNVBlockDescriptor_BsConst_TempGauge
          NvmBlock_NvBlockSwComponentType_NVNeed_NVBlockDescriptor_016: RteNvmRomBlockLocationSymbol=Rte_NvBlockSwComponentType_NVBlockDescriptor_BsConst_TripComputer_ROM_NVBlockDescriptor_BsConst_TripComputer, RteNvmBlockRef=NvBlockSwComponentTypeNVBlockDescriptor_BsConst_TripComputer
          NvmBlock_NvBlockSwComponentType_NVNeed_NVBlockDescriptor_033: RteNvmRomBlockLocationSymbol=Rte_NvBlockSwComponentType_NVBlockDescriptor_BsConst_Warning_ROM_NVBlockDescriptor_BsConst_Warning, RteNvmBlockRef=NvBlockSwComponentTypeNVBlockDescriptor_BsConst_Warning
          NvmBlock_NvBlockSwComponentType_NVNeed_NVBlockDescriptor_022: RteNvmRomBlockLocationSymbol=Rte_NvBlockSwComponentType_NVBlockDescriptor_BsCys_Certicificate_ROM_NVBlockDescriptor_BsCys_Certicificate, RteNvmBlockRef=NvBlockSwComponentTypeNVBlockDescriptor_BsCys_Certicificate
          NvmBlock_NvBlockSwComponentType_NVNeed_NVBlockDescriptor_039: RteNvmRomBlockLocationSymbol=Rte_NvBlockSwComponentType_NVBlockDescriptor_BsDiag_Dtc_ROM_NVBlockDescriptor_BsDiag_Dtc, RteNvmBlockRef=NvBlockSwComponentTypeNVBlockDescriptor_BsDiag_Dtc
          NvmBlock_NvBlockSwComponentType_NVNeed_NVBlockDescriptor_045: RteNvmRomBlockLocationSymbol=Rte_NvBlockSwComponentType_NVBlockDescriptor_BsDiag_ErrorRecord_ROM_NVBlockDescriptor_BsDiag_ErrorRecord, RteNvmBlockRef=NvBlockSwComponentTypeNVBlockDescriptor_BsDiag_ErrorRecord
          NvmBlock_NvBlockSwComponentType_NVNeed_NVBlockDescriptor_051: RteNvmRomBlockLocationSymbol=Rte_NvBlockSwComponentType_NVBlockDescriptor_BsFuSa_Audio_ROM_NVBlockDescriptor_BsFuSa_Audio, RteNvmBlockRef=NvBlockSwComponentTypeNVBlockDescriptor_BsFuSa_Audio
          NvmBlock_NvBlockSwComponentType_NVNeed_NVBlockDescriptor_031: RteNvmRomBlockLocationSymbol=Rte_NvBlockSwComponentType_NVBlockDescriptor_BsFuSa_Communication_ROM_NVBlockDescriptor_BsFuSa_Communication, RteNvmBlockRef=NvBlockSwComponentTypeNVBlockDescriptor_BsFuSa_Communication
          NvmBlock_NvBlockSwComponentType_NVNeed_NVBlockDescriptor_010: RteNvmRomBlockLocationSymbol=Rte_NvBlockSwComponentType_NVBlockDescriptor_BsFuSa_Config_ROM_NVBlockDescriptor_BsFuSa_Config, RteNvmBlockRef=NvBlockSwComponentTypeNVBlockDescriptor_BsFuSa_Config
          NvmBlock_NvBlockSwComponentType_NVNeed_NVBlockDescriptor_017: RteNvmRomBlockLocationSymbol=Rte_NvBlockSwComponentType_NVBlockDescriptor_BsFuSa_Display_ROM_NVBlockDescriptor_BsFuSa_Display, RteNvmBlockRef=NvBlockSwComponentTypeNVBlockDescriptor_BsFuSa_Display
          NvmBlock_NvBlockSwComponentType_NVNeed_NVBlockDescriptor_013: RteNvmRomBlockLocationSymbol=Rte_NvBlockSwComponentType_NVBlockDescriptor_BsFuSa_Power_ROM_NVBlockDescriptor_BsFuSa_Power, RteNvmBlockRef=NvBlockSwComponentTypeNVBlockDescriptor_BsFuSa_Power
          NvmBlock_NvBlockSwComponentType_NVNeed_NVBlockDescriptor_011: RteNvmRomBlockLocationSymbol=Rte_NvBlockSwComponentType_NVBlockDescriptor_BsFuSa_Warning_ROM_NVBlockDescriptor_BsFuSa_Warning, RteNvmBlockRef=NvBlockSwComponentTypeNVBlockDescriptor_BsFuSa_Warning
          NvmBlock_NvBlockSwComponentType_NVNeed_NVBlockDescriptor_026: RteNvmRomBlockLocationSymbol=Rte_NvBlockSwComponentType_NVBlockDescriptor_BsFusa_Fota_ROM_NVBlockDescriptor_BsFusa_Fota, RteNvmBlockRef=NvBlockSwComponentTypeNVBlockDescriptor_BsFusa_Fota
          NvmBlock_NvBlockSwComponentType_NVNeed_NVBlockDescriptor_044: RteNvmRomBlockLocationSymbol=Rte_NvBlockSwComponentType_NVBlockDescriptor_BsReten_Audio_ROM_NVBlockDescriptor_BsReten_Audio, RteNvmBlockRef=NvBlockSwComponentTypeNVBlockDescriptor_BsReten_Audio
          NvmBlock_NvBlockSwComponentType_NVNeed_NVBlockDescriptor_041: RteNvmRomBlockLocationSymbol=Rte_NvBlockSwComponentType_NVBlockDescriptor_BsReten_Communication_ROM_NVBlockDescriptor_BsReten_Communication, RteNvmBlockRef=NvBlockSwComponentTypeNVBlockDescriptor_BsReten_Communication
          NvmBlock_NvBlockSwComponentType_NVNeed_NVBlockDescriptor_018: RteNvmRomBlockLocationSymbol=Rte_NvBlockSwComponentType_NVBlockDescriptor_BsReten_Display_ROM_NVBlockDescriptor_BsReten_Display, RteNvmBlockRef=NvBlockSwComponentTypeNVBlockDescriptor_BsReten_Display
          NvmBlock_NvBlockSwComponentType_NVNeed_NVBlockDescriptor_004: RteNvmRomBlockLocationSymbol=Rte_NvBlockSwComponentType_NVBlockDescriptor_BsReten_Gauges_ROM_NVBlockDescriptor_BsReten_Gauges, RteNvmBlockRef=NvBlockSwComponentTypeNVBlockDescriptor_BsReten_Gauges
          NvmBlock_NvBlockSwComponentType_NVNeed_NVBlockDescriptor_049: RteNvmRomBlockLocationSymbol=Rte_NvBlockSwComponentType_NVBlockDescriptor_BsReten_Illumination_ROM_NVBlockDescriptor_BsReten_Illumination, RteNvmBlockRef=NvBlockSwComponentTypeNVBlockDescriptor_BsReten_Illumination
          NvmBlock_NvBlockSwComponentType_NVNeed_NVBlockDescriptor_028: RteNvmRomBlockLocationSymbol=Rte_NvBlockSwComponentType_NVBlockDescriptor_BsReten_Odometer_ROM_NVBlockDescriptor_BsReten_Odometer, RteNvmBlockRef=NvBlockSwComponentTypeNVBlockDescriptor_BsReten_Odometer
          NvmBlock_NvBlockSwComponentType_NVNeed_NVBlockDescriptor_002: RteNvmRomBlockLocationSymbol=Rte_NvBlockSwComponentType_NVBlockDescriptor_BsReten_Personalization_ROM_NVBlockDescriptor_BsReten_Personalization, RteNvmBlockRef=NvBlockSwComponentTypeNVBlockDescriptor_BsReten_Personalization
          NvmBlock_NvBlockSwComponentType_NVNeed_NVBlockDescriptor_014: RteNvmRomBlockLocationSymbol=Rte_NvBlockSwComponentType_NVBlockDescriptor_BsReten_Power_ROM_NVBlockDescriptor_BsReten_Power, RteNvmBlockRef=NvBlockSwComponentTypeNVBlockDescriptor_BsReten_Power
          NvmBlock_NvBlockSwComponentType_NVNeed_NVBlockDescriptor_058: RteNvmRomBlockLocationSymbol=Rte_NvBlockSwComponentType_NVBlockDescriptor_BsReten_RealTimeClock_ROM_NVBlockDescriptor_BsReten_RealTimeClock, RteNvmBlockRef=NvBlockSwComponentTypeNVBlockDescriptor_BsReten_RealTimeClock
          NvmBlock_NvBlockSwComponentType_NVNeed_NVBlockDescriptor_057: RteNvmRomBlockLocationSymbol=Rte_NvBlockSwComponentType_NVBlockDescriptor_BsReten_Tripcomputer_ROM_NVBlockDescriptor_BsReten_Tripcomputer, RteNvmBlockRef=NvBlockSwComponentTypeNVBlockDescriptor_BsReten_Tripcomputer
          NvmBlock_NvBlockSwComponentType_NVNeed_NVBlockDescriptor_019: RteNvmRomBlockLocationSymbol=Rte_NvBlockSwComponentType_NVBlockDescriptor_BsReten_VisDlt_ROM_NVBlockDescriptor_BsReten_VisDlt, RteNvmBlockRef=NvBlockSwComponentTypeNVBlockDescriptor_BsReten_VisDlt
          NvmBlock_NvBlockSwComponentType_NVNeed_NVBlockDescriptor_053: RteNvmRomBlockLocationSymbol=Rte_NvBlockSwComponentType_NVBlockDescriptor_BsReten_Warning_ROM_NVBlockDescriptor_BsReten_Warning, RteNvmBlockRef=NvBlockSwComponentTypeNVBlockDescriptor_BsReten_Warning
          NvmBlock_NvBlockSwComponentType_NVNeed_NVBlockDescriptor_046: RteNvmRomBlockLocationSymbol=Rte_NvBlockSwComponentType_NVBlockDescriptor_BsRt_CusDlt_ROM_NVBlockDescriptor_BsRt_CusDlt, RteNvmBlockRef=NvBlockSwComponentTypeNVBlockDescriptor_BsRt_CusDlt
          NvmBlock_NvBlockSwComponentType_NVNeed_NVBlockDescriptor_008: RteNvmRomBlockLocationSymbol=Rte_NvBlockSwComponentType_NVBlockDescriptor_BsRt_FuelGauge_ROM_NVBlockDescriptor_BsRt_FuelGauge, RteNvmBlockRef=NvBlockSwComponentTypeNVBlockDescriptor_BsRt_FuelGauge
          NvmBlock_NvBlockSwComponentType_NVNeed_NVBlockDescriptor_005: RteNvmRomBlockLocationSymbol=Rte_NvBlockSwComponentType_NVBlockDescriptor_BsRt_Illumination_ROM_NVBlockDescriptor_BsRt_Illumination, RteNvmBlockRef=NvBlockSwComponentTypeNVBlockDescriptor_BsRt_Illumination
          NvmBlock_NvBlockSwComponentType_NVNeed_NVBlockDescriptor_012: RteNvmRomBlockLocationSymbol=Rte_NvBlockSwComponentType_NVBlockDescriptor_BsRt_Odometer_ROM_NVBlockDescriptor_BsRt_Odometer, RteNvmBlockRef=NvBlockSwComponentTypeNVBlockDescriptor_BsRt_Odometer
          NvmBlock_NvBlockSwComponentType_NVNeed_NVBlockDescriptor_003: RteNvmRomBlockLocationSymbol=Rte_NvBlockSwComponentType_NVBlockDescriptor_BsRt_OilGauge_ROM_NVBlockDescriptor_BsRt_OilGauge, RteNvmBlockRef=NvBlockSwComponentTypeNVBlockDescriptor_BsRt_OilGauge
          NvmBlock_NvBlockSwComponentType_NVNeed_NVBlockDescriptor_043: RteNvmRomBlockLocationSymbol=Rte_NvBlockSwComponentType_NVBlockDescriptor_BsRt_Personalization_ROM_NVBlockDescriptor_BsRt_Personalization, RteNvmBlockRef=NvBlockSwComponentTypeNVBlockDescriptor_BsRt_Personalization
          NvmBlock_NvBlockSwComponentType_NVNeed_NVBlockDescriptor_015: RteNvmRomBlockLocationSymbol=Rte_NvBlockSwComponentType_NVBlockDescriptor_BsRt_PowerGauge_ROM_NVBlockDescriptor_BsRt_PowerGauge, RteNvmBlockRef=NvBlockSwComponentTypeNVBlockDescriptor_BsRt_PowerGauge
          NvmBlock_NvBlockSwComponentType_NVNeed_NVBlockDescriptor_059: RteNvmRomBlockLocationSymbol=Rte_NvBlockSwComponentType_NVBlockDescriptor_BsRt_RealTimeClock_ROM_NVBlockDescriptor_BsRt_RealTimeClock, RteNvmBlockRef=NvBlockSwComponentTypeNVBlockDescriptor_BsRt_RealTimeClock
          NvmBlock_NvBlockSwComponentType_NVNeed_NVBlockDescriptor_042: RteNvmRomBlockLocationSymbol=Rte_NvBlockSwComponentType_NVBlockDescriptor_BsRt_SpeedoGauge_ROM_NVBlockDescriptor_BsRt_SpeedoGauge, RteNvmBlockRef=NvBlockSwComponentTypeNVBlockDescriptor_BsRt_SpeedoGauge
          NvmBlock_NvBlockSwComponentType_NVNeed_NVBlockDescriptor_006: RteNvmRomBlockLocationSymbol=Rte_NvBlockSwComponentType_NVBlockDescriptor_BsRt_TachoGauge_ROM_NVBlockDescriptor_BsRt_TachoGauge, RteNvmBlockRef=NvBlockSwComponentTypeNVBlockDescriptor_BsRt_TachoGauge
          NvmBlock_NvBlockSwComponentType_NVNeed_NVBlockDescriptor_024: RteNvmRomBlockLocationSymbol=Rte_NvBlockSwComponentType_NVBlockDescriptor_BsRt_TempGauge_ROM_NVBlockDescriptor_BsRt_TempGauge, RteNvmBlockRef=NvBlockSwComponentTypeNVBlockDescriptor_BsRt_TempGauge
          NvmBlock_NvBlockSwComponentType_NVNeed_NVBlockDescriptor_035: RteNvmRomBlockLocationSymbol=Rte_NvBlockSwComponentType_NVBlockDescriptor_BsRt_TripComputer_ROM_NVBlockDescriptor_BsRt_TripComputer, RteNvmBlockRef=NvBlockSwComponentTypeNVBlockDescriptor_BsRt_TripComputer
          NvmBlock_NvBlockSwComponentType_NVNeed_NVBlockDescriptor_020: RteNvmRomBlockLocationSymbol=Rte_NvBlockSwComponentType_NVBlockDescriptor_BsRt_Warning_ROM_NVBlockDescriptor_BsRt_Warning, RteNvmBlockRef=NvBlockSwComponentTypeNVBlockDescriptor_BsRt_Warning
          NvmBlock_NvBlockSwComponentType_NVNeed_NVBlockDescriptor_007: RteNvmRomBlockLocationSymbol=Rte_NvBlockSwComponentType_NVBlockDescriptor_BsShare_EcuPartNumber_ROM_NVBlockDescriptor_BsShare_EcuPartNumber, RteNvmBlockRef=NvBlockSwComponentTypeNVBlockDescriptor_BsShare_EcuPartNumber
          NvmBlock_NvBlockSwComponentType_NVNeed_NVBlockDescriptor_056: RteNvmRomBlockLocationSymbol=Rte_NvBlockSwComponentType_NVBlockDescriptor_BsShare_SwUpdFotaFinPrint_ROM_NVBlockDescriptor_BsShare_SwUpdFotaFinPrint, RteNvmBlockRef=NvBlockSwComponentTypeNVBlockDescriptor_BsShare_SwUpdFotaFinPrint
          NvmBlock_NvBlockSwComponentType_NVNeed_NVBlockDescriptor_032: RteNvmRomBlockLocationSymbol=Rte_NvBlockSwComponentType_NVBlockDescriptor_BsShare_SwUpdFotaMode_ROM_NVBlockDescriptor_BsShare_SwUpdFotaMode, RteNvmBlockRef=NvBlockSwComponentTypeNVBlockDescriptor_BsShare_SwUpdFotaMode
          NvmBlock_NvBlockSwComponentType_NVNeed_NVBlockDescriptor_054: RteNvmRomBlockLocationSymbol=Rte_NvBlockSwComponentType_NVBlockDescriptor_BsShare_SwUpdFotaStatus_ROM_NVBlockDescriptor_BsShare_SwUpdFotaStatus, RteNvmBlockRef=NvBlockSwComponentTypeNVBlockDescriptor_BsShare_SwUpdFotaStatus
          NvmBlock_NvBlockSwComponentType_NVNeed_NVBlockDescriptor_021: RteNvmRomBlockLocationSymbol=Rte_NvBlockSwComponentType_NVBlockDescriptor_BsShare_SwUpdFotadecrypt_ROM_NVBlockDescriptor_BsShare_SwUpdFotadecrypt, RteNvmBlockRef=NvBlockSwComponentTypeNVBlockDescriptor_BsShare_SwUpdFotadecrypt
          NvmBlock_NvBlockSwComponentType_NVNeed_NVBlockDescriptor_060: RteNvmRomBlockLocationSymbol=Rte_NvBlockSwComponentType_NVBlockDescriptor_BsShare_SwUpdReflash_ROM_NVBlockDescriptor_BsShare_SwUpdReflash, RteNvmBlockRef=NvBlockSwComponentTypeNVBlockDescriptor_BsShare_SwUpdReflash
          NvmBlock_NvBlockSwComponentType_NVNeed_NVBlockDescriptor_050: RteNvmRomBlockLocationSymbol=Rte_NvBlockSwComponentType_NVBlockDescriptor_BsShare_VehicleConfig_ROM_NVBlockDescriptor_BsShare_VehicleConfig, RteNvmBlockRef=NvBlockSwComponentTypeNVBlockDescriptor_BsShare_VehicleConfig
          NvmBlock_NvBlockSwComponentType_NVNeed_NVBlockDescriptor_040: RteNvmRomBlockLocationSymbol=Rte_NvBlockSwComponentType_NVBlockDescriptor_BsShare_VisMeet_ROM_NVBlockDescriptor_BsShare_VisMeet, RteNvmBlockRef=NvBlockSwComponentTypeNVBlockDescriptor_BsShare_VisMeet
          NvmBlock_NvBlockSwComponentType_NVNeed_NVBlockDescriptor_025: RteNvmRomBlockLocationSymbol=Rte_NvBlockSwComponentType_NVBlockDescriptor_RefCys_Certicificate_ROM_NVBlockDescriptor_RefCys_Certicificate, RteNvmBlockRef=NvBlockSwComponentTypeNVBlockDescriptor_RefCys_Certicificate
          NvmBlock_NvBlockSwComponentType_NVNeed_NVBlockDescriptor_061: RteNvmRomBlockLocationSymbol=Rte_NvBlockSwComponentType_NVBlockDescriptor_RefCys_Certicificate1_ROM_NVBlockDescriptor_RefCys_Certicificate1, RteNvmBlockRef=NvBlockSwComponentTypeNVBlockDescriptor_RefCys_Certicificate1
    RteOsInteraction
      24 x RteUsedOsActivation, all with RteExpectedActivationOffset=0:
        Rte_Al_TE_Test_Comp_AppTaskStubRunnable: RteActivationOsAlarmRef=Os/Rte_Al_TE_Test_Comp_AppTaskStubRunnable, RteActivationOsTaskRef=OsTask_AppFun
        Rte_Al_TE_Test_Comp_AudioTaskStubRunnable: RteActivationOsAlarmRef=Os/Rte_Al_TE_Test_Comp_AudioTaskStubRunnable, RteActivationOsTaskRef=OsTask_AudioFun
        Rte_Al_TE_OsTask_CANFun_0_10ms: RteActivationOsAlarmRef=Os/Rte_Al_TE_OsTask_CANFun_0_10ms, RteActivationOsTaskRef=OsTask_CANFun
        Rte_Al_TE_OsTask_CddFun_0_10ms: RteActivationOsAlarmRef=Os/Rte_Al_TE_OsTask_CddFun_0_10ms, RteActivationOsTaskRef=OsTask_CddFun
        Rte_Al_TE_OsTask_CddFun_0_5ms: RteActivationOsAlarmRef=Os/Rte_Al_TE_OsTask_CddFun_0_5ms, RteActivationOsTaskRef=OsTask_CddFun
        Rte_Al_TE2_OsTask_Diagnostics_0_10ms: RteActivationOsAlarmRef=Os/Rte_Al_TE2_OsTask_Diagnostics_0_10ms, RteActivationOsTaskRef=OsTask_Diagnostics
        Rte_Al_TE_OsTask_Diagnostics_0_100ms: RteActivationOsAlarmRef=Os/Rte_Al_TE_OsTask_Diagnostics_0_100ms, RteActivationOsTaskRef=OsTask_Diagnostics
        Rte_Al_TE_OsTask_EthFun_0_10ms: RteActivationOsAlarmRef=Os/Rte_Al_TE_OsTask_EthFun_0_10ms, RteActivationOsTaskRef=OsTask_EthFun
        Rte_Al_TE_Test_Comp_FotaTaskStubRunnable: RteActivationOsAlarmRef=Os/Rte_Al_TE_Test_Comp_FotaTaskStubRunnable, RteActivationOsTaskRef=OsTask_FotaFun
        Rte_Al_TE_Test_Comp_GaugeTaskStubRunnable: RteActivationOsAlarmRef=Os/Rte_Al_TE_Test_Comp_GaugeTaskStubRunnable, RteActivationOsTaskRef=OsTask_GaugeFun
        Rte_Al_TE_Test_Comp_GraphicsTaskStubRunnable: RteActivationOsAlarmRef=Os/Rte_Al_TE_Test_Comp_GraphicsTaskStubRunnable, RteActivationOsTaskRef=OsTask_Graphics
        Rte_Al_TE_Test_Comp_IndTaskStubRunnable: RteActivationOsAlarmRef=Os/Rte_Al_TE_Test_Comp_IndTaskStubRunnable, RteActivationOsTaskRef=OsTask_IndFun
        Rte_Al_TE_Test_Comp_LinTaskStubRunnable: RteActivationOsAlarmRef=Os/Rte_Al_TE_Test_Comp_LinTaskStubRunnable, RteActivationOsTaskRef=OsTask_LinFun
        Rte_Al_TE_OsTask_Mcal_0_10ms: RteActivationOsAlarmRef=Os/Rte_Al_TE_OsTask_Mcal_0_10ms, RteActivationOsTaskRef=OsTask_Mcal
        Rte_Al_TE2_OsTask_MemSer_0_10ms: RteActivationOsAlarmRef=Os/Rte_Al_TE2_OsTask_MemSer_0_10ms, RteActivationOsTaskRef=OsTask_MemSer
        Rte_Al_TE_Ea_Ea_MainFunction: RteActivationOsAlarmRef=Os/Rte_Al_TE_Ea_Ea_MainFunction, RteActivationOsTaskRef=OsTask_MemSer
        Rte_Al_TE_OsTask_MemSer_0_10ms: RteActivationOsAlarmRef=Os/Rte_Al_TE_OsTask_MemSer_0_10ms, RteActivationOsTaskRef=OsTask_MemSer
        Rte_Al_TE_UclProxyCdd_CUclProxyCdd_Impl_MainFunction: RteActivationOsAlarmRef=Os/Rte_Al_TE_UclProxyCdd_CUclProxyCdd_Impl_MainFunction, RteActivationOsTaskRef=OsTask_MemSer
        Rte_Al_TE_Test_Comp_IoExp_MainFunction: RteActivationOsAlarmRef=Os/Rte_Al_TE_Test_Comp_IoExp_MainFunction, RteActivationOsTaskRef=OsTask_ModeMgt
        Rte_Al_TE_NvMExt_NvMExt_SpeedupRunnable: RteActivationOsAlarmRef=Os/Rte_Al_TE_NvMExt_NvMExt_SpeedupRunnable, RteActivationOsTaskRef=OsTask_NvmSpeedup
        Rte_Al_TE_Test_Comp_TxRxIpcMessage: RteActivationOsAlarmRef=Os/Rte_Al_TE_Test_Comp_TxRxIpcMessage, RteActivationOsTaskRef=OsTask_SafeFun
        Rte_Al_TE_Test_Comp_TripTaskStubRunnable: RteActivationOsAlarmRef=Os/Rte_Al_TE_Test_Comp_TripTaskStubRunnable, RteActivationOsTaskRef=OsTask_TripFun
        Rte_Al_TE_Test_Comp_WarnTaskStubRunnable: RteActivationOsAlarmRef=Os/Rte_Al_TE_Test_Comp_WarnTaskStubRunnable, RteActivationOsTaskRef=OsTask_WarnFun
        Rte_Al_TE_Test_Comp_WdgMgntTaskStubRunnable: RteActivationOsAlarmRef=Os/Rte_Al_TE_Test_Comp_WdgMgntTaskStubRunnable, RteActivationOsTaskRef=OsTask_WdgMngt
  module config NvM
    NvMCommonVendorParams: NvMCfgCbkIncludeList=Rte_Cbk.h
    60 x NvMBlockDescriptor, all with NvMBlockUseSyncMechanism=true, NvMSingleBlockCallback=NULL_PTR, NvMInitBlockCallback=NULL_PTR, NvMUseServicePorts=true:
      NvBlockSwComponentTypeNVBlockDescriptor_BsConst_Audio: NvMNvBlockLength=128, NvMRomBlockDataAddress=Rte_NvBlockSwComponentType_NVBlockDescriptor_BsConst_Audio_ROM_NVBlockDescriptor_BsConst_Audio, NvMWriteRamBlockToNvCallback=Rte_GetMirror_NvBlockSwComponentType_NVBlockDescriptor_BsConst_Audio, NvMReadRamBlockFromNvCallback=Rte_SetMirror_NvBlockSwComponentType_NVBlockDescriptor_BsConst_Audio
      NvBlockSwComponentTypeNVBlockDescriptor_BsConst_Communication: NvMNvBlockLength=64, NvMRomBlockDataAddress=Rte_NvBlockSwComponentType_NVBlockDescriptor_BsConst_Communication_ROM_NVBlockDescriptor_BsConst_Communication, NvMWriteRamBlockToNvCallback=Rte_GetMirror_NvBlockSwComponentType_NVBlockDescriptor_BsConst_Communication, NvMReadRamBlockFromNvCallback=Rte_SetMirror_NvBlockSwComponentType_NVBlockDescriptor_BsConst_Communication
      NvBlockSwComponentTypeNVBlockDescriptor_BsConst_EngOffTimer: NvMNvBlockLength=32, NvMRomBlockDataAddress=Rte_NvBlockSwComponentType_NVBlockDescriptor_BsConst_EngOffTimer_ROM_NVBlockDescriptor_BsConst_EngOffTimer, NvMWriteRamBlockToNvCallback=Rte_GetMirror_NvBlockSwComponentType_NVBlockDescriptor_BsConst_EngOffTimer, NvMReadRamBlockFromNvCallback=Rte_SetMirror_NvBlockSwComponentType_NVBlockDescriptor_BsConst_EngOffTimer
      NvBlockSwComponentTypeNVBlockDescriptor_BsConst_FuelGauge: NvMNvBlockLength=128, NvMRomBlockDataAddress=Rte_NvBlockSwComponentType_NVBlockDescriptor_BsConst_FuelGauge_ROM_NVBlockDescriptor_BsConst_FuelGauge, NvMWriteRamBlockToNvCallback=Rte_GetMirror_NvBlockSwComponentType_NVBlockDescriptor_BsConst_FuelGauge, NvMReadRamBlockFromNvCallback=Rte_SetMirror_NvBlockSwComponentType_NVBlockDescriptor_BsConst_FuelGauge
      NvBlockSwComponentTypeNVBlockDescriptor_BsConst_Illumination: NvMNvBlockLength=128, NvMRomBlockDataAddress=Rte_NvBlockSwComponentType_NVBlockDescriptor_BsConst_Illumination_ROM_NVBlockDescriptor_BsConst_Illumination, NvMWriteRamBlockToNvCallback=Rte_GetMirror_NvBlockSwComponentType_NVBlockDescriptor_BsConst_Illumination, NvMReadRamBlockFromNvCallback=Rte_SetMirror_NvBlockSwComponentType_NVBlockDescriptor_BsConst_Illumination
      NvBlockSwComponentTypeNVBlockDescriptor_BsConst_OilGauge: NvMNvBlockLength=64, NvMRomBlockDataAddress=Rte_NvBlockSwComponentType_NVBlockDescriptor_BsConst_OilGauge_ROM_NVBlockDescriptor_BsConst_OilGauge, NvMWriteRamBlockToNvCallback=Rte_GetMirror_NvBlockSwComponentType_NVBlockDescriptor_BsConst_OilGauge, NvMReadRamBlockFromNvCallback=Rte_SetMirror_NvBlockSwComponentType_NVBlockDescriptor_BsConst_OilGauge
      NvBlockSwComponentTypeNVBlockDescriptor_BsConst_Power: NvMNvBlockLength=32, NvMRomBlockDataAddress=Rte_NvBlockSwComponentType_NVBlockDescriptor_BsConst_Power_ROM_NVBlockDescriptor_BsConst_Power, NvMWriteRamBlockToNvCallback=Rte_GetMirror_NvBlockSwComponentType_NVBlockDescriptor_BsConst_Power, NvMReadRamBlockFromNvCallback=Rte_SetMirror_NvBlockSwComponentType_NVBlockDescriptor_BsConst_Power
      NvBlockSwComponentTypeNVBlockDescriptor_BsConst_PowerGauge: NvMNvBlockLength=64, NvMRomBlockDataAddress=Rte_NvBlockSwComponentType_NVBlockDescriptor_BsConst_PowerGauge_ROM_NVBlockDescriptor_BsConst_PowerGauge, NvMWriteRamBlockToNvCallback=Rte_GetMirror_NvBlockSwComponentType_NVBlockDescriptor_BsConst_PowerGauge, NvMReadRamBlockFromNvCallback=Rte_SetMirror_NvBlockSwComponentType_NVBlockDescriptor_BsConst_PowerGauge
      NvBlockSwComponentTypeNVBlockDescriptor_BsConst_RealTimeClock: NvMNvBlockLength=48, NvMRomBlockDataAddress=Rte_NvBlockSwComponentType_NVBlockDescriptor_BsConst_RealTimeClock_ROM_NVBlockDescriptor_BsConst_RealTimeClock, NvMWriteRamBlockToNvCallback=Rte_GetMirror_NvBlockSwComponentType_NVBlockDescriptor_BsConst_RealTimeClock, NvMReadRamBlockFromNvCallback=Rte_SetMirror_NvBlockSwComponentType_NVBlockDescriptor_BsConst_RealTimeClock
      NvBlockSwComponentTypeNVBlockDescriptor_BsConst_ServiceReminder: NvMNvBlockLength=48, NvMRomBlockDataAddress=Rte_NvBlockSwComponentType_NVBlockDescriptor_BsConst_ServiceReminder_ROM_NVBlockDescriptor_BsConst_ServiceReminder, NvMWriteRamBlockToNvCallback=Rte_GetMirror_NvBlockSwComponentType_NVBlockDescriptor_BsConst_ServiceReminder, NvMReadRamBlockFromNvCallback=Rte_SetMirror_NvBlockSwComponentType_NVBlockDescriptor_BsConst_ServiceReminder
      NvBlockSwComponentTypeNVBlockDescriptor_BsConst_SpeedoGauge: NvMNvBlockLength=64, NvMRomBlockDataAddress=Rte_NvBlockSwComponentType_NVBlockDescriptor_BsConst_SpeedoGauge_ROM_NVBlockDescriptor_BsConst_SpeedoGauge, NvMWriteRamBlockToNvCallback=Rte_GetMirror_NvBlockSwComponentType_NVBlockDescriptor_BsConst_SpeedoGauge, NvMReadRamBlockFromNvCallback=Rte_SetMirror_NvBlockSwComponentType_NVBlockDescriptor_BsConst_SpeedoGauge
      NvBlockSwComponentTypeNVBlockDescriptor_BsConst_TachoGauge: NvMNvBlockLength=64, NvMRomBlockDataAddress=Rte_NvBlockSwComponentType_NVBlockDescriptor_BsConst_TachoGauge_ROM_NVBlockDescriptor_BsConst_TachoGauge, NvMWriteRamBlockToNvCallback=Rte_GetMirror_NvBlockSwComponentType_NVBlockDescriptor_BsConst_TachoGauge, NvMReadRamBlockFromNvCallback=Rte_SetMirror_NvBlockSwComponentType_NVBlockDescriptor_BsConst_TachoGauge
      NvBlockSwComponentTypeNVBlockDescriptor_BsConst_TempGauge: NvMNvBlockLength=64, NvMRomBlockDataAddress=Rte_NvBlockSwComponentType_NVBlockDescriptor_BsConst_TempGauge_ROM_NVBlockDescriptor_BsConst_TempGauge, NvMWriteRamBlockToNvCallback=Rte_GetMirror_NvBlockSwComponentType_NVBlockDescriptor_BsConst_TempGauge, NvMReadRamBlockFromNvCallback=Rte_SetMirror_NvBlockSwComponentType_NVBlockDescriptor_BsConst_TempGauge
      NvBlockSwComponentTypeNVBlockDescriptor_BsConst_TripComputer: NvMNvBlockLength=64, NvMRomBlockDataAddress=Rte_NvBlockSwComponentType_NVBlockDescriptor_BsConst_TripComputer_ROM_NVBlockDescriptor_BsConst_TripComputer, NvMWriteRamBlockToNvCallback=Rte_GetMirror_NvBlockSwComponentType_NVBlockDescriptor_BsConst_TripComputer, NvMReadRamBlockFromNvCallback=Rte_SetMirror_NvBlockSwComponentType_NVBlockDescriptor_BsConst_TripComputer
      NvBlockSwComponentTypeNVBlockDescriptor_BsConst_Warning: NvMNvBlockLength=64, NvMRomBlockDataAddress=Rte_NvBlockSwComponentType_NVBlockDescriptor_BsConst_Warning_ROM_NVBlockDescriptor_BsConst_Warning, NvMWriteRamBlockToNvCallback=Rte_GetMirror_NvBlockSwComponentType_NVBlockDescriptor_BsConst_Warning, NvMReadRamBlockFromNvCallback=Rte_SetMirror_NvBlockSwComponentType_NVBlockDescriptor_BsConst_Warning
      NvBlockSwComponentTypeNVBlockDescriptor_BsCys_Certicificate: NvMNvBlockLength=64, NvMRomBlockDataAddress=Rte_NvBlockSwComponentType_NVBlockDescriptor_BsCys_Certicificate_ROM_NVBlockDescriptor_BsCys_Certicificate, NvMWriteRamBlockToNvCallback=Rte_GetMirror_NvBlockSwComponentType_NVBlockDescriptor_BsCys_Certicificate, NvMReadRamBlockFromNvCallback=Rte_SetMirror_NvBlockSwComponentType_NVBlockDescriptor_BsCys_Certicificate
      NvBlockSwComponentTypeNVBlockDescriptor_BsDiag_Dtc: NvMNvBlockLength=2048, NvMRomBlockDataAddress=Rte_NvBlockSwComponentType_NVBlockDescriptor_BsDiag_Dtc_ROM_NVBlockDescriptor_BsDiag_Dtc, NvMWriteRamBlockToNvCallback=Rte_GetMirror_NvBlockSwComponentType_NVBlockDescriptor_BsDiag_Dtc, NvMReadRamBlockFromNvCallback=Rte_SetMirror_NvBlockSwComponentType_NVBlockDescriptor_BsDiag_Dtc
      NvBlockSwComponentTypeNVBlockDescriptor_BsDiag_ErrorRecord: NvMNvBlockLength=1024, NvMRomBlockDataAddress=Rte_NvBlockSwComponentType_NVBlockDescriptor_BsDiag_ErrorRecord_ROM_NVBlockDescriptor_BsDiag_ErrorRecord, NvMWriteRamBlockToNvCallback=Rte_GetMirror_NvBlockSwComponentType_NVBlockDescriptor_BsDiag_ErrorRecord, NvMReadRamBlockFromNvCallback=Rte_SetMirror_NvBlockSwComponentType_NVBlockDescriptor_BsDiag_ErrorRecord
      NvBlockSwComponentTypeNVBlockDescriptor_BsFuSa_Audio: NvMNvBlockLength=32, NvMRomBlockDataAddress=Rte_NvBlockSwComponentType_NVBlockDescriptor_BsFuSa_Audio_ROM_NVBlockDescriptor_BsFuSa_Audio, NvMWriteRamBlockToNvCallback=Rte_GetMirror_NvBlockSwComponentType_NVBlockDescriptor_BsFuSa_Audio, NvMReadRamBlockFromNvCallback=Rte_SetMirror_NvBlockSwComponentType_NVBlockDescriptor_BsFuSa_Audio
      NvBlockSwComponentTypeNVBlockDescriptor_BsFuSa_Communication: NvMNvBlockLength=16, NvMRomBlockDataAddress=Rte_NvBlockSwComponentType_NVBlockDescriptor_BsFuSa_Communication_ROM_NVBlockDescriptor_BsFuSa_Communication, NvMWriteRamBlockToNvCallback=Rte_GetMirror_NvBlockSwComponentType_NVBlockDescriptor_BsFuSa_Communication, NvMReadRamBlockFromNvCallback=Rte_SetMirror_NvBlockSwComponentType_NVBlockDescriptor_BsFuSa_Communication
      NvBlockSwComponentTypeNVBlockDescriptor_BsFuSa_Config: NvMNvBlockLength=16, NvMRomBlockDataAddress=Rte_NvBlockSwComponentType_NVBlockDescriptor_BsFuSa_Config_ROM_NVBlockDescriptor_BsFuSa_Config, NvMWriteRamBlockToNvCallback=Rte_GetMirror_NvBlockSwComponentType_NVBlockDescriptor_BsFuSa_Config, NvMReadRamBlockFromNvCallback=Rte_SetMirror_NvBlockSwComponentType_NVBlockDescriptor_BsFuSa_Config
      NvBlockSwComponentTypeNVBlockDescriptor_BsFuSa_Display: NvMNvBlockLength=64, NvMRomBlockDataAddress=Rte_NvBlockSwComponentType_NVBlockDescriptor_BsFuSa_Display_ROM_NVBlockDescriptor_BsFuSa_Display, NvMWriteRamBlockToNvCallback=Rte_GetMirror_NvBlockSwComponentType_NVBlockDescriptor_BsFuSa_Display, NvMReadRamBlockFromNvCallback=Rte_SetMirror_NvBlockSwComponentType_NVBlockDescriptor_BsFuSa_Display
      NvBlockSwComponentTypeNVBlockDescriptor_BsFuSa_Power: NvMNvBlockLength=48, NvMRomBlockDataAddress=Rte_NvBlockSwComponentType_NVBlockDescriptor_BsFuSa_Power_ROM_NVBlockDescriptor_BsFuSa_Power, NvMWriteRamBlockToNvCallback=Rte_GetMirror_NvBlockSwComponentType_NVBlockDescriptor_BsFuSa_Power, NvMReadRamBlockFromNvCallback=Rte_SetMirror_NvBlockSwComponentType_NVBlockDescriptor_BsFuSa_Power
      NvBlockSwComponentTypeNVBlockDescriptor_BsFuSa_Warning: NvMNvBlockLength=32, NvMRomBlockDataAddress=Rte_NvBlockSwComponentType_NVBlockDescriptor_BsFuSa_Warning_ROM_NVBlockDescriptor_BsFuSa_Warning, NvMWriteRamBlockToNvCallback=Rte_GetMirror_NvBlockSwComponentType_NVBlockDescriptor_BsFuSa_Warning, NvMReadRamBlockFromNvCallback=Rte_SetMirror_NvBlockSwComponentType_NVBlockDescriptor_BsFuSa_Warning
      NvBlockSwComponentTypeNVBlockDescriptor_BsFusa_Fota: NvMNvBlockLength=32, NvMRomBlockDataAddress=Rte_NvBlockSwComponentType_NVBlockDescriptor_BsFusa_Fota_ROM_NVBlockDescriptor_BsFusa_Fota, NvMWriteRamBlockToNvCallback=Rte_GetMirror_NvBlockSwComponentType_NVBlockDescriptor_BsFusa_Fota, NvMReadRamBlockFromNvCallback=Rte_SetMirror_NvBlockSwComponentType_NVBlockDescriptor_BsFusa_Fota
      NvBlockSwComponentTypeNVBlockDescriptor_BsReten_Audio: NvMNvBlockLength=100, NvMRomBlockDataAddress=Rte_NvBlockSwComponentType_NVBlockDescriptor_BsReten_Audio_ROM_NVBlockDescriptor_BsReten_Audio, NvMWriteRamBlockToNvCallback=Rte_GetMirror_NvBlockSwComponentType_NVBlockDescriptor_BsReten_Audio, NvMReadRamBlockFromNvCallback=Rte_SetMirror_NvBlockSwComponentType_NVBlockDescriptor_BsReten_Audio
      NvBlockSwComponentTypeNVBlockDescriptor_BsReten_Communication: NvMNvBlockLength=100, NvMRomBlockDataAddress=Rte_NvBlockSwComponentType_NVBlockDescriptor_BsReten_Communication_ROM_NVBlockDescriptor_BsReten_Communication, NvMWriteRamBlockToNvCallback=Rte_GetMirror_NvBlockSwComponentType_NVBlockDescriptor_BsReten_Communication, NvMReadRamBlockFromNvCallback=Rte_SetMirror_NvBlockSwComponentType_NVBlockDescriptor_BsReten_Communication
      NvBlockSwComponentTypeNVBlockDescriptor_BsReten_Display: NvMNvBlockLength=100, NvMRomBlockDataAddress=Rte_NvBlockSwComponentType_NVBlockDescriptor_BsReten_Display_ROM_NVBlockDescriptor_BsReten_Display, NvMWriteRamBlockToNvCallback=Rte_GetMirror_NvBlockSwComponentType_NVBlockDescriptor_BsReten_Display, NvMReadRamBlockFromNvCallback=Rte_SetMirror_NvBlockSwComponentType_NVBlockDescriptor_BsReten_Display
      NvBlockSwComponentTypeNVBlockDescriptor_BsReten_Gauges: NvMNvBlockLength=100, NvMRomBlockDataAddress=Rte_NvBlockSwComponentType_NVBlockDescriptor_BsReten_Gauges_ROM_NVBlockDescriptor_BsReten_Gauges, NvMWriteRamBlockToNvCallback=Rte_GetMirror_NvBlockSwComponentType_NVBlockDescriptor_BsReten_Gauges, NvMReadRamBlockFromNvCallback=Rte_SetMirror_NvBlockSwComponentType_NVBlockDescriptor_BsReten_Gauges
      NvBlockSwComponentTypeNVBlockDescriptor_BsReten_Illumination: NvMNvBlockLength=100, NvMRomBlockDataAddress=Rte_NvBlockSwComponentType_NVBlockDescriptor_BsReten_Illumination_ROM_NVBlockDescriptor_BsReten_Illumination, NvMWriteRamBlockToNvCallback=Rte_GetMirror_NvBlockSwComponentType_NVBlockDescriptor_BsReten_Illumination, NvMReadRamBlockFromNvCallback=Rte_SetMirror_NvBlockSwComponentType_NVBlockDescriptor_BsReten_Illumination
      NvBlockSwComponentTypeNVBlockDescriptor_BsReten_Odometer: NvMNvBlockLength=100, NvMRomBlockDataAddress=Rte_NvBlockSwComponentType_NVBlockDescriptor_BsReten_Odometer_ROM_NVBlockDescriptor_BsReten_Odometer, NvMWriteRamBlockToNvCallback=Rte_GetMirror_NvBlockSwComponentType_NVBlockDescriptor_BsReten_Odometer, NvMReadRamBlockFromNvCallback=Rte_SetMirror_NvBlockSwComponentType_NVBlockDescriptor_BsReten_Odometer
      NvBlockSwComponentTypeNVBlockDescriptor_BsReten_Personalization: NvMNvBlockLength=100, NvMRomBlockDataAddress=Rte_NvBlockSwComponentType_NVBlockDescriptor_BsReten_Personalization_ROM_NVBlockDescriptor_BsReten_Personalization, NvMWriteRamBlockToNvCallback=Rte_GetMirror_NvBlockSwComponentType_NVBlockDescriptor_BsReten_Personalization, NvMReadRamBlockFromNvCallback=Rte_SetMirror_NvBlockSwComponentType_NVBlockDescriptor_BsReten_Personalization
      NvBlockSwComponentTypeNVBlockDescriptor_BsReten_Power: NvMNvBlockLength=100, NvMRomBlockDataAddress=Rte_NvBlockSwComponentType_NVBlockDescriptor_BsReten_Power_ROM_NVBlockDescriptor_BsReten_Power, NvMWriteRamBlockToNvCallback=Rte_GetMirror_NvBlockSwComponentType_NVBlockDescriptor_BsReten_Power, NvMReadRamBlockFromNvCallback=Rte_SetMirror_NvBlockSwComponentType_NVBlockDescriptor_BsReten_Power
      NvBlockSwComponentTypeNVBlockDescriptor_BsReten_RealTimeClock: NvMNvBlockLength=100, NvMRomBlockDataAddress=Rte_NvBlockSwComponentType_NVBlockDescriptor_BsReten_RealTimeClock_ROM_NVBlockDescriptor_BsReten_RealTimeClock, NvMWriteRamBlockToNvCallback=Rte_GetMirror_NvBlockSwComponentType_NVBlockDescriptor_BsReten_RealTimeClock, NvMReadRamBlockFromNvCallback=Rte_SetMirror_NvBlockSwComponentType_NVBlockDescriptor_BsReten_RealTimeClock
      NvBlockSwComponentTypeNVBlockDescriptor_BsReten_Tripcomputer: NvMNvBlockLength=100, NvMRomBlockDataAddress=Rte_NvBlockSwComponentType_NVBlockDescriptor_BsReten_Tripcomputer_ROM_NVBlockDescriptor_BsReten_Tripcomputer, NvMWriteRamBlockToNvCallback=Rte_GetMirror_NvBlockSwComponentType_NVBlockDescriptor_BsReten_Tripcomputer, NvMReadRamBlockFromNvCallback=Rte_SetMirror_NvBlockSwComponentType_NVBlockDescriptor_BsReten_Tripcomputer
      NvBlockSwComponentTypeNVBlockDescriptor_BsReten_VisDlt: NvMNvBlockLength=256, NvMRomBlockDataAddress=Rte_NvBlockSwComponentType_NVBlockDescriptor_BsReten_VisDlt_ROM_NVBlockDescriptor_BsReten_VisDlt, NvMWriteRamBlockToNvCallback=Rte_GetMirror_NvBlockSwComponentType_NVBlockDescriptor_BsReten_VisDlt, NvMReadRamBlockFromNvCallback=Rte_SetMirror_NvBlockSwComponentType_NVBlockDescriptor_BsReten_VisDlt
      NvBlockSwComponentTypeNVBlockDescriptor_BsReten_Warning: NvMNvBlockLength=100, NvMRomBlockDataAddress=Rte_NvBlockSwComponentType_NVBlockDescriptor_BsReten_Warning_ROM_NVBlockDescriptor_BsReten_Warning, NvMWriteRamBlockToNvCallback=Rte_GetMirror_NvBlockSwComponentType_NVBlockDescriptor_BsReten_Warning, NvMReadRamBlockFromNvCallback=Rte_SetMirror_NvBlockSwComponentType_NVBlockDescriptor_BsReten_Warning
      NvBlockSwComponentTypeNVBlockDescriptor_BsRt_CusDlt: NvMNvBlockLength=128, NvMRomBlockDataAddress=Rte_NvBlockSwComponentType_NVBlockDescriptor_BsRt_CusDlt_ROM_NVBlockDescriptor_BsRt_CusDlt, NvMWriteRamBlockToNvCallback=Rte_GetMirror_NvBlockSwComponentType_NVBlockDescriptor_BsRt_CusDlt, NvMReadRamBlockFromNvCallback=Rte_SetMirror_NvBlockSwComponentType_NVBlockDescriptor_BsRt_CusDlt
      NvBlockSwComponentTypeNVBlockDescriptor_BsRt_FuelGauge: NvMNvBlockLength=32, NvMRomBlockDataAddress=Rte_NvBlockSwComponentType_NVBlockDescriptor_BsRt_FuelGauge_ROM_NVBlockDescriptor_BsRt_FuelGauge, NvMWriteRamBlockToNvCallback=Rte_GetMirror_NvBlockSwComponentType_NVBlockDescriptor_BsRt_FuelGauge, NvMReadRamBlockFromNvCallback=Rte_SetMirror_NvBlockSwComponentType_NVBlockDescriptor_BsRt_FuelGauge
      NvBlockSwComponentTypeNVBlockDescriptor_BsRt_Illumination: NvMNvBlockLength=100, NvMRomBlockDataAddress=Rte_NvBlockSwComponentType_NVBlockDescriptor_BsRt_Illumination_ROM_NVBlockDescriptor_BsRt_Illumination, NvMWriteRamBlockToNvCallback=Rte_GetMirror_NvBlockSwComponentType_NVBlockDescriptor_BsRt_Illumination, NvMReadRamBlockFromNvCallback=Rte_SetMirror_NvBlockSwComponentType_NVBlockDescriptor_BsRt_Illumination
      NvBlockSwComponentTypeNVBlockDescriptor_BsRt_Odometer: NvMNvBlockLength=128, NvMRomBlockDataAddress=Rte_NvBlockSwComponentType_NVBlockDescriptor_BsRt_Odometer_ROM_NVBlockDescriptor_BsRt_Odometer, NvMWriteRamBlockToNvCallback=Rte_GetMirror_NvBlockSwComponentType_NVBlockDescriptor_BsRt_Odometer, NvMReadRamBlockFromNvCallback=Rte_SetMirror_NvBlockSwComponentType_NVBlockDescriptor_BsRt_Odometer
      NvBlockSwComponentTypeNVBlockDescriptor_BsRt_OilGauge: NvMNvBlockLength=8, NvMRomBlockDataAddress=Rte_NvBlockSwComponentType_NVBlockDescriptor_BsRt_OilGauge_ROM_NVBlockDescriptor_BsRt_OilGauge, NvMWriteRamBlockToNvCallback=Rte_GetMirror_NvBlockSwComponentType_NVBlockDescriptor_BsRt_OilGauge, NvMReadRamBlockFromNvCallback=Rte_SetMirror_NvBlockSwComponentType_NVBlockDescriptor_BsRt_OilGauge
      NvBlockSwComponentTypeNVBlockDescriptor_BsRt_Personalization: NvMNvBlockLength=128, NvMRomBlockDataAddress=Rte_NvBlockSwComponentType_NVBlockDescriptor_BsRt_Personalization_ROM_NVBlockDescriptor_BsRt_Personalization, NvMWriteRamBlockToNvCallback=Rte_GetMirror_NvBlockSwComponentType_NVBlockDescriptor_BsRt_Personalization, NvMReadRamBlockFromNvCallback=Rte_SetMirror_NvBlockSwComponentType_NVBlockDescriptor_BsRt_Personalization
      NvBlockSwComponentTypeNVBlockDescriptor_BsRt_PowerGauge: NvMNvBlockLength=32, NvMRomBlockDataAddress=Rte_NvBlockSwComponentType_NVBlockDescriptor_BsRt_PowerGauge_ROM_NVBlockDescriptor_BsRt_PowerGauge, NvMWriteRamBlockToNvCallback=Rte_GetMirror_NvBlockSwComponentType_NVBlockDescriptor_BsRt_PowerGauge, NvMReadRamBlockFromNvCallback=Rte_SetMirror_NvBlockSwComponentType_NVBlockDescriptor_BsRt_PowerGauge
      NvBlockSwComponentTypeNVBlockDescriptor_BsRt_RealTimeClock: NvMNvBlockLength=48, NvMRomBlockDataAddress=Rte_NvBlockSwComponentType_NVBlockDescriptor_BsRt_RealTimeClock_ROM_NVBlockDescriptor_BsRt_RealTimeClock, NvMWriteRamBlockToNvCallback=Rte_GetMirror_NvBlockSwComponentType_NVBlockDescriptor_BsRt_RealTimeClock, NvMReadRamBlockFromNvCallback=Rte_SetMirror_NvBlockSwComponentType_NVBlockDescriptor_BsRt_RealTimeClock
      NvBlockSwComponentTypeNVBlockDescriptor_BsRt_SpeedoGauge: NvMNvBlockLength=8, NvMRomBlockDataAddress=Rte_NvBlockSwComponentType_NVBlockDescriptor_BsRt_SpeedoGauge_ROM_NVBlockDescriptor_BsRt_SpeedoGauge, NvMWriteRamBlockToNvCallback=Rte_GetMirror_NvBlockSwComponentType_NVBlockDescriptor_BsRt_SpeedoGauge, NvMReadRamBlockFromNvCallback=Rte_SetMirror_NvBlockSwComponentType_NVBlockDescriptor_BsRt_SpeedoGauge
      NvBlockSwComponentTypeNVBlockDescriptor_BsRt_TachoGauge: NvMNvBlockLength=16, NvMRomBlockDataAddress=Rte_NvBlockSwComponentType_NVBlockDescriptor_BsRt_TachoGauge_ROM_NVBlockDescriptor_BsRt_TachoGauge, NvMWriteRamBlockToNvCallback=Rte_GetMirror_NvBlockSwComponentType_NVBlockDescriptor_BsRt_TachoGauge, NvMReadRamBlockFromNvCallback=Rte_SetMirror_NvBlockSwComponentType_NVBlockDescriptor_BsRt_TachoGauge
      NvBlockSwComponentTypeNVBlockDescriptor_BsRt_TempGauge: NvMNvBlockLength=32, NvMRomBlockDataAddress=Rte_NvBlockSwComponentType_NVBlockDescriptor_BsRt_TempGauge_ROM_NVBlockDescriptor_BsRt_TempGauge, NvMWriteRamBlockToNvCallback=Rte_GetMirror_NvBlockSwComponentType_NVBlockDescriptor_BsRt_TempGauge, NvMReadRamBlockFromNvCallback=Rte_SetMirror_NvBlockSwComponentType_NVBlockDescriptor_BsRt_TempGauge
      NvBlockSwComponentTypeNVBlockDescriptor_BsRt_TripComputer: NvMNvBlockLength=64, NvMRomBlockDataAddress=Rte_NvBlockSwComponentType_NVBlockDescriptor_BsRt_TripComputer_ROM_NVBlockDescriptor_BsRt_TripComputer, NvMWriteRamBlockToNvCallback=Rte_GetMirror_NvBlockSwComponentType_NVBlockDescriptor_BsRt_TripComputer, NvMReadRamBlockFromNvCallback=Rte_SetMirror_NvBlockSwComponentType_NVBlockDescriptor_BsRt_TripComputer
      NvBlockSwComponentTypeNVBlockDescriptor_BsRt_Warning: NvMNvBlockLength=32, NvMRomBlockDataAddress=Rte_NvBlockSwComponentType_NVBlockDescriptor_BsRt_Warning_ROM_NVBlockDescriptor_BsRt_Warning, NvMWriteRamBlockToNvCallback=Rte_GetMirror_NvBlockSwComponentType_NVBlockDescriptor_BsRt_Warning, NvMReadRamBlockFromNvCallback=Rte_SetMirror_NvBlockSwComponentType_NVBlockDescriptor_BsRt_Warning
      NvBlockSwComponentTypeNVBlockDescriptor_BsShare_EcuPartNumber: NvMNvBlockLength=128, NvMRomBlockDataAddress=Rte_NvBlockSwComponentType_NVBlockDescriptor_BsShare_EcuPartNumber_ROM_NVBlockDescriptor_BsShare_EcuPartNumber, NvMWriteRamBlockToNvCallback=Rte_GetMirror_NvBlockSwComponentType_NVBlockDescriptor_BsShare_EcuPartNumber, NvMReadRamBlockFromNvCallback=Rte_SetMirror_NvBlockSwComponentType_NVBlockDescriptor_BsShare_EcuPartNumber
      NvBlockSwComponentTypeNVBlockDescriptor_BsShare_SwUpdFotaFinPrint: NvMNvBlockLength=32, NvMRomBlockDataAddress=Rte_NvBlockSwComponentType_NVBlockDescriptor_BsShare_SwUpdFotaFinPrint_ROM_NVBlockDescriptor_BsShare_SwUpdFotaFinPrint, NvMWriteRamBlockToNvCallback=Rte_GetMirror_NvBlockSwComponentType_NVBlockDescriptor_BsShare_SwUpdFotaFinPrint, NvMReadRamBlockFromNvCallback=Rte_SetMirror_NvBlockSwComponentType_NVBlockDescriptor_BsShare_SwUpdFotaFinPrint
      NvBlockSwComponentTypeNVBlockDescriptor_BsShare_SwUpdFotaMode: NvMNvBlockLength=16, NvMRomBlockDataAddress=Rte_NvBlockSwComponentType_NVBlockDescriptor_BsShare_SwUpdFotaMode_ROM_NVBlockDescriptor_BsShare_SwUpdFotaMode, NvMWriteRamBlockToNvCallback=Rte_GetMirror_NvBlockSwComponentType_NVBlockDescriptor_BsShare_SwUpdFotaMode, NvMReadRamBlockFromNvCallback=Rte_SetMirror_NvBlockSwComponentType_NVBlockDescriptor_BsShare_SwUpdFotaMode
      NvBlockSwComponentTypeNVBlockDescriptor_BsShare_SwUpdFotaStatus: NvMNvBlockLength=48, NvMRomBlockDataAddress=Rte_NvBlockSwComponentType_NVBlockDescriptor_BsShare_SwUpdFotaStatus_ROM_NVBlockDescriptor_BsShare_SwUpdFotaStatus, NvMWriteRamBlockToNvCallback=Rte_GetMirror_NvBlockSwComponentType_NVBlockDescriptor_BsShare_SwUpdFotaStatus, NvMReadRamBlockFromNvCallback=Rte_SetMirror_NvBlockSwComponentType_NVBlockDescriptor_BsShare_SwUpdFotaStatus
      NvBlockSwComponentTypeNVBlockDescriptor_BsShare_SwUpdFotadecrypt: NvMNvBlockLength=64, NvMRomBlockDataAddress=Rte_NvBlockSwComponentType_NVBlockDescriptor_BsShare_SwUpdFotadecrypt_ROM_NVBlockDescriptor_BsShare_SwUpdFotadecrypt, NvMWriteRamBlockToNvCallback=Rte_GetMirror_NvBlockSwComponentType_NVBlockDescriptor_BsShare_SwUpdFotadecrypt, NvMReadRamBlockFromNvCallback=Rte_SetMirror_NvBlockSwComponentType_NVBlockDescriptor_BsShare_SwUpdFotadecrypt
      NvBlockSwComponentTypeNVBlockDescriptor_BsShare_SwUpdReflash: NvMNvBlockLength=8, NvMRomBlockDataAddress=Rte_NvBlockSwComponentType_NVBlockDescriptor_BsShare_SwUpdReflash_ROM_NVBlockDescriptor_BsShare_SwUpdReflash, NvMWriteRamBlockToNvCallback=Rte_GetMirror_NvBlockSwComponentType_NVBlockDescriptor_BsShare_SwUpdReflash, NvMReadRamBlockFromNvCallback=Rte_SetMirror_NvBlockSwComponentType_NVBlockDescriptor_BsShare_SwUpdReflash
      NvBlockSwComponentTypeNVBlockDescriptor_BsShare_VehicleConfig: NvMNvBlockLength=256, NvMRomBlockDataAddress=Rte_NvBlockSwComponentType_NVBlockDescriptor_BsShare_VehicleConfig_ROM_NVBlockDescriptor_BsShare_VehicleConfig, NvMWriteRamBlockToNvCallback=Rte_GetMirror_NvBlockSwComponentType_NVBlockDescriptor_BsShare_VehicleConfig, NvMReadRamBlockFromNvCallback=Rte_SetMirror_NvBlockSwComponentType_NVBlockDescriptor_BsShare_VehicleConfig
      NvBlockSwComponentTypeNVBlockDescriptor_BsShare_VisMeet: NvMNvBlockLength=48, NvMRomBlockDataAddress=Rte_NvBlockSwComponentType_NVBlockDescriptor_BsShare_VisMeet_ROM_NVBlockDescriptor_BsShare_VisMeet, NvMWriteRamBlockToNvCallback=Rte_GetMirror_NvBlockSwComponentType_NVBlockDescriptor_BsShare_VisMeet, NvMReadRamBlockFromNvCallback=Rte_SetMirror_NvBlockSwComponentType_NVBlockDescriptor_BsShare_VisMeet
      NvBlockSwComponentTypeNVBlockDescriptor_RefCys_Certicificate: NvMNvBlockLength=64, NvMRomBlockDataAddress=Rte_NvBlockSwComponentType_NVBlockDescriptor_RefCys_Certicificate_ROM_NVBlockDescriptor_RefCys_Certicificate, NvMWriteRamBlockToNvCallback=Rte_GetMirror_NvBlockSwComponentType_NVBlockDescriptor_RefCys_Certicificate, NvMReadRamBlockFromNvCallback=Rte_SetMirror_NvBlockSwComponentType_NVBlockDescriptor_RefCys_Certicificate
      NvBlockSwComponentTypeNVBlockDescriptor_RefCys_Certicificate1: NvMNvBlockLength=64, NvMRomBlockDataAddress=Rte_NvBlockSwComponentType_NVBlockDescriptor_RefCys_Certicificate1_ROM_NVBlockDescriptor_RefCys_Certicificate1, NvMWriteRamBlockToNvCallback=Rte_GetMirror_NvBlockSwComponentType_NVBlockDescriptor_RefCys_Certicificate1, NvMReadRamBlockFromNvCallback=Rte_SetMirror_NvBlockSwComponentType_NVBlockDescriptor_RefCys_Certicificate1
  module config Os
    OsTask_AppFun (OsTask): OsTaskActivation=1, OsTaskPriority=15, OsTaskSchedule=NON
    Rte_Al_TE_Test_Comp_AppTaskStubRunnable (OsAlarm): OsAlarmCounterRef=SystemTimer
      OsAlarmAction
        OsAlarmActivateTask: OsAlarmActivateTaskRef=OsTask_AppFun
    OsTask_AudioFun (OsTask): OsTaskActivation=1, OsTaskPriority=11, OsTaskSchedule=NON
    Rte_Al_TE_Test_Comp_AudioTaskStubRunnable (OsAlarm): OsAlarmCounterRef=SystemTimer
      OsAlarmAction
        OsAlarmActivateTask: OsAlarmActivateTaskRef=OsTask_AudioFun
    OsTask_CANFun (OsTask): OsTaskActivation=1, OsTaskPriority=0, OsTaskSchedule=NON
    Rte_Al_TE_OsTask_CANFun_0_10ms (OsAlarm): OsAlarmCounterRef=SystemTimer
      OsAlarmAction
        OsAlarmActivateTask: OsAlarmActivateTaskRef=OsTask_CANFun
    OsTask_CddFun (OsTask):
      OsTaskActivation = 1
      OsTaskPriority = 2
      OsTaskSchedule = NON
      OsTaskEventRef = Rte_Ev_Cyclic_OsTask_CddFun_0_10ms
      OsTaskEventRef = Rte_Ev_Cyclic_OsTask_CddFun_0_5ms
    Rte_Al_TE_OsTask_CddFun_0_10ms (OsAlarm): OsAlarmCounterRef=SystemTimer
      OsAlarmAction
        OsAlarmSetEvent: OsAlarmSetEventRef=Rte_Ev_Cyclic_OsTask_CddFun_0_10ms, OsAlarmSetEventTaskRef=OsTask_CddFun
    Rte_Al_TE_OsTask_CddFun_0_5ms (OsAlarm): OsAlarmCounterRef=SystemTimer
      OsAlarmAction
        OsAlarmSetEvent: OsAlarmSetEventRef=Rte_Ev_Cyclic_OsTask_CddFun_0_5ms, OsAlarmSetEventTaskRef=OsTask_CddFun
    OsTask_Diagnostics (OsTask):
      OsTaskActivation = 1
      OsTaskPriority = 18
      OsTaskSchedule = NON
      OsTaskEventRef = Rte_Ev_Cyclic2_OsTask_Diagnostics_0_10ms
      OsTaskEventRef = Rte_Ev_Cyclic_OsTask_Diagnostics_0_100ms
    Rte_Al_TE2_OsTask_Diagnostics_0_10ms (OsAlarm): OsAlarmCounterRef=SystemTimer
      OsAlarmAction
        OsAlarmSetEvent: OsAlarmSetEventRef=Rte_Ev_Cyclic2_OsTask_Diagnostics_0_10ms, OsAlarmSetEventTaskRef=OsTask_Diagnostics
    Rte_Al_TE_OsTask_Diagnostics_0_100ms (OsAlarm): OsAlarmCounterRef=SystemTimer
      OsAlarmAction
        OsAlarmSetEvent: OsAlarmSetEventRef=Rte_Ev_Cyclic_OsTask_Diagnostics_0_100ms, OsAlarmSetEventTaskRef=OsTask_Diagnostics
    OsTask_EthFun (OsTask): OsTaskActivation=1, OsTaskPriority=7, OsTaskSchedule=NON
    Rte_Al_TE_OsTask_EthFun_0_10ms (OsAlarm): OsAlarmCounterRef=SystemTimer
      OsAlarmAction
        OsAlarmActivateTask: OsAlarmActivateTaskRef=OsTask_EthFun
    OsTask_FotaFun (OsTask): OsTaskActivation=1, OsTaskPriority=16, OsTaskSchedule=FULL
    Rte_Al_TE_Test_Comp_FotaTaskStubRunnable (OsAlarm): OsAlarmCounterRef=SystemTimer
      OsAlarmAction
        OsAlarmActivateTask: OsAlarmActivateTaskRef=OsTask_FotaFun
    OsTask_GaugeFun (OsTask): OsTaskActivation=1, OsTaskPriority=9, OsTaskSchedule=NON
    Rte_Al_TE_Test_Comp_GaugeTaskStubRunnable (OsAlarm): OsAlarmCounterRef=SystemTimer
      OsAlarmAction
        OsAlarmActivateTask: OsAlarmActivateTaskRef=OsTask_GaugeFun
    OsTask_Graphics (OsTask): OsTaskActivation=1, OsTaskPriority=17, OsTaskSchedule=FULL, OsTaskEventRef=Rte_Ev_Run_Test_Comp_GraphicsTaskStubRunnable
    Rte_Al_TE_Test_Comp_GraphicsTaskStubRunnable (OsAlarm): OsAlarmCounterRef=SystemTimer
      OsAlarmAction
        OsAlarmSetEvent: OsAlarmSetEventRef=Rte_Ev_Run_Test_Comp_GraphicsTaskStubRunnable, OsAlarmSetEventTaskRef=OsTask_Graphics
    OsTask_IndFun (OsTask): OsTaskActivation=1, OsTaskPriority=12, OsTaskSchedule=NON
    Rte_Al_TE_Test_Comp_IndTaskStubRunnable (OsAlarm): OsAlarmCounterRef=SystemTimer
      OsAlarmAction
        OsAlarmActivateTask: OsAlarmActivateTaskRef=OsTask_IndFun
    OsTask_LinFun (OsTask): OsTaskActivation=1, OsTaskPriority=10, OsTaskSchedule=NON
    Rte_Al_TE_Test_Comp_LinTaskStubRunnable (OsAlarm): OsAlarmCounterRef=SystemTimer
      OsAlarmAction
        OsAlarmActivateTask: OsAlarmActivateTaskRef=OsTask_LinFun
    OsTask_Mcal (OsTask): OsTaskActivation=1, OsTaskPriority=5, OsTaskSchedule=NON
    Rte_Al_TE_OsTask_Mcal_0_10ms (OsAlarm): OsAlarmCounterRef=SystemTimer
      OsAlarmAction
        OsAlarmActivateTask: OsAlarmActivateTaskRef=OsTask_Mcal
    OsTask_MemSer (OsTask):
      OsTaskActivation = 1
      OsTaskPriority = 4
      OsTaskSchedule = NON
      OsTaskEventRef = Rte_Ev_Cyclic2_OsTask_MemSer_0_10ms
      OsTaskEventRef = Rte_Ev_Cyclic_OsTask_MemSer_0_10ms
      OsTaskEventRef = Rte_Ev_Run_DmnMgr_DmnMgr_MonitorDmnExtendShutdownTime
      OsTaskEventRef = Rte_Ev_Run_DmnMgr_DmnMgr_MonitorDmnHealthDumpData
      OsTaskEventRef = Rte_Ev_Run_DmnMgr_DmnMgr_MonitorDmnHealthDumpHdrInfo
      OsTaskEventRef = Rte_Ev_Run_DmnMgr_DmnMgr_MonitorDmnHealthFatalError
      OsTaskEventRef = Rte_Ev_Run_DmnMgr_DmnMgr_MonitorDmnHeartBeat
      OsTaskEventRef = Rte_Ev_Run_DmnMgr_DmnMgr_MonitorDmnKeepSystemAwake
      OsTaskEventRef = Rte_Ev_Run_DmnMgr_DmnMgr_MonitorDmnPowerSystemState
      OsTaskEventRef = Rte_Ev_Run_Ea_Ea_MainFunction
      OsTaskEventRef = Rte_Ev_Run_NvBlockSwComponentType_NvBlockSwComponentTypeRunnable
      OsTaskEventRef = Rte_Ev_Run_UclProxyCdd_CUclProxyCdd_Impl_MainFunction
      OsTaskEventRef = Rte_Ev_Run_UclProxyCdd_OnDre_HealthDumpGetData
      OsTaskEventRef = Rte_Ev_Run_UclProxyCdd_OnDre_HealthDumpGetHdr
      OsTaskEventRef = Rte_Ev_Run_UclProxyCdd_OnDre_PowerSystemStateReqChange
    4 x OsAlarm, all with OsAlarmCounterRef=SystemTimer:
      Rte_Al_TE2_OsTask_MemSer_0_10ms
        OsAlarmAction
          OsAlarmSetEvent: OsAlarmSetEventRef=Rte_Ev_Cyclic2_OsTask_MemSer_0_10ms, OsAlarmSetEventTaskRef=OsTask_MemSer
      Rte_Al_TE_Ea_Ea_MainFunction
        OsAlarmAction
          OsAlarmSetEvent: OsAlarmSetEventRef=Rte_Ev_Run_Ea_Ea_MainFunction, OsAlarmSetEventTaskRef=OsTask_MemSer
      Rte_Al_TE_OsTask_MemSer_0_10ms
        OsAlarmAction
          OsAlarmSetEvent: OsAlarmSetEventRef=Rte_Ev_Cyclic_OsTask_MemSer_0_10ms, OsAlarmSetEventTaskRef=OsTask_MemSer
      Rte_Al_TE_UclProxyCdd_CUclProxyCdd_Impl_MainFunction
        OsAlarmAction
          OsAlarmSetEvent: OsAlarmSetEventRef=Rte_Ev_Run_UclProxyCdd_CUclProxyCdd_Impl_MainFunction, OsAlarmSetEventTaskRef=OsTask_MemSer
    OsTask_ModeMgt (OsTask): OsTaskActivation=1, OsTaskPriority=1, OsTaskSchedule=NON
    Rte_Al_TE_Test_Comp_IoExp_MainFunction (OsAlarm): OsAlarmCounterRef=SystemTimer
      OsAlarmAction
        OsAlarmActivateTask: OsAlarmActivateTaskRef=OsTask_ModeMgt
    OsTask_NvmSpeedup (OsTask): OsTaskActivation=1, OsTaskPriority=0, OsTaskSchedule=NON, OsTaskEventRef=Rte_Ev_Run_NvMExt_NvMExt_SpeedupRunnable
    Rte_Al_TE_NvMExt_NvMExt_SpeedupRunnable (OsAlarm): OsAlarmCounterRef=SystemTimer
      OsAlarmAction
        OsAlarmSetEvent: OsAlarmSetEventRef=Rte_Ev_Run_NvMExt_NvMExt_SpeedupRunnable, OsAlarmSetEventTaskRef=OsTask_NvmSpeedup
    OsTask_SafeFun (OsTask): OsTaskActivation=1, OsTaskPriority=8, OsTaskSchedule=NON
    Rte_Al_TE_Test_Comp_TxRxIpcMessage (OsAlarm): OsAlarmCounterRef=SystemTimer
      OsAlarmAction
        OsAlarmActivateTask: OsAlarmActivateTaskRef=OsTask_SafeFun
    OsTask_TripFun (OsTask): OsTaskActivation=1, OsTaskPriority=14, OsTaskSchedule=NON
    Rte_Al_TE_Test_Comp_TripTaskStubRunnable (OsAlarm): OsAlarmCounterRef=SystemTimer
      OsAlarmAction
        OsAlarmActivateTask: OsAlarmActivateTaskRef=OsTask_TripFun
    OsTask_WarnFun (OsTask): OsTaskActivation=1, OsTaskPriority=13, OsTaskSchedule=NON
    Rte_Al_TE_Test_Comp_WarnTaskStubRunnable (OsAlarm): OsAlarmCounterRef=SystemTimer
      OsAlarmAction
        OsAlarmActivateTask: OsAlarmActivateTaskRef=OsTask_WarnFun
    OsTask_WdgMngt (OsTask): OsTaskActivation=1, OsTaskPriority=3, OsTaskSchedule=NON
    Rte_Al_TE_Test_Comp_WdgMgntTaskStubRunnable (OsAlarm): OsAlarmCounterRef=SystemTimer
      OsAlarmAction
        OsAlarmActivateTask: OsAlarmActivateTaskRef=OsTask_WdgMngt
    21 x OsEvent:
      Rte_Ev_Cyclic2_OsTask_Diagnostics_0_10ms
      Rte_Ev_Cyclic2_OsTask_MemSer_0_10ms
      Rte_Ev_Cyclic_OsTask_CddFun_0_10ms
      Rte_Ev_Cyclic_OsTask_CddFun_0_5ms
      Rte_Ev_Cyclic_OsTask_Diagnostics_0_100ms
      Rte_Ev_Cyclic_OsTask_MemSer_0_10ms
      Rte_Ev_Run_DmnMgr_DmnMgr_MonitorDmnExtendShutdownTime
      Rte_Ev_Run_DmnMgr_DmnMgr_MonitorDmnHealthDumpData
      Rte_Ev_Run_DmnMgr_DmnMgr_MonitorDmnHealthDumpHdrInfo
      Rte_Ev_Run_DmnMgr_DmnMgr_MonitorDmnHealthFatalError
      Rte_Ev_Run_DmnMgr_DmnMgr_MonitorDmnHeartBeat
      Rte_Ev_Run_DmnMgr_DmnMgr_MonitorDmnKeepSystemAwake
      Rte_Ev_Run_DmnMgr_DmnMgr_MonitorDmnPowerSystemState
      Rte_Ev_Run_Ea_Ea_MainFunction
      Rte_Ev_Run_NvBlockSwComponentType_NvBlockSwComponentTypeRunnable
      Rte_Ev_Run_NvMExt_NvMExt_SpeedupRunnable
      Rte_Ev_Run_Test_Comp_GraphicsTaskStubRunnable
      Rte_Ev_Run_UclProxyCdd_CUclProxyCdd_Impl_MainFunction
      Rte_Ev_Run_UclProxyCdd_OnDre_HealthDumpGetData
      Rte_Ev_Run_UclProxyCdd_OnDre_HealthDumpGetHdr
      Rte_Ev_Run_UclProxyCdd_OnDre_PowerSystemStateReqChange
    SystemApplication_OsCore0 (OsApplication):
      OsTrusted = true
      OsAppTaskRef = OsTask_AppFun
      OsAppAlarmRef = Os/Rte_Al_TE_Test_Comp_AppTaskStubRunnable
      OsAppTaskRef = OsTask_AudioFun
      OsAppAlarmRef = Os/Rte_Al_TE_Test_Comp_AudioTaskStubRunnable
      OsAppTaskRef = OsTask_CANFun
      OsAppAlarmRef = Os/Rte_Al_TE_OsTask_CANFun_0_10ms
      OsAppTaskRef = OsTask_CddFun
      OsAppAlarmRef = Os/Rte_Al_TE_OsTask_CddFun_0_10ms
      OsAppAlarmRef = Os/Rte_Al_TE_OsTask_CddFun_0_5ms
      OsAppTaskRef = OsTask_Diagnostics
      OsAppAlarmRef = Os/Rte_Al_TE2_OsTask_Diagnostics_0_10ms
      OsAppAlarmRef = Os/Rte_Al_TE_OsTask_Diagnostics_0_100ms
      OsAppTaskRef = OsTask_EthFun
      OsAppAlarmRef = Os/Rte_Al_TE_OsTask_EthFun_0_10ms
      OsAppTaskRef = OsTask_FotaFun
      OsAppAlarmRef = Os/Rte_Al_TE_Test_Comp_FotaTaskStubRunnable
      OsAppTaskRef = OsTask_GaugeFun
      OsAppAlarmRef = Os/Rte_Al_TE_Test_Comp_GaugeTaskStubRunnable
      OsAppTaskRef = OsTask_Graphics
      OsAppAlarmRef = Os/Rte_Al_TE_Test_Comp_GraphicsTaskStubRunnable
      OsAppTaskRef = OsTask_IndFun
      OsAppAlarmRef = Os/Rte_Al_TE_Test_Comp_IndTaskStubRunnable
      OsAppTaskRef = OsTask_LinFun
      OsAppAlarmRef = Os/Rte_Al_TE_Test_Comp_LinTaskStubRunnable
      OsAppTaskRef = OsTask_Mcal
      OsAppAlarmRef = Os/Rte_Al_TE_OsTask_Mcal_0_10ms
      OsAppTaskRef = OsTask_MemSer
      OsAppAlarmRef = Os/Rte_Al_TE2_OsTask_MemSer_0_10ms
      OsAppAlarmRef = Os/Rte_Al_TE_Ea_Ea_MainFunction
      OsAppAlarmRef = Os/Rte_Al_TE_OsTask_MemSer_0_10ms
      OsAppAlarmRef = Os/Rte_Al_TE_UclProxyCdd_CUclProxyCdd_Impl_MainFunction
      OsAppTaskRef = OsTask_ModeMgt
      OsAppAlarmRef = Os/Rte_Al_TE_Test_Comp_IoExp_MainFunction
      OsAppTaskRef = OsTask_NvmSpeedup
      OsAppAlarmRef = Os/Rte_Al_TE_NvMExt_NvMExt_SpeedupRunnable
      OsAppTaskRef = OsTask_SafeFun
      OsAppAlarmRef = Os/Rte_Al_TE_Test_Comp_TxRxIpcMessage
      OsAppTaskRef = OsTask_TripFun
      OsAppAlarmRef = Os/Rte_Al_TE_Test_Comp_TripTaskStubRunnable
      OsAppTaskRef = OsTask_WarnFun
      OsAppAlarmRef = Os/Rte_Al_TE_Test_Comp_WarnTaskStubRunnable
      OsAppTaskRef = OsTask_WdgMngt
      OsAppAlarmRef = Os/Rte_Al_TE_Test_Comp_WdgMgntTaskStubRunnable
  module config EcuC
  ecuc value collection DaVinci_Project: ecuc-values=[Com, Rte, Os, EcuC, NvM]
