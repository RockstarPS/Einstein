AUTOSAR XML (schema 4-2-1)
package /VehicleProject
  ecu instance METER
