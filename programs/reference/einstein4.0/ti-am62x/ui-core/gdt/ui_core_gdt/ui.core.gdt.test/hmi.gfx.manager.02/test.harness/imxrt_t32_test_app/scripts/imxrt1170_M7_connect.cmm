RESet
SYStem.RESet
SYStem.CPU IMXRT1176-CM7
SYStem.CONFIG.DEBUGPORTTYPE SWD
SYStem.CONFIG.CONNECTOR MIPI20T
SYStem.MemAccess DAP
SYStem.JtagClock 10MHz
SYStem.Option VECTRESET OFF
SYStem.attach
break

B::list

