// T32 Fri Sep  3 03:36:40 2021

B::

Break.RESet
Break.CONFIG.METHOD  Program   ONCHIP
Break.CONFIG.VarConvert OFF
Break.CONFIG.InexactData ON
Break.CONFIG.InexactTrigger OFF
Break.CONFIG.InexactResume ON
Break.CONFIG.InexactAddress ON
Break.Set     osStartOS /Program
Break.Set     OsTask_IdleTaskfunc /Program /Onchip
Break.Set     OsTask_BswCtrl_EventPeriodicfunc\10 /Program
Break.Set     OsTask_Bsw_EventPeriodic_0func\11 /Program
Break.Set     OsTask_Bsw_EventPeriodic_0func\50 /Program
Break.Set     OsTask_Bsw_EventPeriodic_1func\11 /Program
Break.Set     OsTask_NvmSpeedupfunc\8 /Program
Break.Set     OsTask_SWCEventPeriodic_0func\8 /Program

ENDDO
