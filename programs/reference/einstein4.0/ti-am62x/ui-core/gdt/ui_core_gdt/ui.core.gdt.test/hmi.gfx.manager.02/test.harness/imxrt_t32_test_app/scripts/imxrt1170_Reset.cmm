sys.up

;&stack =  data.long(d:0x30002000)
;&pc =     data.long(d:0x300024E0)

&stack =  data.long(d:0x20241DB0)
&pc =     Reset_Handler

Register.Set MSP &stack
Register.Set PC &pc