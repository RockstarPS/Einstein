/**
 * @cliArgs --device "AM62Px" --part "Default" --package "AMH" --context "wkup-r5fss0-0" --product "MCU-PLUS-SDK-AM62P@11.02.00"
 * @versions {"tool":"1.24.2+4234"}
 */

/**
 * Import the modules used in this configuration.
 */
const flash        = scripting.addModule("/board/flash/flash", {}, false);
const flash1       = flash.addInstance();
const bootloader   = scripting.addModule("/drivers/bootloader/bootloader", {}, false);
const bootloader1  = bootloader.addInstance();
const bootloader2  = bootloader.addInstance();
const bootloader3  = bootloader.addInstance();
const bootloader4  = bootloader.addInstance();
const bootloader5  = bootloader.addInstance();
const bootloader6  = bootloader.addInstance();
const bootloader7  = bootloader.addInstance();
const bootloader8  = bootloader.addInstance();
const bootloader9  = bootloader.addInstance();
const bootloader10 = bootloader.addInstance();
const bootloader11 = bootloader.addInstance();
const bootloader12 = bootloader.addInstance();
const gtc          = scripting.addModule("/drivers/gtc/gtc");
const ipc          = scripting.addModule("/drivers/ipc/ipc");
const mmcsd        = scripting.addModule("/drivers/mmcsd/mmcsd", {}, false);
const mmcsd1       = mmcsd.addInstance();
const uart         = scripting.addModule("/drivers/uart/uart", {}, false);
const uart1        = uart.addInstance();
const clock        = scripting.addModule("/kernel/dpl/clock");
const debug_log    = scripting.addModule("/kernel/dpl/debug_log");
const mpu_armv7    = scripting.addModule("/kernel/dpl/mpu_armv7", {}, false);
const mpu_armv71   = mpu_armv7.addInstance();
const mpu_armv72   = mpu_armv7.addInstance();
const mpu_armv73   = mpu_armv7.addInstance();
const mpu_armv74   = mpu_armv7.addInstance();
const mpu_armv75   = mpu_armv7.addInstance();
const mpu_armv76   = mpu_armv7.addInstance();
const mpu_armv77   = mpu_armv7.addInstance();
const mpu_armv78   = mpu_armv7.addInstance();
const mpu_armv79   = mpu_armv7.addInstance();
const mpu_armv710  = mpu_armv7.addInstance();

/**
 * Write custom configuration values to the imported modules.
 */
bootloader1.appImageOffset = "0x480000";
bootloader1.$name          = "CONFIG_BOOTLOADER_HSM_A";

bootloader2.$name          = "CONFIG_BOOTLOADER_HSM_B";
bootloader2.appImageOffset = "0x4A0000";

bootloader3.$name          = "CONFIG_BOOTLOADER_HSM_RECOVERY_A";
bootloader3.appImageOffset = "0x4C0000";

bootloader4.$name          = "CONFIG_BOOTLOADER_HSM_RECOVERY_B";
bootloader4.appImageOffset = "0x4E0000";

bootloader5.bootMedia          = "EMMC";
bootloader5.EMMCAppImageOffset = "0x0";
bootloader5.$name              = "CONFIG_BOOTLOADER_PRIMARY_LINUX_A";

bootloader6.bootMedia          = "EMMC";
bootloader6.EMMCAppImageOffset = "0x0";
bootloader6.$name              = "CONFIG_BOOTLOADER_PRIMARY_LINUX_B";
bootloader6.bootPartIndex      = "2";

bootloader7.bootMedia          = "EMMC";
bootloader7.$name              = "CONFIG_BOOTLOADER_RECOVERY_LINUX_A";
bootloader7.bootPartIndex      = "0";
bootloader7.EMMCAppImageOffset = "0x100000";

bootloader8.bootMedia          = "EMMC";
bootloader8.$name              = "CONFIG_BOOTLOADER_RECOVERY_LINUX_B";
bootloader8.bootPartIndex      = "0";
bootloader8.EMMCAppImageOffset = "0x2100000";

bootloader9.$name          = "CONFIG_BOOTLOADER_MCU_A";
bootloader9.appImageOffset = "0x580000";

bootloader10.$name          = "CONFIG_BOOTLOADER_MCU_B";
bootloader10.appImageOffset = "0x980000";

bootloader11.$name          = "CONFIG_BOOTLOADER_MCU_RECOVERY_A";
bootloader11.appImageOffset = "0x500000";

bootloader12.$name          = "CONFIG_BOOTLOADER_MCU_RECOVERY_B";
bootloader12.appImageOffset = "0x540000";

bootloader1.flashDriver                         = flash1;
flash1.$name                                    = "CONFIG_FLASH_SBL";
bootloader2.flashDriver                         = flash1;
bootloader3.flashDriver                         = flash1;
bootloader4.flashDriver                         = flash1;
bootloader9.flashDriver                         = flash1;
bootloader10.flashDriver                        = flash1;
bootloader11.flashDriver                        = flash1;
bootloader12.flashDriver                        = flash1;
flash1.serialFlashDriver.$name                  = "board_flash_serialFlash_serialflash0";
flash1.serialFlashDriver.device                 = "CUSTOM_FLASH";
flash1.serialFlashDriver.fname                  = "mx25uv125";
flash1.serialFlashDriver.protocol               = "1s_1s_1s";
flash1.serialFlashDriver.flashSize              = 16777216;
flash1.serialFlashDriver.flashManfId            = "0xC2";
flash1.serialFlashDriver.flashDeviceId          = "0x8138";
flash1.serialFlashDriver.flashBlockSize         = 65536;
flash1.serialFlashDriver.cmdBlockErase3B        = "0xD8";
flash1.serialFlashDriver.cmdSectorErase3B       = "0x20";
flash1.serialFlashDriver.strDtr_cfgReg          = "0x0";
flash1.serialFlashDriver.strDtr_cmdRegRd        = "0x0";
flash1.serialFlashDriver.strDtr_cmdRegWr        = "0x0";
flash1.serialFlashDriver.strDtr_shift           = 0;
flash1.serialFlashDriver.strDtr_mask            = "0";
flash1.serialFlashDriver.strDtr_bitP            = 0;
flash1.serialFlashDriver.enable4BAddr           = false;
flash1.serialFlashDriver.quirks                 = "";
flash1.serialFlashDriver.bootQuirks             = "";
flash1.serialFlashDriver.peripheralDriver.$name = "CONFIG_OSPI_SBL";

ipc.enableLinuxIpc = false;

mmcsd1.$name             = "CONFIG_MMCSD0";
mmcsd1.addedByBootloader = true;
bootloader5.MMCSDDriver  = mmcsd1;
bootloader6.MMCSDDriver  = mmcsd1;
bootloader7.MMCSDDriver  = mmcsd1;
bootloader8.MMCSDDriver  = mmcsd1;

uart1.$name                      = "CONFIG_UART_SBL";
uart1.useWakeupDomainPeripherals = false;
uart1.addedByBootloader          = true;
uart1.intrEnable                 = "DISABLE";

const udma              = scripting.addModule("/drivers/udma/udma", {}, false);
const udma1             = udma.addInstance({}, false);
udma1.$name             = "CONFIG_UDMA0";
bootloader1.udmaDriver  = udma1;
bootloader2.udmaDriver  = udma1;
bootloader3.udmaDriver  = udma1;
bootloader4.udmaDriver  = udma1;
bootloader5.udmaDriver  = udma1;
bootloader6.udmaDriver  = udma1;
bootloader7.udmaDriver  = udma1;
bootloader8.udmaDriver  = udma1;
bootloader9.udmaDriver  = udma1;
bootloader10.udmaDriver = udma1;
bootloader11.udmaDriver = udma1;
bootloader12.udmaDriver = udma1;

const udma_blkcopy_channel      = scripting.addModule("/drivers/udma/udma_blkcopy_channel", {}, false);
const udma_blkcopy_channel1     = udma_blkcopy_channel.addInstance({}, false);
udma_blkcopy_channel1.$name     = "CONFIG_UDMA_BLKCOPY_CH0";
bootloader1.udmaBlkCopyChannel  = udma_blkcopy_channel1;
bootloader2.udmaBlkCopyChannel  = udma_blkcopy_channel1;
bootloader3.udmaBlkCopyChannel  = udma_blkcopy_channel1;
bootloader4.udmaBlkCopyChannel  = udma_blkcopy_channel1;
bootloader5.udmaBlkCopyChannel  = udma_blkcopy_channel1;
bootloader6.udmaBlkCopyChannel  = udma_blkcopy_channel1;
bootloader7.udmaBlkCopyChannel  = udma_blkcopy_channel1;
bootloader8.udmaBlkCopyChannel  = udma_blkcopy_channel1;
bootloader9.udmaBlkCopyChannel  = udma_blkcopy_channel1;
bootloader10.udmaBlkCopyChannel = udma_blkcopy_channel1;
bootloader11.udmaBlkCopyChannel = udma_blkcopy_channel1;
bootloader12.udmaBlkCopyChannel = udma_blkcopy_channel1;

debug_log.enableCssLog       = false;
debug_log.enableUartLog      = true;
debug_log.uartTrace          = true;
debug_log.uartLog.intrEnable = "DISABLE";
debug_log.uartLog.$name      = "CONFIG_UART_APP";

mpu_armv71.$name             = "REGISTER_REGION";
mpu_armv71.size              = 31;
mpu_armv71.attributes        = "Device";
mpu_armv71.allowExecute      = false;
mpu_armv71.accessPermissions = "Supervisor RD+WR, User RD";

mpu_armv72.$name             = "TCMA_VEC";
mpu_armv72.size              = 7;
mpu_armv72.accessPermissions = "Supervisor RD+WR, User RD";

mpu_armv73.$name    = "DDR";
mpu_armv73.baseAddr = 0x80000000;
mpu_armv73.size     = 31;

mpu_armv74.$name      = "TCMB";
mpu_armv74.baseAddr   = 0x41010000;
mpu_armv74.size       = 15;
mpu_armv74.attributes = "NonCached";

mpu_armv75.$name      = "TCMA";
mpu_armv75.size       = 15;
mpu_armv75.attributes = "NonCached";

mpu_armv76.$name    = "HSM_RAM";
mpu_armv76.baseAddr = 0x43C00000;
mpu_armv76.size     = 18;

mpu_armv77.$name        = "FSS0_OSPI0_CTRL_REG";
mpu_armv77.baseAddr     = 0xFC40000;
mpu_armv77.size         = 8;
mpu_armv77.attributes   = "Device";
mpu_armv77.allowExecute = false;

mpu_armv78.$name        = "UART0_REG";
mpu_armv78.baseAddr     = 0x2800000;
mpu_armv78.size         = 9;
mpu_armv78.attributes   = "Device";
mpu_armv78.allowExecute = false;

mpu_armv79.$name        = "FSS0_DAT_REG1";
mpu_armv79.baseAddr     = 0x60000000;
mpu_armv79.size         = 27;
mpu_armv79.attributes   = "Device";
mpu_armv79.allowExecute = false;

mpu_armv710.$name        = "IPC_REGION";
mpu_armv710.baseAddr     = 0x82B00000;
mpu_armv710.size         = 20;
mpu_armv710.attributes   = "Device";
mpu_armv710.allowExecute = false;

/**
 * Pinmux solution for unlocked pins/peripherals. This ensures that minor changes to the automatic solver in a future
 * version of the tool will not impact the pinmux you originally saw.  These lines can be completely deleted in order to
 * re-solve from scratch.
 */
flash1.serialFlashDriver.peripheralDriver.OSPI.$suggestSolution      = "OSPI0";
flash1.serialFlashDriver.peripheralDriver.OSPI.CLK.$suggestSolution  = "OSPI0_CLK";
flash1.serialFlashDriver.peripheralDriver.OSPI.CSn0.$suggestSolution = "OSPI0_CSn0";
flash1.serialFlashDriver.peripheralDriver.OSPI.DQS.$suggestSolution  = "OSPI0_DQS";
flash1.serialFlashDriver.peripheralDriver.OSPI.D7.$suggestSolution   = "OSPI0_D7";
flash1.serialFlashDriver.peripheralDriver.OSPI.D6.$suggestSolution   = "OSPI0_D6";
flash1.serialFlashDriver.peripheralDriver.OSPI.D5.$suggestSolution   = "OSPI0_D5";
flash1.serialFlashDriver.peripheralDriver.OSPI.D4.$suggestSolution   = "OSPI0_D4";
flash1.serialFlashDriver.peripheralDriver.OSPI.D3.$suggestSolution   = "OSPI0_D3";
flash1.serialFlashDriver.peripheralDriver.OSPI.D2.$suggestSolution   = "OSPI0_D2";
flash1.serialFlashDriver.peripheralDriver.OSPI.D1.$suggestSolution   = "OSPI0_D1";
flash1.serialFlashDriver.peripheralDriver.OSPI.D0.$suggestSolution   = "OSPI0_D0";
mmcsd1.MMC0.$suggestSolution                                         = "MMC0";
uart1.UART.$suggestSolution                                          = "USART0";
uart1.UART.RXD.$suggestSolution                                      = "UART0_RXD";
uart1.UART.TXD.$suggestSolution                                      = "UART0_TXD";
debug_log.uartLog.WKUP_UART.$suggestSolution                         = "WKUP_USART0";
debug_log.uartLog.WKUP_UART.RXD.$suggestSolution                     = "WKUP_UART0_RXD";
debug_log.uartLog.WKUP_UART.TXD.$suggestSolution                     = "WKUP_UART0_TXD";
